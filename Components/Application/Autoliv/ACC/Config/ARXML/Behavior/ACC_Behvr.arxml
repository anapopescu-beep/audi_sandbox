AUTOSAR XML (schema 4-2-2)
package /AUTOLIV/SoftwareComponents/ACC
  complex device driver sw component type ACC: category=MCAL_Communication_Abstraction
    behavior ACC_IB: data-type-mapping=[DataTypeMappingSet_ACC, DataTypeMappingSet_DioIf, DataTypeMappingSet_FSM, DataTypeMappingSet_eCS], handle-termination-and-restart=NO-SUPPORT
      timing event ev_ACC_ReadAccelerometerTemperature1: start-on-event=ACC_ReadAccelerometerTemperature, period=0.04
      timing event ev_GetAccelDataPeriod: start-on-event=ACC_runMainFunction, period=0.001
      operation invoked event oie_pseAccRestartInit_RestartInitialization: start-on-event=ACC_RestartInitialization, operation=pseAccRestartInit.RestartInitialization
      operation invoked event oie_pseAccTemperatureSpiData_GetTemperatureData: start-on-event=ACC_GetAccelerometerTemperature, operation=pseAccTemperatureSpiData.GetTemperatureData
      operation invoked event oie_pseCheckAccAlarmbPin_AutotestCallback: start-on-event=ACC_Autotest_CheckAlarmbPin, operation=pseCheckAccAlarmbPin.AutotestCallback
      4 x external trigger occurred event:
        trSpiIf_spiReadIBFromChannel: start-on-event=ACC_runMainFunction, trigger=ptrrSpiIfServices.SpiIf_spiReadIBFromChannel
        trSpiIf_spiSyncTransmitSequence: start-on-event=ACC_runMainFunction, trigger=ptrrSpiIfServices.SpiIf_spiSyncTransmitSequence
        trSpiIf_writeSpiData: start-on-event=ACC_runMainFunction, trigger=ptrrSpiIfServices.SpiIf_writeSpiData
        trSpiIf_writeSpiData_SendCommandToReadOrWriteRegister: start-on-event=ACC_ReadAccelerometerTemperature, trigger=ptrrSpiIfServices.SpiIf_writeSpiData
      5 x runnable:
        ACC_Autotest_CheckAlarmbPin: sw-addr-method=CODE_ASIL_A
          data-send-points:
            access dsp_u32AccReg1Status: accessed-variable=psrAccStatusFailiureSource.u32AccAlarmRegStatus
            access dsp_u32AccReg2Status: accessed-variable=psrAccStatusFailiureSource.u8AccReturnStatus
            access dsp_u32AccReg3Status: accessed-variable=psrAccStatusFailiureSource.u8AccCRCStatus
          sync call scp_ReadChannel: operation=pclDioIfServices.ReadChannel, timeout=0.0
        ACC_GetAccelerometerTemperature: can-be-invoked-concurrently=true
        ACC_ReadAccelerometerTemperature: can-be-invoked-concurrently=true, external-triggering-point=ptrpAsrOsServicesACC.OsTask_Alv_Wdg_Refresh
        ACC_RestartInitialization: sw-addr-method=CODE_ASIL_A
        ACC_runMainFunction: sw-addr-method=CODE_ASIL_A, can-be-invoked-concurrently=true, external-triggering-point=ptrpAsrOsServicesACC.ACC_GetAccelerometerData
          data-receive-point-by-arguments:
            access drparg_au8SelectedProfile: accessed-variable=prrSolenoidProfile.au8SelectedProfile
          data-send-points:
            5 x access:
              dsp_st3DAccel: accessed-variable=psr3DAcceleration.st3DAccel
              dsp_stAccelMtrPerSecSqd: accessed-variable=psrAccelMtrPerSecSqd.stAccelMtrPerSecSqd
              dsp_u8AccAlarmbPreinitSeqSta: accessed-variable=psrAccStatusFailiureSource.u8AccAlarmbPreinitSeqStatus
              dsp_u8AccInitStateMachine: accessed-variable=psrACCServices.u8AccInitStateMachine
              dsp_u8AccelAxisBroken: accessed-variable=psrAccStatusFailiureSource.u8AccelAxisBroken
  swc implementation ACC_imp: category=MCAL_Communication_Abstraction, programming-language=C, sw-version=1.0.0, vendor-id=0, behavior=ACC_IB
    code-descriptors:
      code ACC_Impl_Code: artifact-descriptors=autosar-engineering-object={short-label=ACC_Impl_Code_CodeDesc, category=SWSRC}
    resource consumption ACC_Impl_ResCons
      33 x memory section:
        CODE: size=0, sw-addrmethod=CODE
        CODE_ASIL_A: size=0, sw-addrmethod=CODE_ASIL_A
        CONST_16: alignment=16, size=16, sw-addrmethod=CONST
        CONST_16_ASIL_A: alignment=16, size=16, sw-addrmethod=CONST_ASIL_A
        CONST_32: alignment=32, size=32, sw-addrmethod=CONST
        CONST_32_ASIL_A: alignment=32, size=32, sw-addrmethod=CONST_ASIL_A
        CONST_8: alignment=8, size=8, sw-addrmethod=CONST
        CONST_8_ASIL_A: alignment=8, size=8, sw-addrmethod=CONST_ASIL_A
        CONST_BOOL: alignment=8, size=1, sw-addrmethod=CONST
        CONST_BOOL_ASIL_A: alignment=8, size=1, sw-addrmethod=CONST_ASIL_A
        CONST_UNSPECIFIED: alignment=UNSPECIFIED, size=0, sw-addrmethod=CONST
        CONST_UNSPECIFIED_ASIL_A: alignment=UNSPECIFIED, size=0, sw-addrmethod=CONST_ASIL_A
        VAR_INIT_16: alignment=16, size=16, sw-addrmethod=VAR_INIT
        VAR_INIT_16_ASIL_A: alignment=16, size=16, sw-addrmethod=VAR_INIT_ASIL_A
        VAR_INIT_32: alignment=32, size=32, sw-addrmethod=VAR_INIT
        VAR_INIT_32_ASIL_A: alignment=32, size=32, sw-addrmethod=VAR_INIT_ASIL_A
        VAR_INIT_8: alignment=8, size=8, sw-addrmethod=VAR_INIT
        VAR_INIT_8_ASIL_A: alignment=8, size=8, sw-addrmethod=VAR_INIT_ASIL_A
        VAR_INIT_BOOL: alignment=8, size=1, sw-addrmethod=VAR_INIT
        VAR_INIT_BOOL_ASIL_A: alignment=8, size=1, sw-addrmethod=VAR_INIT_ASIL_A
        VAR_INIT_UNSPECIFIED: alignment=UNSPECIFIED, size=0, sw-addrmethod=VAR_INIT
        VAR_INIT_UNSPECIFIED_ASIL_A: alignment=UNSPECIFIED, size=0, sw-addrmethod=VAR_INIT_ASIL_A
        VAR_NO_INIT_16: alignment=16, size=16, sw-addrmethod=VAR_NOINIT
        VAR_NO_INIT_16_ASIL_A: alignment=16, size=16, sw-addrmethod=VAR_NOINIT_ASIL_A
        VAR_NO_INIT_32: alignment=32, size=32, sw-addrmethod=VAR_NOINIT
        VAR_NO_INIT_32_ASIL_A: alignment=32, size=32, sw-addrmethod=VAR_NOINIT_ASIL_A
        VAR_NO_INIT_8: alignment=8, size=8, sw-addrmethod=VAR_NOINIT
        VAR_NO_INIT_8_ASIL_A: alignment=8, size=8, sw-addrmethod=VAR_NOINIT_ASIL_A
        VAR_NO_INIT_BOOL: alignment=8, size=1, sw-addrmethod=VAR_NOINIT
        VAR_NO_INIT_BOOL_ASIL_A: alignment=8, size=1, sw-addrmethod=VAR_NOINIT_ASIL_A
        VAR_NO_INIT_UNSPECIFIED: alignment=UNSPECIFIED, size=0, sw-addrmethod=VAR_NOINIT
        VAR_NO_INIT_UNSPECIFIED_ASIL_A: alignment=UNSPECIFIED, size=0, sw-addrmethod=VAR_NOINIT_ASIL_A
        VAR_POWER_ON_CLEARED: alignment=UNSPECIFIED, size=0, sw-addrmethod=VAR_POWER_ON_CLEARED
