AUTOSAR XML (schema 4-2-2)
package /AUTOLIV/SoftwareComponents/ATM
  application sw component type ATM: category=SWC
    behavior ATM_IB_AutoTestManager: data-type-mapping=[DataTypeMappingSet_ATM, DataTypeMappingSet_FSM], handle-termination-and-restart=NO-SUPPORT
      timing event ATM_evMainFunction: start-on-event=ATM_runMainFunction, period=0.001
      operation invoked event oie_pseAutotestServices_GetCriticalAutoTestsReachedFlag: start-on-event=ATM_runGetCriticalAutoTestsReachedFlag, operation=pseAutotestServices.GetCriticalAutoTestsReachedFlag
      operation invoked event oie_pseAutotestServices_GetTestResult: start-on-event=ATM_runGetTestResult, operation=pseAutotestServices.GetTestResult
      4 x runnable, all with sw-addr-method=CODE_ASIL_A:
        ATM_Init: external-triggering-point=ptrpAtmServicesBswMIf.ATM_Init
        ATM_runGetCriticalAutoTestsReachedFlag
        ATM_runGetTestResult: can-be-invoked-concurrently=true
        ATM_runMainFunction: external-triggering-point=ptrpAtmServicesAsrOs.ATM_runMainFunction
          44 x sync call, all with timeout=0.0:
            scp_AutotestCallback: operation=pclCheckAdc.AutotestCallback
            scp_AutotestCallback1: operation=pclRunResetCause.AutotestCallback
            scp_AutotestCallback10: operation=pclCheckShortToVBAT.AutotestCallback
            scp_AutotestCallback11: operation=pclCheckAccAlarmbPin.AutotestCallback
            scp_AutotestCallback12: operation=pclCheckSbcStatusInfo.AutotestCallback
            scp_AutotestCallback13: operation=pclEcuOverTemperature.AutotestCallback
            scp_AutotestCallback14: operation=pclCheckPowerStage.AutotestCallback
            scp_AutotestCallback15: operation=pclCheckSolenoidOvervoltage.AutotestCallback
            scp_AutotestCallback16: operation=pclCheckMcuSelfTest.AutotestCallback
            scp_AutotestCallback17: operation=pclCheckCrcOnMcuRegisters.AutotestCallback
            scp_AutotestCallback19: operation=pclRunPFlashMemoryCorruption.AutotestCallback
            scp_AutotestCallback2: operation=pclRunEepromMemoryCorruption.AutotestCallback
            scp_AutotestCallback20: operation=pclRunRamMemoryCorruption.AutotestCallback
            scp_AutotestCallback3: operation=pclRunEepromMemoryNotProgrammed.AutotestCallback
            scp_AutotestCallback34: operation=pclCheckAdcCalib.AutotestCallback
            scp_AutotestCallback4: operation=pclRunExtWDTest.AutotestCallback
            scp_AutotestCallback5: operation=pclCheckPowerSupplyUV.AutotestCallback
            scp_AutotestCallback6: operation=pclCheckPowerSupplyOV.AutotestCallback
            scp_AutotestCallback7: operation=pclCheckActuatorState.AutotestCallback
            scp_AutotestCallback8: operation=pclCheckShortToGND.AutotestCallback
            scp_AutotestCallback9: operation=pclCheckOpenCircuit.AutotestCallback
            scp_CheckModeStatus: operation=pclModeManagement.CheckModeStatus
            scp_ClearPrestoredFreezeFrame: operation=pclEvtActuatorState.SetEventStatus
            scp_EIM_ManageAecStatus: operation=pclInjectError.EIM_ManageAecStatus
            scp_SetEventStatus: operation=pclEvtAdcOutOfOrder.SetEventStatus
            scp_SetEventStatus1: operation=pclEvtPowerSupllyOV.SetEventStatus
            scp_SetEventStatus10: operation=pclEvtSolenoidOvervoltage.SetEventStatus
            scp_SetEventStatus11: operation=pclEvtMcuCrcRegisters.SetEventStatus
            scp_SetEventStatus12: operation=pclEvtEcuoverTemperature.SetEventStatus
            scp_SetEventStatus2: operation=pclEvtPowerSupllyUV.SetEventStatus
            scp_SetEventStatus22: operation=pclEvtNvmNotPrg.SetEventStatus
            scp_SetEventStatus23: operation=pclEvtExtWdgOutOfOrder.SetEventStatus
            scp_SetEventStatus24: operation=pclEvtWarmReset.SetEventStatus
            scp_SetEventStatus28: operation=pclEvtAdcCalibration.SetEventStatus
            scp_SetEventStatus3: operation=pclEvtMcuSelftest.SetEventStatus
            scp_SetEventStatus31: operation=pclEvtRamEcc.SetEventStatus
            scp_SetEventStatus32: operation=pclEvtNvmEcc.SetEventStatus
            scp_SetEventStatus33: operation=pclEvtFlsEcc.SetEventStatus
            scp_SetEventStatus4: operation=pclEvtActuatorShortToVBAT.SetEventStatus
            scp_SetEventStatus5: operation=pclEvtActuatorShortToGND.SetEventStatus
            scp_SetEventStatus6: operation=pclEvtActuatorOpenCircuit.SetEventStatus
            scp_SetEventStatus7: operation=pclEvtSbcStatusFailiure.SetEventStatus
            scp_SetEventStatus8: operation=pclEvtAccStatusFailure.SetEventStatus
            scp_SetEventStatus9: operation=pclEvtPowerStageFailiure.SetEventStatus
  swc implementation ATM_imp: category=SWC, programming-language=C, sw-version=1.0.0, vendor-id=0, behavior=ATM_IB_AutoTestManager
    code-descriptors:
      code ATM_Impl_Code: artifact-descriptors=autosar-engineering-object={short-label=ATM_Impl_Code_CodeDesc, category=SWSRC}
    resource consumption ATM_Impl_ResCons
      33 x memory section:
        CODE: size=0, sw-addrmethod=CODE
        CODE_ASIL_A: size=0, sw-addrmethod=CODE_ASIL_A
        CONST_16: alignment=16, size=16, sw-addrmethod=CONST
        CONST_16_ASIL_A: alignment=16, size=16, sw-addrmethod=CONST_ASIL_A
        CONST_32: alignment=32, size=32, sw-addrmethod=CONST
        CONST_32_ASIL_A: alignment=32, size=32, sw-addrmethod=CONST_ASIL_A
        CONST_8: alignment=8, size=8, sw-addrmethod=CONST
        CONST_8_ASIL_A: alignment=8, size=8, sw-addrmethod=CONST_ASIL_A
        CONST_BOOL: alignment=8, size=1, sw-addrmethod=CONST
        CONST_BOOL_ASIL_A: alignment=8, size=1, sw-addrmethod=CONST_ASIL_A
        CONST_UNSPECIFIED: alignment=UNSPECIFIED, size=0, sw-addrmethod=CONST
        CONST_UNSPECIFIED_ASIL_A: alignment=UNSPECIFIED, size=0, sw-addrmethod=CONST_ASIL_A
        VAR_INIT_16: alignment=16, size=16, sw-addrmethod=VAR_INIT
        VAR_INIT_16_ASIL_A: alignment=16, size=16, sw-addrmethod=VAR_INIT_ASIL_A
        VAR_INIT_32: alignment=32, size=32, sw-addrmethod=VAR_INIT
        VAR_INIT_32_ASIL_A: alignment=32, size=32, sw-addrmethod=VAR_INIT_ASIL_A
        VAR_INIT_8: alignment=8, size=8, sw-addrmethod=VAR_INIT
        VAR_INIT_8_ASIL_A: alignment=8, size=8, sw-addrmethod=VAR_INIT_ASIL_A
        VAR_INIT_BOOL: alignment=8, size=1, sw-addrmethod=VAR_INIT
        VAR_INIT_BOOL_ASIL_A: alignment=8, size=1, sw-addrmethod=VAR_INIT_ASIL_A
        VAR_INIT_UNSPECIFIED: alignment=UNSPECIFIED, size=0, sw-addrmethod=VAR_INIT
        VAR_INIT_UNSPECIFIED_ASIL_A: alignment=UNSPECIFIED, size=0, sw-addrmethod=VAR_INIT_ASIL_A
        VAR_NO_INIT_16: alignment=16, size=16, sw-addrmethod=VAR_NOINIT
        VAR_NO_INIT_16_ASIL_A: alignment=16, size=16, sw-addrmethod=VAR_NOINIT_ASIL_A
        VAR_NO_INIT_32: alignment=32, size=32, sw-addrmethod=VAR_NOINIT
        VAR_NO_INIT_32_ASIL_A: alignment=32, size=32, sw-addrmethod=VAR_NOINIT_ASIL_A
        VAR_NO_INIT_8: alignment=8, size=8, sw-addrmethod=VAR_NOINIT
        VAR_NO_INIT_8_ASIL_A: alignment=8, size=8, sw-addrmethod=VAR_NOINIT_ASIL_A
        VAR_NO_INIT_BOOL: alignment=8, size=1, sw-addrmethod=VAR_NOINIT
        VAR_NO_INIT_BOOL_ASIL_A: alignment=8, size=1, sw-addrmethod=VAR_NOINIT_ASIL_A
        VAR_NO_INIT_UNSPECIFIED: alignment=UNSPECIFIED, size=0, sw-addrmethod=VAR_NOINIT
        VAR_NO_INIT_UNSPECIFIED_ASIL_A: alignment=UNSPECIFIED, size=0, sw-addrmethod=VAR_NOINIT_ASIL_A
        VAR_POWER_ON_CLEARED: alignment=UNSPECIFIED, size=0, sw-addrmethod=VAR_POWER_ON_CLEARED
