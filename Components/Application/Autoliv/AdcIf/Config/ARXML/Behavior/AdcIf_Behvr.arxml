AUTOSAR XML (schema 4-2-2)
package /AUTOLIV/SoftwareComponents/AdcIf
  ecu abstraction sw component type AdcIf: category=MCAL_IO_Drivers
    behavior AdcIf_IB_0: constant-value-mapping=ConstantsMappingSet_AdcIf, data-type-mapping=[DataTypeMappingSet_AdcIf, DataTypeMappingSet_CIL], handle-termination-and-restart=NO-SUPPORT
      6 x operation invoked event:
        oie_pseAdcIfServices_StartConversion: start-on-event=AdcIf_StartConversion, operation=pseAdcIfServices.StartConversion
        oie_pseAdcIfServices_StopConversion: start-on-event=AdcIf_StopConversion, operation=pseAdcIfServices.StopConversion
        oie_pseAdcIfServices_WaitForConversion: start-on-event=AdcIf_WaitForConversion, operation=pseAdcIfServices.WaitForConversion
        oie_pseCheckAdcCalib_AutotestCallback: start-on-event=AdcIf_Autotest_CheckAdcCalib, operation=pseCheckAdcCalib.AutotestCallback
        oie_pseCheckAdc_AutotestCallback: start-on-event=AdcIf_Autotest_CheckAdc, operation=pseCheckAdc.AutotestCallback
        oie_pseRawAdcService_getChannelValue: start-on-event=AdcIf_runGetChannelValue, operation=pseRawAdcService.getChannelValue
      8 x external trigger occurred event:
        trAdc_ReadGroup: start-on-event=AdcIf_GPTOnTimer_Expiration, trigger=ptrrAsrAdcServicesAdcIf.Adc_ReadGroup
        trAdc_StartGroupConversion: start-on-event=AdcIf_runInit, trigger=ptrrAsrAdcServicesAdcIf.Adc_StartGroupConversion
        trAdc_StopGroupConversion: start-on-event=AdcIf_runDeInit, trigger=ptrrAsrAdcServicesAdcIf.Adc_StopGroupConversion
        trAsrAdc_Calibrate: start-on-event=AdcIf_Calib, trigger=ptrrAsrAdcServicesAdcIf.Adc_Calibrate
        trAsrAdc_StartGroupConversion: start-on-event=AdcIf_GPTOnTimer_Expiration, trigger=ptrrAsrAdcServicesAdcIf.Adc_StartGroupConversion
        trGpt_EnableNotification: start-on-event=AdcIf_runInit, trigger=ptrrAsrGptServicesAdcIf.Gpt_EnableNotification
        trGpt_Init: start-on-event=AdcIf_runInit, trigger=ptrrAsrGptServicesAdcIf.Gpt_Init
        trGpt_StartTimer: start-on-event=AdcIf_runInit, trigger=ptrrAsrGptServicesAdcIf.Gpt_StartTimer
      10 x runnable, all with sw-addr-method=CODE_ASIL_A:
        AdcIf_Autotest_CheckAdc: runnable-entity-argument=symbol=uint8
        AdcIf_Autotest_CheckAdcCalib
        AdcIf_Calib: external-triggering-point=ptrpEcuMIfServicesAdcIf.AdcIf_Calib
        AdcIf_GPTOnTimer_Expiration: external-triggering-point=ptrpAsrGptServicesAdcIf.AdcIf_GPTOnTimer_Expiration
          data-send-points:
            access dsp_aau16HistoricalAdcSamples: accessed-variable=prrAdcBufferServices.aau16HistoricalAdcSamples
            access dsp_u8HistoricalAdcSampleInd: accessed-variable=prrAdcBufferServices.u8HistoricalAdcSampleIndex
        AdcIf_StartConversion
        AdcIf_StopConversion
        AdcIf_WaitForConversion
        AdcIf_runDeInit: can-be-invoked-concurrently=true, external-triggering-point=ptrpAdcIfServicesBswMIf.AdcIf_runDeInit
        AdcIf_runGetChannelValue: can-be-invoked-concurrently=true
        AdcIf_runInit: can-be-invoked-concurrently=true, external-triggering-point=ptrpAdcIfServicesBswMIf.AdcIf_runInit
  swc implementation AdcIf_imp: category=MCAL_IO_Drivers, programming-language=C, sw-version=1.0.0, vendor-id=0, behavior=AdcIf_IB_0
    code-descriptors:
      code AdcIf_Impl_Code: artifact-descriptors=autosar-engineering-object={short-label=AdcIf_Impl_Code_CodeDesc, category=SWSRC}
    resource consumption AdcIf_ImplResCons
      33 x memory section:
        CODE: size=0, sw-addrmethod=CODE
        CODE_ASIL_A: size=0, sw-addrmethod=CODE_ASIL_A
        CONST_16: alignment=16, size=16, sw-addrmethod=CONST
        CONST_16_ASIL_A: alignment=16, size=16, sw-addrmethod=CONST_ASIL_A
        CONST_32: alignment=32, size=32, sw-addrmethod=CONST
        CONST_32_ASIL_A: alignment=32, size=32, sw-addrmethod=CONST_ASIL_A
        CONST_8: alignment=8, size=8, sw-addrmethod=CONST
        CONST_8_ASIL_A: alignment=8, size=8, sw-addrmethod=CONST_ASIL_A
        CONST_BOOL: alignment=8, size=1, sw-addrmethod=CONST
        CONST_BOOL_ASIL_A: alignment=8, size=1, sw-addrmethod=CONST_ASIL_A
        CONST_UNSPECIFIED: alignment=UNSPECIFIED, size=0, sw-addrmethod=CONST
        CONST_UNSPECIFIED_ASIL_A: alignment=UNSPECIFIED, size=0, sw-addrmethod=CONST_ASIL_A
        VAR_INIT_16: alignment=16, size=16, sw-addrmethod=VAR_INIT
        VAR_INIT_16_ASIL_A: alignment=16, size=16, sw-addrmethod=VAR_INIT_ASIL_A
        VAR_INIT_32: alignment=32, size=32, sw-addrmethod=VAR_INIT
        VAR_INIT_32_ASIL_A: alignment=32, size=32, sw-addrmethod=VAR_INIT_ASIL_A
        VAR_INIT_8: alignment=8, size=8, sw-addrmethod=VAR_INIT
        VAR_INIT_8_ASIL_A: alignment=8, size=8, sw-addrmethod=VAR_INIT_ASIL_A
        VAR_INIT_BOOL: alignment=8, size=1, sw-addrmethod=VAR_INIT
        VAR_INIT_BOOL_ASIL_A: alignment=8, size=1, sw-addrmethod=VAR_INIT_ASIL_A
        VAR_INIT_UNSPECIFIED: alignment=UNSPECIFIED, size=0, sw-addrmethod=VAR_INIT
        VAR_INIT_UNSPECIFIED_ASIL_A: alignment=UNSPECIFIED, size=0, sw-addrmethod=VAR_INIT_ASIL_A
        VAR_NO_INIT_16: alignment=16, size=16, sw-addrmethod=VAR_NOINIT
        VAR_NO_INIT_16_ASIL_A: alignment=16, size=16, sw-addrmethod=VAR_NOINIT_ASIL_A
        VAR_NO_INIT_32: alignment=32, size=32, sw-addrmethod=VAR_NOINIT
        VAR_NO_INIT_32_ASIL_A: alignment=32, size=32, sw-addrmethod=VAR_NOINIT_ASIL_A
        VAR_NO_INIT_8: alignment=8, size=8, sw-addrmethod=VAR_NOINIT
        VAR_NO_INIT_8_ASIL_A: alignment=8, size=8, sw-addrmethod=VAR_NOINIT_ASIL_A
        VAR_NO_INIT_BOOL: alignment=8, size=1, sw-addrmethod=VAR_NOINIT
        VAR_NO_INIT_BOOL_ASIL_A: alignment=8, size=1, sw-addrmethod=VAR_NOINIT_ASIL_A
        VAR_NO_INIT_UNSPECIFIED: alignment=UNSPECIFIED, size=0, sw-addrmethod=VAR_NOINIT
        VAR_NO_INIT_UNSPECIFIED_ASIL_A: alignment=UNSPECIFIED, size=0, sw-addrmethod=VAR_NOINIT_ASIL_A
        VAR_POWER_ON_CLEARED: alignment=UNSPECIFIED, size=0, sw-addrmethod=VAR_POWER_ON_CLEARED
