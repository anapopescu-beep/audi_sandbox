AUTOSAR XML (schema 4-2-2)
package /AUTOLIV/SoftwareComponents/BswMIf
  application sw component type BswMIf: category=BSW_System_Services
    behavior BswMIf_IB: data-type-mapping=[DataTypeMappingSet_BswMIf, DataTypeMappingSet_FSM, DataTypeMappingSet_NvmIf, DataTypeMappingSet_RCM], handle-termination-and-restart=NO-SUPPORT
      external trigger occurred event EcuM_ValidateWakeupEvent: start-on-event=BswM_OnStartupTwoB, trigger=ptrrAsrEcuMServicesBswMIf.EcuM_ValidateWakeupEvent
      timing event ev_BswMIf_runMainFunction: start-on-event=BswMIf_runMainFunction, period=0.01
      operation invoked event oie_pseEcuStateTransitions_BswM_SetEcuStateTransitionStatus: start-on-event=BswM_SetEcuStateTransitionStatus, operation=pseEcuStateTransitions.BswM_SetEcuStateTransitionStatus
      operation invoked event oie_psePassengerOccupancyState_BswM_UpdatePassangerOccupancyStatus: start-on-event=BswM_UpdatePassangerOccupancyStatus, operation=psePassengerOccupancyState.BswM_UpdatePassangerOccupancyStatus
      93 x external trigger occurred event:
        trATM_Init: start-on-event=BswM_OnStartComEffective, trigger=ptrrAtmServicesBswMIf.ATM_Init
        trActivateTask_BswM_OnPostRunFromRun: start-on-event=BswM_OnPostRunFromRun, trigger=ptrrAsrOsServicesBswMIf.OS_UserActivateTask
        trActivateTask_BswM_OnStartupTwoA: start-on-event=BswM_OnStartupTwoA, trigger=ptrrAsrOsServicesBswMIf.OS_UserActivateTask
        trActivateTask_BswM_On_Prep_Shutdown: start-on-event=BswM_On_Prep_Shutdown, trigger=ptrrAsrOsServicesBswMIf.OS_UserActivateTask
        trAdcIf_runDeInit: start-on-event=BswM_OnGoOffOneA, trigger=ptrrAdcIfServicesBswMIf.AdcIf_runDeInit
        trAdcIf_runInit: start-on-event=BswM_OnStartupTwoA, trigger=ptrrAdcIfServicesBswMIf.AdcIf_runInit
        trBswM_RequestMode: start-on-event=BswM_Cyclic_10msTimer, trigger=ptrrAsrBswMServicesBswMIf.BswM_RequestMode
        trBswM_RequestMode_BswM_CB_NfyNvMJobEnd: start-on-event=BswM_CB_NfyNvMJobEnd, trigger=ptrrAsrBswMServicesBswMIf.BswM_RequestMode
        trBswM_RequestMode_BswM_OnGoOffOneA: start-on-event=BswM_OnGoOffOneA, trigger=ptrrAsrBswMServicesBswMIf.BswM_RequestMode
        trBswM_RequestMode_BswM_OnLowPwrFromPostRun: start-on-event=BswM_OnLowPwrFromPostRun, trigger=ptrrAsrBswMServicesBswMIf.BswM_RequestMode
        trBswM_RequestMode_BswM_OnPostRunFromRun: start-on-event=BswM_OnPostRunFromRun, trigger=ptrrAsrBswMServicesBswMIf.BswM_RequestMode
        trBswM_RequestMode_BswM_OnRunFromLowPwrBusAvailable: start-on-event=BswM_OnRunFromLowPwrBusAvailable, trigger=ptrrAsrBswMServicesBswMIf.BswM_RequestMode
        trBswM_RequestMode_BswM_OnRunFromLowPwrPassengerDetected: start-on-event=BswM_OnRunFromLowPwrPassengerDetected, trigger=ptrrAsrBswMServicesBswMIf.BswM_RequestMode
        trBswM_RequestMode_BswM_OnRunFromPostRunBusAvailable: start-on-event=BswM_OnRunFromPostRunBusAvailable, trigger=ptrrAsrBswMServicesBswMIf.BswM_RequestMode
        trBswM_RequestMode_BswM_OnRunFromPostRunPassengerDetected: start-on-event=BswM_OnRunFromPostRunPassengerDetected, trigger=ptrrAsrBswMServicesBswMIf.BswM_RequestMode
        trBswM_RequestMode_BswM_OnRunFromWakeup: start-on-event=BswM_OnRunFromWakeup, trigger=ptrrAsrBswMServicesBswMIf.BswM_RequestMode
        trBswM_RequestMode_BswM_OnStartComEffective: start-on-event=BswM_OnStartComEffective, trigger=ptrrAsrBswMServicesBswMIf.BswM_RequestMode
        trBswM_RequestMode_BswM_OnStartupTwoA: start-on-event=BswM_OnStartupTwoA, trigger=ptrrAsrBswMServicesBswMIf.BswM_RequestMode
        trBswM_RequestMode_BswM_OnStartupTwoB: start-on-event=BswM_OnStartupTwoB, trigger=ptrrAsrBswMServicesBswMIf.BswM_RequestMode
        trBswM_RequestMode_BswM_On_Prep_Shutdown: start-on-event=BswM_On_Prep_Shutdown, trigger=ptrrAsrBswMServicesBswMIf.BswM_RequestMode
        trCIL_runInit: start-on-event=BswM_OnStartComEffective, trigger=ptrrCilServicesBswMIf.CIL_runInit
        trCanIf_CheckWakeup: start-on-event=BswM_CB_NfyNvMJobEnd, trigger=ptrrAsrCanIfServicesBswMIf.CanIf_CheckWakeup
        trCanIf_Init: start-on-event=BswM_OnStartupTwoA, trigger=ptrrAsrCanIfServicesBswMIf.CanIf_Init
        trCanSM_Init: start-on-event=BswM_OnStartupTwoA, trigger=ptrrAsrCanSMServicesBswMIf.CanSM_Init
        trCanTp_Init: start-on-event=BswM_OnStartupTwoA, trigger=ptrrAsrCanTpServicesBswMIf.CanTp_Init
        trCan_EnableControllerInterrupts_BswM_OnStartupTwoA: start-on-event=BswM_OnStartupTwoA, trigger=ptrrAsrCanServicesBswMIf.Can_EnableControllerInterrupts
        trCan_SetControllerMode_BswM_OnStartupTwoA: start-on-event=BswM_OnStartupTwoA, trigger=ptrrAsrCanServicesBswMIf.Can_SetControllerMode
        trClearEvent: start-on-event=OsTask_Bsw_ReadWrite_AllProcess, trigger=ptrrAsrOsServicesBswMIf.OS_UserClearEvent
        trComM_ASR40_RequestComMode_BswM_OnPostRunFromRun: start-on-event=BswM_OnPostRunFromRun, trigger=ptrrAsrComMServicesBswMIf.ComM_ASR40_RequestComMode
        trComM_ASR40_RequestComMode_BswM_OnWakeupValidation: start-on-event=BswM_OnWakeupValidation, trigger=ptrrAsrComMServicesBswMIf.ComM_ASR40_RequestComMode
        trComM_CommunicationAllowed: start-on-event=BswM_OnWakeupValidation, trigger=ptrrAsrComMServicesBswMIf.ComM_CommunicationAllowed
        trComM_DeInit: start-on-event=BswM_OnGoOffOneA, trigger=ptrrAsrComMServicesBswMIf.ComM_DeInit
        trComM_Init: start-on-event=BswM_OnStartupTwoB, trigger=ptrrAsrComMServicesBswMIf.ComM_Init
        trCom_ClearIpduGroupVector_BswM_OnDisableTxPdu: start-on-event=BswM_OnDisableTxPdu, trigger=ptrrAsrComServicesBswMIf.Com_ClearIpduGroupVector
        trCom_ClearIpduGroupVector_BswM_OnEnableTxPdu: start-on-event=BswM_OnEnableTxPdu, trigger=ptrrAsrComServicesBswMIf.Com_ClearIpduGroupVector
        trCom_Init: start-on-event=BswM_OnStartupTwoA, trigger=ptrrAsrComServicesBswMIf.Com_Init
        trCom_IpduGroupControl_BswM_OnDisableTxPdu: start-on-event=BswM_OnDisableTxPdu, trigger=ptrrAsrComServicesBswMIf.Com_IpduGroupControl
        trCom_IpduGroupControl_BswM_OnEnableTxPdu: start-on-event=BswM_OnEnableTxPdu, trigger=ptrrAsrComServicesBswMIf.Com_IpduGroupControl
        trCom_SetIpduGroup_BswM_OnDisableTxPdu: start-on-event=BswM_OnDisableTxPdu, trigger=ptrrAsrComServicesBswMIf.Com_SetIpduGroup
        trCom_SetIpduGroup_BswM_OnEnableTxPdu: start-on-event=BswM_OnEnableTxPdu, trigger=ptrrAsrComServicesBswMIf.Com_SetIpduGroup
        trDIA_Init: start-on-event=BswM_OnStartComEffective, trigger=ptrrDiaServicesBswMIf.DIA_Init
        trDcm_Init: start-on-event=BswM_OnStartComEffective, trigger=ptrrAsrDcmServicesBswMIf.Dcm_Init
        trDem_Init: start-on-event=BswM_OnStartupTwoB, trigger=ptrrAsrDemServicesBswMIf.Dem_Init
        trDem_Shutdown: start-on-event=BswM_On_Prep_Shutdown, trigger=ptrrAsrDemServicesBswMIf.Dem_Shutdown
        trEcuM_ClearWakeupEvent: start-on-event=BswM_OnStartComEffective, trigger=ptrrAsrEcuMServicesBswMIf.EcuM_ClearWakeupEvent
        trEcuM_ClearWakeupEvent_BswM_On_Prep_Shutdown: start-on-event=BswM_On_Prep_Shutdown, trigger=ptrrAsrEcuMServicesBswMIf.EcuM_ClearWakeupEvent
        trEcuM_GoDown: start-on-event=BswM_ProceedReset, trigger=ptrrAsrEcuMServicesBswMIf.EcuM_GoDown
        trEcuM_GoDown_BswM_OnWakeupExpired: start-on-event=BswM_OnWakeupExpired, trigger=ptrrAsrEcuMServicesBswMIf.EcuM_GoDown
        trFSM_Init: start-on-event=BswM_OnStartupTwoB, trigger=ptrrFsmServicesBswMIf.FSM_Init
        trFSM_ModesInit: start-on-event=BswM_OnStartComEffective, trigger=ptrrFsmServicesBswMIf.FSM_ModesInit
        trFee_MainFunction: start-on-event=OsTask_Bsw_ReadWrite_AllProcess, trigger=ptrrAsrFeeServicesBswMIf.Fee_MainFunction
        trFls_MainFunction: start-on-event=OsTask_Bsw_ReadWrite_AllProcess, trigger=ptrrAsrFlsServicesBswMIf.Fls_MainFunction
        trGpt_DisableNotification: start-on-event=BswM_Cyclic_10msTimer, trigger=ptrrAsrGptServicesBswMIf.Gpt_DisableNotification
        trGpt_DisableNotification_BswM_OnRunFromPostRunBusAvailable: start-on-event=BswM_OnRunFromPostRunBusAvailable, trigger=ptrrAsrGptServicesBswMIf.Gpt_DisableNotification
        trGpt_EnableNotification_BswM_OnRunFromLowPwrPassengerDetected: start-on-event=BswM_OnRunFromLowPwrPassengerDetected, trigger=ptrrAsrGptServicesBswMIf.Gpt_EnableNotification
        trGpt_EnableNotification_BswM_OnRunFromPostRunPassengerDetected: start-on-event=BswM_OnRunFromPostRunPassengerDetected, trigger=ptrrAsrGptServicesBswMIf.Gpt_EnableNotification
        trGpt_EnableNotification_BswM_OnStartupTwoB: start-on-event=BswM_OnStartupTwoB, trigger=ptrrAsrGptServicesBswMIf.Gpt_EnableNotification
        trGpt_StartTimer_BswM_CB_NfyNvMJobEnd: start-on-event=BswM_CB_NfyNvMJobEnd, trigger=ptrrAsrGptServicesBswMIf.Gpt_StartTimer
        trGpt_StartTimer_BswM_OnRunFromLowPwrPassengerDetected: start-on-event=BswM_OnRunFromLowPwrPassengerDetected, trigger=ptrrAsrGptServicesBswMIf.Gpt_StartTimer
        trGpt_StartTimer_BswM_OnRunFromPostRunPassengerDetected: start-on-event=BswM_OnRunFromPostRunPassengerDetected, trigger=ptrrAsrGptServicesBswMIf.Gpt_StartTimer
        trGpt_StopTimer: start-on-event=BswM_Cyclic_10msTimer, trigger=ptrrAsrGptServicesBswMIf.Gpt_StopTimer
        trGpt_StopTimer_BswM_OnRunFromPostRunBusAvailable: start-on-event=BswM_OnRunFromPostRunBusAvailable, trigger=ptrrAsrGptServicesBswMIf.Gpt_StopTimer
        trLPM_sleepInit: start-on-event=BswM_OnLowPwrFromPostRun, trigger=ptrrLpmServicesBswMIf.LPM_sleepInit
        trLPM_sleepMainLoop: start-on-event=BswM_OnLowPwrFromPostRun, trigger=ptrrLpmServicesBswMIf.LPM_sleepMainLoop
        trLPM_sleepRestore: start-on-event=BswM_OnLowPwrFromPostRun, trigger=ptrrLpmServicesBswMIf.LPM_sleepRestore
        trMIC_Init: start-on-event=BswM_OnStartupTwoA, trigger=ptrrMicServices.MIC_Init
        trMcuIf_Init: start-on-event=BswM_OnRunFromWakeup, trigger=ptrrMcuIfServicesBswMIf.McuIf_Init
        trNvM_Init: start-on-event=BswM_OnStartupTwoA, trigger=ptrrAsrNvMServicesBswMIf.NvM_Init
        trNvM_MainFunction: start-on-event=OsTask_Bsw_ReadWrite_AllProcess, trigger=ptrrAsrNvMServicesBswMIf.NvM_MainFunction
        trNvM_ReadAll_BswM_OnStartupTwoA: start-on-event=BswM_OnStartupTwoA, trigger=ptrrAsrNvMServicesBswMIf.NvM_ReadAll
        trNvM_WriteAll_BswM_OnPostRunFromRun: start-on-event=BswM_OnPostRunFromRun, trigger=ptrrAsrNvMServicesBswMIf.NvM_WriteAll
        trNvM_WriteAll_BswM_On_Prep_Shutdown: start-on-event=BswM_On_Prep_Shutdown, trigger=ptrrAsrNvMServicesBswMIf.NvM_WriteAll
        trOStopScheduleTable_BswM_OnStartComEffective: start-on-event=BswM_OnStartComEffective, trigger=ptrrAsrOsServicesBswMIf.OS_UserStopScheduleTable
        trPduR_Init: start-on-event=BswM_OnStartupTwoA, trigger=ptrrAsrPduRServicesBswMIf.PduR_Init
        trRCM_runDetermineResetCause: start-on-event=BswM_OnStartComEffective, trigger=ptrrRcmServicesBswMIf.RCM_runDetermineResetCause
        trResumeAllInterrupts: start-on-event=OsTask_Bsw_ReadWrite_AllProcess, trigger=ptrrAsrOsServicesBswMIf.OS_FastResumeAllInterrupts
        trRte_StartScheduleTable_SchM_DefaultScheduleTable: start-on-event=BswM_ProceedReset, trigger=ptrrAsrOsServicesBswMIf.OS_UserStartScheduleTable
        trRte_Start_BswM_OnStartComEffective: start-on-event=BswM_OnStartComEffective, trigger=ptrrAsrRteServicesBswMIf.Rte_Start
        trRte_Stop: start-on-event=BswM_On_Prep_Shutdown, trigger=ptrrAsrRteServicesBswMIf.Rte_Stop
        trSAD_Init: start-on-event=BswM_OnStartComEffective, trigger=ptrrSadServicesBswMIf.SAD_Init
        trSetEvent: start-on-event=OsTask_Bsw_ReadWrite_AllProcess, trigger=ptrrAsrOsServicesBswMIf.OS_UserSetEvent
        trSetEvent_BswM_OnPostRunFromRun: start-on-event=BswM_OnPostRunFromRun, trigger=ptrrAsrOsServicesBswMIf.OS_UserSetEvent
        trSetEvent_BswM_OnStartupTwoA: start-on-event=BswM_OnStartupTwoA, trigger=ptrrAsrOsServicesBswMIf.OS_UserSetEvent
        trSetEvent_BswM_On_Prep_Shutdown: start-on-event=BswM_On_Prep_Shutdown, trigger=ptrrAsrOsServicesBswMIf.OS_UserSetEvent
        trStartScheduleTableRel_BswM_CB_NfyNvMJobEnd: start-on-event=BswM_CB_NfyNvMJobEnd, trigger=ptrrAsrOsServicesBswMIf.OS_UserStartScheduleTable
        trStartScheduleTableRel_BswM_OnPostRunFromRun: start-on-event=BswM_OnPostRunFromRun, trigger=ptrrAsrOsServicesBswMIf.OS_UserStartScheduleTable
        trStartScheduleTableRel_BswM_On_Prep_Shutdown: start-on-event=BswM_On_Prep_Shutdown, trigger=ptrrAsrOsServicesBswMIf.OS_UserStartScheduleTable
        trStopScheduleTable_BswM_CB_NfyNvMJobEnd: start-on-event=BswM_CB_NfyNvMJobEnd, trigger=ptrrAsrOsServicesBswMIf.OS_UserStopScheduleTable
        trStopScheduleTable_BswM_OnPostRunFromRun: start-on-event=BswM_OnPostRunFromRun, trigger=ptrrAsrOsServicesBswMIf.OS_UserStopScheduleTable
        trStopScheduleTable_Rte_DefaultScheduleTable: start-on-event=BswM_ProceedReset, trigger=ptrrAsrOsServicesBswMIf.OS_UserStopScheduleTable
        trSuspendAllInterrupts: start-on-event=OsTask_Bsw_ReadWrite_AllProcess, trigger=ptrrAsrOsServicesBswMIf.OS_FastSuspendAllInterrupts
        trTerminateTask: start-on-event=OsTask_Bsw_ReadWrite_AllProcess, trigger=ptrrAsrOsServicesBswMIf.OS_UserTerminateTask
        trWaitEvent: start-on-event=OsTask_Bsw_ReadWrite_AllProcess, trigger=ptrrAsrOsServicesBswMIf.OS_UserWaitEvent
      28 x runnable:
        BswMIf_runMainFunction: external-triggering-point=ptrpAsrOsServicesBswMIf.BswMIf_runMainFunction
          data-send-points:
            access dsp_u8BlockRestoreStatus: accessed-variable=psrBswMIfServices.u8BlockRestoreStatus
          4 x sync call, all with timeout=0.0:
            scp_GetNvmBlockStatus: operation=pclNvmIfServices.GetNvmBlockStatus
            scp_RestorePRAMBlockDefaults: operation=pclNvmIfServices.RestorePRAMBlockDefaults
            scp_SetRamBlockStatus: operation=pclNvmIfServices.SetRamBlockStatus
            scp_updateCurrentEcuState: operation=pclCILGetEcuState.updateCurrentEcuState
        BswM_CB_NfyNvMJobEnd: external-triggering-point=ptrpAsrNvMServicesBswMIf.BswM_CB_NfyNvMJobEnd, symbol=BswM_CB_NfyNvMJobEnd_0
        BswM_Cyclic_10msTimer: external-triggering-point=ptrpAsrGptServicesBswMIf.BswM_Cyclic_10msTimer
        BswM_HWResetNotification: external-triggering-point=ptrpAsrBswMServicesBswMIf.BswM_HWResetNotification
          sync call scp_NotifyResetCause: operation=pclNotifyResetCause.NotifyResetCause, timeout=0.0
        BswM_JumpToFBLNotification: external-triggering-point=ptrpAsrBswMServicesBswMIf.BswM_JumpToFBLNotification
          sync call scp_NotifyResetCause: operation=pclNotifyResetCause.NotifyResetCause, timeout=0.0
        BswM_OnDisableTxPdu: external-triggering-point=ptrpAsrBswMServicesBswMIf.BswM_OnDisableTxPdu
        BswM_OnEnableTxPdu: external-triggering-point=ptrpAsrBswMServicesBswMIf.BswM_OnEnableTxPdu
        BswM_OnGoOffOneA: external-triggering-point=ptrpAsrBswMServicesBswMIf.BswM_OnGoOffOneA
        BswM_OnLowPwrFromPostRun: external-triggering-point=ptrpAsrBswMServicesBswMIf.BswM_OnLowPwrFromPostRun
        BswM_OnPostRunFromRun: external-triggering-point=ptrpAsrBswMServicesBswMIf.BswM_OnPostRunFromRun
        BswM_OnRunFromLowPwrBusAvailable: external-triggering-point=ptrpAsrBswMServicesBswMIf.BswM_OnRunFromLowPwrBusAvailable
        BswM_OnRunFromLowPwrPassengerDetected: external-triggering-point=ptrpAsrBswMServicesBswMIf.BswM_OnRunFromLowPwrPassengerDetected
        BswM_OnRunFromPostRunBusAvailable: external-triggering-point=ptrpAsrBswMServicesBswMIf.BswM_OnRunFromPostRunBusAvailable
        BswM_OnRunFromPostRunPassengerDetected: external-triggering-point=ptrpAsrBswMServicesBswMIf.BswM_OnRunFromPostRunPassengerDetected
        BswM_OnRunFromSafeState: sw-addr-method=CODE_ASIL_A, external-triggering-point=ptrpAsrBswMServicesBswMIf.BswM_OnRunFromSafeState
          data-send-points:
            access dsp_au8DiagReq: accessed-variable=psrFsmSolenoidReqBswMIf.au8DiagReq
            access dsp_au8DiagReqComplement: accessed-variable=psrFsmSolenoidReqBswMIf.au8DiagReqComplement
        BswM_OnRunFromWakeup: external-triggering-point=ptrpAsrBswMServicesBswMIf.BswM_OnRunFromWakeup
        BswM_OnSafeStateFromPostRun: sw-addr-method=CODE_ASIL_A, external-triggering-point=ptrpAsrBswMServicesBswMIf.BswM_OnSafeStateFromPostRun
          data-send-points:
            access dsp_au8DiagReq: accessed-variable=psrFsmSolenoidReqBswMIf.au8DiagReq
            access dsp_au8DiagReqComplement: accessed-variable=psrFsmSolenoidReqBswMIf.au8DiagReqComplement
        BswM_OnStartComEffective: external-triggering-point=ptrpAsrBswMServicesBswMIf.BswM_OnStartComEffective
          sync call scp_SetOperationCycleState: operation=pclDemSetOpCycle.SetOperationCycleState, timeout=0.0
        BswM_OnStartupTwoA: external-triggering-point=ptrpAsrBswMServicesBswMIf.BswM_OnStartupTwoA
        BswM_OnStartupTwoB: external-triggering-point=ptrpAsrBswMServicesBswMIf.BswM_OnStartupTwoB
        BswM_OnWakeupExpired: external-triggering-point=ptrpAsrBswMServicesBswMIf.BswM_OnWakeupExpired
        BswM_OnWakeupValidation: external-triggering-point=ptrpAsrBswMServicesBswMIf.BswM_OnWakeupValidation
        BswM_On_Prep_Shutdown: external-triggering-point=ptrpAsrBswMServicesBswMIf.BswM_On_Prep_Shutdown
        BswM_ProceedReset: external-triggering-point=ptrpAsrBswMServicesBswMIf.BswM_ProceedReset
        BswM_SWResetNotification: external-triggering-point=ptrpAsrBswMServicesBswMIf.BswM_SWResetNotification
          sync call scp_NotifyResetCause: operation=pclNotifyResetCause.NotifyResetCause, timeout=0.0
        BswM_SetEcuStateTransitionStatus: external-triggering-point=ptrpNmIfServicesBswMIf.BswM_SetEcuStateTransitionStatus
        BswM_UpdatePassangerOccupancyStatus
        OsTask_Bsw_ReadWrite_AllProcess: external-triggering-point=ptrpAsrOsServicesBswMIf.OsTask_Bsw_ReadWrite_AllProcess, symbol=OsTask_Bsw_ReadWrite_AllProcess_0
  swc implementation BswMIf_imp: category=BSW_System_Services, programming-language=C, sw-version=1.0.0, vendor-id=0, behavior=BswMIf_IB
    code-descriptors:
      code BswMIf_Impl_Code: artifact-descriptors=autosar-engineering-object={short-label=BswMIf_Impl_Code_CodeDesc, category=SWSRC}
    resource consumption BswMIf_Impl_ResCons
      33 x memory section:
        CODE: size=0, sw-addrmethod=CODE
        CODE_ASIL_A: size=0, sw-addrmethod=CODE_ASIL_A
        CONST_16: alignment=16, size=16, sw-addrmethod=CONST
        CONST_16_ASIL_A: alignment=16, size=16, sw-addrmethod=CONST_ASIL_A
        CONST_32: alignment=32, size=32, sw-addrmethod=CONST
        CONST_32_ASIL_A: alignment=32, size=32, sw-addrmethod=CONST_ASIL_A
        CONST_8: alignment=8, size=8, sw-addrmethod=CONST
        CONST_8_ASIL_A: alignment=8, size=8, sw-addrmethod=CONST_ASIL_A
        CONST_BOOL: alignment=8, size=1, sw-addrmethod=CONST
        CONST_BOOL_ASIL_A: alignment=8, size=1, sw-addrmethod=CONST_ASIL_A
        CONST_UNSPECIFIED: alignment=UNSPECIFIED, size=0, sw-addrmethod=CONST
        CONST_UNSPECIFIED_ASIL_A: alignment=UNSPECIFIED, size=0, sw-addrmethod=CONST_ASIL_A
        VAR_INIT_16: alignment=16, size=16, sw-addrmethod=VAR_INIT
        VAR_INIT_16_ASIL_A: alignment=16, size=16, sw-addrmethod=VAR_INIT_ASIL_A
        VAR_INIT_32: alignment=32, size=32, sw-addrmethod=VAR_INIT
        VAR_INIT_32_ASIL_A: alignment=32, size=32, sw-addrmethod=VAR_INIT_ASIL_A
        VAR_INIT_8: alignment=8, size=8, sw-addrmethod=VAR_INIT
        VAR_INIT_8_ASIL_A: alignment=8, size=8, sw-addrmethod=VAR_INIT_ASIL_A
        VAR_INIT_BOOL: alignment=8, size=1, sw-addrmethod=VAR_INIT
        VAR_INIT_BOOL_ASIL_A: alignment=8, size=1, sw-addrmethod=VAR_INIT_ASIL_A
        VAR_INIT_UNSPECIFIED: alignment=UNSPECIFIED, size=0, sw-addrmethod=VAR_INIT
        VAR_INIT_UNSPECIFIED_ASIL_A: alignment=UNSPECIFIED, size=0, sw-addrmethod=VAR_INIT_ASIL_A
        VAR_NO_INIT_16: alignment=16, size=16, sw-addrmethod=VAR_NOINIT
        VAR_NO_INIT_16_ASIL_A: alignment=16, size=16, sw-addrmethod=VAR_NOINIT_ASIL_A
        VAR_NO_INIT_32: alignment=32, size=32, sw-addrmethod=VAR_NOINIT
        VAR_NO_INIT_32_ASIL_A: alignment=32, size=32, sw-addrmethod=VAR_NOINIT_ASIL_A
        VAR_NO_INIT_8: alignment=8, size=8, sw-addrmethod=VAR_NOINIT
        VAR_NO_INIT_8_ASIL_A: alignment=8, size=8, sw-addrmethod=VAR_NOINIT_ASIL_A
        VAR_NO_INIT_BOOL: alignment=8, size=1, sw-addrmethod=VAR_NOINIT
        VAR_NO_INIT_BOOL_ASIL_A: alignment=8, size=1, sw-addrmethod=VAR_NOINIT_ASIL_A
        VAR_NO_INIT_UNSPECIFIED: alignment=UNSPECIFIED, size=0, sw-addrmethod=VAR_NOINIT
        VAR_NO_INIT_UNSPECIFIED_ASIL_A: alignment=UNSPECIFIED, size=0, sw-addrmethod=VAR_NOINIT_ASIL_A
        VAR_POWER_ON_CLEARED: alignment=UNSPECIFIED, size=0, sw-addrmethod=VAR_POWER_ON_CLEARED
