AUTOSAR XML (schema 4-2-2)
package /AUTOLIV/SoftwareComponents/CIL
  application sw component type CIL: category=SWC
    behavior CIL_IB_CommunicationInteractionLayer: constant-value-mapping=[ConstantsMappingSet_CIL, ConstantsMappingSet_EcuExtract], data-type-mapping=[DataTypeMappingSet_ACC, DataTypeMappingSet_AdcIf, DataTypeMappingSet_CIL, DataTypeMappingSet_FSM, DataTypeMappingSet_IoHwAb, DataTypeMappingSet_SAD, DataTypeMappingSet_SBC, DataTypeMappingSet_SpiIf, DataTypeMappingSet_SystemExtract, DataTypeMappingSet_eCS], handle-termination-and-restart=NO-SUPPORT
      4 x timing event:
        CIL_evAppliToCAN: start-on-event=CIL_runAppliToCAN, period=0.002
        CIL_evCANToAppli: start-on-event=CIL_runCANToAppli, period=0.01
        ev_CIL_runCANToSafetyAppli: start-on-event=CIL_runCANToSafetyAppli, period=0.01
        ev_MFPeriod: start-on-event=CIL_runManageMF, period=0.002
      operation invoked event oie_pclSetEcuStateSignal_updateCurrentEcuState: start-on-event=CIL_updateCurrentEcuState, operation=pseSetEcuStateSignal.updateCurrentEcuState
      6 x runnable:
        CIL_runAppliToCAN: sw-addr-method=CODE, external-triggering-point=ptrpAsrOsServicesCIL.CIL_runAppliToCAN
          data-receive-point-by-arguments:
            6 x access:
              drparg_au8BuckleStatus: accessed-variable=prrBuckleStatus.au8BuckleStatus
              drparg_au8SeatOccupancySenso: accessed-variable=prrSeatOccupancySensorStatus.au8SeatOccupancySensorStatus
              drparg_st3DAccel: accessed-variable=prr3DAcceleration.st3DAccel
              drparg_stAccelMtrPerSecSqd: accessed-variable=prrAccelMtrPerSecSqd.stAccelMtrPerSecSqd
              drparg_u16BallPosition: accessed-variable=prrEcsAlgoData.u16BallPosition
              drparg_u8EcsFlag: accessed-variable=prrEcsAlgoData.u8EcsFlag
          data-send-points:
            24 x access:
              dsp_DE_eCS_Error_Reihe1_BFS_1: accessed-variable=SP_IF_eCS_Error_Reihe1_BFS_1.DE_eCS_Error_Reihe1_BFS_1
              dsp_DE_eCS_Error_Reihe1_BFS_2: accessed-variable=SP_IF_eCS_Error_Reihe1_BFS_2.DE_eCS_Error_Reihe1_BFS_2
              dsp_DE_eCS_Error_Reihe1_FS_1: accessed-variable=SP_IF_eCS_Error_Reihe1_FS_1.DE_eCS_Error_Reihe1_FS_1
              dsp_DE_eCS_Error_Reihe1_FS_2: accessed-variable=SP_IF_eCS_Error_Reihe1_FS_2.DE_eCS_Error_Reihe1_FS_2
              dsp_DE_eCS_Error_Reihe2_BFS: accessed-variable=SP_IF_eCS_Error_Reihe2_BFS.DE_eCS_Error_Reihe2_BFS
              dsp_DE_eCS_Error_Reihe2_FS: accessed-variable=SP_IF_eCS_Error_Reihe2_FS.DE_eCS_Error_Reihe2_FS
              dsp_DE_eCS_Gurtschloss_Statu: accessed-variable=SP_IF_eCS_Gurtschloss_Status_Reihe2_BF_XIX_Grundumfang_XIX_eCS.DE_eCS_Gurtschloss_Status_Reihe2_BF
              dsp_DE_eCS_Gurtschloss_Statu1: accessed-variable=SP_IF_eCS_Gurtschloss_Status_Reihe2_FA_XIX_Grundumfang_XIX_eCS.DE_eCS_Gurtschloss_Status_Reihe2_FA
              dsp_DE_eCS_HW_defekt: accessed-variable=SP_IF_eCS_HW_defekt_XIX_Grundumfang_XIX_eCS.DE_eCS_HW_defekt
              dsp_DE_eCS_SBS_Belegung_Reih: accessed-variable=SP_IF_eCS_SBS_Belegung_Reihe2_BF_XIX_Grundumfang_XIX_eCS.DE_eCS_SBS_Belegung_Reihe2_BF
              dsp_DE_eCS_SBS_Belegung_Reih1: accessed-variable=SP_IF_eCS_SBS_Belegung_Reihe2_FA_XIX_Grundumfang_XIX_eCS.DE_eCS_SBS_Belegung_Reihe2_FA
              dsp_DE_eCS_SBS_LastState_Rei: accessed-variable=SP_IF_eCS_SBS_LastState_Reihe2_BFS.DE_eCS_SBS_LastState_Reihe2_BFS
              dsp_DE_eCS_SBS_LastState_Rei1: accessed-variable=SP_IF_eCS_SBS_LastState_Reihe2_FS.DE_eCS_SBS_LastState_Reihe2_FS
              dsp_DE_eCS_Status: accessed-variable=SP_IF_eCS_Status_XIX_Grundumfang_XIX_eCS.DE_eCS_Status
              dsp_DE_eCS_Status_Verr_Reihe: accessed-variable=SP_IF_eCS_Status_Verr_Reihe1_BFS_1.DE_eCS_Status_Verr_Reihe1_BFS_1
              dsp_DE_eCS_Status_Verr_Reihe1: accessed-variable=SP_IF_eCS_Status_Verr_Reihe1_BFS_2.DE_eCS_Status_Verr_Reihe1_BFS_2
              dsp_DE_eCS_Status_Verr_Reihe2: accessed-variable=SP_IF_eCS_Status_Verr_Reihe1_FS_1.DE_eCS_Status_Verr_Reihe1_FS_1
              dsp_DE_eCS_Status_Verr_Reihe3: accessed-variable=SP_IF_eCS_Status_Verr_Reihe1_FS_2.DE_eCS_Status_Verr_Reihe1_FS_2
              dsp_DE_eCS_Status_Verr_Reihe4: accessed-variable=SP_IF_eCS_Status_Verr_Reihe2_BFS.DE_eCS_Status_Verr_Reihe2_BFS
              dsp_DE_eCS_Status_Verr_Reihe5: accessed-variable=SP_IF_eCS_Status_Verr_Reihe2_FS.DE_eCS_Status_Verr_Reihe2_FS
              dsp_DE_eCS_Stoerung: accessed-variable=SP_IF_eCS_Stoerung_XIX_Grundumfang_XIX_eCS.DE_eCS_Stoerung
              dsp_EcuCanDataOut: accessed-variable=P_CAN_CanDataOut_Frame_0.EcuCanDataOut
              dsp_GliwaCanDataOut: accessed-variable=P_CAN_GliwaDataOut_Frame.GliwaCanDataOut
              dsp_MfLogger: accessed-variable=P_CAN_MF_Logger_Frame.MfLogger
          sync call scp_CheckModeStatus: operation=pclModeManagement.CheckModeStatus, timeout=0.0
        CIL_runCANToAppli: sw-addr-method=CODE, external-triggering-point=ptrpAsrOsServicesCIL.CIL_runCANToAppli
          data-receive-point-by-arguments:
            7 x access:
              drparg_DE_AB_Gurtschloss_BF: accessed-variable=RP_IF_AB_Gurtschloss_BF_XIX_Grundumfang_XIX_eCS.DE_AB_Gurtschloss_BF
              drparg_DE_AB_Gurtschloss_FA: accessed-variable=RP_IF_AB_Gurtschloss_FA_XIX_Grundumfang_XIX_eCS.DE_AB_Gurtschloss_FA
              drparg_DE_AB_Gurtschloss_Rei: accessed-variable=RP_IF_AB_Gurtschloss_Reihe2_BF_XIX_Grundumfang_XIX_eCS.DE_AB_Gurtschloss_Reihe2_BF
              drparg_DE_AB_Gurtschloss_Rei1: accessed-variable=RP_IF_AB_Gurtschloss_Reihe2_FA_XIX_Grundumfang_XIX_eCS.DE_AB_Gurtschloss_Reihe2_FA
              drparg_DE_AB_Gurtschloss_Rei2: accessed-variable=RP_IF_AB_Gurtschloss_Reihe3_BF_XIX_Grundumfang_XIX_eCS.DE_AB_Gurtschloss_Reihe3_BF
              drparg_DE_AB_Gurtschloss_Rei3: accessed-variable=RP_IF_AB_Gurtschloss_Reihe3_FA_XIX_Grundumfang_XIX_eCS.DE_AB_Gurtschloss_Reihe3_FA
              drparg_GliwaCanDataIn: accessed-variable=P_CAN_GliwaDataIn_Frame.GliwaCanDataIn
          data-send-points:
            access dsp_au8MergedBuckleStatus: accessed-variable=psrCILData.au8MergedBuckleStatus
            access dsp_u8IsCrashActive: accessed-variable=psrCrashStatus.u8IsCrashActive
        CIL_runCANToSafetyAppli: sw-addr-method=CODE_ASIL_A, external-triggering-point=ptrpAsrOsServicesCIL.CIL_runCANToSafetyAppli
          data-receive-point-by-arguments:
            7 x access:
              drparg_DE_AB_Crash_Int: accessed-variable=RP_IF_AB_Crash_Int_XIX_Grundumfang_XIX_eCS.DE_AB_Crash_Int
              drparg_DE_AB_eCS_Aktuatortes: accessed-variable=RP_IF_AB_eCS_Aktuatortest_BF_XIX_Grundumfang_XIX_eCS.DE_AB_eCS_Aktuatortest_BF
              drparg_DE_AB_eCS_Aktuatortes1: accessed-variable=RP_IF_AB_eCS_Aktuatortest_FA_XIX_Grundumfang_XIX_eCS.DE_AB_eCS_Aktuatortest_FA
              drparg_DE_AB_eCS_Aktuatortes2: accessed-variable=RP_IF_AB_eCS_Aktuatortest_Reihe2_BF_XIX_Grundumfang_XIX_eCS.DE_AB_eCS_Aktuatortest_Reihe2_BF
              drparg_DE_AB_eCS_Aktuatortes3: accessed-variable=RP_IF_AB_eCS_Aktuatortest_Reihe2_FA_XIX_Grundumfang_XIX_eCS.DE_AB_eCS_Aktuatortest_Reihe2_FA
              drparg_DE_AB_eCS_Aktuatortes4: accessed-variable=RP_IF_AB_eCS_Aktuatortest_Reihe3_BF_XIX_Grundumfang_XIX_eCS.DE_AB_eCS_Aktuatortest_Reihe3_BF
              drparg_DE_AB_eCS_Aktuatortes5: accessed-variable=RP_IF_AB_eCS_Aktuatortest_Reihe3_FA_XIX_Grundumfang_XIX_eCS.DE_AB_eCS_Aktuatortest_Reihe3_FA
          data-send-points:
            access dsp_au8DiagReq: accessed-variable=psrEcsDiagRequest.au8DiagReq
            access dsp_au8DiagReqComplement: accessed-variable=psrEcsDiagRequest.au8DiagReqComplement
        CIL_runInit: sw-addr-method=CODE, external-triggering-point=ptrpCilServicesBswMIf.CIL_runInit
        CIL_runManageMF: sw-addr-method=CODE, external-triggering-point=ptrpAsrOsServicesCIL.CIL_runManageMF  # CIL_runManageMeasurementFrame
          data-receive-point-by-arguments:
            18 x access:
              drparg_au16Pwm: accessed-variable=prrSolenoidPWM.au16Pwm
              drparg_au8CurrentStep: accessed-variable=pclSolenoidStep.au8CurrentStep
              drparg_au8SelectedProfile: accessed-variable=pclSolenoidProfile.au8SelectedProfile
              drparg_au8SolenoidAutotestSt: accessed-variable=prrSolenoidShortToVccStatus.au8SolenoidAutotestStatus
              drparg_au8SolenoidAutotestSt1: accessed-variable=prrSolenoidShortToGndStatus.au8SolenoidAutotestStatus
              drparg_au8SolenoidAutotestSt2: accessed-variable=prrSolenoidOCStatus.au8SolenoidAutotestStatus
              drparg_au8SolenoidNbOfBackups: accessed-variable=prrSolenoidStuckStatus.au8SolenoidIsStuck
              drparg_au8SolenoidOvervoltag: accessed-variable=prrSolenoidOvervoltageStatus.au8SolenoidOvervoltageStatus
              drparg_au8SolenoidState: accessed-variable=prrSolenoidState.au8SolenoidState
              drparg_st3DAccel: accessed-variable=prr3DAcceleration.st3DAccel
              drparg_u16BallPosition: accessed-variable=prrEcsAlgoData.u16BallPosition
              drparg_u32AccReg1Status: accessed-variable=prrAccStatusFailiureSource.u32AccAlarmRegStatus
              drparg_u32AccReg2Status: accessed-variable=prrAccStatusFailiureSource.u8AccReturnStatus
              drparg_u32AccReg3Status: accessed-variable=prrAccStatusFailiureSource.u8AccCRCStatus
              drparg_u32SbcReg1Status: accessed-variable=prrSbcStatusFailiureSource.u32SbcReg1Status
              drparg_u8AccAlarmbPreinitSeq: accessed-variable=prrAccStatusFailiureSource.u8AccAlarmbPreinitSeqStatus
              drparg_u8AccelAxisBroken: accessed-variable=prrAccStatusFailiureSource.u8AccelAxisBroken
              drparg_u8EcsFlag: accessed-variable=prrEcsAlgoData.u8EcsFlag
          data-send-points:
            access dsp_stMFData: accessed-variable=P_CAN_MF_Frame.stMFData
          6 x sync call, all with timeout=0.0:
            scp_GetTemperature: operation=pclMcuCharacteristics.GetTemperature
            scp_GetTemperature1: operation=pclPtcSensor.GetTemperature
            scp_GetTemperature2: operation=pclAccSensor.GetTemperature
            scp_GetTemperature3: operation=pclEcuCharacterstics.GetTemperature
            scp_GetTemperature4: operation=pclSolenoidCharacteristics.GetTemperature
            scp_getMeasure: operation=pclConvAdcService.getMeasure
        CIL_updateCurrentEcuState
  swc implementation CIL_impCommunicationInteractionLayer: category=SWC, programming-language=C, sw-version=1.0.0, vendor-id=0, behavior=CIL_IB_CommunicationInteractionLayer
    code-descriptors:
      code CIL_Impl_Code: artifact-descriptors=autosar-engineering-object={short-label=CIL_Impl_Code_CodeDesc, category=SWSRC}
    resource consumption CIL_Impl_ResCons
      33 x memory section:
        CODE: size=0, sw-addrmethod=CODE
        CODE_ASIL_A: size=0, sw-addrmethod=CODE_ASIL_A
        CONST_16: alignment=16, size=16, sw-addrmethod=CONST
        CONST_16_ASIL_A: alignment=16, size=16, sw-addrmethod=CONST_ASIL_A
        CONST_32: alignment=32, size=32, sw-addrmethod=CONST
        CONST_32_ASIL_A: alignment=32, size=32, sw-addrmethod=CONST_ASIL_A
        CONST_8: alignment=8, size=8, sw-addrmethod=CONST
        CONST_8_ASIL_A: alignment=8, size=8, sw-addrmethod=CONST_ASIL_A
        CONST_BOOL: alignment=8, size=1, sw-addrmethod=CONST
        CONST_BOOL_ASIL_A: alignment=8, size=1, sw-addrmethod=CONST_ASIL_A
        CONST_UNSPECIFIED: alignment=UNSPECIFIED, size=0, sw-addrmethod=CONST
        CONST_UNSPECIFIED_ASIL_A: alignment=UNSPECIFIED, size=0, sw-addrmethod=CONST_ASIL_A
        VAR_INIT_16: alignment=16, size=16, sw-addrmethod=VAR_INIT
        VAR_INIT_16_ASIL_A: alignment=16, size=16, sw-addrmethod=VAR_INIT_ASIL_A
        VAR_INIT_32: alignment=32, size=32, sw-addrmethod=VAR_INIT
        VAR_INIT_32_ASIL_A: alignment=32, size=32, sw-addrmethod=VAR_INIT_ASIL_A
        VAR_INIT_8: alignment=8, size=8, sw-addrmethod=VAR_INIT
        VAR_INIT_8_ASIL_A: alignment=8, size=8, sw-addrmethod=VAR_INIT_ASIL_A
        VAR_INIT_BOOL: alignment=8, size=1, sw-addrmethod=VAR_INIT
        VAR_INIT_BOOL_ASIL_A: alignment=8, size=1, sw-addrmethod=VAR_INIT_ASIL_A
        VAR_INIT_UNSPECIFIED: alignment=UNSPECIFIED, size=0, sw-addrmethod=VAR_INIT
        VAR_INIT_UNSPECIFIED_ASIL_A: alignment=UNSPECIFIED, size=0, sw-addrmethod=VAR_INIT_ASIL_A
        VAR_NO_INIT_16: alignment=16, size=16, sw-addrmethod=VAR_NOINIT
        VAR_NO_INIT_16_ASIL_A: alignment=16, size=16, sw-addrmethod=VAR_NOINIT_ASIL_A
        VAR_NO_INIT_32: alignment=32, size=32, sw-addrmethod=VAR_NOINIT
        VAR_NO_INIT_32_ASIL_A: alignment=32, size=32, sw-addrmethod=VAR_NOINIT_ASIL_A
        VAR_NO_INIT_8: alignment=8, size=8, sw-addrmethod=VAR_NOINIT
        VAR_NO_INIT_8_ASIL_A: alignment=8, size=8, sw-addrmethod=VAR_NOINIT_ASIL_A
        VAR_NO_INIT_BOOL: alignment=8, size=1, sw-addrmethod=VAR_NOINIT
        VAR_NO_INIT_BOOL_ASIL_A: alignment=8, size=1, sw-addrmethod=VAR_NOINIT_ASIL_A
        VAR_NO_INIT_UNSPECIFIED: alignment=UNSPECIFIED, size=0, sw-addrmethod=VAR_NOINIT
        VAR_NO_INIT_UNSPECIFIED_ASIL_A: alignment=UNSPECIFIED, size=0, sw-addrmethod=VAR_NOINIT_ASIL_A
        VAR_POWER_ON_CLEARED: alignment=UNSPECIFIED, size=0, sw-addrmethod=VAR_POWER_ON_CLEARED
