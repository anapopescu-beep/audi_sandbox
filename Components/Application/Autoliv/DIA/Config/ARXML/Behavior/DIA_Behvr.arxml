AUTOSAR XML (schema 4-2-2)
package /AUTOLIV/SoftwareComponents/DIA
  application sw component type DIA: category=SWC  # DIA_AC_DiagOnCAN
    behavior DIA_IB_0:
      constant-value-mapping=[ConstantsMappingSet_NvmIf, ConstantsMappingSet_STM]
      data-type-mapping=[DataTypeMappingSet_ACC, DataTypeMappingSet_DIA, DataTypeMappingSet_FSM, DataTypeMappingSet_IoHwAb, DataTypeMappingSet_NVP, DataTypeMappingSet_NvmIf, DataTypeMappingSet_RCM, DataTypeMappingSet_SAD, DataTypeMappingSet_STM, DataTypeMappingSet_SpiIf, DataTypeMappingSet_eCS]
      handle-termination-and-restart=NO-SUPPORT
      86 x operation invoked event:
        DIA_evDID_4024_SWSystemTimeData_ReadData: start-on-event=DIA_runDid4024_SWSystemTimeRead, operation=pseDID_4024_SWSystemTime.ReadData
        DIA_evDID_FD00_HWVersion_ReadData: start-on-event=DIA_runDidFD00_HWVersionRead, operation=pseDID_FD00_HWVersion.ReadData
        DIA_evDID_FD01_SWVersion_ReadData: start-on-event=DIA_runDidFD01_SWVersionRead, operation=pseDID_FD01_SWVersion.ReadData
        oie_RoutineServices_RID_F793_ProcessModeRoutine_RequestResults: start-on-event=DIA_runRidF793_ProcessModeRequestRes, operation=pseRoutineControl_ProcessModeRoutine.RequestResults
        oie_RoutineServices_RID_F793_ProcessModeRoutine_Start: start-on-event=DIA_runRidF793_ProcessModeStart, operation=pseRoutineControl_ProcessModeRoutine.Start
        oie_pseCallBackDCMRequestServices_CBReqServInd_1_StartProtocol: start-on-event=DIA_runCallBackDCMRequestServices_CBReqServInd_1_StartProtocol, operation=pseCallBackDCMRequestServices_CBReqServInd_1.StartProtocol
        oie_pseCallBackDCMRequestServices_CBReqServInd_1_StopProtocol: start-on-event=DIA_runCallBackDCMRequestServices_CBReqServInd_1_StopProtocol, operation=pseCallBackDCMRequestServices_CBReqServInd_1.StopProtocol
        oie_pseDID_0236_ProgrammingDataElockEcu_ReadData: start-on-event=DIA_run_Did0236_ProgrammingDataElockEcuRead, operation=pseDID_0236_ProgrammingDataElockEcu.ReadData
        oie_pseDID_0236_ProgrammingDataElockEcu_WriteData: start-on-event=DIA_run_Did0236_ProgrammingDataElockEcuWrite, operation=pseDID_0236_ProgrammingDataElockEcu.WriteData
        oie_pseDID_023E_WSCForProgrammingElockEcu_ReadData: start-on-event=DIA_run_Did023E_WSCForProgrammingElockEcuRead, operation=pseDID_023E_WSCForProgrammingElockEcu.ReadData
        oie_pseDID_023E_WSCForProgrammingElockEcu_WriteData: start-on-event=DIA_run_Did023E_WSCForProgrammingElockEcuWrite, operation=pseDID_023E_WSCForProgrammingElockEcu.WriteData
        oie_pseDID_0407_VWLogicalSoftwareBlockCounterOfProgrammingAttempts_ReadData: start-on-event=DIA_runDid0407_VWLogicalSoftwareBlockCounterOfProgrammingAttemptsRead, operation=pseDID_0407_VWLogicalSoftwareBlockCounterOfProgrammingAttempts.ReadData
        oie_pseDID_040F_VWLogicalSoftwareBlockLockValue_ReadData: start-on-event=DIA_runDid040F_VWLogicalSoftwareBlockLockValueRead, operation=pseDID_040F_VWLogicalSoftwareBlockLockValue.ReadData
        oie_pseDID_0410_BootloaderTPBlocksize_ReadData: start-on-event=DIA_runDid0410_BootloaderTPBlocksizeRead, operation=pseDID_0410_BootloaderTPBlocksize.ReadData
        oie_pseDID_0410_BootloaderTPBlocksize_WriteData: start-on-event=DIA_runDid0410_BootloaderTPBlocksizeWrite, operation=pseDID_0410_BootloaderTPBlocksize.WriteData
        oie_pseDID_0448_ProgrammingPreconditions_ReadData: start-on-event=DIA_runDid0448_ProgrammingPreconditionsRead, operation=pseDID_0448_ProgrammingPreconditions.ReadData
        oie_pseDID_F15B_FingerprintAndProgrammingDateOfLogicalSoftwareBlocks_ReadData: start-on-event=DIA_runDidF15B_FingerprintAndProgrammingDateOfLogicalSoftwareBlocksRead, operation=pseDID_F15B_FingerprintAndProgrammingDateOfLogicalSoftwareBlocks.ReadData
        oie_pseDID_F187_VWSparePartNumber_ReadData: start-on-event=DIA_runDidF187_VWSparePartNumberRead, operation=pseDID_F187_VWSparePartNumber.ReadData
        oie_pseDID_F187_VWSparePartNumber_WriteData: start-on-event=DIA_runDidF187_VWSparePartNumberWrite, operation=pseDID_F187_VWSparePartNumber.WriteData
        oie_pseDID_F189_VWApplicationSoftwareVersionNumber_ReadData: start-on-event=DIA_runDidF189_VWApplicationSoftwareVersionNumberRead, operation=pseDID_F189_VWApplicationSoftwareVersionNumber.ReadData
        oie_pseDID_F189_VWApplicationSoftwareVersionNumber_WriteData: start-on-event=DIA_runDidF189_VWApplicationSoftwareVersionNumberWrite, operation=pseDID_F189_VWApplicationSoftwareVersionNumber.WriteData
        oie_pseDID_F18C_ECUSerialNumberData_ReadData: start-on-event=DIA_runDidF18C_ECUSerialNumberRead, operation=pseDID_F18C_ECUSerialNumberData.ReadData
        oie_pseDID_F18C_ECUSerialNumberData_WriteData: start-on-event=DIA_runDidF18C_ECUSerialNumberWrite, operation=pseDID_F18C_ECUSerialNumberData.WriteData
        oie_pseDID_F191_VWECUHardwareNumber_ReadData: start-on-event=DIA_runDidF191_VWLogicalSoftwareBlockLockValueRead, operation=pseDID_F191_VWECUHardwareNumber.ReadData
        oie_pseDID_F191_VWECUHardwareNumber_WriteData: start-on-event=DIA_runDidF191_VWECUHardwareNumberWrite, operation=pseDID_F191_VWECUHardwareNumber.WriteData
        oie_pseDID_F197_VWSystemNameOrEngineType_ReadData: start-on-event=DIA_runDidF197_VWSystemNameOrEngineTypeRead, operation=pseDID_F197_VWSystemNameOrEngineType.ReadData
        oie_pseDID_F197_VWSystemNameOrEngineType_WriteData: start-on-event=DIA_runDidF197_VWSystemNameOrEngineTypeWrite, operation=pseDID_F197_VWSystemNameOrEngineType.WriteData
        oie_pseDID_F19E_ASAMODXFileIdentifier_ReadData: start-on-event=DIA_runDidF19E_ASAMODXFileIdentifierRead, operation=pseDID_F19E_ASAMODXFileIdentifier.ReadData
        oie_pseDID_F19E_ASAMODXFileIdentifier_WriteData: start-on-event=DIA_runDidF19E_ASAMODXFileIdentifierWrite, operation=pseDID_F19E_ASAMODXFileIdentifier.WriteData
        oie_pseDID_F1A2_ASAMODXFileVersion_ReadData: start-on-event=DIA_runDidF1A2_ASAMODXFileVersionRead, operation=pseDID_F1A2_ASAMODXFileVersion.ReadData
        oie_pseDID_F1A2_ASAMODXFileVersion_WriteData: start-on-event=DIA_runDidF1A2_ASAMODXFileVersionWrite, operation=pseDID_F1A2_ASAMODXFileVersion.WriteData
        oie_pseDID_F1A3_VWECUHardwareVersionNumber_ReadData: start-on-event=DIA_runDidF1A3_VWECUHardwareVersionNumberRead, operation=pseDID_F1A3_VWECUHardwareVersionNumber.ReadData
        oie_pseDID_F1A3_VWECUHardwareVersionNumber_WriteData: start-on-event=DIA_runDidF1A3_VWECUHardwareVersionNumberWrite, operation=pseDID_F1A3_VWECUHardwareVersionNumber.WriteData
        oie_pseDID_F1AB_VWLogicalSoftwareBlockVersion_ReadData: start-on-event=DIA_runDidF1AB_VWLogicalSoftwareBlockVersionRead, operation=pseDID_F1AB_VWLogicalSoftwareBlockVersion.ReadData
        oie_pseDID_F1B4_TechnicalSpecificationsVersion_ReadData: start-on-event=DIA_runDidF1B4_TechnicalSpecificationsVersionRead, operation=pseDID_F1B4_TechnicalSpecificationsVersion.ReadData
        oie_pseDID_F1D5_FDSProject_ReadData: start-on-event=DIA_runDidF1D5_FDSProjectDataRead, operation=pseDID_F1D5_FDSProject.ReadData
        oie_pseDID_F1DF_ECUProgrammingInformation_ReadData_0: start-on-event=DIA_runDidF1DF_ECUProgrammingInformationRead, operation=pseDID_F1DF_ECUProgrammingInformation.ReadData
        oie_pseDID_FD00_HWVersion_WriteData: start-on-event=DIA_runDidFD00_HWVersionWrite, operation=pseDID_FD00_HWVersion.WriteData
        oie_pseDID_FD03_AEETraceabilityNumber_ReadData: start-on-event=DIA_runDidFD03_AEETraceabilityNumberRead, operation=pseDID_FD03_AEETraceabilityNumber.ReadData
        oie_pseDID_FD03_AEETraceabilityNumber_WriteData: start-on-event=DIA_runDidFD03_AEETraceabilityNumberWrite, operation=pseDID_FD03_AEETraceabilityNumber.WriteData
        oie_pseDID_FD08_ResetCause_ReadData: start-on-event=DIA_runDidFD08_ResetCauseRead, operation=pseDID_FD08_ResetCause.ReadData
        oie_pseDID_FD09_LastWarmResetParam_ReadData: start-on-event=DIA_runDidFD09_LastWarmResetParamRead, operation=pseDID_FD09_LastWarmResetParam.ReadData
        oie_pseDID_FD0F_BatteryMeasure_ReadData: start-on-event=DIA_runDid_FD0F_BatteryMeasureRead, operation=pseDID_FD0F_BatteryMeasure.ReadData
        oie_pseDID_FD10_ECUTemperature_ReadData: start-on-event=DIA_run_DidFD10_ECUTemperatureRead, operation=pseDID_FD10_ECUTemperature.ReadData
        oie_pseDID_FD62_EccOccurenceNb_ReadData: start-on-event=DIA_runDidFD62_EccOccurenceNbRead, operation=pseDID_FD62_EccOccurenceNb.ReadData
        oie_pseDID_FD8B_ECUManufacturingDate_ReadData: start-on-event=DIA_runDidFD8B_ECUManufacturingDateRead, operation=pseDID_FD8B_ECUManufacturingDate.ReadData
        oie_pseDID_FD8B_ECUManufacturingDate_WriteData: start-on-event=DIA_runDidFD8B_ECUManufacturingDateWrite, operation=pseDID_FD8B_ECUManufacturingDate.WriteData
        oie_pseDID_FD8C_AssemblySerialNumber_ReadData: start-on-event=DIA_runDidFD8C_AssemblySerialNumberRead, operation=pseDID_FD8C_AssemblySerialNumber.ReadData
        oie_pseDID_FD8C_AssemblySerialNumber_WriteData: start-on-event=DIA_runDidFD8C_AssemblySerialNumberWrite, operation=pseDID_FD8C_AssemblySerialNumber.WriteData
        oie_pseDID_FDE0_EcsVariant_ReadData: start-on-event=DIA_runDidFDE0_EcsVariantRead, operation=pseDID_FDE0_EcsVariant.ReadData
        oie_pseDID_FDE0_EcsVariant_WriteData: start-on-event=DIA_runDidFDE0_EcsVariantWrite, operation=pseDID_FDE0_EcsVariant.WriteData
        oie_pseDID_FDE1_EcsParameters_ReadData: start-on-event=DIA_runDidFDE1_EcsParametersRead, operation=pseDID_FDE1_EcsParameters.ReadData
        oie_pseDID_FDE1_EcsParameters_WriteData: start-on-event=DIA_runDidFDE1_EcsParametersWrite, operation=pseDID_FDE1_EcsParameters.WriteData
        oie_pseDID_FDE2_EcsAccOffsets_ReadData: start-on-event=DIA_runDidFDE2_EcsAccOffsetsRead, operation=pseDID_FDE2_EcsAccOffsets.ReadData
        oie_pseDID_FDE2_EcsAccOffsets_WriteData: start-on-event=DIA_runDidFDE2_EcsAccOffsetsWrite, operation=pseDID_FDE2_EcsAccOffsets.WriteData
        oie_pseDID_FDE3_EcsProfiles_ReadData: start-on-event=DIA_runDidFDE3_EcsProfilesRead, operation=pseDID_FDE3_EcsProfiles.ReadData
        oie_pseDID_FDE3_EcsProfiles_WriteData: start-on-event=DIA_runDidFDE3_EcsProfilesWrite, operation=pseDID_FDE3_EcsProfiles.WriteData
        oie_pseDID_FDE4_EcsSteps_ReadData: start-on-event=DIA_runDidFDE4_EcsStepsRead, operation=pseDID_FDE4_EcsSteps.ReadData
        oie_pseDID_FDE4_EcsSteps_WriteData: start-on-event=DIA_runDidFDE4_EcsStepsWrite, operation=pseDID_FDE4_EcsSteps.WriteData
        oie_pseDID_FDE5_EcsAccLowPass_ReadData: start-on-event=DIA_runDidFDE5_EcsAccLowPassRead, operation=pseDID_FDE5_EcsAccLowPass.ReadData
        oie_pseDID_FDE5_EcsAccLowPass_WriteData: start-on-event=DIA_runDidFDE5_EcsAccLowPassWrite, operation=pseDID_FDE5_EcsAccLowPass.WriteData
        oie_pseDID_FDE7_EcsAlgoOutputDelay_ReadData: start-on-event=DIA_runDidFDE7_EcsAlgoOutputDelayRead, operation=pseDID_FDE7_EcsAlgoOutputDelay.ReadData
        oie_pseDID_FDE7_EcsAlgoOutputDelay_WriteData: start-on-event=DIA_runDidFDE7_EcsAlgoOutputDelayWrite, operation=pseDID_FDE7_EcsAlgoOutputDelay.WriteData
        oie_pseDID_FDE9_SensitivityLutData_ReadData: start-on-event=DIA_runDidFDE9_EcsSensitivityLutRead, operation=pseDID_FDE9_SensitivityLutData.ReadData
        oie_pseDID_FDE9_SensitivityLutData_WriteData: start-on-event=DIA_runDidFDE9_EcsSensitivityLutWrite, operation=pseDID_FDE9_SensitivityLutData.WriteData
        oie_pseDID_FDEA_SensitivityOptData_ReadData: start-on-event=DIA_runDidFDEA_EcsSensitivityOptRead, operation=pseDID_FDEA_SensitivityOptData.ReadData
        oie_pseDID_FDEA_SensitivityOptData_WriteData: start-on-event=DIA_runDidFDEA_EcsSensitivityOptWrite, operation=pseDID_FDEA_SensitivityOptData.WriteData
        oie_pseDID_FDFF_MeasurementFrameRamConf_ReadData: start-on-event=DIA_runDidFDFF_MeasurementFrameRamConfRead, operation=pseDID_FDFF_MeasurementFrameRamConf.ReadData
        oie_pseDID_FDFF_MeasurementFrameRamConf_WriteData: start-on-event=DIA_runDidFDFF_MeasurementFrameRamConfWrite, operation=pseDID_FDFF_MeasurementFrameRamConf.WriteData
        oie_pseDID_FE00_AllEventStatusesRead_ReadData: start-on-event=DIA_runDidFE00_AllEventStatusesRead, operation=pseDID_FE00_AllEventStatusesRead.ReadData
        oie_pseDID_FEFF_MeasurementFramesConf_ReadData: start-on-event=DIA_runDidFEFF_MeasurementFramesConfRead, operation=pseDID_FEFF_MeasurementFramesConf.ReadData
        oie_pseDID_FEFF_MeasurementFramesConf_WriteData: start-on-event=DIA_runDidFEFF_MeasurementFramesConfWrite, operation=pseDID_FEFF_MeasurementFramesConf.WriteData
        oie_pseRID_F793_ProcessModeRoutine_Stop: start-on-event=DIA_runRidF793_ProcessModeStop, operation=pseRoutineControl_ProcessModeRoutine.Stop
        oie_pseRoutineControl_AccAngleOffsetCalibration_Start: start-on-event=DIA_runRidF797_AccAngleOffsetCalibrationStart, operation=pseRoutineControl_AccAngleOffsetCalibration.Start
        oie_pseRoutineControl_AccCalib_Start: start-on-event=DIA_runRidF794_AccCalibStart, operation=pseRoutineControl_AccCalib.Start
        oie_pseRoutineControl_CheckProgrammingPreconditions_Start: start-on-event=DIA_runRid0203_CheckProgrammingPreconditions, operation=pseRoutineControl_CheckProgrammingPreconditions.Start
        oie_pseRoutineControl_EcuTempCalibration_Start: start-on-event=DIA_runRidF796_EcuTempCalibration, operation=pseRoutineControl_EcuTempCalibration.Start
        oie_pseRoutineControl_LockSolenoid_Start: start-on-event=DIA_runRidF795_LockSolenoidStart, operation=pseRoutineControl_LockSolenoid.Start
        oie_pseRoutineControl_LockSolenoid_Stop: start-on-event=DIA_runRidF795_LockSolenoidStop, operation=pseRoutineControl_LockSolenoid.Stop
        oie_pseRoutineControl_LockUnlockECU_RequestResults: start-on-event=DIA_runRidF781_EcuUnlockRequestRes, operation=pseRoutineControl_LockUnlockECU.RequestResults
        oie_pseRoutineControl_LockUnlockECU_Start: start-on-event=DIA_runRidF781_EcuUnlockStart, operation=pseRoutineControl_LockUnlockECU.Start
        oie_pseRoutineControl_LockUnlockECU_Stop: start-on-event=DIA_runRidF781_EcuUnlockStop, operation=pseRoutineControl_LockUnlockECU.Stop
        oie_pseSecurityAccess_CompareKey: start-on-event=DIA_runSecurityAccessCompareKey, operation=pseSecurityAccess.CompareKey
        oie_pseSecurityAccess_GetSeed: start-on-event=DIA_runSecurityAccessGetSeed, operation=pseSecurityAccess.GetSeed
        oie_pseServiceRequestSupplierNotification_Confirmation: start-on-event=DIA_runServiceRequestConfirmation, operation=pseServiceRequestSupplierNotification.Confirmation
        oie_pseServiceRequestSupplierNotification_Indication: start-on-event=DIA_runServiceRequestIndication, operation=pseServiceRequestSupplierNotification.Indication
      88 x runnable:
        DIA_Init: can-be-invoked-concurrently=true, external-triggering-point=ptrpDiaServicesBswMIf.DIA_Init
          sync call scp_GetNvmBlockStatus: operation=pclNvmIfServices.GetNvmBlockStatus, timeout=0.0
          sync call scp_WriteNvmBlock: operation=pclNvmIfServices.WriteNvmBlock, timeout=0.0
        DIA_runCallBackDCMRequestServices_CBReqServInd_1_StartProtocol: can-be-invoked-concurrently=true
        DIA_runCallBackDCMRequestServices_CBReqServInd_1_StopProtocol: can-be-invoked-concurrently=true, symbol=DIA_runRte_Call_Dcm_CallBackDCMRequestServices_CBReqServInd_1_StopProtocol
        DIA_runDid0407_VWLogicalSoftwareBlockCounterOfProgrammingAttemptsRead
        DIA_runDid040F_VWLogicalSoftwareBlockLockValueRead
        DIA_runDid0410_BootloaderTPBlocksizeRead
        DIA_runDid0410_BootloaderTPBlocksizeWrite
        DIA_runDid0448_ProgrammingPreconditionsRead
        DIA_runDid4024_SWSystemTimeRead: can-be-invoked-concurrently=true
          sync call SSCP_pclSystemTime_ReadAbsoluteSystemTime: operation=pclSystemTime.ReadAbsoluteSystemTime, timeout=0.0
        DIA_runDidF15B_FingerprintAndProgrammingDateOfLogicalSoftwareBlocksRead
        DIA_runDidF187_VWSparePartNumberRead
        DIA_runDidF187_VWSparePartNumberWrite
        DIA_runDidF189_VWApplicationSoftwareVersionNumberRead
        DIA_runDidF189_VWApplicationSoftwareVersionNumberWrite
        DIA_runDidF18C_ECUSerialNumberRead
        DIA_runDidF18C_ECUSerialNumberWrite
        DIA_runDidF191_VWECUHardwareNumberWrite
        DIA_runDidF191_VWLogicalSoftwareBlockLockValueRead: symbol=DIA_runDidF191_VWECUHardwareNumberRead
        DIA_runDidF197_VWSystemNameOrEngineTypeRead
        DIA_runDidF197_VWSystemNameOrEngineTypeWrite
        DIA_runDidF19E_ASAMODXFileIdentifierRead
        DIA_runDidF19E_ASAMODXFileIdentifierWrite
        DIA_runDidF1A2_ASAMODXFileVersionRead
        DIA_runDidF1A2_ASAMODXFileVersionWrite
        DIA_runDidF1A3_VWECUHardwareVersionNumberRead
        DIA_runDidF1A3_VWECUHardwareVersionNumberWrite
        DIA_runDidF1AB_VWLogicalSoftwareBlockVersionRead
        DIA_runDidF1B4_TechnicalSpecificationsVersionRead
        DIA_runDidF1D5_FDSProjectDataRead
        DIA_runDidF1DF_ECUProgrammingInformationRead
        DIA_runDidFD00_HWVersionRead
        DIA_runDidFD00_HWVersionWrite
        DIA_runDidFD01_SWVersionRead: can-be-invoked-concurrently=true
        DIA_runDidFD03_AEETraceabilityNumberRead
        DIA_runDidFD03_AEETraceabilityNumberWrite
        DIA_runDidFD08_ResetCauseRead: can-be-invoked-concurrently=true
          sync call scp_GetResetCause: operation=pclResetCause.GetResetCause, timeout=0.0
        DIA_runDidFD09_LastWarmResetParamRead: can-be-invoked-concurrently=true
        DIA_runDidFD62_EccOccurenceNbRead: can-be-invoked-concurrently=true
        DIA_runDidFD8B_ECUManufacturingDateRead: can-be-invoked-concurrently=true
        DIA_runDidFD8B_ECUManufacturingDateWrite
        DIA_runDidFD8C_AssemblySerialNumberRead
        DIA_runDidFD8C_AssemblySerialNumberWrite
        DIA_runDidFDE0_EcsVariantRead
        DIA_runDidFDE0_EcsVariantWrite
        DIA_runDidFDE1_EcsParametersRead
        DIA_runDidFDE1_EcsParametersWrite
        DIA_runDidFDE2_EcsAccOffsetsRead
        DIA_runDidFDE2_EcsAccOffsetsWrite
        DIA_runDidFDE3_EcsProfilesRead
        DIA_runDidFDE3_EcsProfilesWrite
          sync call scp_calculateProfileTimeout: operation=pclFsmServices.calculateProfileTimeout, timeout=0.0
        DIA_runDidFDE4_EcsStepsRead
        DIA_runDidFDE4_EcsStepsWrite
        DIA_runDidFDE5_EcsAccLowPassRead
        DIA_runDidFDE5_EcsAccLowPassWrite
        DIA_runDidFDE7_EcsAlgoOutputDelayRead: symbol=DIA_runDIDFDE7_EcsAlgoOutputDelayRead
        DIA_runDidFDE7_EcsAlgoOutputDelayWrite: symbol=DIA_runDIDFDE7_EcsAlgoOutputDelayWrite
        DIA_runDidFDE9_EcsSensitivityLutRead
        DIA_runDidFDE9_EcsSensitivityLutWrite
        DIA_runDidFDEA_EcsSensitivityOptRead
        DIA_runDidFDEA_EcsSensitivityOptWrite
        DIA_runDidFDFF_MeasurementFrameRamConfRead
        DIA_runDidFDFF_MeasurementFrameRamConfWrite: can-be-invoked-concurrently=true
        DIA_runDidFE00_AllEventStatusesRead: can-be-invoked-concurrently=true
          sync call scp_GetEventStatus: operation=pclDemServices.GetEventStatus, timeout=0.0
        DIA_runDidFEFF_MeasurementFramesConfRead: can-be-invoked-concurrently=true
        DIA_runDidFEFF_MeasurementFramesConfWrite: can-be-invoked-concurrently=true
        DIA_runDid_FD0F_BatteryMeasureRead
          sync call scp_getMeasure: operation=pclConvAdcService.getMeasure, timeout=0.0
        DIA_runRid0203_CheckProgrammingPreconditions
        DIA_runRidF781_EcuUnlockRequestRes
        DIA_runRidF781_EcuUnlockStart
        DIA_runRidF781_EcuUnlockStop
        DIA_runRidF793_ProcessModeRequestRes
          sync call scp_GetNvmBlockLength: operation=pclNvmIfServices.GetNvmBlockLength, timeout=0.0
        DIA_runRidF793_ProcessModeStart
        DIA_runRidF793_ProcessModeStop
        DIA_runRidF794_AccCalibStart
          data-receive-point-by-arguments:
            access drparg_st3DAccel: accessed-variable=prr3DAcceleration.st3DAccel
        DIA_runRidF795_LockSolenoidStart: sw-addr-method=CODE_ASIL_A
          data-send-points:
            access dsp_u8DiagReq: accessed-variable=pseEcsDiagRequest.au8DiagReq
            access dsp_u8DiagReqComplement: accessed-variable=pseEcsDiagRequest.au8DiagReqComplement
        DIA_runRidF795_LockSolenoidStop: sw-addr-method=CODE_ASIL_A
          data-send-points:
            access dsp_u8DiagReq: accessed-variable=pseEcsDiagRequest.au8DiagReq
        DIA_runRidF796_EcuTempCalibration
          4 x sync call, all with timeout=0.0:
            scp_GetTemperature: operation=pclAccSensor.GetTemperature
            scp_GetTemperature1: operation=pclMcuCharacteristics.GetTemperature
            scp_GetTemperature2: operation=pclPtcSensor.GetTemperature
            scp_SetRamBlockStatus: operation=pclNvmIfServices.SetRamBlockStatus
        DIA_runRidF797_AccAngleOffsetCalibrationStart
        DIA_runSecurityAccessCompareKey: can-be-invoked-concurrently=true  # To compare the key provided bi the tested tool with the expected one
        DIA_runSecurityAccessGetSeed: can-be-invoked-concurrently=true  # TO provide the requested seed
          sync call scp_ReadAbsoluteSystemTime1: operation=pclSystemTime.ReadAbsoluteSystemTime, timeout=0.0
        DIA_runServiceRequestConfirmation
        DIA_runServiceRequestIndication
        DIA_runSessionChangeIndication: can-be-invoked-concurrently=true  # To indicate that session has changed
        DIA_run_Did0236_ProgrammingDataElockEcuRead
        DIA_run_Did0236_ProgrammingDataElockEcuWrite
        DIA_run_Did023E_WSCForProgrammingElockEcuRead
        DIA_run_Did023E_WSCForProgrammingElockEcuWrite
        DIA_run_DidFD10_ECUTemperatureRead
          sync call scp_GetTemperature: operation=pclEcuCharacterstics.GetTemperature, timeout=0.0
          sync call scp_getMeasure: operation=pclConvAdcService.getMeasure, timeout=0.0
  swc implementation DIA_imp: category=SWC, programming-language=C, sw-version=1.0.0, vendor-id=0, behavior=DIA_IB_0
    code-descriptors:
      code DIA_Impl_Code: artifact-descriptors=autosar-engineering-object={short-label=DIA_Impl_Code_CodeDesc, category=SWSRC}
    resource consumption DIA_Impl_ResCons
      33 x memory section:
        CODE: size=0, sw-addrmethod=CODE
        CODE_ASIL_A: size=0, sw-addrmethod=CODE_ASIL_A
        CONST_16: alignment=16, size=16, sw-addrmethod=CONST
        CONST_16_ASIL_A: alignment=16, size=16, sw-addrmethod=CONST_ASIL_A
        CONST_32: alignment=32, size=32, sw-addrmethod=CONST
        CONST_32_ASIL_A: alignment=32, size=32, sw-addrmethod=CONST_ASIL_A
        CONST_8: alignment=8, size=8, sw-addrmethod=CONST
        CONST_8_ASIL_A: alignment=8, size=8, sw-addrmethod=CONST_ASIL_A
        CONST_BOOL: alignment=8, size=1, sw-addrmethod=CONST
        CONST_BOOL_ASIL_A: alignment=8, size=1, sw-addrmethod=CONST_ASIL_A
        CONST_UNSPECIFIED: alignment=UNSPECIFIED, size=0, sw-addrmethod=CONST
        CONST_UNSPECIFIED_ASIL_A: alignment=UNSPECIFIED, size=0, sw-addrmethod=CONST_ASIL_A
        VAR_INIT_16: alignment=16, size=16, sw-addrmethod=VAR_INIT
        VAR_INIT_16_ASIL_A: alignment=16, size=16, sw-addrmethod=VAR_INIT_ASIL_A
        VAR_INIT_32: alignment=32, size=32, sw-addrmethod=VAR_INIT
        VAR_INIT_32_ASIL_A: alignment=32, size=32, sw-addrmethod=VAR_INIT_ASIL_A
        VAR_INIT_8: alignment=8, size=8, sw-addrmethod=VAR_INIT
        VAR_INIT_8_ASIL_A: alignment=8, size=8, sw-addrmethod=VAR_INIT_ASIL_A
        VAR_INIT_BOOL: alignment=8, size=1, sw-addrmethod=VAR_INIT
        VAR_INIT_BOOL_ASIL_A: alignment=8, size=1, sw-addrmethod=VAR_INIT_ASIL_A
        VAR_INIT_UNSPECIFIED: alignment=UNSPECIFIED, size=0, sw-addrmethod=VAR_INIT
        VAR_INIT_UNSPECIFIED_ASIL_A: alignment=UNSPECIFIED, size=0, sw-addrmethod=VAR_INIT_ASIL_A
        VAR_NO_INIT_16: alignment=16, size=16, sw-addrmethod=VAR_NOINIT
        VAR_NO_INIT_16_ASIL_A: alignment=16, size=16, sw-addrmethod=VAR_NOINIT_ASIL_A
        VAR_NO_INIT_32: alignment=32, size=32, sw-addrmethod=VAR_NOINIT
        VAR_NO_INIT_32_ASIL_A: alignment=32, size=32, sw-addrmethod=VAR_NOINIT_ASIL_A
        VAR_NO_INIT_8: alignment=8, size=8, sw-addrmethod=VAR_NOINIT
        VAR_NO_INIT_8_ASIL_A: alignment=8, size=8, sw-addrmethod=VAR_NOINIT_ASIL_A
        VAR_NO_INIT_BOOL: alignment=8, size=1, sw-addrmethod=VAR_NOINIT
        VAR_NO_INIT_BOOL_ASIL_A: alignment=8, size=1, sw-addrmethod=VAR_NOINIT_ASIL_A
        VAR_NO_INIT_UNSPECIFIED: alignment=UNSPECIFIED, size=0, sw-addrmethod=VAR_NOINIT
        VAR_NO_INIT_UNSPECIFIED_ASIL_A: alignment=UNSPECIFIED, size=0, sw-addrmethod=VAR_NOINIT_ASIL_A
        VAR_POWER_ON_CLEARED: alignment=UNSPECIFIED, size=0, sw-addrmethod=VAR_POWER_ON_CLEARED
