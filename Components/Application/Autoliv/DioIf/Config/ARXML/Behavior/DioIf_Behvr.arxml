AUTOSAR XML (schema 4-2-2)
package /AUTOLIV/SoftwareComponents/DioIf
  complex device driver sw component type DioIf: category=MCAL_IO_Drivers
    behavior DioIf_IB: data-type-mapping=DataTypeMappingSet_DioIf, handle-termination-and-restart=NO-SUPPORT
      operation invoked event oie_psrDioIfServices_ReadChannel: start-on-event=DioIf_runReadChannel, operation=psrDioIfServices.ReadChannel
      operation invoked event oie_psrDioIfServices_WriteChannel: start-on-event=DioIf_runWriteChannel, operation=psrDioIfServices.WriteChannel
      external trigger occurred event trDio_ReadChannel: start-on-event=DioIf_Init, trigger=ptrrAsrDioServicesDioIf.Dio_ReadChannel
      external trigger occurred event trDio_WriteChannel: start-on-event=DioIf_Init, trigger=ptrrAsrDioServicesDioIf.Dio_WriteChannel
      runnable DioIf_Init: sw-addr-method=CODE_ASIL_A, external-triggering-point=ptrpEcuMIfServicesDioIf.DioIf_Init
      runnable DioIf_runReadChannel: sw-addr-method=CODE_ASIL_A, can-be-invoked-concurrently=true
      runnable DioIf_runWriteChannel: sw-addr-method=CODE_ASIL_A, can-be-invoked-concurrently=true
  swc implementation DioIf_imp: category=MCAL_IO_Drivers, programming-language=C, sw-version=1.0.0, vendor-id=0, behavior=DioIf_IB
    code-descriptors:
      code DioIf_Impl_Code: artifact-descriptors=autosar-engineering-object={short-label=DioIf_Impl_Code_CodeDesc, category=SWSRC}
    resource consumption DioIf_Impl_ResCons
      33 x memory section:
        CODE: size=0, sw-addrmethod=CODE
        CODE_ASIL_A: size=0, sw-addrmethod=CODE_ASIL_A
        CONST_16: alignment=16, size=16, sw-addrmethod=CONST
        CONST_16_ASIL_A: alignment=16, size=16, sw-addrmethod=CONST_ASIL_A
        CONST_32: alignment=32, size=32, sw-addrmethod=CONST
        CONST_32_ASIL_A: alignment=32, size=32, sw-addrmethod=CONST_ASIL_A
        CONST_8: alignment=8, size=8, sw-addrmethod=CONST
        CONST_8_ASIL_A: alignment=8, size=8, sw-addrmethod=CONST_ASIL_A
        CONST_BOOL: alignment=8, size=1, sw-addrmethod=CONST
        CONST_BOOL_ASIL_A: alignment=8, size=1, sw-addrmethod=CONST_ASIL_A
        CONST_UNSPECIFIED: alignment=UNSPECIFIED, size=0, sw-addrmethod=CONST
        CONST_UNSPECIFIED_ASIL_A: alignment=UNSPECIFIED, size=0, sw-addrmethod=CONST_ASIL_A
        VAR_INIT_16: alignment=16, size=16, sw-addrmethod=VAR_INIT
        VAR_INIT_16_ASIL_A: alignment=16, size=16, sw-addrmethod=VAR_INIT_ASIL_A
        VAR_INIT_32: alignment=32, size=32, sw-addrmethod=VAR_INIT
        VAR_INIT_32_ASIL_A: alignment=32, size=32, sw-addrmethod=VAR_INIT_ASIL_A
        VAR_INIT_8: alignment=8, size=8, sw-addrmethod=VAR_INIT
        VAR_INIT_8_ASIL_A: alignment=8, size=8, sw-addrmethod=VAR_INIT_ASIL_A
        VAR_INIT_BOOL: alignment=8, size=1, sw-addrmethod=VAR_INIT
        VAR_INIT_BOOL_ASIL_A: alignment=8, size=1, sw-addrmethod=VAR_INIT_ASIL_A
        VAR_INIT_UNSPECIFIED: alignment=UNSPECIFIED, size=0, sw-addrmethod=VAR_INIT
        VAR_INIT_UNSPECIFIED_ASIL_A: alignment=UNSPECIFIED, size=0, sw-addrmethod=VAR_INIT_ASIL_A
        VAR_NO_INIT_16: alignment=16, size=16, sw-addrmethod=VAR_NOINIT
        VAR_NO_INIT_16_ASIL_A: alignment=16, size=16, sw-addrmethod=VAR_NOINIT_ASIL_A
        VAR_NO_INIT_32: alignment=32, size=32, sw-addrmethod=VAR_NOINIT
        VAR_NO_INIT_32_ASIL_A: alignment=32, size=32, sw-addrmethod=VAR_NOINIT_ASIL_A
        VAR_NO_INIT_8: alignment=8, size=8, sw-addrmethod=VAR_NOINIT
        VAR_NO_INIT_8_ASIL_A: alignment=8, size=8, sw-addrmethod=VAR_NOINIT_ASIL_A
        VAR_NO_INIT_BOOL: alignment=8, size=1, sw-addrmethod=VAR_NOINIT
        VAR_NO_INIT_BOOL_ASIL_A: alignment=8, size=1, sw-addrmethod=VAR_NOINIT_ASIL_A
        VAR_NO_INIT_UNSPECIFIED: alignment=UNSPECIFIED, size=0, sw-addrmethod=VAR_NOINIT
        VAR_NO_INIT_UNSPECIFIED_ASIL_A: alignment=UNSPECIFIED, size=0, sw-addrmethod=VAR_NOINIT_ASIL_A
        VAR_POWER_ON_CLEARED: alignment=UNSPECIFIED, size=0, sw-addrmethod=VAR_POWER_ON_CLEARED
