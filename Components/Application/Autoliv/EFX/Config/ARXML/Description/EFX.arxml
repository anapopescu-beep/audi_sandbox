AUTOSAR XML (schema 4-2-2)
package /AUTOLIV/SoftwareComponents/EFX
  ecu abstraction sw component type EFX: category=ECU_HW_Abstraction
    provide port pseEfxServices: server-com-spec{operation=LPF_Filter, queue-length=1}, provided-interface=icsEfxServices  # # Architecture Element ID - ARCH_SW_EFX_pseEfxServices_EFX_LPF_Filter_u16_u16 # Description - The interface shall read the {Current value} and filter it via a first order low pass filter - The interface shall output the result via the {Filtered value} output parameter # Data Flow ## Inputs - {Current value} - Has to conform to uint16 range ## Outputs - {Filtered value} - Has to conform to uint16 range for EFX_LPF_Filter_u16_u16 # Linked Runnable - EFX_LPF_Filter_u16_u16 #Traceability -------------------------------------------------------------------------------------------------------------------- # Architecture Element ID - ARCH_SW_EFX_pseEfxServices_Efx_HystCenterHalfDelta_u16_u8 # Description - The interface shall read the {Current value} and filter it via a first order low pass filter - The interface shall output the result via the {Filtered value} output parameter # Data Flow ## Inputs - {Current value} - Has to conform to uint16 range ## Outputs - {Filtered value} - Has to conform to uint8 range for Efx_HystCenterHalfDelta_u16_u8 # Linked Runnable - Efx_HystCenterHalfDelta_u16_u8 #Traceability
