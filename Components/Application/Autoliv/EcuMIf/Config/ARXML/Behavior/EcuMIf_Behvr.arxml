AUTOSAR XML (schema 4-2-2)
package /AUTOLIV/SoftwareComponents/EcuMIf
  application sw component type EcuMIf: category=BSW_System_Services
    behavior EcuMIf_IB: data-type-mapping=[DataTypeMappingSet_EcuMIf, DataTypeMappingSet_RCM], handle-termination-and-restart=NO-SUPPORT
      13 x external trigger occurred event:
        trAdcIf_Calib: start-on-event=EcuM_DefaultInitListOne, trigger=ptrrEcuMIfServicesAdcIf.AdcIf_Calib
        trAdc_Init: start-on-event=EcuM_DefaultInitListOne, trigger=ptrrAsrAdcServicesEcuMIf.Adc_Init
        trCanIf_CheckValidation: start-on-event=EcuM_CheckValidation, trigger=ptrrAsrCanIfServicesEcuMIf.CanIf_CheckValidation
        trCanIf_SetControllerMode: start-on-event=EcuM_StartWakeupSources, trigger=ptrrAsrCanIfServicesEcuMIf.CanIf_SetControllerMode
        trCanIf_SetControllerMode_EcuM_StopWakeupSources: start-on-event=EcuM_StopWakeupSources, trigger=ptrrAsrCanIfServicesEcuMIf.CanIf_SetControllerMode
        trCan_Init: start-on-event=EcuM_DefaultInitListOne, trigger=ptrrAsrCanServicesEcuMIf.Can_Init
        trDem_PreInit: start-on-event=EcuM_DefaultInitListOne, trigger=ptrrAsrDemServicesEcuMIf.Dem_Init
        trDioIf_Init: start-on-event=EcuM_DefaultInitListOne, trigger=ptrrEcuMIfServicesDioIf.DioIf_Init
        trFee_Init: start-on-event=EcuM_DefaultInitListOne, trigger=ptrrAsrFeeServicesEcuMIf.Fee_Init
        trFls_Init: start-on-event=EcuM_DefaultInitListOne, trigger=ptrrAsrFlsServicesEcuMIf.Fls_Init
        trMcu_Init: start-on-event=EcuM_DefaultInitListOne, trigger=ptrrAsrMcuServicesEcuMIf.Mcu_Init
        trPwm_Init: start-on-event=EcuM_DefaultInitListOne, trigger=ptrrAsrPwmServicesEcuMIf.Pwm_Init
        trSpi_Init: start-on-event=EcuM_DefaultInitListOne, trigger=ptrrSpiServicesEcuMIf.Spi_Init
      21 x runnable:
        Can_CheckWakeup: external-triggering-point=ptrpAsrCanServicesEcuMIf.Can_CheckWakeup, symbol=Can_CheckWakeup_symb
        EcuM_AL_DriverInitOne: external-triggering-point=ptrpAsrEcuMServicesEcuMIf.EcuM_AL_DriverInitOne, symbol=EcuM_AL_DriverInitOne_symb
        EcuM_AL_Reset: external-triggering-point=ptrpAsrEcuMServicesEcuMIf.EcuM_AL_Reset, symbol=EcuM_AL_Reset_symb
          sync call scp_SBC_Reset: operation=pclSbcServices.SBC_Reset, timeout=0.0
        EcuM_AL_SetProgrammableInterrupts: external-triggering-point=ptrpAsrEcuMServicesEcuMIf.EcuM_AL_SetProgrammableInterrupts, symbol=EcuM_AL_SetProgrammableInterrupts_symb
        EcuM_AL_SwitchOff: external-triggering-point=ptrpAsrEcuMServicesEcuMIf.EcuM_AL_SwitchOff, symbol=EcuM_AL_SwitchOff_symb
          sync call scp_NotifyResetCause: operation=pclNotifyResetCause.NotifyResetCause, timeout=0.0
          sync call scp_SBC_Shutdown: operation=pclSbcServices.SBC_Shutdown, timeout=0.0
        EcuM_CheckRamHash: external-triggering-point=ptrpAsrEcuMServicesEcuMIf.EcuM_CheckRamHash, symbol=EcuM_CheckRamHash_symb
        EcuM_CheckValidation: external-triggering-point=ptrpAsrEcuMServicesEcuMIf.EcuM_CheckValidation, symbol=EcuM_CheckValidation_symb
        EcuM_CheckWakeup: external-triggering-point=ptrpAsrEcuMServicesEcuMIf.EcuM_CheckWakeup, symbol=EcuM_CheckWakeup_symb
        EcuM_DefaultInitListOne: external-triggering-point=ptrpAsrEcuMServicesEcuMIf.EcuM_DriverInitListOne, symbol=EcuM_DefaultInitListOne_0_symb
        EcuM_DeterminePbConfiguration: external-triggering-point=ptrpAsrEcuMServicesEcuMIf.EcuM_DeterminePbConfiguration, symbol=EcuM_DeterminePbConfiguration_symb
        EcuM_DisableWakeupSources: external-triggering-point=ptrpAsrEcuMServicesEcuMIf.EcuM_DisableWakeupSources, symbol=EcuM_DisableWakeupSources_symb
        EcuM_EnableWakeupSources: external-triggering-point=ptrpAsrEcuMServicesEcuMIf.EcuM_EnableWakeupSources, symbol=EcuM_EnableWakeupSources_symb
        EcuM_ErrorHook: external-triggering-point=ptrpAsrEcuMServicesEcuMIf.EcuM_ErrorHook, symbol=EcuM_ErrorHook_symb
        EcuM_GenerateRamHash: external-triggering-point=ptrpAsrEcuMServicesEcuMIf.EcuM_GenerateRamHash, symbol=EcuM_GenerateRamHash_symb
        EcuM_OnGoOffOne: external-triggering-point=ptrpAsrEcuMServicesEcuMIf.EcuM_OnGoOffOne, symbol=EcuM_OnGoOffOne_symb
        EcuM_OnGoOffTwo: external-triggering-point=ptrpAsrEcuMServicesEcuMIf.EcuM_OnGoOffTwo, symbol=EcuM_OnGoOffTwo_symb
        EcuM_PostHalt: external-triggering-point=ptrpAsrEcuMServicesEcuMIf.EcuM_PostHalt, symbol=EcuM_PostHalt_symb
        EcuM_PreHalt: external-triggering-point=ptrpAsrEcuMServicesEcuMIf.EcuM_PreHalt, symbol=EcuM_PreHalt_symb
        EcuM_SleepActivity: external-triggering-point=ptrpAsrEcuMServicesEcuMIf.EcuM_SleepActivity, symbol=EcuM_SleepActivity_symb
        EcuM_StartWakeupSources: external-triggering-point=ptrpAsrEcuMServicesEcuMIf.EcuM_StartWakeupSources, symbol=EcuM_StartWakeupSources_symb
        EcuM_StopWakeupSources: external-triggering-point=ptrpAsrEcuMServicesEcuMIf.EcuM_StopWakeupSources, symbol=EcuM_StopWakeupSources_symb
  swc implementation EcuMIf_imp: category=BSW_System_Services, programming-language=C, sw-version=1.0.0, vendor-id=0, behavior=EcuMIf_IB
    code-descriptors:
      code EcuMIf_Impl_Code: artifact-descriptors=autosar-engineering-object={short-label=EcuMIf_Impl_Code_CodeDesc, category=SWSRC}
    resource consumption EcuMIf_Impl_ResCons
      33 x memory section:
        CODE: size=0, sw-addrmethod=CODE
        CODE_ASIL_A: size=0, sw-addrmethod=CODE_ASIL_A
        CONST_16: alignment=16, size=16, sw-addrmethod=CONST
        CONST_16_ASIL_A: alignment=16, size=16, sw-addrmethod=CONST_ASIL_A
        CONST_32: alignment=32, size=32, sw-addrmethod=CONST
        CONST_32_ASIL_A: alignment=32, size=32, sw-addrmethod=CONST_ASIL_A
        CONST_8: alignment=8, size=8, sw-addrmethod=CONST
        CONST_8_ASIL_A: alignment=8, size=8, sw-addrmethod=CONST_ASIL_A
        CONST_BOOL: alignment=8, size=1, sw-addrmethod=CONST
        CONST_BOOL_ASIL_A: alignment=8, size=1, sw-addrmethod=CONST_ASIL_A
        CONST_UNSPECIFIED: alignment=UNSPECIFIED, size=0, sw-addrmethod=CONST
        CONST_UNSPECIFIED_ASIL_A: alignment=UNSPECIFIED, size=0, sw-addrmethod=CONST_ASIL_A
        VAR_INIT_16: alignment=16, size=16, sw-addrmethod=VAR_INIT
        VAR_INIT_16_ASIL_A: alignment=16, size=16, sw-addrmethod=VAR_INIT_ASIL_A
        VAR_INIT_32: alignment=32, size=32, sw-addrmethod=VAR_INIT
        VAR_INIT_32_ASIL_A: alignment=32, size=32, sw-addrmethod=VAR_INIT_ASIL_A
        VAR_INIT_8: alignment=8, size=8, sw-addrmethod=VAR_INIT
        VAR_INIT_8_ASIL_A: alignment=8, size=8, sw-addrmethod=VAR_INIT_ASIL_A
        VAR_INIT_BOOL: alignment=8, size=1, sw-addrmethod=VAR_INIT
        VAR_INIT_BOOL_ASIL_A: alignment=8, size=1, sw-addrmethod=VAR_INIT_ASIL_A
        VAR_INIT_UNSPECIFIED: alignment=UNSPECIFIED, size=0, sw-addrmethod=VAR_INIT
        VAR_INIT_UNSPECIFIED_ASIL_A: alignment=UNSPECIFIED, size=0, sw-addrmethod=VAR_INIT_ASIL_A
        VAR_NO_INIT_16: alignment=16, size=16, sw-addrmethod=VAR_NOINIT
        VAR_NO_INIT_16_ASIL_A: alignment=16, size=16, sw-addrmethod=VAR_NOINIT_ASIL_A
        VAR_NO_INIT_32: alignment=32, size=32, sw-addrmethod=VAR_NOINIT
        VAR_NO_INIT_32_ASIL_A: alignment=32, size=32, sw-addrmethod=VAR_NOINIT_ASIL_A
        VAR_NO_INIT_8: alignment=8, size=8, sw-addrmethod=VAR_NOINIT
        VAR_NO_INIT_8_ASIL_A: alignment=8, size=8, sw-addrmethod=VAR_NOINIT_ASIL_A
        VAR_NO_INIT_BOOL: alignment=8, size=1, sw-addrmethod=VAR_NOINIT
        VAR_NO_INIT_BOOL_ASIL_A: alignment=8, size=1, sw-addrmethod=VAR_NOINIT_ASIL_A
        VAR_NO_INIT_UNSPECIFIED: alignment=UNSPECIFIED, size=0, sw-addrmethod=VAR_NOINIT
        VAR_NO_INIT_UNSPECIFIED_ASIL_A: alignment=UNSPECIFIED, size=0, sw-addrmethod=VAR_NOINIT_ASIL_A
        VAR_POWER_ON_CLEARED: alignment=UNSPECIFIED, size=0, sw-addrmethod=VAR_POWER_ON_CLEARED
