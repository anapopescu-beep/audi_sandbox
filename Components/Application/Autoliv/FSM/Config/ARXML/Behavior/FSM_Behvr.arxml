AUTOSAR XML (schema 4-2-2)
package /AUTOLIV/SoftwareComponents/FSM
  application sw component type FSM: category=SWC
    behavior FSM_IB_FiniteStateMachine: data-type-mapping=[DataTypeMappingSet_AdcIf, DataTypeMappingSet_CIL, DataTypeMappingSet_DioIf, DataTypeMappingSet_FSM, DataTypeMappingSet_IoHwAb, DataTypeMappingSet_NvmIf, DataTypeMappingSet_PwmIf, DataTypeMappingSet_SAD, DataTypeMappingSet_eCS], handle-termination-and-restart=NO-SUPPORT
      timing event FSM_evUpdateModeStatus: start-on-event=FSM_runUpdateModeStatus, period=0.001
      timing event ev_FsmMainFunctionperiod: start-on-event=FSM_runMainFunction, period=0.001
      operation invoked event oie_pseFsmServices_calculateProfileTimeout: start-on-event=FSM_runCalculateProfileTimeout, operation=pseFsmServices.calculateProfileTimeout
      operation invoked event oie_pseModeManagement_CheckModeStatus: start-on-event=FSM_runCheckModeStatus, operation=pseModeManagement.CheckModeStatus
      operation invoked event oie_pseUnlockTimeout_getUnlockTimeoutPeriod: start-on-event=FSM_getUnlockDetectionTimeoutPeriod, operation=pseFsmServices.getUnlockTimeoutPeriod
      explicit-inter-runnable-variables:
        data FSM_u32_ModesStatus: sw-addr-method=VAR_INIT, type=uint32, init-value=ZERO:0
        data FSM_u32_ModesStatusComplement: sw-addr-method=VAR_INIT, type=uint32, init-value=ZERO:0
      7 x runnable, all with sw-addr-method=CODE_ASIL_A:
        FSM_Init: external-triggering-point=ptrpFsmServicesBswMIf.FSM_Init
        FSM_ModesInit: external-triggering-point=ptrpFsmServicesBswMIf.FSM_ModesInit
          written-local-variables:
            access MMG_u32_ModesStatus: accessed-variable=FSM_u32_ModesStatus
            access MMG_u32_ModesStatus_Complement: accessed-variable=FSM_u32_ModesStatusComplement
        FSM_getUnlockDetectionTimeoutPeriod
        FSM_runCalculateProfileTimeout
        FSM_runCheckModeStatus: can-be-invoked-concurrently=true
          read-local-variables:
            access MMG_u32_ModesStatus: accessed-variable=FSM_u32_ModesStatus
            access MMG_u32_ModesStatus_Complement: accessed-variable=FSM_u32_ModesStatusComplement
          sync call scp_GetEventStatus: operation=pclDemServices.GetEventStatus, timeout=0.0
          written-local-variables:
            access MMG_u32_ModesStatus1: accessed-variable=FSM_u32_ModesStatus
            access MMG_u32_ModesStatus_Complement1: accessed-variable=FSM_u32_ModesStatusComplement
        FSM_runMainFunction: external-triggering-point=ptrpAsrOsServicesFSM.FSM_runMainFunction
          data-receive-point-by-arguments:
            5 x access:
              drparg_au8DiagReq: accessed-variable=prrEcsDiagRequest.au8DiagReq
              drparg_au8DiagReqComplement: accessed-variable=prrEcsDiagRequest.au8DiagReqComplement
              drparg_au8SolenoidAutotestSt: accessed-variable=prrSolenoidOpenCircuitStatus.au8SolenoidAutotestStatus
              drparg_au8SolenoidAutotestSt1: accessed-variable=prrSolenoidShortToGndStatus.au8SolenoidAutotestStatus
              drparg_u8EcsFlag: accessed-variable=prrEcsAlgoFlag.u8EcsFlag
          data-send-points:
            access dsp_au8SelectedProfile: accessed-variable=psrSolenoidProfile.au8SelectedProfile
            access dsp_au8SolenoidNbOfBackups: accessed-variable=psrSolenoidStuckStatus.au8SolenoidIsStuck
            access dsp_au8SolenoidState: accessed-variable=psrSolenoidState.au8SolenoidState
          sync call scp_GetCounterPassedThreshold: operation=pclDemIfEventSerices.GetCounterPassedThreshold, timeout=0.0
          sync call scp_GetTestResult: operation=pclAutotestServices.GetTestResult, timeout=0.0
          sync call scp_SetRamBlockStatus: operation=pclNvmIfServices.SetRamBlockStatus, timeout=0.0
        FSM_runUpdateModeStatus: can-be-invoked-concurrently=true, external-triggering-point=ptrpAsrOsServicesFSM.FSM_runUpdateModeStatus
          data-receive-point-by-arguments:
            6 x access:
              drparg_au8MergedBuckleStatus: accessed-variable=prrCILData.au8MergedBuckleStatus
              drparg_au8SolenoidOvervoltag: accessed-variable=prrSolenoidOverVoltageStatus.au8SolenoidOvervoltageStatus
              drparg_au8SolenoidUnlockConf: accessed-variable=prrSolenoidConfirmation.au8SolenoidStatus
              drparg_u8AccInitStateMachine: accessed-variable=prrACCServices.u8AccInitStateMachine
              drparg_u8BlockRestoreStatus: accessed-variable=prrBswMIfServices.u8BlockRestoreStatus
              drparg_u8IsCrashActive: accessed-variable=prrCrashStatus.u8IsCrashActive
          sync call scp_GetCriticalAutoTestsReac: operation=pclAutotestServices.GetCriticalAutoTestsReachedFlag, timeout=0.0
          sync call scp_GetEventStatus: operation=pclDemServices.GetEventStatus, timeout=0.0
          sync call scp_getMeasure: operation=pclConvAdcService.getMeasure, timeout=0.0
  swc implementation FSM_imp: category=SWC, programming-language=C, sw-version=1.0.0, vendor-id=0, behavior=FSM_IB_FiniteStateMachine
    code-descriptors:
      code FSM_Impl_Code: artifact-descriptors=autosar-engineering-object={short-label=FSM_Impl_Code_CodeDesc, category=SWSRC}
    resource consumption FSM_Impl_ResCons
      33 x memory section:
        CODE: size=0, sw-addrmethod=CODE
        CODE_ASIL_A: size=0, sw-addrmethod=CODE_ASIL_A
        CONST_16: alignment=16, size=16, sw-addrmethod=CONST
        CONST_16_ASIL_A: alignment=16, size=16, sw-addrmethod=CONST_ASIL_A
        CONST_32: alignment=32, size=32, sw-addrmethod=CONST
        CONST_32_ASIL_A: alignment=32, size=32, sw-addrmethod=CONST_ASIL_A
        CONST_8: alignment=8, size=8, sw-addrmethod=CONST
        CONST_8_ASIL_A: alignment=8, size=8, sw-addrmethod=CONST_ASIL_A
        CONST_BOOL: alignment=8, size=1, sw-addrmethod=CONST
        CONST_BOOL_ASIL_A: alignment=8, size=1, sw-addrmethod=CONST_ASIL_A
        CONST_UNSPECIFIED: alignment=UNSPECIFIED, size=0, sw-addrmethod=CONST
        CONST_UNSPECIFIED_ASIL_A: alignment=UNSPECIFIED, size=0, sw-addrmethod=CONST_ASIL_A
        VAR_INIT_16: alignment=16, size=16, sw-addrmethod=VAR_INIT
        VAR_INIT_16_ASIL_A: alignment=16, size=16, sw-addrmethod=VAR_INIT_ASIL_A
        VAR_INIT_32: alignment=32, size=32, sw-addrmethod=VAR_INIT
        VAR_INIT_32_ASIL_A: alignment=32, size=32, sw-addrmethod=VAR_INIT_ASIL_A
        VAR_INIT_8: alignment=8, size=8, sw-addrmethod=VAR_INIT
        VAR_INIT_8_ASIL_A: alignment=8, size=8, sw-addrmethod=VAR_INIT_ASIL_A
        VAR_INIT_BOOL: alignment=8, size=1, sw-addrmethod=VAR_INIT
        VAR_INIT_BOOL_ASIL_A: alignment=8, size=1, sw-addrmethod=VAR_INIT_ASIL_A
        VAR_INIT_UNSPECIFIED: alignment=UNSPECIFIED, size=0, sw-addrmethod=VAR_INIT
        VAR_INIT_UNSPECIFIED_ASIL_A: alignment=UNSPECIFIED, size=0, sw-addrmethod=VAR_INIT_ASIL_A
        VAR_NO_INIT_16: alignment=16, size=16, sw-addrmethod=VAR_NOINIT
        VAR_NO_INIT_16_ASIL_A: alignment=16, size=16, sw-addrmethod=VAR_NOINIT_ASIL_A
        VAR_NO_INIT_32: alignment=32, size=32, sw-addrmethod=VAR_NOINIT
        VAR_NO_INIT_32_ASIL_A: alignment=32, size=32, sw-addrmethod=VAR_NOINIT_ASIL_A
        VAR_NO_INIT_8: alignment=8, size=8, sw-addrmethod=VAR_NOINIT
        VAR_NO_INIT_8_ASIL_A: alignment=8, size=8, sw-addrmethod=VAR_NOINIT_ASIL_A
        VAR_NO_INIT_BOOL: alignment=8, size=1, sw-addrmethod=VAR_NOINIT
        VAR_NO_INIT_BOOL_ASIL_A: alignment=8, size=1, sw-addrmethod=VAR_NOINIT_ASIL_A
        VAR_NO_INIT_UNSPECIFIED: alignment=UNSPECIFIED, size=0, sw-addrmethod=VAR_NOINIT
        VAR_NO_INIT_UNSPECIFIED_ASIL_A: alignment=UNSPECIFIED, size=0, sw-addrmethod=VAR_NOINIT_ASIL_A
        VAR_POWER_ON_CLEARED: alignment=UNSPECIFIED, size=0, sw-addrmethod=VAR_POWER_ON_CLEARED
