AUTOSAR XML (schema 4-2-2)
package /AUTOLIV/SoftwareComponents/IoHwAb
  ecu abstraction sw component type IoHwAb: category=ECU_HW_Abstraction
    behavior IoHwAb_IB: data-type-mapping=[DataTypeMappingSet_ACC, DataTypeMappingSet_AdcIf, DataTypeMappingSet_DioIf, DataTypeMappingSet_EFX, DataTypeMappingSet_FSM, DataTypeMappingSet_IoHwAb, DataTypeMappingSet_NvmIf, DataTypeMappingSet_SAD], handle-termination-and-restart=NO-SUPPORT
      4 x timing event:
        ev_IoHwAb_DetectVoltageFluctuation: start-on-event=IoHwAb_DetectVoltageFluctuation, period=0.002
        ev_IoHwAb_runFilterMeasurements100ms: start-on-event=IoHwAb_runFilterMeasurements100ms, period=0.1
        ev_IoHwAb_runFilterMeasurements10ms: start-on-event=IoHwAb_runFilterMeasurements10ms, period=0.01
        ev_IoHwAb_runFilterMeasurements2ms: start-on-event=IoHwAb_runFilterMeasurements2ms, period=0.002
      11 x operation invoked event:
        oie_pseAccSensor_GetTemperature: start-on-event=IoHwAb_GetAccelerometerTemperature, operation=pseAccSensor.GetTemperature
        oie_pseCheckPowerSupplyOV_AutotestCallback: start-on-event=IoHwAb_CheckPowerSupplyOvervoltageAutotest, operation=pseCheckPowerSupplyOV.AutotestCallback
        oie_pseCheckPowerSupplyUV_AutotestCallback: start-on-event=IoHwAb_CheckPowerSupplyUndervoltageAutotest, operation=pseCheckPowerSupplyUV.AutotestCallback
        oie_pseEcuCharacteristics_GetTemperature: start-on-event=IoHwAb_GetEcuTemperature, operation=pseEcuCharacteristics.GetTemperature
        oie_pseEcuOverTemperature_AutotestCallback: start-on-event=IoHwAb_CheckEcuOverTemperatureAutotest, operation=pseEcuOverTemperature.AutotestCallback
        oie_pseHandleSeatCurrentCircuit_IoHwAb_HandleSeatCurrentCircuit: start-on-event=IoHwAb_HandleSeatCurrentCircuit, operation=pseHandleSeatCurrentCircuit.IoHwAb_HandleSeatCurrentCircuit
        oie_pseIoHwAbService_getMeasure: start-on-event=IoHwAb_runGetMeasure, operation=pseConvAdcService.getMeasure
        oie_pseLowPowerWakeUp_DetectSeatOccupancy: start-on-event=IoHwAb_HandleSeatVariants, operation=pseLowPowerWakeUp.HandleSeatVariants
        oie_pseMcuCharacteristics_GetTemperature: start-on-event=IoHwAb_GetMcuTemperature, operation=pseMcuCharacteristics.GetTemperature
        oie_psePtcSensor_GetTemperature: start-on-event=IoHwAb_GetPtcTemperature, operation=psePtcSensor.GetTemperature
        oie_pseSolenoidCharacterstics_GetTemperature: start-on-event=IoHwAb_GetSolenoidTemperature, operation=pseSolenoidCharacterstics.GetTemperature
      15 x runnable:
        IoHwAb_CheckEcuOverTemperatureAutotest
        IoHwAb_CheckPowerSupplyOvervoltageAutotest: sw-addr-method=CODE_ASIL_A
          sync call scp_GetTestResult: operation=pclAutotestServices.GetTestResult, timeout=0.0
        IoHwAb_CheckPowerSupplyUndervoltageAutotest: sw-addr-method=CODE_ASIL_A
        IoHwAb_DetectVoltageFluctuation: external-triggering-point=ptrpAsrOsServicesIoHwAb.IoHwAb_DetectVoltageFluctuation
          data-receive-point-by-arguments:
            4 x access:
              drparg_aau16HistoricalAdcSam: accessed-variable=prrAdcBufferServices.aau16HistoricalAdcSamples
              drparg_au8CurrentStep: accessed-variable=pclSolenoidStep.au8CurrentStep
              drparg_au8SelectedProfile: accessed-variable=pclSolenoidProfile.au8SelectedProfile
              drparg_u8HistoricalAdcSample: accessed-variable=prrAdcBufferServices.u8HistoricalAdcSampleIndex
          data-send-points:
            access dsp_au8SolenoidUnlockConfirm: accessed-variable=psrSolenoidConfirmation.au8SolenoidStatus
          sync call scp_CheckModeStatus: operation=pclModeManagement.CheckModeStatus, timeout=0.0
          sync call scp_getUnlockDetectionTimeou: operation=pclUnlockTimeout.getUnlockTimeoutPeriod, timeout=0.0
        IoHwAb_GetAccelerometerTemperature: can-be-invoked-concurrently=true
          sync call scp_GetTemperatureData: operation=pclAccSpiData.GetTemperatureData, timeout=0.0
        IoHwAb_GetEcuTemperature: can-be-invoked-concurrently=true
        IoHwAb_GetMcuTemperature: can-be-invoked-concurrently=true
        IoHwAb_GetPtcTemperature: can-be-invoked-concurrently=true
        IoHwAb_GetSolenoidTemperature
        IoHwAb_HandleSeatCurrentCircuit
        IoHwAb_HandleSeatVariants
          sync call scp_BswM_UpdatePassangerOccu: operation=pclPassengerOccupancyState.BswM_UpdatePassangerOccupancyStatus, timeout=0.0
          sync call scp_SetRamBlockStatus: operation=pclNvmIfServices.SetRamBlockStatus, timeout=0.0
          sync call scp_WriteChannel: operation=pclDioIfServices.WriteChannel, timeout=0.0
        IoHwAb_runFilterMeasurements100ms: sw-addr-method=CODE_ASIL_A, external-triggering-point=ptrpAsrOsServicesIoHwAb.IoHwAb_runFilterMeasurements100ms
          sync call scp_LPF_Filter: operation=pclEfxServices.LPF_Filter, timeout=0.0
        IoHwAb_runFilterMeasurements10ms: sw-addr-method=CODE_ASIL_A, external-triggering-point=ptrpAsrOsServicesIoHwAb.IoHwAb_runFilterMeasurements10ms
          data-send-points:
            access dsp_au8BuckleStatus: accessed-variable=psrBuckleStatus.au8BuckleStatus
            access dsp_au8SeatOccupancySensorSt: accessed-variable=psrSeatOccupancySensorStatus.au8SeatOccupancySensorStatus
          sync call scp_LPF_Filter: operation=pclEfxServices.LPF_Filter, timeout=0.0
        IoHwAb_runFilterMeasurements2ms: sw-addr-method=CODE_ASIL_A, external-triggering-point=ptrpAsrOsServicesIoHwAb.IoHwAb_runFilterMeasurements2ms
          sync call scp_LPF_Filter: operation=pclEfxServices.LPF_Filter, timeout=0.0
        IoHwAb_runGetMeasure: sw-addr-method=CODE_ASIL_A, can-be-invoked-concurrently=true
          data-receive-point-by-arguments:
            access drparg_au16Pwm: accessed-variable=prrSolenoidPwm.au16Pwm
            access drparg_au16SolenoidmATarget: accessed-variable=prrSolenoidElectricalCharacteristics.au32SolenoidmATarget
          sync call scp_getChannelValue: operation=pclRawAdcService.getChannelValue, timeout=0.0
  swc implementation IoHwAb_imp: category=ECU_HW_Abstraction, programming-language=C, sw-version=1.0.0, vendor-id=0, behavior=IoHwAb_IB
    code-descriptors:
      code IoHwAb_Impl_Code: artifact-descriptors=autosar-engineering-object={short-label=IoHwAb_Impl_Code_CodeDesc, category=SWSRC}
    resource consumption IoHwAb_Impl_ResCons
      33 x memory section:
        CODE: size=0, sw-addrmethod=CODE
        CODE_ASIL_A: size=0, sw-addrmethod=CODE_ASIL_A
        CONST_16: alignment=16, size=16, sw-addrmethod=CONST
        CONST_16_ASIL_A: alignment=16, size=16, sw-addrmethod=CONST_ASIL_A
        CONST_32: alignment=32, size=32, sw-addrmethod=CONST
        CONST_32_ASIL_A: alignment=32, size=32, sw-addrmethod=CONST_ASIL_A
        CONST_8: alignment=8, size=8, sw-addrmethod=CONST
        CONST_8_ASIL_A: alignment=8, size=8, sw-addrmethod=CONST_ASIL_A
        CONST_BOOL: alignment=8, size=1, sw-addrmethod=CONST
        CONST_BOOL_ASIL_A: alignment=8, size=1, sw-addrmethod=CONST_ASIL_A
        CONST_UNSPECIFIED: alignment=UNSPECIFIED, size=0, sw-addrmethod=CONST
        CONST_UNSPECIFIED_ASIL_A: alignment=UNSPECIFIED, size=0, sw-addrmethod=CONST_ASIL_A
        VAR_INIT_16: alignment=16, size=16, sw-addrmethod=VAR_INIT
        VAR_INIT_16_ASIL_A: alignment=16, size=16, sw-addrmethod=VAR_INIT_ASIL_A
        VAR_INIT_32: alignment=32, size=32, sw-addrmethod=VAR_INIT
        VAR_INIT_32_ASIL_A: alignment=32, size=32, sw-addrmethod=VAR_INIT_ASIL_A
        VAR_INIT_8: alignment=8, size=8, sw-addrmethod=VAR_INIT
        VAR_INIT_8_ASIL_A: alignment=8, size=8, sw-addrmethod=VAR_INIT_ASIL_A
        VAR_INIT_BOOL: alignment=8, size=1, sw-addrmethod=VAR_INIT
        VAR_INIT_BOOL_ASIL_A: alignment=8, size=1, sw-addrmethod=VAR_INIT_ASIL_A
        VAR_INIT_UNSPECIFIED: alignment=UNSPECIFIED, size=0, sw-addrmethod=VAR_INIT
        VAR_INIT_UNSPECIFIED_ASIL_A: alignment=UNSPECIFIED, size=0, sw-addrmethod=VAR_INIT_ASIL_A
        VAR_NO_INIT_16: alignment=16, size=16, sw-addrmethod=VAR_NOINIT
        VAR_NO_INIT_16_ASIL_A: alignment=16, size=16, sw-addrmethod=VAR_NOINIT_ASIL_A
        VAR_NO_INIT_32: alignment=32, size=32, sw-addrmethod=VAR_NOINIT
        VAR_NO_INIT_32_ASIL_A: alignment=32, size=32, sw-addrmethod=VAR_NOINIT_ASIL_A
        VAR_NO_INIT_8: alignment=8, size=8, sw-addrmethod=VAR_NOINIT
        VAR_NO_INIT_8_ASIL_A: alignment=8, size=8, sw-addrmethod=VAR_NOINIT_ASIL_A
        VAR_NO_INIT_BOOL: alignment=8, size=1, sw-addrmethod=VAR_NOINIT
        VAR_NO_INIT_BOOL_ASIL_A: alignment=8, size=1, sw-addrmethod=VAR_NOINIT_ASIL_A
        VAR_NO_INIT_UNSPECIFIED: alignment=UNSPECIFIED, size=0, sw-addrmethod=VAR_NOINIT
        VAR_NO_INIT_UNSPECIFIED_ASIL_A: alignment=UNSPECIFIED, size=0, sw-addrmethod=VAR_NOINIT_ASIL_A
        VAR_POWER_ON_CLEARED: alignment=UNSPECIFIED, size=0, sw-addrmethod=VAR_POWER_ON_CLEARED
