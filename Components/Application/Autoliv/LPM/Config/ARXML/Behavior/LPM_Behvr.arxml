AUTOSAR XML (schema 4-2-2)
package /AUTOLIV/SoftwareComponents/LPM
  application sw component type LPM: category=SWC
    behavior LPM_IB: data-type-mapping=DataTypeMappingSet_LPM, handle-termination-and-restart=NO-SUPPORT
      5 x runnable:
        LPM_sleepInit: external-triggering-point=ptrpLpmServicesBswMIf.LPM_sleepInit
          sync call scp_SBC_SetToLowPower: operation=pclSbcServices.SBC_SetToLowPower, timeout=0.0
          sync call scp_SBC_sleepTriggerWatchdog: operation=pclSbcServices.SBC_sleepTriggerWatchdog, timeout=0.0
        LPM_sleepMainLoop: external-triggering-point=ptrpLpmServicesBswMIf.LPM_sleepMainLoop
          5 x sync call, all with timeout=0.0:
            scp_DetectSeatOccupancy: operation=pclLowPowerWakeUp.HandleSeatVariants
            scp_IoHwAb_HandleSeatCurrent: operation=pclHandleSeatCurrentCircuit.IoHwAb_HandleSeatCurrentCircuit
            scp_StartConversion: operation=pclAdcIfServices.StartConversion
            scp_StopConversion: operation=pclAdcIfServices.StopConversion
            scp_WaitForConversion: operation=pclAdcIfServices.WaitForConversion
        LPM_sleepRestore: external-triggering-point=ptrpLpmServicesBswMIf.LPM_sleepRestore
          sync call scp_RestartInitialization: operation=pclAccRestartInit.RestartInitialization, timeout=0.0
          sync call scp_SBC_SetToNormal: operation=pclSbcServices.SBC_SetToNormal, timeout=0.0
        LPTMR_ISR: external-triggering-point=ptrpLpmServicesAsrOs.LPTMR_ISR, symbol=LPM_LPTMR_ISR
        PORTD_ISR: external-triggering-point=ptrpLpmServicesAsrOs.PORTD_ISR, symbol=LPM_PORTD_ISR
  swc implementation LPM_imp: category=SWC, programming-language=C, sw-version=1.0.0, vendor-id=0, behavior=LPM_IB
    code-descriptors:
      code LPM_Impl_Code: artifact-descriptors=autosar-engineering-object={short-label=LPM_Impl_Code_CodeDesc, category=SWSRC}
    resource consumption LPM_Impl_ResCons
      33 x memory section:
        CODE: size=0, sw-addrmethod=CODE
        CODE_ASIL_A: size=0, sw-addrmethod=CODE_ASIL_A
        CONST_16: alignment=16, size=16, sw-addrmethod=CONST
        CONST_16_ASIL_A: alignment=16, size=16, sw-addrmethod=CONST_ASIL_A
        CONST_32: alignment=32, size=32, sw-addrmethod=CONST
        CONST_32_ASIL_A: alignment=32, size=32, sw-addrmethod=CONST_ASIL_A
        CONST_8: alignment=8, size=8, sw-addrmethod=CONST
        CONST_8_ASIL_A: alignment=8, size=8, sw-addrmethod=CONST_ASIL_A
        CONST_BOOL: alignment=8, size=1, sw-addrmethod=CONST
        CONST_BOOL_ASIL_A: alignment=8, size=1, sw-addrmethod=CONST_ASIL_A
        CONST_UNSPECIFIED: alignment=UNSPECIFIED, size=0, sw-addrmethod=CONST
        CONST_UNSPECIFIED_ASIL_A: alignment=UNSPECIFIED, size=0, sw-addrmethod=CONST_ASIL_A
        VAR_INIT_16: alignment=16, size=16, sw-addrmethod=VAR_INIT
        VAR_INIT_16_ASIL_A: alignment=16, size=16, sw-addrmethod=VAR_INIT_ASIL_A
        VAR_INIT_32: alignment=32, size=32, sw-addrmethod=VAR_INIT
        VAR_INIT_32_ASIL_A: alignment=32, size=32, sw-addrmethod=VAR_INIT_ASIL_A
        VAR_INIT_8: alignment=8, size=8, sw-addrmethod=VAR_INIT
        VAR_INIT_8_ASIL_A: alignment=8, size=8, sw-addrmethod=VAR_INIT_ASIL_A
        VAR_INIT_BOOL: alignment=8, size=1, sw-addrmethod=VAR_INIT
        VAR_INIT_BOOL_ASIL_A: alignment=8, size=1, sw-addrmethod=VAR_INIT_ASIL_A
        VAR_INIT_UNSPECIFIED: alignment=UNSPECIFIED, size=0, sw-addrmethod=VAR_INIT
        VAR_INIT_UNSPECIFIED_ASIL_A: alignment=UNSPECIFIED, size=0, sw-addrmethod=VAR_INIT_ASIL_A
        VAR_NO_INIT_16: alignment=16, size=16, sw-addrmethod=VAR_NOINIT
        VAR_NO_INIT_16_ASIL_A: alignment=16, size=16, sw-addrmethod=VAR_NOINIT_ASIL_A
        VAR_NO_INIT_32: alignment=32, size=32, sw-addrmethod=VAR_NOINIT
        VAR_NO_INIT_32_ASIL_A: alignment=32, size=32, sw-addrmethod=VAR_NOINIT_ASIL_A
        VAR_NO_INIT_8: alignment=8, size=8, sw-addrmethod=VAR_NOINIT
        VAR_NO_INIT_8_ASIL_A: alignment=8, size=8, sw-addrmethod=VAR_NOINIT_ASIL_A
        VAR_NO_INIT_BOOL: alignment=8, size=1, sw-addrmethod=VAR_NOINIT
        VAR_NO_INIT_BOOL_ASIL_A: alignment=8, size=1, sw-addrmethod=VAR_NOINIT_ASIL_A
        VAR_NO_INIT_UNSPECIFIED: alignment=UNSPECIFIED, size=0, sw-addrmethod=VAR_NOINIT
        VAR_NO_INIT_UNSPECIFIED_ASIL_A: alignment=UNSPECIFIED, size=0, sw-addrmethod=VAR_NOINIT_ASIL_A
        VAR_POWER_ON_CLEARED: alignment=UNSPECIFIED, size=0, sw-addrmethod=VAR_POWER_ON_CLEARED
