AUTOSAR XML (schema 4-2-2)
package /AUTOLIV/SoftwareComponents/MIC
  complex device driver sw component type MIC: category=BSW_Complex_Device_Drivers  # MIC_AC_MemoryIntegrityControl
    behavior MIC_IB_MemoryIntegrityControl: constant-value-mapping=ConstantsMappingSet_NvmIf, data-type-mapping=[DataTypeMappingSet_ATM, DataTypeMappingSet_MIC, DataTypeMappingSet_NvmIf, DataTypeMappingSet_RCM], handle-termination-and-restart=NO-SUPPORT
      operation invoked event oie_pseRunEepromMemoryCorruption_AutotestCallback: start-on-event=MIC_Autotest_RunEepromMemoryCorruption, operation=pseRunEepromMemoryCorruption.AutotestCallback
      operation invoked event oie_pseRunPFlashMemoryCorruption_AutotestCallback: start-on-event=MIC_Autotest_RunPFlashMemoryCorruption, operation=pseRunPFlashMemoryCorruption.AutotestCallback
      operation invoked event oie_pseRunRamMemoryCorruption_AutotestCallback: start-on-event=MIC_Autotest_RunRamMemoryCorruption, operation=pseRunRamMemoryCorruption.AutotestCallback
      6 x runnable, all with sw-addr-method=CODE_ASIL_A:
        MIC_Autotest_RunEepromMemoryCorruption
          sync call scp_GetResetCause: operation=pclResetCause.GetResetCause, timeout=0.0
          sync call scp_SetRamBlockStatus: operation=pclNvmIfServices.SetRamBlockStatus, timeout=0.0
        MIC_Autotest_RunPFlashMemoryCorruption: can-be-invoked-concurrently=true
          sync call scp_GetResetCause: operation=pclResetCause.GetResetCause, timeout=0.0
        MIC_Autotest_RunRamMemoryCorruption: can-be-invoked-concurrently=true
          sync call scp_GetResetCause: operation=pclResetCause.GetResetCause, timeout=0.0
        MIC_BusFaultException: external-triggering-point=p_ptrrMicServicesOsIf.MIC_BusFaultException
          sync call scp_NotifyResetCause: operation=pclResetCauseNotification.NotifyResetCause, timeout=0.0
        MIC_HardFaultException: external-triggering-point=p_ptrrMicServicesOsIf.MIC_HardFaultException
          sync call scp_NotifyResetCause: operation=pclResetCauseNotification.NotifyResetCause, timeout=0.0
          sync call scp_SBC_Reset: operation=pclSbcServices.SBC_Reset, timeout=0.0
        MIC_Init: can-be-invoked-concurrently=true, external-triggering-point=p_ptrrMicServicesBswMIf.MIC_Init
          sync call scp_NotifyResetCause: operation=pclResetCauseNotification.NotifyResetCause, timeout=0.0
  swc implementation MIC_impMemoryIntegrityControl: category=BSW_Complex_Device_Drivers, programming-language=C, sw-version=1.0.0, vendor-id=0, behavior=MIC_IB_MemoryIntegrityControl
    code-descriptors:
      code MIC_Impl_Code: artifact-descriptors=autosar-engineering-object={short-label=MIC_Impl_Code_CodeDesc, category=SWSRC}
    resource consumption MIC_Impl_ResCons
      34 x memory section:
        CODE: size=0, sw-addrmethod=CODE
        CODE_ASIL_A: size=0, sw-addrmethod=CODE_ASIL_A
        CONST_16: alignment=16, size=16, sw-addrmethod=CONST
        CONST_16_ASIL_A: alignment=16, size=16, sw-addrmethod=CONST_ASIL_A
        CONST_32: alignment=32, size=32, sw-addrmethod=CONST
        CONST_32_ASIL_A: alignment=32, size=32, sw-addrmethod=CONST_ASIL_A
        CONST_8: alignment=8, size=8, sw-addrmethod=CONST
        CONST_8_ASIL_A: alignment=8, size=8, sw-addrmethod=CONST_ASIL_A
        CONST_BOOL: alignment=8, size=1, sw-addrmethod=CONST
        CONST_BOOL_ASIL_A: alignment=8, size=1, sw-addrmethod=CONST_ASIL_A
        CONST_UNSPECIFIED: alignment=UNSPECIFIED, size=0, sw-addrmethod=CONST
        CONST_UNSPECIFIED_ASIL_A: alignment=UNSPECIFIED, size=0, sw-addrmethod=CONST_ASIL_A
        STK_OVFL_PATT: alignment=32, size=0
        VAR_INIT_16: alignment=16, size=16, sw-addrmethod=VAR_INIT
        VAR_INIT_16_ASIL_A: alignment=16, size=16, sw-addrmethod=VAR_INIT_ASIL_A
        VAR_INIT_32: alignment=32, size=32, sw-addrmethod=VAR_INIT
        VAR_INIT_32_ASIL_A: alignment=32, size=32, sw-addrmethod=VAR_INIT_ASIL_A
        VAR_INIT_8: alignment=8, size=8, sw-addrmethod=VAR_INIT
        VAR_INIT_8_ASIL_A: alignment=8, size=8, sw-addrmethod=VAR_INIT_ASIL_A
        VAR_INIT_BOOL: alignment=8, size=1, sw-addrmethod=VAR_INIT
        VAR_INIT_BOOL_ASIL_A: alignment=8, size=1, sw-addrmethod=VAR_INIT_ASIL_A
        VAR_INIT_UNSPECIFIED: alignment=UNSPECIFIED, size=0, sw-addrmethod=VAR_INIT
        VAR_INIT_UNSPECIFIED_ASIL_A: alignment=UNSPECIFIED, size=0, sw-addrmethod=VAR_INIT_ASIL_A
        VAR_NO_INIT_16: alignment=16, size=16, sw-addrmethod=VAR_NOINIT
        VAR_NO_INIT_16_ASIL_A: alignment=16, size=16, sw-addrmethod=VAR_NOINIT_ASIL_A
        VAR_NO_INIT_32: alignment=32, size=32, sw-addrmethod=VAR_NOINIT
        VAR_NO_INIT_32_ASIL_A: alignment=32, size=32, sw-addrmethod=VAR_NOINIT_ASIL_A
        VAR_NO_INIT_8: alignment=8, size=8, sw-addrmethod=VAR_NOINIT
        VAR_NO_INIT_8_ASIL_A: alignment=8, size=8, sw-addrmethod=VAR_NOINIT_ASIL_A
        VAR_NO_INIT_BOOL: alignment=8, size=1, sw-addrmethod=VAR_NOINIT
        VAR_NO_INIT_BOOL_ASIL_A: alignment=8, size=1, sw-addrmethod=VAR_NOINIT_ASIL_A
        VAR_NO_INIT_UNSPECIFIED: alignment=UNSPECIFIED, size=0, sw-addrmethod=VAR_NOINIT
        VAR_NO_INIT_UNSPECIFIED_ASIL_A: alignment=UNSPECIFIED, size=0, sw-addrmethod=VAR_NOINIT_ASIL_A
        VAR_POWER_ON_CLEARED: alignment=UNSPECIFIED, size=0, sw-addrmethod=VAR_POWER_ON_CLEARED
