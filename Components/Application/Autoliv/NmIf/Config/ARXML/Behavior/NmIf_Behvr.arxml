AUTOSAR XML (schema 4-2-2)
package /AUTOLIV/SoftwareComponents/NmIf
  application sw component type NmIf: category=BSW_Communication_Services
    behavior NmIf_IB: data-type-mapping=DataTypeMappingSet_NmIf, handle-termination-and-restart=NO-SUPPORT
      timing event ev_NmIf_runMainFunction: start-on-event=NmIf_runMainFunction, period=0.01
      external trigger occurred event trBswM_RequestMode: start-on-event=NmIf_runMainFunction, trigger=ptrrAsrBswMServicesNmIf.BswM_RequestMode
      external trigger occurred event trComM_ASR40_RequestComMode: start-on-event=NmIf_runMainFunction, trigger=ptrrAsrComMServicesNmIf.ComM_ASR40_RequestComMode
      7 x runnable:
        NmIf_CbkRxAck_Airbag_01: external-triggering-point=ptrpAsrComServicesNmIf.NmIf_CbkRxAck_Airbag_01
        NmIf_CbkRxAck_Airbag_02: external-triggering-point=ptrpAsrComServicesNmIf.NmIf_CbkRxAck_Airbag_02
        NmIf_CbkRxAck_Airbag_eCS_01: external-triggering-point=ptrpAsrComServicesNmIf.NmIf_CbkRxAck_Airbag_eCS_01
        NmIf_CbkRxTOut_Airbag_01: external-triggering-point=ptrpAsrComServicesNmIf.NmIf_CbkRxTOut_Airbag_01
        NmIf_CbkRxTOut_Airbag_02: external-triggering-point=ptrpAsrComServicesNmIf.NmIf_CbkRxTOut_Airbag_02
        NmIf_CbkRxTOut_Airbag_eCS_01: external-triggering-point=ptrpAsrComServicesNmIf.NmIf_CbkRxTOut_Airbag_eCS_01
        NmIf_runMainFunction: external-triggering-point=ptrpAsrOsServicesNmIf.NmIf_runMainFunction
          sync call scp_BswM_SetEcuStateTransiti: operation=pclEcuStateTransitionBswMIf.BswM_SetEcuStateTransitionStatus, timeout=0.0
  swc implementation NmIf_imp: category=BSW_Communication_Services, programming-language=C, sw-version=1.0.0, vendor-id=0, behavior=NmIf_IB
    code-descriptors:
      code NmIf_Impl_Code: artifact-descriptors=autosar-engineering-object={short-label=NmIf_Impl_Code_CodeDesc, category=SWSRC}
    resource consumption NmIf_Impl_ResCons
      33 x memory section:
        CODE: size=0, sw-addrmethod=CODE
        CODE_ASIL_A: size=0, sw-addrmethod=CODE_ASIL_A
        CONST_16: alignment=16, size=16, sw-addrmethod=CONST
        CONST_16_ASIL_A: alignment=16, size=16, sw-addrmethod=CONST_ASIL_A
        CONST_32: alignment=32, size=32, sw-addrmethod=CONST
        CONST_32_ASIL_A: alignment=32, size=32, sw-addrmethod=CONST_ASIL_A
        CONST_8: alignment=8, size=8, sw-addrmethod=CONST
        CONST_8_ASIL_A: alignment=8, size=8, sw-addrmethod=CONST_ASIL_A
        CONST_BOOL: alignment=8, size=1, sw-addrmethod=CONST
        CONST_BOOL_ASIL_A: alignment=8, size=1, sw-addrmethod=CONST_ASIL_A
        CONST_UNSPECIFIED: alignment=UNSPECIFIED, size=0, sw-addrmethod=CONST
        CONST_UNSPECIFIED_ASIL_A: alignment=UNSPECIFIED, size=0, sw-addrmethod=CONST_ASIL_A
        VAR_INIT_16: alignment=16, size=16, sw-addrmethod=VAR_INIT
        VAR_INIT_16_ASIL_A: alignment=16, size=16, sw-addrmethod=VAR_INIT_ASIL_A
        VAR_INIT_32: alignment=32, size=32, sw-addrmethod=VAR_INIT
        VAR_INIT_32_ASIL_A: alignment=32, size=32, sw-addrmethod=VAR_INIT_ASIL_A
        VAR_INIT_8: alignment=8, size=8, sw-addrmethod=VAR_INIT
        VAR_INIT_8_ASIL_A: alignment=8, size=8, sw-addrmethod=VAR_INIT_ASIL_A
        VAR_INIT_BOOL: alignment=8, size=1, sw-addrmethod=VAR_INIT
        VAR_INIT_BOOL_ASIL_A: alignment=8, size=1, sw-addrmethod=VAR_INIT_ASIL_A
        VAR_INIT_UNSPECIFIED: alignment=UNSPECIFIED, size=0, sw-addrmethod=VAR_INIT
        VAR_INIT_UNSPECIFIED_ASIL_A: alignment=UNSPECIFIED, size=0, sw-addrmethod=VAR_INIT_ASIL_A
        VAR_NO_INIT_16: alignment=16, size=16, sw-addrmethod=VAR_NOINIT
        VAR_NO_INIT_16_ASIL_A: alignment=16, size=16, sw-addrmethod=VAR_NOINIT_ASIL_A
        VAR_NO_INIT_32: alignment=32, size=32, sw-addrmethod=VAR_NOINIT
        VAR_NO_INIT_32_ASIL_A: alignment=32, size=32, sw-addrmethod=VAR_NOINIT_ASIL_A
        VAR_NO_INIT_8: alignment=8, size=8, sw-addrmethod=VAR_NOINIT
        VAR_NO_INIT_8_ASIL_A: alignment=8, size=8, sw-addrmethod=VAR_NOINIT_ASIL_A
        VAR_NO_INIT_BOOL: alignment=8, size=1, sw-addrmethod=VAR_NOINIT
        VAR_NO_INIT_BOOL_ASIL_A: alignment=8, size=1, sw-addrmethod=VAR_NOINIT_ASIL_A
        VAR_NO_INIT_UNSPECIFIED: alignment=UNSPECIFIED, size=0, sw-addrmethod=VAR_NOINIT
        VAR_NO_INIT_UNSPECIFIED_ASIL_A: alignment=UNSPECIFIED, size=0, sw-addrmethod=VAR_NOINIT_ASIL_A
        VAR_POWER_ON_CLEARED: alignment=UNSPECIFIED, size=0, sw-addrmethod=VAR_POWER_ON_CLEARED
