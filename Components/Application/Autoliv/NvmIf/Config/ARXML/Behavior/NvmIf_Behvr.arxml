AUTOSAR XML (schema 4-2-2)
package /AUTOLIV/SoftwareComponents/NvmIf
  ecu abstraction sw component type NvmIf: category=BSW_Memory_Services
    behavior NvmIf: constant-value-mapping=ConstantsMappingSet_NvmIf, data-type-mapping=[DataTypeMappingSet_ATM, DataTypeMappingSet_NvmIf], handle-termination-and-restart=NO-SUPPORT
      9 x operation invoked event:
        oie_pseNvmIfServices_GetBlockStatus: start-on-event=NvmIf_GetNvmBlockStatus, operation=pseNvmIfServices.GetNvmBlockStatus
        oie_pseNvmIfServices_GetNvmBlockLength: start-on-event=NvmIf_GetNvmBlockLength, operation=pseNvmIfServices.GetNvmBlockLength
        oie_pseNvmIfServices_NvmIf_GetRamAddressByBlockId: start-on-event=NvmIf_GetRamAddressByBlockId, operation=pseNvmIfServices.NvmIf_GetRamAddressByBlockId
        oie_pseNvmIfServices_ReadBlockByAddress: start-on-event=NvmIf_ReadBlockByAddress, operation=pseNvmIfServices.ReadBlockByAddress
        oie_pseNvmIfServices_RestorePRAMBlockDefaults: start-on-event=NvmIf_RestorePRAMBlockDefaults, operation=pseNvmIfServices.RestorePRAMBlockDefaults
        oie_pseNvmIfServices_SetRamBlockStatus: start-on-event=NvmIf_SetRamBlockStatus, operation=pseNvmIfServices.SetRamBlockStatus
        oie_pseNvmIfServices_WriteBlockByAddress: start-on-event=NvmIf_WriteBlockByAddress, operation=pseNvmIfServices.WriteBlockByAddress
        oie_pseNvmIfServices_WriteNvmBlock: start-on-event=NvmIf_WriteNvmBlock, operation=pseNvmIfServices.WriteNvmBlock
        oie_pseRunEepromMemoryNotProgrammed_AutotestCallback: start-on-event=NvmIf_Autotest_RunEepromMemoryNotProgrammed, operation=pseRunEepromMemoryNotProgrammed.AutotestCallback
      9 x runnable:
        NvmIf_Autotest_RunEepromMemoryNotProgrammed: sw-addr-method=CODE_ASIL_A
        NvmIf_GetNvmBlockLength
        NvmIf_GetNvmBlockStatus: can-be-invoked-concurrently=true
          39 x sync call, all with timeout=0.0:
            scp_GetErrorStatus: operation=pclNvmService_AeeTraceabilityNumber.GetErrorStatus
            scp_GetErrorStatus1: operation=pclNvmService_AssemblySerialNumber.GetErrorStatus
            scp_GetErrorStatus10: operation=pclNvmService_EcsSteps.GetErrorStatus
            scp_GetErrorStatus11: operation=pclNvmService_EcsVariant.GetErrorStatus
            scp_GetErrorStatus12: operation=pclNvmService_HwPartNumber.GetErrorStatus
            scp_GetErrorStatus13: operation=pclNvmService_LockUnlockECU.GetErrorStatus
            scp_GetErrorStatus14: operation=pclNvmServices_AutotestEnableParam.GetErrorStatus
            scp_GetErrorStatus15: operation=pclNvmServices_AutotestParam.GetErrorStatus
            scp_GetErrorStatus16: operation=pclNvmServices_DemDefault.GetErrorStatus
            scp_GetErrorStatus17: operation=pclNvmServices_EccCounters.GetErrorStatus
            scp_GetErrorStatus18: operation=pclNvmServices_MeasFrameCfg.GetErrorStatus
            scp_GetErrorStatus19: operation=pclNvmServices_ProcessMode.GetErrorStatus
            scp_GetErrorStatus2: operation=pclNvmService_EcsAccLowPass.GetErrorStatus
            scp_GetErrorStatus20: operation=pclNvmServices_WarmResetCounters.GetErrorStatus
            scp_GetErrorStatus21: operation=pclNvmServices_EcuTempCalibration.GetErrorStatus
            scp_GetErrorStatus22: operation=pclNvmService_AlvNvmVersion.GetErrorStatus
            scp_GetErrorStatus23: operation=pclNvmService_AccAngleCalibration.GetErrorStatus
            scp_GetErrorStatus24: operation=pclNvmService_EcsSensitivityOPT.GetErrorStatus
            scp_GetErrorStatus25: operation=pclNvmService_EolCounters.GetErrorStatus
            scp_GetErrorStatus26: operation=pclNvmService_PhysicalMeasurements.GetErrorStatus
            scp_GetErrorStatus27: operation=pclNvmService_SolenoidParam.GetErrorStatus
            scp_GetErrorStatus28: operation=pclNvmService_EcuStateTimingParam.GetErrorStatus
            scp_GetErrorStatus29: operation=pclNvmService_OemSparePartNumber.GetErrorStatus
            scp_GetErrorStatus3: operation=pclNvmService_EcsAccOffsets.GetErrorStatus
            scp_GetErrorStatus30: operation=pclNvmService_OemHardwareNumber.GetErrorStatus
            scp_GetErrorStatus31: operation=pclNvmService_OemSystemName.GetErrorStatus
            scp_GetErrorStatus32: operation=pclNvmService_OemFlashBootloader.GetErrorStatus
            scp_GetErrorStatus33: operation=pclNvmService_OemOdxIdentifier.GetErrorStatus
            scp_GetErrorStatus34: operation=pclNvmService_OemOdxVersion.GetErrorStatus
            scp_GetErrorStatus35: operation=pclNvmService_OemEcuSerialNumber.GetErrorStatus
            scp_GetErrorStatus36: operation=pclNvmService_OemLogicalBlockVersion.GetErrorStatus
            scp_GetErrorStatus37: operation=pclNvmService_OemHardwareVersionNumber.GetErrorStatus
            scp_GetErrorStatus38: operation=pclNvmService_OemAppSwVersionNumber.GetErrorStatus
            scp_GetErrorStatus4: operation=pclNvmService_EcsAlgoOutputDelay.GetErrorStatus
            scp_GetErrorStatus5: operation=pclNvmService_EcsParameters.GetErrorStatus
            scp_GetErrorStatus6: operation=pclNvmServices_MeasFrameRamCfg.GetErrorStatus
            scp_GetErrorStatus7: operation=pclNvmService_EcsProfiles.GetErrorStatus
            scp_GetErrorStatus8: operation=pclNvmService_SBSLastState.GetErrorStatus
            scp_GetErrorStatus9: operation=pclNvmService_EcsSensitivityLUT.GetErrorStatus
        NvmIf_GetRamAddressByBlockId
        NvmIf_ReadBlockByAddress
        NvmIf_RestorePRAMBlockDefaults
        NvmIf_SetRamBlockStatus
          39 x sync call, all with timeout=0.0:
            scp_SetRamBlockStatus: operation=pclNvmService_AeeTraceabilityNumber.SetRamBlockStatus
            scp_SetRamBlockStatus1: operation=pclNvmService_AssemblySerialNumber.SetRamBlockStatus
            scp_SetRamBlockStatus10: operation=pclNvmService_EcsSteps.SetRamBlockStatus
            scp_SetRamBlockStatus11: operation=pclNvmService_EcsVariant.SetRamBlockStatus
            scp_SetRamBlockStatus12: operation=pclNvmService_HwPartNumber.SetRamBlockStatus
            scp_SetRamBlockStatus13: operation=pclNvmService_LockUnlockECU.SetRamBlockStatus
            scp_SetRamBlockStatus14: operation=pclNvmServices_AutotestEnableParam.SetRamBlockStatus
            scp_SetRamBlockStatus15: operation=pclNvmServices_AutotestParam.SetRamBlockStatus
            scp_SetRamBlockStatus16: operation=pclNvmServices_DemDefault.SetRamBlockStatus
            scp_SetRamBlockStatus17: operation=pclNvmServices_EccCounters.SetRamBlockStatus
            scp_SetRamBlockStatus18: operation=pclNvmServices_MeasFrameCfg.SetRamBlockStatus
            scp_SetRamBlockStatus19: operation=pclNvmServices_ProcessMode.SetRamBlockStatus
            scp_SetRamBlockStatus2: operation=pclNvmService_EcsAccLowPass.SetRamBlockStatus
            scp_SetRamBlockStatus20: operation=pclNvmServices_WarmResetCounters.SetRamBlockStatus
            scp_SetRamBlockStatus21: operation=pclNvmServices_EcuTempCalibration.SetRamBlockStatus
            scp_SetRamBlockStatus22: operation=pclNvmService_AlvNvmVersion.SetRamBlockStatus
            scp_SetRamBlockStatus23: operation=pclNvmService_AccAngleCalibration.SetRamBlockStatus
            scp_SetRamBlockStatus24: operation=pclNvmService_EcsSensitivityOPT.SetRamBlockStatus
            scp_SetRamBlockStatus25: operation=pclNvmService_EolCounters.SetRamBlockStatus
            scp_SetRamBlockStatus26: operation=pclNvmService_PhysicalMeasurements.SetRamBlockStatus
            scp_SetRamBlockStatus27: operation=pclNvmService_SolenoidParam.SetRamBlockStatus
            scp_SetRamBlockStatus28: operation=pclNvmService_EcuStateTimingParam.SetRamBlockStatus
            scp_SetRamBlockStatus29: operation=pclNvmService_OemSparePartNumber.SetRamBlockStatus
            scp_SetRamBlockStatus3: operation=pclNvmService_EcsAccOffsets.SetRamBlockStatus
            scp_SetRamBlockStatus30: operation=pclNvmService_OemHardwareNumber.SetRamBlockStatus
            scp_SetRamBlockStatus31: operation=pclNvmService_OemSystemName.SetRamBlockStatus
            scp_SetRamBlockStatus32: operation=pclNvmService_OemFlashBootloader.SetRamBlockStatus
            scp_SetRamBlockStatus33: operation=pclNvmService_OemOdxIdentifier.SetRamBlockStatus
            scp_SetRamBlockStatus34: operation=pclNvmService_OemOdxVersion.SetRamBlockStatus
            scp_SetRamBlockStatus35: operation=pclNvmService_OemEcuSerialNumber.SetRamBlockStatus
            scp_SetRamBlockStatus36: operation=pclNvmService_OemLogicalBlockVersion.SetRamBlockStatus
            scp_SetRamBlockStatus37: operation=pclNvmService_OemHardwareVersionNumber.SetRamBlockStatus
            scp_SetRamBlockStatus38: operation=pclNvmService_OemAppSwVersionNumber.SetRamBlockStatus
            scp_SetRamBlockStatus4: operation=pclNvmService_EcsAlgoOutputDelay.SetRamBlockStatus
            scp_SetRamBlockStatus5: operation=pclNvmService_EcsParameters.SetRamBlockStatus
            scp_SetRamBlockStatus6: operation=pclNvmServices_MeasFrameRamCfg.SetRamBlockStatus
            scp_SetRamBlockStatus7: operation=pclNvmService_EcsProfiles.SetRamBlockStatus
            scp_SetRamBlockStatus8: operation=pclNvmService_SBSLastState.SetRamBlockStatus
            scp_SetRamBlockStatus9: operation=pclNvmService_EcsSensitivityLUT.SetRamBlockStatus
        NvmIf_WriteBlockByAddress
        NvmIf_WriteNvmBlock
          39 x sync call, all with timeout=0.0:
            scp_WriteBlock: operation=pclNvmService_AeeTraceabilityNumber.WriteBlock
            scp_WriteBlock1: operation=pclNvmService_AssemblySerialNumber.WriteBlock
            scp_WriteBlock10: operation=pclNvmService_EcsSteps.WriteBlock
            scp_WriteBlock11: operation=pclNvmService_EcsVariant.WriteBlock
            scp_WriteBlock12: operation=pclNvmService_HwPartNumber.WriteBlock
            scp_WriteBlock13: operation=pclNvmService_LockUnlockECU.WriteBlock
            scp_WriteBlock14: operation=pclNvmServices_AutotestEnableParam.WriteBlock
            scp_WriteBlock15: operation=pclNvmServices_AutotestParam.WriteBlock
            scp_WriteBlock16: operation=pclNvmServices_DemDefault.WriteBlock
            scp_WriteBlock17: operation=pclNvmServices_EccCounters.WriteBlock
            scp_WriteBlock18: operation=pclNvmServices_MeasFrameCfg.WriteBlock
            scp_WriteBlock19: operation=pclNvmServices_ProcessMode.WriteBlock
            scp_WriteBlock2: operation=pclNvmService_EcsAccLowPass.WriteBlock
            scp_WriteBlock20: operation=pclNvmServices_WarmResetCounters.WriteBlock
            scp_WriteBlock21: operation=pclNvmServices_EcuTempCalibration.WriteBlock
            scp_WriteBlock22: operation=pclNvmService_AlvNvmVersion.WriteBlock
            scp_WriteBlock23: operation=pclNvmService_AccAngleCalibration.WriteBlock
            scp_WriteBlock24: operation=pclNvmService_EcsSensitivityOPT.WriteBlock
            scp_WriteBlock25: operation=pclNvmService_EolCounters.WriteBlock
            scp_WriteBlock26: operation=pclNvmService_PhysicalMeasurements.WriteBlock
            scp_WriteBlock27: operation=pclNvmService_SolenoidParam.WriteBlock
            scp_WriteBlock28: operation=pclNvmService_EcuStateTimingParam.WriteBlock
            scp_WriteBlock29: operation=pclNvmService_OemSparePartNumber.WriteBlock
            scp_WriteBlock3: operation=pclNvmService_EcsAccOffsets.WriteBlock
            scp_WriteBlock30: operation=pclNvmService_OemHardwareNumber.WriteBlock
            scp_WriteBlock31: operation=pclNvmService_OemSystemName.WriteBlock
            scp_WriteBlock32: operation=pclNvmService_OemFlashBootloader.WriteBlock
            scp_WriteBlock33: operation=pclNvmService_OemOdxIdentifier.WriteBlock
            scp_WriteBlock34: operation=pclNvmService_OemOdxVersion.WriteBlock
            scp_WriteBlock35: operation=pclNvmService_OemEcuSerialNumber.WriteBlock
            scp_WriteBlock36: operation=pclNvmService_OemLogicalBlockVersion.WriteBlock
            scp_WriteBlock37: operation=pclNvmService_OemHardwareVersionNumber.WriteBlock
            scp_WriteBlock38: operation=pclNvmService_OemAppSwVersionNumber.WriteBlock
            scp_WriteBlock4: operation=pclNvmService_EcsAlgoOutputDelay.WriteBlock
            scp_WriteBlock5: operation=pclNvmService_EcsParameters.WriteBlock
            scp_WriteBlock6: operation=pclNvmServices_MeasFrameRamCfg.WriteBlock
            scp_WriteBlock7: operation=pclNvmService_EcsProfiles.WriteBlock
            scp_WriteBlock8: operation=pclNvmService_SBSLastState.WriteBlock
            scp_WriteBlock9: operation=pclNvmService_EcsSensitivityLUT.WriteBlock
  swc implementation NvmIf_imp: category=BSW_Memory_Services, programming-language=C, sw-version=1.0.0, vendor-id=0, behavior=NvmIf
    code-descriptors:
      code NvmIf_Impl_Code: artifact-descriptors=autosar-engineering-object={short-label=NvmIf_Impl_Code_CodeDesc, category=SWSRC}
    resource consumption NvmIf_ImplResCons
      33 x memory section:
        CODE: size=0, sw-addrmethod=CODE
        CODE_ASIL_A: size=0, sw-addrmethod=CODE_ASIL_A
        CONST_16: alignment=16, size=16, sw-addrmethod=CONST
        CONST_16_ASIL_A: alignment=16, size=16, sw-addrmethod=CONST_ASIL_A
        CONST_32: alignment=32, size=32, sw-addrmethod=CONST
        CONST_32_ASIL_A: alignment=32, size=32, sw-addrmethod=CONST_ASIL_A
        CONST_8: alignment=8, size=8, sw-addrmethod=CONST
        CONST_8_ASIL_A: alignment=8, size=8, sw-addrmethod=CONST_ASIL_A
        CONST_BOOL: alignment=8, size=1, sw-addrmethod=CONST
        CONST_BOOL_ASIL_A: alignment=8, size=1, sw-addrmethod=CONST_ASIL_A
        CONST_UNSPECIFIED: alignment=UNSPECIFIED, size=0, sw-addrmethod=CONST
        CONST_UNSPECIFIED_ASIL_A: alignment=UNSPECIFIED, size=0, sw-addrmethod=CONST_ASIL_A
        VAR_INIT_16: alignment=16, size=16, sw-addrmethod=VAR_INIT
        VAR_INIT_16_ASIL_A: alignment=16, size=16, sw-addrmethod=VAR_INIT_ASIL_A
        VAR_INIT_32: alignment=32, size=32, sw-addrmethod=VAR_INIT
        VAR_INIT_32_ASIL_A: alignment=32, size=32, sw-addrmethod=VAR_INIT_ASIL_A
        VAR_INIT_8: alignment=8, size=8, sw-addrmethod=VAR_INIT
        VAR_INIT_8_ASIL_A: alignment=8, size=8, sw-addrmethod=VAR_INIT_ASIL_A
        VAR_INIT_BOOL: alignment=8, size=1, sw-addrmethod=VAR_INIT
        VAR_INIT_BOOL_ASIL_A: alignment=8, size=1, sw-addrmethod=VAR_INIT_ASIL_A
        VAR_INIT_UNSPECIFIED: alignment=UNSPECIFIED, size=0, sw-addrmethod=VAR_INIT
        VAR_INIT_UNSPECIFIED_ASIL_A: alignment=UNSPECIFIED, size=0, sw-addrmethod=VAR_INIT_ASIL_A
        VAR_NO_INIT_16: alignment=16, size=16, sw-addrmethod=VAR_NOINIT
        VAR_NO_INIT_16_ASIL_A: alignment=16, size=16, sw-addrmethod=VAR_NOINIT_ASIL_A
        VAR_NO_INIT_32: alignment=32, size=32, sw-addrmethod=VAR_NOINIT
        VAR_NO_INIT_32_ASIL_A: alignment=32, size=32, sw-addrmethod=VAR_NOINIT_ASIL_A
        VAR_NO_INIT_8: alignment=8, size=8, sw-addrmethod=VAR_NOINIT
        VAR_NO_INIT_8_ASIL_A: alignment=8, size=8, sw-addrmethod=VAR_NOINIT_ASIL_A
        VAR_NO_INIT_BOOL: alignment=8, size=1, sw-addrmethod=VAR_NOINIT
        VAR_NO_INIT_BOOL_ASIL_A: alignment=8, size=1, sw-addrmethod=VAR_NOINIT_ASIL_A
        VAR_NO_INIT_UNSPECIFIED: alignment=UNSPECIFIED, size=0, sw-addrmethod=VAR_NOINIT
        VAR_NO_INIT_UNSPECIFIED_ASIL_A: alignment=UNSPECIFIED, size=0, sw-addrmethod=VAR_NOINIT_ASIL_A
        VAR_POWER_ON_CLEARED: alignment=UNSPECIFIED, size=0, sw-addrmethod=VAR_POWER_ON_CLEARED
