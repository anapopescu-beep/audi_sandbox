AUTOSAR XML (schema 4-2-2)
package /AUTOLIV/SoftwareComponents/OsIf
  application sw component type OsIf: category=BSW_Operating_System
    behavior OsIf_IB: data-type-mapping=[DataTypeMappingSet_OsIf, DataTypeMappingSet_RCM], handle-termination-and-restart=NO-SUPPORT
      4 x external trigger occurred event:
        trBswM_RequestMode: start-on-event=OsTask_Bsw_Init, trigger=ptrrAsrBswMServicesOsIf.BswM_RequestMode
        trEcuM_StartupTwo: start-on-event=OsTask_Bsw_Init, trigger=ptrrAsrEcuMServicesOsIf.EcuM_StartupTwo
        trMIC_BusFaultException: start-on-event=ProtectionHook, trigger=ptrrMicServices.MIC_BusFaultException
        trMIC_HardFaultException: start-on-event=ProtectionHook, trigger=ptrrMicServices.MIC_HardFaultException
      runnable ErrorHook: external-triggering-point=ptrpAsrOsServicesOsIf.ErrorHook, symbol=ErrorHook_OsApplication_0
        sync call scp_GetOSErrorStatus: operation=pclRcmServices.ReportOsErrorStatus, timeout=0.0
        sync call scp_NotifyResetCause: operation=pclResetCauseNotification.NotifyResetCause, timeout=0.0
      runnable OsTask_Bsw_Init: external-triggering-point=ptrpAsrOsServicesOsIf.OsTask_Bsw_Init, symbol=OsTask_Bsw_Init_OsApplication_0
      runnable ProtectionHook: external-triggering-point=ptrpAsrOsServicesOsIf.ProtectionHook, symbol=ProtectionHook_OsApplication_0
        sync call scp_GetOSErrorStatus: operation=pclRcmServices.ReportOsErrorStatus, timeout=0.0
        sync call scp_NotifyResetCause: operation=pclResetCauseNotification.NotifyResetCause, timeout=0.0
  swc implementation OsIf_imp: category=BSW_Operating_System, programming-language=C, sw-version=1.0.0, vendor-id=0, behavior=OsIf_IB
    code-descriptors:
      code OsIf_Impl_Code: artifact-descriptors=autosar-engineering-object={short-label=OsIf_Impl_Code_CodeDesc, category=SWSRC}
    resource consumption OsIf_Impl_ResCons
      33 x memory section:
        CODE: size=0, sw-addrmethod=CODE
        CODE_ASIL_A: size=0, sw-addrmethod=CODE_ASIL_A
        CONST_16: alignment=16, size=16, sw-addrmethod=CONST
        CONST_16_ASIL_A: alignment=16, size=16, sw-addrmethod=CONST_ASIL_A
        CONST_32: alignment=32, size=32, sw-addrmethod=CONST
        CONST_32_ASIL_A: alignment=32, size=32, sw-addrmethod=CONST_ASIL_A
        CONST_8: alignment=8, size=8, sw-addrmethod=CONST
        CONST_8_ASIL_A: alignment=8, size=8, sw-addrmethod=CONST_ASIL_A
        CONST_BOOL: alignment=8, size=1, sw-addrmethod=CONST
        CONST_BOOL_ASIL_A: alignment=8, size=1, sw-addrmethod=CONST_ASIL_A
        CONST_UNSPECIFIED: alignment=UNSPECIFIED, size=0, sw-addrmethod=CONST
        CONST_UNSPECIFIED_ASIL_A: alignment=UNSPECIFIED, size=0, sw-addrmethod=CONST_ASIL_A
        VAR_INIT_16: alignment=16, size=16, sw-addrmethod=VAR_INIT
        VAR_INIT_16_ASIL_A: alignment=16, size=16, sw-addrmethod=VAR_INIT_ASIL_A
        VAR_INIT_32: alignment=32, size=32, sw-addrmethod=VAR_INIT
        VAR_INIT_32_ASIL_A: alignment=32, size=32, sw-addrmethod=VAR_INIT_ASIL_A
        VAR_INIT_8: alignment=8, size=8, sw-addrmethod=VAR_INIT
        VAR_INIT_8_ASIL_A: alignment=8, size=8, sw-addrmethod=VAR_INIT_ASIL_A
        VAR_INIT_BOOL: alignment=8, size=1, sw-addrmethod=VAR_INIT
        VAR_INIT_BOOL_ASIL_A: alignment=8, size=1, sw-addrmethod=VAR_INIT_ASIL_A
        VAR_INIT_UNSPECIFIED: alignment=UNSPECIFIED, size=0, sw-addrmethod=VAR_INIT
        VAR_INIT_UNSPECIFIED_ASIL_A: alignment=UNSPECIFIED, size=0, sw-addrmethod=VAR_INIT_ASIL_A
        VAR_NO_INIT_16: alignment=16, size=16, sw-addrmethod=VAR_NOINIT
        VAR_NO_INIT_16_ASIL_A: alignment=16, size=16, sw-addrmethod=VAR_NOINIT_ASIL_A
        VAR_NO_INIT_32: alignment=32, size=32, sw-addrmethod=VAR_NOINIT
        VAR_NO_INIT_32_ASIL_A: alignment=32, size=32, sw-addrmethod=VAR_NOINIT_ASIL_A
        VAR_NO_INIT_8: alignment=8, size=8, sw-addrmethod=VAR_NOINIT
        VAR_NO_INIT_8_ASIL_A: alignment=8, size=8, sw-addrmethod=VAR_NOINIT_ASIL_A
        VAR_NO_INIT_BOOL: alignment=8, size=1, sw-addrmethod=VAR_NOINIT
        VAR_NO_INIT_BOOL_ASIL_A: alignment=8, size=1, sw-addrmethod=VAR_NOINIT_ASIL_A
        VAR_NO_INIT_UNSPECIFIED: alignment=UNSPECIFIED, size=0, sw-addrmethod=VAR_NOINIT
        VAR_NO_INIT_UNSPECIFIED_ASIL_A: alignment=UNSPECIFIED, size=0, sw-addrmethod=VAR_NOINIT_ASIL_A
        VAR_POWER_ON_CLEARED: alignment=UNSPECIFIED, size=0, sw-addrmethod=VAR_POWER_ON_CLEARED
