AUTOSAR XML (schema 4-2-2)
package /AUTOLIV/SoftwareComponents/RCM
  complex device driver sw component type RCM: category=BSW_Complex_Device_Drivers
    behavior RCM_IB_0: data-type-mapping=[DataTypeMappingSet_ATM, DataTypeMappingSet_NvmIf, DataTypeMappingSet_RCM, DataTypeMappingSet_SpiIf], handle-termination-and-restart=NO-SUPPORT, port-api-option{enable-take-address=false, indirect-api=false, port=pseResetCause}
      5 x operation invoked event:
        RCM_evDetermineResetCause: start-on-event=RCM_DetermineResetCause, operation=pseResetCause.DetermineResetCause
        RCM_evGetResetCause: start-on-event=RCM_GetResetCause, operation=pseResetCause.GetResetCause
        RCM_evNotifyResetCause: start-on-event=RCM_NotifyResetCause, operation=pseResetCauseNotification.NotifyResetCause
        oie_pseOSErrorReport_GetOSErrorStatus: start-on-event=RCM_ReportOSError, operation=pseOSErrorReport.ReportOsErrorStatus
        oie_pseRunResetCause_AutotestCallback: start-on-event=RCM_Autotest_ResetCause, operation=pseRunResetCause.AutotestCallback
      explicit-inter-runnable-variables:
        data u8ResetCause: step-size=0.0, sw-calibration-access=READ-ONLY, type=u32ResetCauseType_Appl, init-value=constant-reference=APPLINIT_KU32_RESET_CAUSE_UNKNOWN  # Reset cause computed by the RCM component
      5 x runnable, all with sw-addr-method=CODE_ASIL_A:
        RCM_Autotest_ResetCause: can-be-invoked-concurrently=true
        RCM_DetermineResetCause: can-be-invoked-concurrently=true, external-triggering-point=ptrpRcmServicesBswMIf.RCM_runDetermineResetCause  # To determine the reset cause
          sync call scp_GetSbcStatus1: operation=pclSbcWdgServices.GetSbcStatus, timeout=0.0
          sync call scp_SetRamBlockStatus: operation=pclNvmIfServices.SetRamBlockStatus, timeout=0.0
        RCM_GetResetCause: can-be-invoked-concurrently=true, external-triggering-point=ptrpRcmServicesBswMIf.RCM_runGetResetCause
          read-local-variables:
            access u8ResetCause: accessed-variable=u8ResetCause
        RCM_NotifyResetCause: can-be-invoked-concurrently=true  # this function give sthe possibility to the rest of the SW application to store in protected memory section that a reset will be performed
        RCM_ReportOSError
  swc implementation RCM_imp: category=BSW_Complex_Device_Drivers, programming-language=C, sw-version=1.0.0, vendor-id=0, behavior=RCM_IB_0
    code-descriptors:
      code RCM_Impl_Code: artifact-descriptors=autosar-engineering-object={short-label=RCM_Impl_Code_CodeDesc, category=SWSRC}
    resource consumption RCM_Impl_ResCons
      33 x memory section:
        CODE: size=0, sw-addrmethod=CODE
        CODE_ASIL_A: size=0, sw-addrmethod=CODE_ASIL_A
        CONST_16: alignment=16, size=16, sw-addrmethod=CONST
        CONST_16_ASIL_A: alignment=16, size=16, sw-addrmethod=CONST_ASIL_A
        CONST_32: alignment=32, size=32, sw-addrmethod=CONST
        CONST_32_ASIL_A: alignment=32, size=32, sw-addrmethod=CONST_ASIL_A
        CONST_8: alignment=8, size=8, sw-addrmethod=CONST
        CONST_8_ASIL_A: alignment=8, size=8, sw-addrmethod=CONST_ASIL_A
        CONST_BOOL: alignment=8, size=1, sw-addrmethod=CONST
        CONST_BOOL_ASIL_A: alignment=8, size=1, sw-addrmethod=CONST_ASIL_A
        CONST_UNSPECIFIED: alignment=UNSPECIFIED, size=0, sw-addrmethod=CONST
        CONST_UNSPECIFIED_ASIL_A: alignment=UNSPECIFIED, size=0, sw-addrmethod=CONST_ASIL_A
        VAR_INIT_16: alignment=16, size=16, sw-addrmethod=VAR_INIT
        VAR_INIT_16_ASIL_A: alignment=16, size=16, sw-addrmethod=VAR_INIT_ASIL_A
        VAR_INIT_32: alignment=32, size=32, sw-addrmethod=VAR_INIT
        VAR_INIT_32_ASIL_A: alignment=32, size=32, sw-addrmethod=VAR_INIT_ASIL_A
        VAR_INIT_8: alignment=8, size=8, sw-addrmethod=VAR_INIT
        VAR_INIT_8_ASIL_A: alignment=8, size=8, sw-addrmethod=VAR_INIT_ASIL_A
        VAR_INIT_BOOL: alignment=8, size=1, sw-addrmethod=VAR_INIT
        VAR_INIT_BOOL_ASIL_A: alignment=8, size=1, sw-addrmethod=VAR_INIT_ASIL_A
        VAR_INIT_UNSPECIFIED: alignment=UNSPECIFIED, size=0, sw-addrmethod=VAR_INIT
        VAR_INIT_UNSPECIFIED_ASIL_A: alignment=UNSPECIFIED, size=0, sw-addrmethod=VAR_INIT_ASIL_A
        VAR_NO_INIT_16: alignment=16, size=16, sw-addrmethod=VAR_NOINIT
        VAR_NO_INIT_16_ASIL_A: alignment=16, size=16, sw-addrmethod=VAR_NOINIT_ASIL_A
        VAR_NO_INIT_32: alignment=32, size=32, sw-addrmethod=VAR_NOINIT
        VAR_NO_INIT_32_ASIL_A: alignment=32, size=32, sw-addrmethod=VAR_NOINIT_ASIL_A
        VAR_NO_INIT_8: alignment=8, size=8, sw-addrmethod=VAR_NOINIT
        VAR_NO_INIT_8_ASIL_A: alignment=8, size=8, sw-addrmethod=VAR_NOINIT_ASIL_A
        VAR_NO_INIT_BOOL: alignment=8, size=1, sw-addrmethod=VAR_NOINIT
        VAR_NO_INIT_BOOL_ASIL_A: alignment=8, size=1, sw-addrmethod=VAR_NOINIT_ASIL_A
        VAR_NO_INIT_UNSPECIFIED: alignment=UNSPECIFIED, size=0, sw-addrmethod=VAR_NOINIT
        VAR_NO_INIT_UNSPECIFIED_ASIL_A: alignment=UNSPECIFIED, size=0, sw-addrmethod=VAR_NOINIT_ASIL_A
        VAR_POWER_ON_CLEARED: alignment=UNSPECIFIED, size=0, sw-addrmethod=VAR_POWER_ON_CLEARED
