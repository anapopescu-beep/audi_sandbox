AUTOSAR XML (schema 4-2-2)
# The material contained in this specification is protected by copyright and
# other types of Intellectual Property Rights. The commercial exploitation of
# the material contained in this specification requires a license to such
# Intellectual Property Rights.
# This specification may be utilized or reproduced without any modification, in
# any form or by any means, for informational purposes only.
# For any other purpose, no part of the specification may be utilized or
# reproduced, in any form or by any means, without permission in writing from
# the publisher.
# licensed under the same rules as applicable to the AUTOSAR Standard.
package /AUTOSAR/AISpecification/PhysicalDimensions
  18 x physical dimension:
    Len1: length-exp=1  # Length 1
    Len1M1TiNeg2: length-exp=1, mass-exp=1, time-exp=-2  # Length 1 Mass 1 Time -2
    Len1TiNeg{1..3}: length-exp=1, time-exp=-{1..3}  # Length 1 Time -{1..3}
    Len2M1TiNeg2: length-exp=2, mass-exp=1, time-exp=-2  # Length 2 Mass 1 Time -2
    Len2M1TiNeg3: length-exp=2, mass-exp=1, time-exp=-3  # Length 2 Mass 1 Time -3
    Len2M1TiNeg3INeg1: length-exp=2, mass-exp=1, time-exp=-3, current-exp=-1  # Length 2 Mass 1 Time -3 Electric current -1
    LenNeg1: length-exp=-1  # Length -1
    LenNeg1M1TiNeg2: length-exp=-1, mass-exp=1, time-exp=-2  # Length -1 Mass 1 Time -2
    M1: mass-exp=1  # Mass 1
    M1TiNeg1: mass-exp=1, time-exp=-1  # Mass 1 Time -1
    M1TiNeg2: mass-exp=1, time-exp=-2  # Mass 1 Time -2
    NoDimension  # No Dimension
    T1: temperature-exp=1  # Temperature 1
    Ti1: time-exp=1  # Time 1
    TiNeg1: time-exp=-1  # Time -1
    TiNeg2: time-exp=-2  # Time -2
