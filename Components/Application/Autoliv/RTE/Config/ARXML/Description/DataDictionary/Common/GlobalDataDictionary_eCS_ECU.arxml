AUTOSAR XML (schema 4-2-2)
standard types defined: UInt16, UInt32, UInt8
package /AUTOLIV/ACC_DataDictionary/ApplicationDataTypes
  app type u32AccFailiureCauseType_Appl: category=VALUE
package /AUTOLIV/ACC_DataDictionary/ClientServerInterfaces
  client server interface icsAccRestartInit
    operation RestartInitialization
  client server interface icsAccSpiTempData
    operation GetTemperatureData
      arg u16SpiTemperatureData: type=uint16, direction=OUT, server-argument-impl-policy=USE-ARGUMENT-TYPE
package /AUTOLIV/ACC_DataDictionary/ConstantsMappingSet
  constant specification mapping set ConstantsMappingSet_ACC
package /AUTOLIV/ACC_DataDictionary/DataTypeMappingSet
  data type mapping set DataTypeMappingSet_ACC
    data-type-maps:
      application-data-type=s16AccTemperature, implementation-data-type=sint16
      application-data-type=UInt8_Appl, implementation-data-type=uint8
      application-data-type=u8TestResultType_Appl, implementation-data-type=u8TestResultType
      application-data-type=u32AccFailiureCauseType_Appl, implementation-data-type=uint32
package /AUTOLIV/ACC_DataDictionary/SenderReceiverInterfaces
  sender receiver interface isrAccFailiureSource
    5 x data, all with init-value=0:
      u32AccAlarmRegStatus: type=u32AccFailiureCauseType_Appl
      u8AccAlarmbPreinitSeqStatus: type=uint8
      u8AccCRCStatus: type=uint8
      u8AccReturnStatus: type=uint8
      u8AccelAxisBroken: type=uint8
package /AUTOLIV/ACC_DataDictionary/TriggerInterfaces
  trigger interface trAccServices
    trigger ACC_AccelerometerInit: trigger-period={cse-code=1000, cse-code-factor=0}
package /AUTOLIV/ATM_DataDictionnary/ApplicationDataTypes
  app type u8AutoTestIdType_Appl:  # Identifier of auto test
    category=VALUE
    sw-calibration-access=READ-ONLY
    compu {0=ATM_KU8_ID_TEST_ADC_OUT_OF_ORDER, 1=ATM_KU8_ID_PFLASH_MEMORY_CORRUPTION, 2=ATM_KU8_ID_NVM_NOT_PROG, 3=ATM_KU8_ID_NVM_MEMORY_CORRUPTION, 4=ATM_KU8_ID_RAM_MEMORY_CORRUPTION, 5=ATM_KU8_ID_RESET_CAUSE, 6=ATM_KU8_ID_TEST_ADC_CALIB, 7=ATM_KU8_ID_TEST_ECU_OVER_TEMPERATURE, 8=ATM_KU8_ID_EXT_WDG_OUT_OF_ORDER, 9=ATM_KU8_ID_POWER_SUPPLY_UV, 10=ATM_KU8_ID_POWER_SUPPLY_OV, 11=ATM_KU8_ID_ACTUATOR_STUCK, 12=ATM_KU8_ID_OPEN_CIRCUIT, 13=ATM_KU8_ID_SHORT_TO_GND, 14=ATM_KU8_ID_SHORT_TO_VBAT, 15=ATM_KU8_ID_MCU_SELFTEST, 16=ATM_KU8_ID_ACC_CHECK_ALARMB, 17=ATM_KU8_ID_SBC_CHECK_STATUS_INFO, 18=ATM_KU8_ID_ECU_BATTERY_UNSTABLE, 19=ATM_KU8_ID_SOLENOID_OVERVOLTAGE, 20=ATM_KU8_ID_POWER_STAGE_FAULT, 21=ATM_KU8_ID_MCU_CRC_REGISTERS, 22=ATM_KU8_NB_OF_AUTOTEST}
  app type u8TestResultType_Appl: category=VALUE, sw-calibration-access=READ-ONLY, compu-method=scAutoTestResultScaling
package /AUTOLIV/ATM_DataDictionnary/ClientServerInterfaces
  client server interface icsAutotestCallback
    operation AutotestCallback
      arg pu8TestResult: type=u8TestResultType_Appl, direction=OUT, server-argument-impl-policy=USE-ARGUMENT-TYPE
  client server interface icsAutotestServices
    operation GetCriticalAutoTestsReachedFlag
      arg u8CriticalAutoTestsReachedFlag: type=uint8, direction=OUT, server-argument-impl-policy=USE-ARGUMENT-TYPE
    operation GetTestResult
      arg u8AutoTestId: type=u8AutoTestIdType_Appl, direction=IN
      arg u8TestResult: type=u8TestResultType_Appl, direction=OUT
package /AUTOLIV/ATM_DataDictionnary/ComputationMethods
  compu method scAutoTestResultScaling: 1=KU8_ATM_TEST_OK, 2=KU8_ATM_TEST_NOK, 4=KU8_ATM_TEST_NOT_DECIDED, 8=KU8_ATM_TEST_NON_EXISTENT, 16=KU8_ATM_TEST_BAD_CONDITIONS
package /AUTOLIV/ATM_DataDictionnary/DataTypeMappingSet
  data type mapping set DataTypeMappingSet_ATM
    data-type-maps:
      application-data-type=u8AutoTestIdType_Appl, implementation-data-type=u8AutoTestIdType
      application-data-type=u8TestResultType_Appl, implementation-data-type=u8TestResultType
package /AUTOLIV/ATM_DataDictionnary/ImplementationDataTypes
  impl type u8AutoTestIdType: implementation-data-type=uint8
  impl type u8TestResultType: compu-method=scAutoTestResultScaling, implementation-data-type=uint8
package /AUTOLIV/ATM_DataDictionnary/TriggerInterfaces
  trigger interface itrAtmServices
    trigger ATM_Init: trigger-period={cse-code=1000, cse-code-factor=0}
package /AUTOLIV/AUTOSAR_MemMap/SwAddrMethods
  4 x sw addr method:
    CODE_ASIL_A: memory-allocation-keyword-policy=ADDR-METHOD-SHORT-NAME, section-type=CODE
    CONST_ASIL_A: memory-allocation-keyword-policy=ADDR-METHOD-SHORT-NAME-AND-ALIGNMENT, section-type=CONST
    VAR_INIT_ASIL_A: memory-allocation-keyword-policy=ADDR-METHOD-SHORT-NAME-AND-ALIGNMENT, section-initialization-policy=INIT, section-type=VAR
    VAR_NOINIT_ASIL_A: memory-allocation-keyword-policy=ADDR-METHOD-SHORT-NAME-AND-ALIGNMENT, section-initialization-policy=NO-INIT, section-type=VAR
package /AUTOLIV/AdcIf_DataDictionnary/ApplicationDataTypes
  app type u16AdcValueLsbType_Appl: category=VALUE, sw-calibration-access=READ-ONLY, range raw 0..1023
  app type u16SolenoidCurrentType_Appl: category=VALUE, compu {phys=raw for raw 0..500}
  app type u8AdcChannelIDType_Appl:
    category=VALUE
    sw-calibration-access=READ-ONLY
    compu {0..5=KU8_ADC_CH_ID_MAG_V_1..KU8_ADC_CH_ID_MAG_V_6, 6=KU8_ADC_CH_ID_WAKE_1, 7=KU8_ADC_CH_ID_WAKE_2, 8=KU8_ADC_CH_ID_V_BATT, 9=KU8_ADC_CH_ID_V_REF_HIGH, 10=KU8_ADC_CH_ID_V_REF_LOW, 11=KU8_ADC_CH_ID_PTC_TEMP, 12=KU8_ADC_CH_V_ECU_TEMP_MCU_BAND_GAP, 13=KU8_ADC_CH_V_ECU_TEMP_MCU, 14=KU8_ADC_CH_V_ECU_TEMP_ACC, 15..20=KU8_ADC_CH_ID_MAG_I_1..KU8_ADC_CH_ID_MAG_I_6, 21..26=KU8_ADC_CH_ID_SOLENOID_TEMP_1..KU8_ADC_CH_ID_SOLENOID_TEMP_6, 27..32=KU8_ADC_CH_ID_MAG_V_10_MS_1..KU8_ADC_CH_ID_MAG_V_10_MS_6, 33..38=KU8_ADC_CH_ID_MAG_V_100_MS_1..KU8_ADC_CH_ID_MAG_V_100_MS_6, 39=KU8_ADC_CH_ID_V_BATT_10_MS, 40=KU8_ADC_CH_ID_BOOST_DIAG, 41=KU8_ADC_CH_ID_MAG_V_1_1, 42=KU8_ADC_CH_ID_MAG_V_2_1, 43=KU8_ADC_CH_ID_MAG_V_3_1, 44=KU8_ADC_CH_ID_MAG_V_4_1, 45=KU8_ADC_CH_ID_MAG_V_5_1, 46=KU8_ADC_CH_ID_MAG_V_6_1, 47=KU8_ADC_CH_ID_MAG_V_1_2, 48=KU8_ADC_CH_ID_MAG_V_2_2, 49=KU8_ADC_CH_ID_MAG_V_3_2, 50=KU8_ADC_CH_ID_MAG_V_4_2, 51=KU8_ADC_CH_ID_MAG_V_5_2, 52=KU8_ADC_CH_ID_MAG_V_6_2, 53=KU8_ADC_CH_ID_MAG_V_1_3, 54=KU8_ADC_CH_ID_MAG_V_2_3, 55=KU8_ADC_CH_ID_MAG_V_3_3, 56=KU8_ADC_CH_ID_MAG_V_4_3, 57=KU8_ADC_CH_ID_MAG_V_5_3, 58=KU8_ADC_CH_ID_MAG_V_6_3}
package /AUTOLIV/AdcIf_DataDictionnary/ClientServerInterfaces
  client server interface icsRawAdcService
    operation getChannelValue
      arg u8ChannelId: type=u8AdcChannelIDType_Appl, direction=IN, server-argument-impl-policy=USE-ARGUMENT-TYPE
      arg u16Value: type=u16AdcValueLsbType_Appl, direction=OUT, server-argument-impl-policy=USE-ARGUMENT-TYPE
package /AUTOLIV/AdcIf_DataDictionnary/ConstantsMappingSet
  constant specification mapping set ConstantsMappingSet_AdcIf
  constant specification mapping set ConstantsMappingSet_DcmIf
package /AUTOLIV/AdcIf_DataDictionnary/DataTypeMappingSet
  data type mapping set DataTypeMappingSet_AdcIf
    data-type-maps:
      application-data-type=u16SolenoidCurrentType_Appl, implementation-data-type=u16SolenoidCurrentType
      application-data-type=u16AdcValueLsbType_Appl, implementation-data-type=u16AdcValueLsbType
      application-data-type=u8AdcChannelIDType_Appl, implementation-data-type=u8AdcChannelIDType
      application-data-type=u8TestResultType_Appl, implementation-data-type=u8TestResultType
      application-data-type=u8AutoTestIdType_Appl, implementation-data-type=u8AutoTestIdType
      application-data-type=u8HistoricalAdcSampleIndex, implementation-data-type=uint8
      application-data-type=aau16HistoricalAdcSamplesType_Appl, implementation-data-type=aau16HistoricalAdcSamplesType
package /AUTOLIV/AdcIf_DataDictionnary/ImplementationDataTypes
  4 x impl type:
    aau16HistoricalAdcSamplesType: category=ARRAY
      element elem_aau16HistoricalAdcSamples: category=ARRAY, array-size=6, array-size-semantics=FIXED-SIZE
        element elem_au16HistoricalAdcSamples: category=VALUE, array-size=6, array-size-semantics=FIXED-SIZE, base-type=uint16, sw-calibration-access=READ-ONLY
    u16AdcValueLsbType: range raw 0..1023, implementation-data-type=uint16
    u16SolenoidCurrentType: implementation-data-type=uint16
    u8AdcChannelIDType: implementation-data-type=uint8
package /AUTOLIV/AdcIf_DataDictionnary/SenderReceiverInterfaces
  sender receiver interface isrSolenoidAdcBuffer
    data aau16HistoricalAdcSamples: type=aau16HistoricalAdcSamplesType_Appl, init-value=[aau16HistoricalAdcSamples_0:6 x 0, aau16HistoricalAdcSamples_1:6 x 0, aau16HistoricalAdcSamples_2:6 x 0, aau16HistoricalAdcSamples_3:6 x 0, aau16HistoricalAdcSamples_4:6 x 0, aau16HistoricalAdcSamples_5:6 x 0]
    data u8HistoricalAdcSampleIndex: type=u8HistoricalAdcSampleIndex, init-value=0
package /AUTOLIV/AdcIf_DataDictionnary/TriggerInterfaces
  trigger interface itrAdcIfServices
    4 x trigger, all with trigger-period={cse-code=1000, cse-code-factor=0}:
      AdcIf_Calib
      AdcIf_runDeInit
      AdcIf_runGetChannelValue
      AdcIf_runInit
package /AUTOLIV/BswMIf_DataDictionary/ClientServerInterfaces
  client server interface icsEcuTransitionState
    operation BswM_SetEcuStateTransitionStatus
      arg u8TransitionStatus: type=uint8, direction=IN, server-argument-impl-policy=USE-ARGUMENT-TYPE
  client server interface icsPassengerOccupancyState
    operation BswM_UpdatePassangerOccupancyStatus
package /AUTOLIV/BswMIf_DataDictionary/ConstantsMappingSet
  constant specification mapping set ConstantsMappingSet_BswMIf
package /AUTOLIV/BswMIf_DataDictionary/DataTypeMappingSet
  data type mapping set DataTypeMappingSet_BswMIf
package /AUTOLIV/CIL_DataDictionnary/ApplicationDataTypes
  6 x app type, all with category=VALUE:
    MeasureFramesDataIDType_Appl: compu {4097=ADC_KU16_MF_ADC_VSUP, 4098=ADC_KU16_MF_MCU_TEMPERATURE, 4099=ADC_KU16_MF_HEAT_TEMP_HIGH, 4100=ADC_KU16_MF_HEAT_TEMP_LOW, 4101=ADC_KU16_MF_HEAT_IS_INPUT, 4102=ADC_KU16_MF_ADC_VBAT, 24580=HDV_KU16_MF_POWER_ORDER_STEERING_WHEEL, 24581=HDV_KU16_MF_POWER_ORDER_ENCLOSURE, 24582=HDV_KU16_MF_MAT_CURRENT, 24583=HDV_KU16_MF_POWER_STEERING_WHEEL, 24584=HDV_KU16_MF_POWER_ENCLOSURE, 24585=HDV_KU16_MF_MAT_TEMPERATURE, 24586=HDV_KU16_MF_SWS_TEMPERATURE, 24587=HDV_KU8_MF_FAILED_TESTS_FLAGS, 24588=HDV_KU16_MF_HEAT_AMB_TEMP, 24577=HDV_KU8_MF_MASTER_REGUL, 24578=HDV_KU8_MF_PWM_CYCLE_CNT, 24579=HDV_KU8_MF_PWM_ORDER, 28679=HFE_KU16_MF_MAT_INTEGRAL_SUM_H, 28680=HFE_KU16_MF_MAT_INTEGRAL_SUM_L, 28678=HFE_KU16_MF_NVP_KD_ENCLOSURE, 28675=HFE_KU16_MF_NVP_KD_MAT, 28677=HFE_KU16_MF_NVP_KI_ENCLOSURE, 28674=HFE_KU16_MF_NVP_KI_MAT, 28676=HFE_KU16_MF_NVP_KP_ENCLOSURE, 28673=HFE_KU16_MF_NVP_KP_MAT, 32772=HFS_KU8_MF_FUNCTION_SELECTED, 32773=HFS_KU8_MF_FUNCTION_STATE, 32774=HFS_KU8_MF_MICRO_BAD_PRE_CONDITIONS, 32770=HFS_KU8_MF_PRE_CONDITIONS, 32771=HFS_KU8_MF_TEMPERATURE_TARGET_REQUESTED, 32769=HFS_KU8_MF_TEMPERATURE_TARGET_SELECTED, 36865=HOD_KU16_MF_ZONE1_ADC_MEASURE, 36866=HOD_KU16_MF_ZONE2_ADC_MEASURE, 36867=HOD_KU16_MF_ZONE3_ADC_MEASURE, 36868=HOD_KU16_MF_ZONE4_ADC_MEASURE, 36869=HOD_KU16_MF_ADC_MEAS_OFFSET_ZONES, 36870=HOD_KU16_MF_ADC_MEAS_C40_OC, 36871=HOD_KU16_MF_ADC_MEAS_C40_OC_OFFSET, 36872=HOD_KU16_MF_ADC_MEAS_C40_ZONE, 36873=HOD_KU16_MF_ADC_MEAS_C40_ZONE_OFFSET, 36874=HOD_KU16_MF_ADC_MEAS_GUARD, 36875=HOD_KU16_MF_ADC_MEAS_GUARD_OFFSET, 36876=HOD_KU16_MF_ADC_MEAS_CREF, 36877=HOD_KU16_MF_ADC_MEAS_CREF_OFFSET, 40983=HOA_KU16_MF_AREA1_CAPACITANCE_ALL, 40984=HOA_KU16_MF_AREA2_CAPACITANCE_ALL, 40985=HOA_KU16_MF_AREA3_CAPACITANCE_ALL, 40986=HOA_KU16_MF_AREA4_CAPACITANCE_ALL, 40992=HOA_KU16_MF_ZONE1_ADAPTATIVE_THRESHOLD_VAL, 40993=HOA_KU16_MF_ZONE2_ADAPTATIVE_THRESHOLD_VAL, 40994=HOA_KU16_MF_ZONE3_ADAPTATIVE_THRESHOLD_VAL, 40995=HOA_KU16_MF_ZONE4_ADAPTATIVE_THRESHOLD_VAL, 41006=HOA_KU16_MF_ALGO_AREA1_BARYCENTER_ONE_HAND, 41007=HOA_KU16_MF_ALGO_AREA2_BARYCENTER_ONE_HAND, 41008=HOA_KU16_MF_ALGO_AREA3_BARYCENTER_ONE_HAND, 41009=HOA_KU16_MF_ALGO_AREA4_BARYCENTER_ONE_HAND, 41010=HOA_KU16_MF_ALGO_DETAIL_CLASS, 41011=HOA_KU16_MF_ALGO_GAP_CRIT_1_TO_4, 41012=HOA_KU16_MF_ALGO_AREA1_BARYCENTER_NO_HAND, 41013=HOA_KU16_MF_ALGO_AREA2_BARYCENTER_NO_HAND, 41014=HOA_KU16_MF_ALGO_AREA3_BARYCENTER_NO_HAND, 41015=HOA_KU16_MF_ALGO_AREA4_BARYCENTER_NO_HAND}
    MeasureFramesReturnDataType_Appl: compu {65535=KU16_MF_DEFAULT_DATA}
    u16VxType_Appl
    u8BuckeStateType_Appl
    u8MFLogger_Appl: compu {1=KU8_STARTUP}
    u8MergedBuckleStatusType_Appl: compu {0=KU8_BUCKLE_LATCHED, 1=KU8_BUCKLE_NOT_LATCHED, 2=KU8_BUCKLE_UNKNOWN}
package /AUTOLIV/CIL_DataDictionnary/ClientServerInterfaces
  client server interface icsEcuStateServices
    operation updateCurrentEcuState
      arg u8CurrentEcuState: type=uint8, direction=IN, server-argument-impl-policy=USE-ARGUMENT-TYPE
package /AUTOLIV/CIL_DataDictionnary/ComputationMethods
  compu method scVx: phys=raw*0.1 for raw 0..409.5; unit NoSignalUnit  # scVehicleSpeed | From C class DBC
package /AUTOLIV/CIL_DataDictionnary/Constants
  constant specification APPLINIT_KU8_CAR_CRASH_DETECTED_FALSE: value-spec=85
  constant specification IMPLINIT_KU8_CAR_CRASH_DETECTED_FALSE: value-spec=85
package /AUTOLIV/CIL_DataDictionnary/ConstantsMappingSet
  constant specification mapping set ConstantsMappingSet_CIL
package /AUTOLIV/CIL_DataDictionnary/DataConstraints
  range dc_u8IsCarCrashDetectedType: raw 0..255
package /AUTOLIV/CIL_DataDictionnary/DataTypeMappingSet
  data type mapping set DataTypeMappingSet_CIL
    data-type-maps:
      application-data-type=u8Error_Reihe1_BFS_1Type_Appl, implementation-data-type=uint8
      application-data-type=u8Error_Reihe1_BFS_2Type_Appl, implementation-data-type=uint8
      application-data-type=u8Error_Reihe1_FS_1Type_Appl, implementation-data-type=uint8
      application-data-type=u8Error_Reihe1_FS_2Type_Appl, implementation-data-type=uint8
      application-data-type=u8Error_Reihe2_BFSType_Appl, implementation-data-type=uint8
      application-data-type=u8Error_Reihe2_FSType_Appl, implementation-data-type=uint8
      application-data-type=u8SBS_LastState_Reihe2_BFSType_Appl, implementation-data-type=uint8
      application-data-type=u8SBS_LastState_Reihe2_FSType_Appl, implementation-data-type=uint8
      application-data-type=u8Status_Verr_Reihe1_BFS_1Type_Appl, implementation-data-type=uint8
      application-data-type=u8Status_Verr_Reihe1_BFS_2Type_Appl, implementation-data-type=uint8
      application-data-type=u8Status_Verr_Reihe1_FS_1Type_Appl, implementation-data-type=uint8
      application-data-type=u8Status_Verr_Reihe1_FS_2Type_Appl, implementation-data-type=uint8
      application-data-type=u8Status_Verr_Reihe2_BFSType_Appl, implementation-data-type=uint8
      application-data-type=u8Status_Verr_Reihe2_FSType_Appl, implementation-data-type=uint8
      application-data-type=u16VxType_Appl, implementation-data-type=u16VxType
      application-data-type=MeasureFramesDataIDType_Appl, implementation-data-type=u16MeasureFramesDataIDType
      application-data-type=MeasureFramesReturnDataType_Appl, implementation-data-type=uint16
      application-data-type=u8BuckeStateType_Appl, implementation-data-type=u8BuckleStateType
      application-data-type=u8AbCrashIntType_Appl, implementation-data-type=uint8
      application-data-type=u8GurtschlossStatusReihe2BFType_Appl, implementation-data-type=uint8
      application-data-type=u8SbsBelegungReihe2BFType_Appl, implementation-data-type=uint8
      application-data-type=u8eCSHwErrorType_Appl, implementation-data-type=uint8
      application-data-type=u8eCSStatusType_Appl, implementation-data-type=uint8
      application-data-type=u8AbAktuatorTestBFType_Appl, implementation-data-type=uint8
      application-data-type=u8SbsBelegungReihe2FAType_Appl, implementation-data-type=uint8
      application-data-type=u8GurtschlossStatusReihe2FAType_Appl, implementation-data-type=uint8
      application-data-type=u8eCSStoerungErrorType_Appl, implementation-data-type=uint8
      application-data-type=u8AbAktuatorTestFAType_Appl, implementation-data-type=uint8
      application-data-type=u8AbAktuatorTestReihe2FAType_Appl, implementation-data-type=uint8
      application-data-type=u8AbAktuatorTestReihe2BFType_Appl, implementation-data-type=uint8
      application-data-type=u8AbAktuatorTestReihe3FAType_Appl, implementation-data-type=uint8
      application-data-type=u8AbAktuatorTestReihe3BFType_Appl, implementation-data-type=uint8
      application-data-type=au8MergedBuckleStatusType_Appl, implementation-data-type=au8MergedBuckleStatusType
      uint8
      application-data-type=u8MFLogger_Appl, implementation-data-type=uint8
package /AUTOLIV/CIL_DataDictionnary/ImplementationDataTypes
  4 x impl type, all with category=TYPE_REFERENCE:
    s8VehicleAmbientTemperatureType: implementation-data-type=sint8
    u16MeasureFramesDataIDType: implementation-data-type=uint16
    u16VxType: implementation-data-type=uint16
    u8BuckleStateType: implementation-data-type=uint8
package /AUTOLIV/CIL_DataDictionnary/TriggerInterfaces
  trigger interface itrCilServices
    trigger CIL_runInit: trigger-period={cse-code=1000, cse-code-factor=0}
package /AUTOLIV/DIA_DataDictionnary/ApplicationDataTypes
  app type u8SbcStatusInfoType: category=VALUE, compu-method=scSbcStatusInformation
package /AUTOLIV/DIA_DataDictionnary/ConstantsMappingSet
  constant specification mapping set ConstantsMappingSet_DIA
package /AUTOLIV/DIA_DataDictionnary/DataTypeMappingSet
  data type mapping set DataTypeMappingSet_DIA
    data-type-maps:
      application-data-type=u8AdcChannelIDType_Appl, implementation-data-type=u8AdcChannelIDType
      application-data-type=u16AdcValueLsbType_Appl, implementation-data-type=u16AdcValueLsbType
package /AUTOLIV/DIA_DataDictionnary/TriggerInterfaces
  trigger interface itrDiaServices
    trigger DIA_Init: trigger-period={cse-code=1000, cse-code-factor=0}
package /AUTOLIV/DcmIf_DataDictionary/DataTypeMappingSet
  data type mapping set DataTypeMappingSet_DcmIf
package /AUTOLIV/DemIf_DataDictionary/ClientServerInterfaces
  client server interface icsDemIfEventServices
    operation GetCounterPassedThreshold
      arg ku16EventId: type=Dem_EventIdType, direction=IN, server-argument-impl-policy=USE-ARGUMENT-TYPE
      arg pu16DebounceTime: type=uint16, direction=OUT, server-argument-impl-policy=USE-ARGUMENT-TYPE
package /AUTOLIV/DemIf_DataDictionary/ConstantsMappingSet
  constant specification mapping set ConstantsMappingSet_DemIf
package /AUTOLIV/DemIf_DataDictionary/DataTypeMappingSet
  data type mapping set DataTypeMappingSet_DemIf
package /AUTOLIV/DioIf_DataDictionnary/ApplicationDataTypes
  app type u8DioIfChannelType_Appl: category=VALUE, compu {0..5=DIOIF_CH_EN_CS_1..DIOIF_CH_EN_CS_6, 6=DIOIF_CH_EN_BOOST, 7=DIOIF_CH_ON_OFF_POWER, 8=DIOIF_CH_ACC_ALARM_B, 9=DIOIF_CH_WAKE_CYCLIC_POWER, 10=DIOIF_CH_WAKE_SW1, 11=DIOIF_CH_WAKE_SW2, 12=DIOIF_CH_MAX}
  app type u8DioIfLvlType_Appl: category=VALUE  # u8DioIfLevelType_Appl
package /AUTOLIV/DioIf_DataDictionnary/ClientServerInterfaces
  client server interface icsDioIfServices
    operation ReadChannel
      arg u8ChannelID: type=u8DioIfChannelType_Appl, direction=IN, server-argument-impl-policy=USE-ARGUMENT-TYPE
      arg u8Level: type=u8DioIfLvlType_Appl, direction=OUT, server-argument-impl-policy=USE-ARGUMENT-TYPE
    operation WriteChannel
      arg u8ChannelID: type=u8DioIfChannelType_Appl, direction=IN, server-argument-impl-policy=USE-ARGUMENT-TYPE
      arg u8Level: type=u8DioIfLvlType_Appl, direction=IN, server-argument-impl-policy=USE-ARGUMENT-TYPE  # u8ChannelLevel
package /AUTOLIV/DioIf_DataDictionnary/ConstantsMappingSet
  constant specification mapping set ConstantsMappingSet_DioIf
package /AUTOLIV/DioIf_DataDictionnary/DataTypeMappingSet
  data type mapping set DataTypeMappingSet_DioIf
    data-type-maps:
      application-data-type=u8DioIfChannelType_Appl, implementation-data-type=u8DioIfChannelType
      application-data-type=u8DioIfLvlType_Appl, implementation-data-type=u8DioIfLvlType
package /AUTOLIV/DioIf_DataDictionnary/ImplementationDataTypes
  impl type u8DioIfChannelType: implementation-data-type=uint8
  impl type u8DioIfLvlType: implementation-data-type=uint8  # u8DioIfLevelType
package /AUTOLIV/DioIf_DataDictionnary/TriggerInterfaces
  trigger interface itrDioIfServices
    trigger DioIf_Init: trigger-period={cse-code=1000, cse-code-factor=0}
    trigger DioIf_runReadChannel: trigger-period={cse-code=1000, cse-code-factor=0}
    trigger DioIf_runWriteChannel: trigger-period={cse-code=1000, cse-code-factor=0}
package /AUTOLIV/EFX_DataDictionary/ClientServerInterfaces
  client server interface icsEfxServices
    operation LPF_Filter
      arg LastSample: type=uint16, direction=IN, server-argument-impl-policy=USE-ARGUMENT-TYPE
      arg CurrentSample: type=uint16, direction=IN, server-argument-impl-policy=USE-ARGUMENT-TYPE
      arg FilteredValue: type=uint16, direction=OUT, server-argument-impl-policy=USE-ARGUMENT-TYPE
package /AUTOLIV/EFX_DataDictionary/ConstantsMappingSet
  constant specification mapping set ConstantsMappingSet_EFX
package /AUTOLIV/EFX_DataDictionary/DataTypeMappingSet
  data type mapping set DataTypeMappingSet_EFX
package /AUTOLIV/EIM_DataDictionary/ClientServerInterfaces
  client server interface icsInjectError
    operation EIM_ManageAecStatus
package /AUTOLIV/EIM_DataDictionary/ConstantsMappingSet
  constant specification mapping set ConstantsMappingSet_EIM
package /AUTOLIV/EIM_DataDictionary/DataTypeMappingSet
  data type mapping set DataTypeMappingSet_EIM
package /AUTOLIV/EcuMIf_DataDictionary/ConstantsMappingSet
  constant specification mapping set ConstantsMappingSet_EcuMIf
package /AUTOLIV/EcuMIf_DataDictionary/DataTypeMappingSet
  data type mapping set DataTypeMappingSet_EcuMIf
package /AUTOLIV/EcuMIf_DataDictionary/TriggerInterfaces
  trigger interface itrEcuMIfServices: is-service=true
    4 x trigger, all with trigger-period={cse-code=1000, cse-code-factor=0}:
      AdcIf_Calib
      DioIf_Init
      PwmIf_Init
      SBC_Reset
package /AUTOLIV/FSM_DataDictionnary/ApplicationDataTypes
  4 x application array data type, all with category=ARRAY:
    au16PwmType_Appl
      element elem_au16PwmType_Appl: category=VALUE, type=u16PwmDutyCycleType_Appl, array-size-semantics=FIXED-SIZE, max-number-of-elements=6
    au8FsmStateType_Appl
      element elem_au8FsmStateType_Appl: category=VALUE, type=u8FsmStateType_Appl, array-size-semantics=FIXED-SIZE, max-number-of-elements=6
    au8RequestedProfileType_Appl
      element elem_au8RequestedProfileType_Appl: category=VALUE, type=u8RequestedProfileType_Appl, array-size-semantics=FIXED-SIZE, max-number-of-elements=6
    au8SolenoidType_Appl
      element elem_au8SolenoidType_Appl: category=VALUE, type=u8SolenoidUsageType_Appl, array-size-semantics=FIXED-SIZE, max-number-of-elements=6
  4 x app type, all with category=VALUE:
    u8FsmStateType_Appl: compu {0=KU8_LOCK_STATE, 1=KU8_UNLOCK_STATE, 2=KU8_BACKUP_STATE, 3=KU8_DISABLED_STATE, 4=KU8_STARTUP_STATE, 5=KU8_DIAGNOSTIC_STATE, else KU8_LOCK_STATE}
    u8RequestedProfileType_Appl: compu {0=KU8_PROFILE_UNLOCK, 1=KU8_PROFILE_BACKUP, 2=KU8_PROFILE_DIAGNOSTIC, 3=KU8_NB_OF_PROFILES, 255=KU8_PROFILE_NONE}
    u8SolenoidBackupsType_Appl: data-constr=DataConstr_uint8
    u8SolenoidUsageType_Appl
package /AUTOLIV/FSM_DataDictionnary/ClientServerInterfaces
  client server interface icsModeManagementServices
    operation CheckModeStatus
      arg u64ModesToCheck: type=u64ModeMaskType_Appl, direction=IN, server-argument-impl-policy=USE-ARGUMENT-TYPE
      arg bModeStatus: type=uint8, direction=OUT, server-argument-impl-policy=USE-ARGUMENT-TYPE
package /AUTOLIV/FSM_DataDictionnary/Constants
  constant specification ECS_KU8_NB_SOLENOID: value-spec=6
package /AUTOLIV/FSM_DataDictionnary/ConstantsMappingSet
  constant specification mapping set ConstantsMappingSet_FSM
package /AUTOLIV/FSM_DataDictionnary/DataTypeMappingSet
  data type mapping set DataTypeMappingSet_FSM
    data-type-maps:
      application-data-type=u8RequestedProfileType_Appl, implementation-data-type=u8SolenoidProfileType
      application-data-type=au8RequestedProfileType_Appl, implementation-data-type=au8SolenoidProfileType
      application-data-type=au8FsmStateType_Appl, implementation-data-type=au8FsmStateType
      application-data-type=u8FsmStateType_Appl, implementation-data-type=u8FsmStateType
      application-data-type=au8SolenoidType_Appl, implementation-data-type=au8SolenoidType
      application-data-type=u8SolenoidUsageType_Appl, implementation-data-type=u8SolenoidUsageType
      application-data-type=au16PwmType_Appl, implementation-data-type=au16PwmType
      application-data-type=u64ModeMaskType_Appl, implementation-data-type=uint64
      application-data-type=u8eCSDiagReqType_Appl, implementation-data-type=u8eCSDiagReqType
      application-data-type=au8eCSDiagReqType_Appl, implementation-data-type=au8eCSDiagReqType
      application-data-type=au8SolenoidBackupsType_Appl, implementation-data-type=au8SolenoidBackupsType
package /AUTOLIV/FSM_DataDictionnary/ImplementationDataTypes
  8 x impl type:
    au16PwmType: category=ARRAY
      element u16Pwm: category=VALUE, array-size=6, array-size-semantics=FIXED-SIZE, base-type=uint16
    au8FsmStateType: category=ARRAY
      element u8FsmState: array-size=6, array-size-semantics=FIXED-SIZE, implementation-data-type=u8FsmStateType
    au8SolenoidBackupsType: category=ARRAY
      element u8SolenoidBackups: category=VALUE, array-size=6, array-size-semantics=FIXED-SIZE, base-type=uint8, data-constr=DataConstr_uint8
    au8SolenoidProfileType: category=ARRAY
      element u8FsmProfile: array-size=6, array-size-semantics=FIXED-SIZE, implementation-data-type=u8SolenoidProfileType
    au8SolenoidType: category=ARRAY
      element u8IsSolenoidUsed: category=VALUE, array-size=6, array-size-semantics=FIXED-SIZE, base-type=boolean
    u8FsmStateType: implementation-data-type=uint8
    u8SolenoidProfileType: implementation-data-type=uint8
    u8SolenoidUsageType: implementation-data-type=uint8
package /AUTOLIV/FSM_DataDictionnary/SenderReceiverInterfaces
  4 x sender receiver interface:
    isrFsmSolenoidsState
      data au8SolenoidState: type=au8FsmStateType_Appl, init-value=6 x KU8_LOCK_STATE
    isrSolenoidBackups
      data au8SolenoidIsStuck: type=au8SolenoidBackupsType_Appl, init-value=6 x 0
    isrSolenoidProfile
      data au8SelectedProfile: type=au8RequestedProfileType_Appl, init-value=6 x KU8_PROFILE_UNLOCK
    isrSolenoidPwm
      data au16Pwm: type=au16PwmType_Appl, init-value=6 x 0
package /AUTOLIV/FSM_DataDictionnary/TriggerInterfaces
  trigger interface itrFsmServices
    trigger FSM_Init: trigger-period={cse-code=1000, cse-code-factor=0}
    trigger FSM_ModesInit: trigger-period={cse-code=1000, cse-code-factor=0}
package /AUTOLIV/GlobalDictionary/ApplicationDataTypes
  6 x application record data type, all with category=STRUCTURE:
    REC_CanDataOut
      64 x application record element, all with category=VALUE, type=u8CAN_ByteType_Appl:
        u8Byte{0..63}
    REC_CanDataOut64
      8 x application record element, all with category=VALUE, type=ApplicationDataTypes/u64CAN_BytesType_Appl:
        u64Byte_0_7
        u64Byte_8_15
        u64Byte_16_23
        u64Byte_24_31
        u64Byte_32_39
        u64Byte_40_47
        u64Byte_48_55
        u64Byte_56_63
    REC_GliwaDataIn
      8 x application record element, all with category=VALUE, type=u8CAN_ByteType_Appl:
        u8Byte{1..7}
        u8Byte0
    REC_GliwaDataOut
      64 x application record element, all with category=VALUE, type=u8CAN_ByteType_Appl:
        u8Byte{0..63}
    REC_NM_EcuToNetwork: sw-calibration-access=READ-ONLY  # (degraded)
      application record element NetworkManagementState: category=VALUE, type=u8CAN_NetworkManagementStateType_Appl  # Status der Airbag ON-Leuchte (degraded) / Passenger Airbag LED on status (degraded)
      application record element ActivatedRepeatMessage: category=VALUE, type=u8CAN_ActivatedRepeatMessageType_Appl  # Status der Airbag OFF-Leuchte (degraded) / Airbag LED off status (degraded)
    REC_NM_NetworkToEcu: sw-calibration-access=READ-ONLY
      application record element NetworkManagement_Dummy_ERR: category=VALUE, type=u8CAN_ByteType_Appl
  8 x app type, all with category=VALUE:
    UInt16_Appl: sw-calibration-access=READ-ONLY
    UInt32_Appl: sw-calibration-access=READ-ONLY, range phys 0..4294967295, raw 0..4294967295, raw -INF..INF
    UInt8_Appl: sw-calibration-access=READ-ONLY, range phys 0..255, raw 0..255
    u32RelativeSystemTimeType_Appl: sw-calibration-access=READ-ONLY, range phys 0..4294967295, raw 0..4294967295  # Type of system time (resolution : 10 ms) COVERS: PRO_SF03_1230
    u8CAN_ActivatedRepeatMessageType_Appl
    u8CAN_ByteType_Appl: sw-calibration-access=READ-ONLY, data-constr=dc_u8CANByteType
    u8CAN_NetworkManagementStateType_Appl: sw-calibration-access=READ-ONLY, data-constr=dc_u8CANNetworkManagementStateType
    u8ComMainFunctionStateMaskType_Appl
package /AUTOLIV/GlobalDictionary/DataConstraints
  range dc_SInt16: phys -32768..32767, raw -32768..32767
  range dc_UInt16: phys 0..65535, raw 0..65535
  range dc_b8ReceptionFlagType: raw 0..255
  range dc_u8EventStatus: raw 0..255
package /AUTOLIV/GlobalDictionary/ImplementationDataTypes
  11 x impl type:
    REC_CanDataOut64_Type: category=STRUCTURE
      8 x element, all with category=TYPE_REFERENCE, implementation-data-type=UInt64:
        u64Byte_0_7
        u64Byte_8_15
        u64Byte_16_23
        u64Byte_24_31
        u64Byte_32_39
        u64Byte_40_47
        u64Byte_48_55
        u64Byte_56_63
    REC_CanDataOut_Type: category=STRUCTURE
      64 x element, all with category=TYPE_REFERENCE, implementation-data-type=u8CAN_ByteType:
        u8Byte{0..7}: base-type=uint8, sw-calibration-access=READ-ONLY, data-constr=dc_u8CANByteType
        u8Byte{8..63}
    REC_GliwaDataIn_Type: category=STRUCTURE
      8 x element, all with category=TYPE_REFERENCE, implementation-data-type=u8CAN_ByteType:
        u8Byte{0..7}
    REC_GliwaDataOut_Type: category=STRUCTURE
      64 x element, all with category=TYPE_REFERENCE, implementation-data-type=u8CAN_ByteType:
        u8Byte{0..63}
    REC_NM_EcuToNetwork: category=STRUCTURE
      element NetworkManagementState: implementation-data-type=u8CAN_NetworkManagementStateType
      element ActivatedRepeatMessage: implementation-data-type=u8CAN_ActivatedRepeatMessageType
    REC_NM_NetworkToEcu: category=STRUCTURE
      element NetworkManagement_Dummy: implementation-data-type=u8CAN_ByteType
    u32RelativeSystemTimeType: implementation-data-type=uint32
    u8CAN_ActivatedRepeatMessageType: implementation-data-type=uint8
    u8CAN_ByteType: implementation-data-type=uint8
    u8CAN_NetworkManagementStateType: implementation-data-type=uint8
    u8ComMainFunctionStateMaskType: implementation-data-type=uint8
package /AUTOLIV/IoHwAb_DataDictionary/ApplicationDataTypes
  application array data type au8BuckleStatus: category=ARRAY
    element elem_au8BuckleStatus: category=VALUE, type=u8BuckleStatusType_Appl, array-size-semantics=FIXED-SIZE, max-number-of-elements=2
  application array data type au8SeatOccupancySensor: category=ARRAY
    element elem_au8SeatOccupancySensor: category=VALUE, type=u8SeatOccupancySensorType_Appl, array-size-semantics=FIXED-SIZE, max-number-of-elements=2
  7 x app type, all with category=VALUE:
    s16AccTemperature: unit=Celsius
    s16EcuTemp: unit=Celsius
    s16McuTemperature: unit=Celsius
    s16PtcTemperature: unit=Celsius
    s16SolenoidTemperatureType: sw-intended-resolution=1, invalid-value=0 Celsius, unit=Celsius
    u8BuckleStatusType_Appl: compu {0=KU8_BUCKLE_LATCHED, 1=KU8_BUCKLE_NOT_LATCHED, 2=KU8_BUCKLE_UNKNOWN}, unit=NoUnit
    u8SeatOccupancySensorType_Appl: compu {0=KU8_SEAT_OCCUPANCY_DETECTED, 1=KU8_SEAT_OCCUPANCY_NOT_DETECTED, 2=KU8_SEAT_OCCUPANCY_UNKNOWN, 4=KU8_SEAT_OCCUPANCY_SHORT_TO_GND}, unit=NoUnit
package /AUTOLIV/IoHwAb_DataDictionary/ClientServerInterfaces
  8 x client server interface:
    icsAdcIfServices
      operation StartConversion
      operation StopConversion
      operation WaitForConversion
    icsConvertedAdcService
      operation getMeasure
        arg u8TypeOfMeasure: type=u8AdcChannelIDType_Appl, direction=IN, server-argument-impl-policy=USE-ARGUMENT-TYPE
        arg u16Measure: type=uint16, direction=OUT, server-argument-impl-policy=USE-ARGUMENT-TYPE
    icsHandleSeatCurrentCircuit
      operation IoHwAb_HandleSeatCurrentCircuit
        4 x arg, all with server-argument-impl-policy=USE-ARGUMENT-TYPE:
          pu16WakeCh1: type=uint16, direction=OUT
          pu16WakeCh2: type=uint16, direction=OUT
          pu8Valid: type=uint8, direction=OUT
          u8ResetState: type=uint8, direction=IN
    icsIoHwAbAcc
      operation GetTemperature
        arg s16AccTemperature: type=s16AccTemperature, direction=OUT, server-argument-impl-policy=USE-ARGUMENT-TYPE
    icsIoHwAbEcuTemp
      operation GetTemperature
        arg s16EcuTemperature: type=s16EcuTemp, direction=OUT, server-argument-impl-policy=USE-ARGUMENT-TYPE
    icsIoHwAbMcu
      operation GetTemperature
        arg s16McuTemperature: type=s16McuTemperature, direction=OUT, server-argument-impl-policy=USE-ARGUMENT-TYPE
    icsIoHwAbPtc
      operation GetTemperature
        arg s16PtcSensorTemperature: type=s16PtcTemperature, direction=OUT, server-argument-impl-policy=USE-ARGUMENT-TYPE
    icsLowPowerWakeUp
      operation HandleSeatVariants
        arg u16WakeCh1: type=uint16, direction=IN, server-argument-impl-policy=USE-ARGUMENT-TYPE
        arg u16WakeCh2: type=uint16, direction=IN, server-argument-impl-policy=USE-ARGUMENT-TYPE
        arg bReturn: type=boolean, direction=OUT, server-argument-impl-policy=USE-ARGUMENT-TYPE
package /AUTOLIV/IoHwAb_DataDictionary/ClientServerInterfaces0
  client server interface isrSolenoidCharacteristics
    operation GetTemperature
      arg u8TypeOfMeasure: type=uint8, direction=IN, server-argument-impl-policy=USE-ARGUMENT-TYPE
      arg s16SolenoidTemperature: type=sint16, direction=OUT, server-argument-impl-policy=USE-ARGUMENT-TYPE
package /AUTOLIV/IoHwAb_DataDictionary/DataTypeMappingSet
  data type mapping set DataTypeMappingSet_IoHwAb
    data-type-maps:
      application-data-type=u16AdcValueLsbType_Appl, implementation-data-type=u16AdcValueLsbType
      application-data-type=u8AdcChannelIDType_Appl, implementation-data-type=u8AdcChannelIDType
      application-data-type=u8TestResultType_Appl, implementation-data-type=u8TestResultType
      application-data-type=u8AutoTestIdType_Appl, implementation-data-type=u8AutoTestIdType
      application-data-type=s16McuTemperature, implementation-data-type=sint16
      application-data-type=s16PtcTemperature, implementation-data-type=sint16
      application-data-type=s16EcuTemp, implementation-data-type=sint16
      application-data-type=au8SolenoidUnlockConfirmation, implementation-data-type=au8SolenoidUnlockConfirmationType
      application-data-type=au8BuckleStatus, implementation-data-type=au8BuckleStatusType
      application-data-type=au8SeatOccupancySensor, implementation-data-type=au8SeatOccupancySensorType
package /AUTOLIV/IoHwAb_DataDictionary/ImplementationDataTypes
  4 x impl type, all with category=ARRAY:
    au8BuckleStatusType
      element au8BuckleStatus: category=VALUE, array-size=2, array-size-semantics=FIXED-SIZE, base-type=uint8, range raw 0..1, raw -INF..INF, invalid-value=UNKNOWN:2
    au8SeatOccupancySensorType
      element au8SeatOccupancySensor: category=VALUE, array-size=2, array-size-semantics=FIXED-SIZE, base-type=uint8, range raw 0..1, raw -INF..INF, invalid-value=UNKNOWN:2
    au8SolenoidUnlockConfirmationType
      element elem_au8SolenoidUnlockConfirmation: category=VALUE, array-size=6, array-size-semantics=FIXED-SIZE, base-type=uint8, range raw 0..1, raw -INF..INF
    s16SolenoidTemperatureType
      element elem_s16SolenoidTemperature: category=VALUE, array-size=6, array-size-semantics=FIXED-SIZE, base-type=float32, sw-calibration-access=READ-ONLY, range raw >-INF..<INF, raw -INF..INF
package /AUTOLIV/IoHwAb_DataDictionary/SenderReceiverInterfaces
  sender receiver interface isrBuckleStatus
    data au8BuckleStatus: type=au8BuckleStatus, init-value=[KU8_BUCKLE_LATCHED, KU8_BUCKLE_LATCHED]
  sender receiver interface isrSeatOccupancySensor
    data au8SeatOccupancySensorStatus: type=au8SeatOccupancySensor, init-value=[KU8_SEAT_OCCUPANCY_DETECTED, KU8_SEAT_OCCUPANCY_DETECTED]
  sender receiver interface isrSolenoidConfirmation
    data au8SolenoidStatus: type=au8SolenoidUnlockConfirmation, init-value=6 x KU8_SOLENOID_UNLOCK_NOT_CONFIRMED
package /AUTOLIV/LPM_DataDictionary/ConstantsMappingSet
  constant specification mapping set ConstantsMappingSet_LPM
package /AUTOLIV/LPM_DataDictionary/DataTypeMappingSet
  data type mapping set DataTypeMappingSet_LPM
package /AUTOLIV/LPM_DataDictionary/TriggerInterfaces
  trigger interface itrLpmServices
    trigger LPM_sleepInit: trigger-period={cse-code=1000, cse-code-factor=0}
    trigger LPM_sleepMainLoop: trigger-period={cse-code=1000, cse-code-factor=0}
    trigger LPM_sleepRestore: trigger-period={cse-code=1000, cse-code-factor=0}
package /AUTOLIV/MIC_DataDictionnary/ConstantsMappingSet
  constant specification mapping set ConstantsMappingSet_MIC
package /AUTOLIV/MIC_DataDictionnary/DataTypeMappingSet
  data type mapping set DataTypeMappingSet_MIC
    data-type-maps:
      application-data-type=u32ResetReasonNotificationType_Appl, implementation-data-type=u32ResetReasonNotificationType
      u8ResetReasonNotificationStatusType
      u8SbcStatusInfoType
package /AUTOLIV/MIC_DataDictionnary/TriggerInterfaces
  trigger interface itrMicServices: is-service=true
    trigger MIC_BusFaultException: trigger-period={cse-code=1000, cse-code-factor=0}
    trigger MIC_HardFaultException: trigger-period={cse-code=1000, cse-code-factor=0}
    trigger MIC_Init: trigger-period={cse-code=1000, cse-code-factor=0}
package /AUTOLIV/McuIf_DataDictionary/ConstantsMappingSet
  constant specification mapping set ConstantsMappingSet_McuIf
package /AUTOLIV/McuIf_DataDictionary/DataTypeMappingSet
  data type mapping set DataTypeMappingSet_McuIf
package /AUTOLIV/McuIf_DataDictionary/TriggerInterfaces
  trigger interface itrMcuIfServices
    trigger McuIf_Init: trigger-period={cse-code=1000, cse-code-factor=0}
package /AUTOLIV/NVP_DataDictionnary/ApplicationDataTypes
  app type u8NvpEcuLockType_Appl: category=VALUE, compu {170=KU8_ECU_UNLOCK, 85=KU8_ECU_LOCK}, unit=NoSignalUnit
  app type u8NvpProcessModeType_Appl: category=VALUE, compu {85=KU8_NVP_PROCESS_MODE_INACTIVE, 170=KU8_NVP_PROCESS_MODE_ACTIVE}
package /AUTOLIV/NVP_DataDictionnary/ConstantsMappingSet
  constant specification mapping set ConstantsMappingSet_NVP
package /AUTOLIV/NVP_DataDictionnary/DataTypeMappingSet
  data type mapping set DataTypeMappingSet_NVP
    data-type-maps:
      application-data-type=u8NvpProcessModeType_Appl, implementation-data-type=uint8
      application-data-type=u8NvpEcuLockType_Appl, implementation-data-type=uint8
package /AUTOLIV/NVP_DataDictionnary/SenderReceiverInterfaces
  nv data interface nvNvpBlockDescriptor: is-service=true
    nv-datas:
      data u8NvpEcuLockStatus: type=u8NvpEcuLockType_Appl, init-value=[KU8_ECU_UNLOCK KU8_ECU_LOCK] NoSignalUnit
      data u8NvpProcessMode: type=u8NvpProcessModeType_Appl, init-value=KU8_NVP_PROCESS_MODE_INACTIVE
package /AUTOLIV/NmIf_DataDictionary/ConstantsMappingSet
  constant specification mapping set ConstantsMappingSet_NmIf
package /AUTOLIV/NmIf_DataDictionary/DataTypeMappingSet
  data type mapping set DataTypeMappingSet_NmIf
package /AUTOLIV/NmIf_DataDictionary/TriggerInterfaces
  trigger interface itrNmIfServices
    trigger BswM_SetEcuStateTransitionStatus: trigger-period={cse-code=1000, cse-code-factor=0}
package /AUTOLIV/NvmIf_DataDictionnary/ApplicationDataTypes
  4 x app type, all with category=VALUE:
    u16CalibBlockIdType_Appl: sw-calibration-access=READ-ONLY
    u16NvmBlockIdType_Appl: sw-calibration-access=READ-ONLY
    u16NvmBlockLengthType_Appl
    u8RequestResultType_Appl
package /AUTOLIV/NvmIf_DataDictionnary/ClientServerInterfaces
  client server interface icsNvmIfServices  # Covers AUTOSAR_SWS_NVRAMManager.pdf V3.2.0 R4.0 Rev 3 - NVM734
    8 x operation:
      GetNvmBlockLength
        arg u16BlockId: type=NvM_ASR42_BlockIdType, direction=IN, server-argument-impl-policy=USE-ARGUMENT-TYPE
        arg pu16BlockLength: type=u16NvmBlockLengthType_Appl, direction=OUT, server-argument-impl-policy=USE-ARGUMENT-TYPE
      GetNvmBlockStatus
        arg u16BlockId: type=NvM_ASR42_BlockIdType, direction=IN, server-argument-impl-policy=USE-ARGUMENT-TYPE
        arg pu8BlockStatus: type=NvM_ASR42_RequestResultType, direction=OUT, server-argument-impl-policy=USE-ARGUMENT-TYPE
      NvmIf_GetRamAddressByBlockId
        arg u16BlockId: type=NvM_ASR42_BlockIdType, direction=IN, server-argument-impl-policy=USE-ARGUMENT-TYPE
        arg pu32BlockRamAddress: type=uint32, direction=OUT, server-argument-impl-policy=USE-ARGUMENT-TYPE
      ReadBlockByAddress
        arg u32DestAddress: type=uint32, direction=IN, server-argument-impl-policy=USE-ARGUMENT-TYPE
        arg pvData: type=NvM_ASR42_DstPtrType, direction=OUT, server-argument-impl-policy=USE-ARGUMENT-TYPE
      RestorePRAMBlockDefaults
        arg u16BlockId: type=NvM_ASR42_BlockIdType, direction=IN, server-argument-impl-policy=USE-ARGUMENT-TYPE
      SetRamBlockStatus
        arg u16BlockId: type=NvM_ASR42_BlockIdType, direction=IN, server-argument-impl-policy=USE-ARGUMENT-TYPE
        arg u8BlockChanged: type=uint8, direction=IN, server-argument-impl-policy=USE-ARGUMENT-TYPE
      WriteBlockByAddress
        arg u32DestAddress: type=uint32, direction=IN, server-argument-impl-policy=USE-ARGUMENT-TYPE
        arg pvData: type=NvM_ASR42_DstPtrType, direction=OUT, server-argument-impl-policy=USE-ARGUMENT-TYPE
      WriteNvmBlock
        arg u16BlockId: type=NvM_ASR42_BlockIdType, direction=IN, server-argument-impl-policy=USE-ARGUMENT-TYPE
        arg pvNvM_SrcPtr: type=NvM_SrcPtrType, direction=OUT, server-argument-impl-policy=USE-ARGUMENT-TYPE
    4 x error:
      BLOCK_JOB_PENDING: error-code=5
      FAILED: error-code=2
      MEMORY_CLUSTER_BUSY: error-code=4
      PARAM_OUT_OF_RANGE: error-code=3
package /AUTOLIV/NvmIf_DataDictionnary/ConstantsMappingSet
  constant specification mapping set ConstantsMappingSet_NvmIf
package /AUTOLIV/NvmIf_DataDictionnary/DataTypeMappingSet
  data type mapping set DataTypeMappingSet_NvmIf
    data-type-maps:
      application-data-type=u16CalibBlockIdType_Appl, implementation-data-type=u16CalibBlockIdType
      application-data-type=u16NvmBlockIdType_Appl, implementation-data-type=u16NvmBlockIdType
      application-data-type=u16NvmBlockLengthType_Appl, implementation-data-type=u16NvmBlockLengthType
      application-data-type=u8RequestResultType_Appl, implementation-data-type=u8RequestResultType
package /AUTOLIV/NvmIf_DataDictionnary/ImplementationDataTypes
  4 x impl type, all with category=TYPE_REFERENCE:
    u16CalibBlockIdType: sw-calibration-access=READ-ONLY, implementation-data-type=uint16
    u16NvmBlockIdType: sw-calibration-access=READ-ONLY, implementation-data-type=uint16
    u16NvmBlockLengthType: implementation-data-type=uint16
    u8RequestResultType: base-type=uint8, implementation-data-type=uint8
package /AUTOLIV/OsIf_DataDictionary/ConstantsMappingSet
  constant specification mapping set ConstantsMappingSet_OsIf
package /AUTOLIV/OsIf_DataDictionary/DataTypeMappingSet
  data type mapping set DataTypeMappingSet_OsIf
package /AUTOLIV/PwmIf_DataDictionnary/ApplicationDataTypes
  app type u16PwmDutyCycleType_Appl: category=VALUE, sw-calibration-access=READ-ONLY
  app type u8PwmChannelType_Appl: category=VALUE, sw-calibration-access=READ-ONLY, compu {0..5=PWMIF_CH_SOLENOID_1..PWMIF_CH_SOLENOID_6, 6=PWMIF_CH_MAX} "scPwmIfChannels"
package /AUTOLIV/PwmIf_DataDictionnary/ClientServerInterfaces
  client server interface icsPwmIfServices
    operation DisablePWM
      arg cu8ChannelID: type=u8PwmChannelType_Appl, direction=IN, server-argument-impl-policy=USE-ARGUMENT-TYPE
    operation EnablePWM
      arg cu8ChannelID: type=u8PwmChannelType_Appl, direction=IN, server-argument-impl-policy=USE-ARGUMENT-TYPE
    operation SetDutyCycle
      arg cu8ChannelID: type=u8PwmChannelType_Appl, direction=IN, server-argument-impl-policy=USE-ARGUMENT-TYPE
      arg cu16DutyCycle: type=u16PwmDutyCycleType_Appl, direction=IN, server-argument-impl-policy=USE-ARGUMENT-TYPE
package /AUTOLIV/PwmIf_DataDictionnary/ConstantsMappingSet
  constant specification mapping set ConstantsMappingSet_PwmIf
package /AUTOLIV/PwmIf_DataDictionnary/DataTypeMappingSet
  data type mapping set DataTypeMappingSet_PwmIf
    data-type-maps:
      application-data-type=u8PwmChannelType_Appl, implementation-data-type=u8PwmChannelType
      application-data-type=u16PwmDutyCycleType_Appl, implementation-data-type=u16PwmDutyCycleType
package /AUTOLIV/PwmIf_DataDictionnary/ImplementationDataTypes
  impl type u16PwmDutyCycleType: implementation-data-type=uint16
  impl type u8PwmChannelType: implementation-data-type=uint8
package /AUTOLIV/PwmIf_DataDictionnary/TriggerInterfaces
  trigger interface itrPwmIfServices
    trigger PwmIf_SetDutyCycle: trigger-period={cse-code=1000, cse-code-factor=0}
package /AUTOLIV/RCM_DataDictionnary/ApplicationDataTypes
  app type u32ResetCauseType_Appl:  # Type for the reset causes handled by the PP Platform
    category=VALUE
    sw-calibration-access=READ-ONLY
    compu {0=KU32_RESET_CAUSE_UNKNOWN, 0x01=KU32_SBC_POR_MASK, 0x02=KU32_SBC_GPIO_WK_WU_MASK, 0x04=KU32_SBC_WK_WU_MASK, 0x08=KU32_SBC_TIMER_WU_MASK, 0x10=KU32_SBC_CAN_WU_MASK, 0x20=KU32_MCU_LOW_VOLTAGE_DETECT_RESET_MASK, 0x40=KU32_MCU_LOSS_OF_CLOCK_RESET_MASK, 0x80=KU32_MCU_LOSS_OF_LOCK_RESET_MASK, 0x100=KU32_MCU_WATCHDOG_RESET_MASK, 0x200=KU32_MCU_EXTERNAL_RESET_PIN_MASK, 0x400=KU32_MCU_POWER_ON_RESET_MASK, 0x800=KU32_MCU_JTAG_GENERATED_RESET_MASK, 0x1000=KU32_MCU_CORE_LOCKUP_RESET_MASK, 0x2000=KU32_MCU_SOFTWARE_RESET_MASK, 0x4000=KU32_MCU_MDM_AP_SYSTEM_RESET_REQUESTED_MASK, 0x8000=KU32_MCU_STOP_ACKNOWLEDGE_ERROR_RESET_MASK, 0x10000=KU32_APP_INVALID_INTERRUPT_NOTIFICACTION_MASK, 0x20000=KU32_APP_OS_EXCEPTION_NOTIFICATION_MASK, 0x40000=KU32_APP_BATTERY_LOSS_NOTIFICATION_MASK, 0x80000=KU32_APP_ECC_RAM_NOTIFICATION_MASK, 0x100000=KU32_APP_ECC_PFLASH_NOTIFICATION_MASK, 0x200000=KU32_APP_ECC_E2P_NOTIFICATION_MASK, 0x400000=KU32_APP_ECC_UNIDENTIFIED_NOTIFICATION_MASK, 0x800000=KU32_APP_MACHINE_EXCEPTION_NOTIFICATION_MASK, 0x1000000=KU32_APP_SW_WDG_TEST_NOTIFICATION_MASK, 0x2000000=KU32_APP_WAKE_UP_EVENT_NOTIFICATION_MASK, 0x4000000=KU32_APP_BLTD_RESET_NOTIFICATION_MASK, 0x8000000=KU32_APP_STACK_OVERFLOW_NOTIFICATION_MASK, 0x10000000=KU32_APP_RAM_DATA_CORRUPTED_NOTIFICATION_MASK, 0x20000000=KU32_APP_DIAG_HARD_RESET_NOTIFICATION_MASK, 0x40000000=KU32_APP_DIAG_SOFT_RESET_NOTIFICATION_MASK} "List of reset causes handled by the PP4G SW"
    range raw 0..4294967295
  app type u32ResetReasonNotificationType_Appl:  # Type to allow the notification to RCM by other SW modules that a reset will be managed
    category=VALUE
    compu {0=KU32_INVALID_INTERRUPT_NOTIFICATION, 1=KU32_OS_EXCEPTION_NOTIFICATION, 2=KU32_BATTERY_LOSS_NOTIFICATION, 3=KU32_ECC_RAM_NOTIFICATION, 4=KU32_ECC_PFLASH_NOTIFICATION, 5=KU32_ECC_E2P_NOTIFICATION, 6=KU32_ECC_UNIDENTIFIED_NOTIFICATION, 7=KU32_MACHINE_EXCEPTION_NOTIFICATION, 8=KU32_SW_WDG_TEST_NOTIFICATION, 9=KU32_WAKE_UP_EVENT_NOTIFICATION, 10=KU32_BTLD_RESET_NOTIFICATION, 11=KU32_STACK_OVERFLOW_NOTIFICATION, 12=KU32_RAM_DATA_CORRUPTED_NOTIFICATION, 13=KU32_DIAG_HARD_RESET_NOTIFICATION, 14=KU32_DIAG_SOFT_RESET_NOTIFICATION, 15=KU32_MAX_RESET_NOTIFICATION} "list of reset causes handled by SW in order to notify RCM that a reset will occur for the corresponding reason"
    range raw 0..4294967295
package /AUTOLIV/RCM_DataDictionnary/ClientServerInterfaces
  client server interface icsResetCause
    operation DetermineResetCause
    operation GetResetCause
      arg pu32ResetCause: type=u32ResetCauseType_Appl, direction=OUT  # Cause of the ECU reset cause
  client server interface icsResetCauseNotification  # Interface for notification to RCM by other SW modules of the cause which will lead to reset
    operation NotifyResetCause
      arg u32ResetCauseNotification: type=u32ResetReasonNotificationType_Appl, direction=IN, server-argument-impl-policy=USE-ARGUMENT-TYPE  # Reset Cause information that will lead to a SW reset.
package /AUTOLIV/RCM_DataDictionnary/Constants
  constant specification APPLINIT_KU32_RESET_CAUSE_UNKNOWN: value-spec=0
  constant specification IMPLINIT_KU32_RESET_CAUSE_UNKNOWN: value-spec=0
package /AUTOLIV/RCM_DataDictionnary/DataTypeMappingSet
  data type mapping set DataTypeMappingSet_RCM
    data-type-maps:
      application-data-type=u32ResetCauseType_Appl, implementation-data-type=u32ResetCauseType
      u8ResetReasonNotificationStatusType
      application-data-type=u32ResetReasonNotificationType_Appl, implementation-data-type=u32ResetReasonNotificationType
package /AUTOLIV/RCM_DataDictionnary/ImplementationDataTypes
  5 x impl type, all with category=TYPE_REFERENCE:
    u32ResetCauseType: range raw 0..4294967295, implementation-data-type=uint32
    u32ResetReasonNotificationType: range raw 0..4294967295, implementation-data-type=uint32
    u8OSErrorType: implementation-data-type=uint8
    u8OSTaskIDType: implementation-data-type=uint8
    u8ResetReasonNotificationStatusType: implementation-data-type=uint8
package /AUTOLIV/RCM_DataDictionnary/SenderReceiverInterfaces
  client server interface icsRcmServices
    operation ReportOsErrorStatus
      arg u8TaskID: type=u8OSTaskIDType, direction=IN, server-argument-impl-policy=USE-ARGUMENT-TYPE
      arg u8IDOSError: type=u8OSErrorType, direction=IN, server-argument-impl-policy=USE-ARGUMENT-TYPE
package /AUTOLIV/RCM_DataDictionnary/TriggerInterfaces
  trigger interface itrRcmServices
    trigger RCM_runConfirmResetCause: trigger-period={cse-code=1000, cse-code-factor=0}
    trigger RCM_runDetermineResetCause: trigger-period={cse-code=1000, cse-code-factor=0}
    trigger RCM_runGetResetCause: trigger-period={cse-code=1000, cse-code-factor=0}
package /AUTOLIV/SAD_DataDictionnary/ApplicationDataTypes
  range DataConstr_impl_u8GurtschlossStatusReihe2BFType_Appl: raw 0..3, raw -INF..INF
  range DataConstr_impl_u8SolenoidElectricalAutotestType_Appl: raw 0..1, raw -INF..INF
  range DataConstr_impl_u8SolenoidElectricalAutotestType_Appl: raw 0..1, raw -INF..INF
  range DataConstr_impl_u8SolenoidElectricalAutotestType_Appl: raw 0..1, raw -INF..INF
  application record data type REC_ProfileCfgType_Appl: category=STRUCTURE
    application record element au8FollowingProfile: category=ARRAY, type=au8FollowingProfileType_Appl
    application record element au8LastStep: category=ARRAY, type=au8LastStepType_Appl
  15 x application array data type, all with category=ARRAY:
    aau16HistoricalAdcSamplesType_Appl
      element elem_aau16HistoricalAdcSamples: category=ARRAY, type=au16HistoricalAdcSamplesType_Appl, array-size-semantics=FIXED-SIZE, max-number-of-elements=6
    as16SlopeValueType_Appl: dynamic-array-size-profile=(None)
      element elem_as16SlopeValueType_Appl: category=VALUE, type=s16SlopeValueType_Appl, array-size-semantics=FIXED-SIZE, max-number-of-elements=6
    au16FirstOrderType_Appl
      element elem_au16FirstOrderType_Appl: category=VALUE, type=u16FirstOrderType_Appl, array-size-semantics=FIXED-SIZE, max-number-of-elements=6
    au16HistoricalAdcSamplesType_Appl
      element elem_au16HistoricalAdcSamples: category=VALUE, type=UInt16_Appl, array-size-semantics=FIXED-SIZE, max-number-of-elements=6
    au32SolenoidmATargetType_Appl
      element elem_au32SolenoidmATargetType_Appl: category=VALUE, type=UInt32_Appl, array-size-semantics=FIXED-SIZE, max-number-of-elements=6
    au8CurrentStepType_Appl
      element elem_au8CurrentStepType_Appl: category=VALUE, type=UInt8_Appl, array-size-semantics=FIXED-SIZE, max-number-of-elements=6
    au8FollowingProfileType_Appl
      element elem_au8FollowingProfileType_Appl: category=VALUE, type=u8FollowingProfileType_Appl, array-size-semantics=FIXED-SIZE, max-number-of-elements=4
    au8LastStepType_Appl
      element elem_au8LastStepType_Appl: category=VALUE, type=u8LastStepType_Appl, array-size-semantics=FIXED-SIZE, max-number-of-elements=4
    au8OrderType_Appl
      element elem_au8OrderType_Appl: category=VALUE, type=u8OrderType_Appl, array-size-semantics=FIXED-SIZE, max-number-of-elements=6
    au8SolenoidBackupsType_Appl
      element elem_au8SolenoidBackupsType_Appl: category=VALUE, type=u8SolenoidBackupsType_Appl, array-size-semantics=FIXED-SIZE, max-number-of-elements=6
    au8SolenoidOCStatus
      element elem_au8SolenoidOCStatus: category=VALUE, type=u8SolenoidElectricalAutotestType_Appl, array-size-semantics=FIXED-SIZE, max-number-of-elements=6
    au8SolenoidOvervoltageStatusType_Appl
      element elem_au8SolenoidOvervoltageStatusType_Appl: category=VALUE, type=u8SolenoidElectricalAutotestType_Appl, array-size-semantics=FIXED-SIZE, max-number-of-elements=6
    au8SolenoidShortToGndStatus
      element elem_au8SolenoidShortToGndStatus: category=VALUE, type=u8SolenoidElectricalAutotestType_Appl, array-size-semantics=FIXED-SIZE, max-number-of-elements=6
    au8SolenoidShortToVccStatus
      element elem_au8SolenoidShortToVccStatus: category=VALUE, type=u8SolenoidElectricalAutotestType_Appl, array-size-semantics=FIXED-SIZE, max-number-of-elements=6
    au8SolenoidUnlockConfirmation
      element elem_au8SolenoidUnlockConfirmation: category=VALUE, type=u8SolenoidUnlockConfirmationType_Appl, array-size-semantics=FIXED-SIZE, max-number-of-elements=6
  impl type au8eCSDiagReqType: category=ARRAY
    element elem_au8eCSDiagReqType_Appl: category=VALUE, array-size=6, array-size-semantics=FIXED-SIZE, base-type=uint8, sw-calibration-access=READ-ONLY, range raw 0..255, raw -INF..INF
  application array data type au8eCSDiagReqType_Appl: category=ARRAY
    element elem_au8eCSDiagReqType_Appl: category=VALUE, type=u8eCSDiagReqType_Appl, array-size-semantics=FIXED-SIZE, max-number-of-elements=6
  app type s16SlopeValueType_Appl: category=VALUE, compu {phys=raw for raw -32768..32767}
  39 x app type, all with category=VALUE:
    u16FirstOrderType_Appl: compu {phys=raw for raw -32768..32767}
    u64CAN_BytesType_Appl: sw-calibration-access=READ-ONLY, data-constr=DataConstr_uint64
    u64CAN_BytesType_Appl: sw-calibration-access=READ-ONLY, data-constr=DataConstr_uint64
    u64ModeMaskType_Appl: compu {1=KU64_CRITICAL_AUTOTESTS_IN_PROGRESS, 2=KU64_NVM_BLOCK_RESTORE_IN_PROGRESS, 4=KU64_SOLENOID_1_ABORTION_ERROR, 8=KU64_SOLENOID_1_INHIB_ERROR, 16=KU64_SOLENOID_1_UNLOCK_CONFIRMED, 32=KU64_SOLENOID_1_BUCKLE_LATCHED, 64=KU64_SOLENOID_2_ABORTION_ERROR, 128=KU64_SOLENOID_2_INHIB_ERROR, 256=KU64_SOLENOID_2_UNLOCK_CONFIRMED, 512=KU64_SOLENOID_2_BUCKLE_LATCHED, 1024=KU64_SOLENOID_3_ABORTION_ERROR, 2048=KU64_SOLENOID_3_INHIB_ERROR, 4096=KU64_SOLENOID_3_UNLOCK_CONFIRMED, 8192=KU64_SOLENOID_3_BUCKLE_LATCHED, 16384=KU64_SOLENOID_4_ABORTION_ERROR, 32768=KU64_SOLENOID_4_INHIB_ERROR, 65536=KU64_SOLENOID_4_UNLOCK_CONFIRMED, 131072=KU64_SOLENOID_4_BUCKLE_LATCHED, 262144=KU64_SOLENOID_5_ABORTION_ERROR, 524288=KU64_SOLENOID_5_INHIB_ERROR, 1048576=KU64_SOLENOID_5_UNLOCK_CONFIRMED, 2097152=KU64_SOLENOID_5_BUCKLE_LATCHED, 4194304=KU64_SOLENOID_6_ABORTION_ERROR, 8388608=KU64_SOLENOID_6_INHIB_ERROR, 16777216=KU64_SOLENOID_6_UNLOCK_CONFIRMED, 33554432=KU64_SOLENOID_6_BUCKLE_LATCHED, 67108864=KU64_ECU_PERMANENT_HW_ERROR, 134217728=KU64_ECU_SPORADIC_ERROR, 268435456=KU64_ECU_CAN_INHIB_STATUS, 536870912=KU64_SOLENOID_1_CONFIGURED, 1073741824=KU64_SOLENOID_2_CONFIGURED, 2147483648=KU64_SOLENOID_3_CONFIGURED, 4294967296=KU64_SOLENOID_4_CONFIGURED, 8589934592=KU64_SOLENOID_5_CONFIGURED, 17179869184=KU64_SOLENOID_6_CONFIGURED, 34359738368=KU64_INIT_PHASE_IN_PROGRESS, 68719476736=KU64_ECU_BATTERY_UNSTABLE}
    u8AbAktuatorTestBFType_Appl: compu-method=CM_AB_eCS_Aktuatortest_BF
    u8AbAktuatorTestFAType_Appl: compu-method=CM_AB_eCS_Aktuatortest_FA
    u8AbAktuatorTestReihe2BFType_Appl: compu-method=CM_AB_eCS_Aktuatortest_Reihe2_BF
    u8AbAktuatorTestReihe2FAType_Appl: compu-method=CM_AB_eCS_Aktuatortest_Reihe2_FA
    u8AbAktuatorTestReihe3BFType_Appl: compu-method=CM_AB_eCS_Aktuatortest_Reihe3_BF
    u8AbAktuatorTestReihe3FAType_Appl: compu-method=CM_AB_eCS_Aktuatortest_Reihe3_FA
    u8AbCrashIntType_Appl: compu-method=CM_AB_Crash_Int
    u8Error_Reihe1_BFS_1Type_Appl: compu-method=CM_eCS_Error_Reihe1_BFS_1
    u8Error_Reihe1_BFS_2Type_Appl: compu-method=CM_eCS_Error_Reihe1_BFS_2
    u8Error_Reihe1_FS_1Type_Appl: compu-method=CM_eCS_Error_Reihe1_FS_1
    u8Error_Reihe1_FS_2Type_Appl: compu-method=CM_eCS_Error_Reihe1_FS_2
    u8Error_Reihe2_BFSType_Appl: compu-method=CM_eCS_Error_Reihe2_BFS
    u8Error_Reihe2_FSType_Appl: compu-method=CM_eCS_Error_Reihe2_FS
    u8FollowingProfileType_Appl
    u8GurtschlossStatusReihe2BFType_Appl: compu-method=CM_eCS_Gurtschloss_Status_Reihe2_BF
    u8GurtschlossStatusReihe2FAType_Appl: compu-method=CM_eCS_Gurtschloss_Status_Reihe2_FA
    u8HistoricalAdcSampleIndex
    u8LastStepType_Appl
    u8OrderType_Appl
    u8SBS_LastState_Reihe2_BFSType_Appl: compu-method=CM_eCS_SBS_LastState_Reihe2_BFS
    u8SBS_LastState_Reihe2_FSType_Appl: compu-method=CM_eCS_SBS_LastState_Reihe2_FS
    u8SbsBelegungReihe2BFType_Appl: compu-method=CM_eCS_SBS_Belegung_Reihe2_BF
    u8SbsBelegungReihe2FAType_Appl: compu-method=CM_eCS_SBS_Belegung_Reihe2_FA
    u8SolenoidElectricalAutotestType_Appl: compu {0=KU8_SOLENOID_ELECTRICAL_AT_PASSED, 1=KU8_SOLENOID_ELECTRICAL_AT_FAILED}
    u8SolenoidUnlockConfirmationType_Appl: compu {0=KU8_SOLENOID_UNLOCK_NOT_CONFIRMED, 1=KU8_SOLENOID_UNLOCK_CONFIRMED}
    u8SpiChannelType: data-constr=DataConstr_uint8
    u8Status_Verr_Reihe1_BFS_1Type_Appl: compu-method=CM_eCS_Status_Verr_Reihe1_BFS_1
    u8Status_Verr_Reihe1_BFS_2Type_Appl: compu-method=CM_eCS_Status_Verr_Reihe1_BFS_2
    u8Status_Verr_Reihe1_FS_1Type_Appl: compu-method=CM_eCS_Status_Verr_Reihe1_FS_1
    u8Status_Verr_Reihe1_FS_2Type_Appl: compu-method=CM_eCS_Status_Verr_Reihe1_FS_2
    u8Status_Verr_Reihe2_BFSType_Appl: compu-method=CM_eCS_Status_Verr_Reihe2_BFS
    u8Status_Verr_Reihe2_FSType_Appl: compu-method=CM_eCS_Status_Verr_Reihe2_FS
    u8eCSHwErrorType_Appl: compu-method=CM_eCS_HW_defekt
    u8eCSStatusType_Appl: compu-method=CM_eCS_Status
    u8eCSStoerungErrorType_Appl: compu-method=CM_eCS_Stoerung
package /AUTOLIV/SAD_DataDictionnary/ConstantsMappingSet
  constant specification mapping set ConstantsMappingSet_SAD
package /AUTOLIV/SAD_DataDictionnary/DataTypeMappingSet
  data type mapping set DataTypeMappingSet_SAD
    data-type-maps:
      application-data-type=REC_ProfileCfgType_Appl, implementation-data-type=REC_stProfileCfgType
      application-data-type=au8FollowingProfileType_Appl, implementation-data-type=au8FollowingProfileType
      application-data-type=au8LastStepType_Appl, implementation-data-type=au8LastStepType
      application-data-type=u8FollowingProfileType_Appl, implementation-data-type=u8FollowingProfileType
      application-data-type=u8LastStepType_Appl, implementation-data-type=u8LastStepType
      application-data-type=as16SlopeValueType_Appl, implementation-data-type=as16SlopeValueType
      application-data-type=au16FirstOrderType_Appl, implementation-data-type=au16FirstOrderType
      application-data-type=au8OrderType_Appl, implementation-data-type=au8OrderType
      application-data-type=u16FirstOrderType_Appl, implementation-data-type=u16FirstOrderType
      application-data-type=s16SlopeValueType_Appl, implementation-data-type=s16SlopeValueType
      application-data-type=u8OrderType_Appl, implementation-data-type=u8OrderType
      application-data-type=UInt8_Appl, implementation-data-type=uint8
      application-data-type=au8CurrentStepType_Appl, implementation-data-type=au8CurrentStepType
      application-data-type=au8SolenoidOCStatus, implementation-data-type=au8SolenoidOCStatusType
      application-data-type=au8SolenoidShortToVccStatus, implementation-data-type=au8SolenoidShortToVccStatusType
      application-data-type=au8SolenoidShortToGndStatus, implementation-data-type=au8SolenoidShortToGndStatusType
      application-data-type=au32SolenoidmATargetType_Appl, implementation-data-type=au32SolenoidmATargetType
      application-data-type=au8SolenoidOvervoltageStatusType_Appl, implementation-data-type=au8SolenoidOvervoltageStatusType
  impl type u8CurrentStepType: implementation-data-type=uint8
package /AUTOLIV/SAD_DataDictionnary/ImplementationDataTypes
  17 x impl type:
    REC_stProfileCfgType: category=STRUCTURE
      element au8FollowingProfile: implementation-data-type=au8FollowingProfileType
      element au8LastStep: implementation-data-type=au8LastStepType
    as16SlopeValueType: category=ARRAY
      element s16SlopeValue: array-size=6, array-size-semantics=FIXED-SIZE, implementation-data-type=s16SlopeValueType
    au16FirstOrderType: category=ARRAY
      element u16FirstOrder: array-size=6, array-size-semantics=FIXED-SIZE, implementation-data-type=u16FirstOrderType
    au32SolenoidmATargetType: category=ARRAY
      element elem_au32SolenoidmATarget: category=VALUE, array-size=6, array-size-semantics=FIXED-SIZE, base-type=uint32, sw-calibration-access=READ-ONLY, range phys 0..4294967295, raw 0..4294967295, raw -INF..INF
    au8CurrentStepType: category=ARRAY
      element elem_au8CurrentStepType_Appl: array-size=6, array-size-semantics=FIXED-SIZE, implementation-data-type=u8CurrentStepType
    au8FollowingProfileType: category=ARRAY
      element u8FollowingProfile: array-size=4, array-size-semantics=FIXED-SIZE, implementation-data-type=u8FollowingProfileType
    au8LastStepType: category=ARRAY
      element u8LastStep: array-size=4, array-size-semantics=FIXED-SIZE, implementation-data-type=u8LastStepType
    au8OrderType: category=ARRAY
      element u8Order: category=VALUE, array-size=6, array-size-semantics=FIXED-SIZE, base-type=uint8
    au8SolenoidOCStatusType: category=ARRAY
      element elem_au8SolenoidOCStatus: category=VALUE, array-size=6, array-size-semantics=FIXED-SIZE, base-type=uint8, range raw 0..1, raw -INF..INF
    au8SolenoidOvervoltageStatusType: category=ARRAY
      element elem_au8SolenoidOvervoltageStatusType_Appl: category=VALUE, array-size=6, array-size-semantics=FIXED-SIZE, base-type=uint8, range raw 0..1, raw -INF..INF
    au8SolenoidShortToGndStatusType: category=ARRAY
      element elem_au8SolenoidShortToGndStatus: category=VALUE, array-size=6, array-size-semantics=FIXED-SIZE, base-type=uint8, range raw 0..1, raw -INF..INF
    au8SolenoidShortToVccStatusType: category=ARRAY
      element elem_au8SolenoidShortToVccStatus: category=VALUE, array-size=6, array-size-semantics=FIXED-SIZE, base-type=uint8, range raw 0..1, raw -INF..INF
    s16SlopeValueType: implementation-data-type=sint16
    u16FirstOrderType: implementation-data-type=uint16
    u8FollowingProfileType: implementation-data-type=uint8
    u8LastStepType: implementation-data-type=uint8
    u8OrderType: implementation-data-type=uint8
package /AUTOLIV/SAD_DataDictionnary/SenderReceiverInterfaces
  7 x sender receiver interface:
    isrExecutedProfile
      data u8ExecutedProfile: type=au8RequestedProfileType_Appl, init-value=6 x KU8_PROFILE_UNLOCK
      data u8ExecutedProfileOld: type=au8RequestedProfileType_Appl, init-value=6 x KU8_PROFILE_UNLOCK
    isrSolenoidElectricalCharacteristics
      data au32SolenoidmATarget: type=au32SolenoidmATargetType_Appl, init-value=6 x 0
    isrSolenoidOCStatus
      data au8SolenoidAutotestStatus: type=au8SolenoidOCStatus
    isrSolenoidOvervoltageStatus
      data au8SolenoidOvervoltageStatus: type=au8SolenoidOvervoltageStatusType_Appl, init-value=6 x KU8_SOLENOID_ELECTRICAL_AT_PASSED
    isrSolenoidShortToGndStatus
      data au8SolenoidAutotestStatus: type=au8SolenoidShortToGndStatus, init-value=6 x KU8_SOLENOID_ELECTRICAL_AT_PASSED
    isrSolenoidShortToVccStatus
      data au8SolenoidAutotestStatus: type=au8SolenoidShortToVccStatus, init-value=6 x KU8_SOLENOID_ELECTRICAL_AT_PASSED
    isrSolenoidStep
      data au8CurrentStep: type=au8CurrentStepType_Appl
package /AUTOLIV/SAD_DataDictionnary/TriggerInterfaces
  trigger interface itrSadServices
    trigger SAD_Init: trigger-period={cse-code=1000, cse-code-factor=0}
package /AUTOLIV/SBC_DataDictionnary/ApplicationDataTypes
  app type u32SbcFailiureCauseType_Appl: category=VALUE
package /AUTOLIV/SBC_DataDictionnary/ClientServerInterfaces
  client server interface icsSbcDeviceServices
    operation GetSbcStatus
      arg u32StatusInformation: type=uint32, direction=OUT, server-argument-impl-policy=USE-ARGUMENT-TYPE
    operation SBC_Reset
    operation SBC_Shutdown
  client server interface icsSbcServices
    operation SBC_SetToLowPower
    operation SBC_SetToNormal
    operation SBC_sleepTriggerWatchdog
package /AUTOLIV/SBC_DataDictionnary/ConstantsMappingSet
  constant specification mapping set ConstantsMappingSet_SBC
package /AUTOLIV/SBC_DataDictionnary/DataTypeMappingSet
  data type mapping set DataTypeMappingSet_SBC
    data-type-maps:
      u8SbcStatusInfoType
      application-data-type=u8TestResultType_Appl, implementation-data-type=u8TestResultType
      application-data-type=u32SbcFailiureCauseType_Appl, implementation-data-type=uint32
package /AUTOLIV/SBC_DataDictionnary/ImplementationDataTypes
  impl type u8SbcStatusInfoType: implementation-data-type=uint8
package /AUTOLIV/SBC_DataDictionnary/TriggerInterfaces
  trigger interface itrSbcServices
    trigger SBC_ForceExternalWatchdogReset: trigger-period={cse-code=1000, cse-code-factor=0}
    trigger SBC_Init: trigger-period={cse-code=1000, cse-code-factor=0}
package /AUTOLIV/STM_DataDictionnary/ApplicationDataTypes
  application record data type stAbsoluteSystemTimeType_Appl: category=STRUCTURE, sw-calibration-access=READ-ONLY  # The absolute system time is composed of: - Absolute time in second - Offset in 100' second (0-&amp;gt;99) COVERS: PRO_SF03_1217
    application record element u32SystemTimeInSec: category=VALUE, type=UInt32_Appl
    application record element u8SystemTimeOffset: category=VALUE, type=UInt8_Appl
package /AUTOLIV/STM_DataDictionnary/ClientServerInterfaces
  client server interface icsSystemTime
    operation ReadAbsoluteSystemTime  # To read the absolute system time (time elapsed since the initial ECU programming) COVERS: PRO_SF05_3449
      arg pstAbsoluteSystemTime: type=stAbsoluteSystemTimeType_Appl, direction=OUT  # Value of the absolute system time
package /AUTOLIV/STM_DataDictionnary/ConstantsMappingSet
  constant specification mapping set ConstantsMappingSet_STM
package /AUTOLIV/STM_DataDictionnary/DataTypeMappingSet
  data type mapping set DataTypeMappingSet_STM
    data-type-maps:
      application-data-type=stAbsoluteSystemTimeType_Appl, implementation-data-type=stAbsoluteSystemTimeType
      application-data-type=u32RelativeSystemTimeType_Appl, implementation-data-type=u32RelativeSystemTimeType
package /AUTOLIV/STM_DataDictionnary/ImplementationDataTypes
  impl type stAbsoluteSystemTimeType: category=STRUCTURE, sw-calibration-access=READ-ONLY
    element u32SystemTimeInSec: implementation-data-type=UInt32
    element u8SystemTimeOffset: implementation-data-type=UInt8
package /AUTOLIV/SpiIf_DataDictionnary/ApplicationDataTypes
  application array data type au8SpiChannelSequenceType: category=ARRAY
    element elem_au8SpiChannelSequenceType: category=VALUE, type=UInt8_Appl, array-size-semantics=VARIABLE-SIZE, max-number-of-elements=2
  app type u8SpiDataBufferType: category=VALUE
  app type u8SpiSequenceType: category=VALUE
package /AUTOLIV/SpiIf_DataDictionnary/ConstantsMappingSet
  constant specification mapping set ConstantsMappingSet_SpiIf
package /AUTOLIV/SpiIf_DataDictionnary/DataTypeMappingSet
  data type mapping set DataTypeMappingSet_SpiIf
    data-type-maps:
      application-data-type=u8SpiChannelType, implementation-data-type=uint8
      application-data-type=au8SpiChannelSequenceType, implementation-data-type=au8stSpiChannelSequenceType
      application-data-type=u8SpiSequenceType, implementation-data-type=UInt8
      application-data-type=u8SpiDataBufferType, implementation-data-type=UInt8
package /AUTOLIV/SpiIf_DataDictionnary/ImplementationDataTypes
  impl type au8stSpiChannelSequenceType: category=ARRAY
    element elem_au8SpiChannelSequenceType: category=VALUE, array-size=2, array-size-semantics=VARIABLE-SIZE, base-type=uint8, sw-calibration-access=READ-ONLY, range phys 0..255, raw 0..255
package /AUTOLIV/SpiIf_DataDictionnary/SenderReceiverInterfaces
  sender receiver interface isr3DAcceleration
    data st3DAccel: type=REC_3D_AccelerationType_Appl
package /AUTOLIV/SpiIf_DataDictionnary/TriggerInterfaces
  trigger interface itrSpiIfServices
    trigger SpiIf_spiReadIBFromChannel: trigger-period={cse-code=1000, cse-code-factor=0}
    trigger SpiIf_spiSyncTransmitSequence: trigger-period={cse-code=1000, cse-code-factor=0}
    trigger SpiIf_writeSpiData: trigger-period={cse-code=1000, cse-code-factor=0}
package /AUTOLIV/eCS_DataDictionnary/ApplicationDataTypes
  application record data type REC_3D_AccelMtrPerSecSqdType_Appl: category=STRUCTURE  # REC_3D_Acceleration_In_Meter_Per_Second_Squared
    application record element s16AxAppl: category=VALUE, type=s16AccelerationSI_UnitType_Appl
    application record element s16AyAppl: category=VALUE, type=s16AccelerationSI_UnitType_Appl
    application record element s16AzAppl: category=VALUE, type=s16AccelerationSI_UnitType_Appl
  application record data type REC_3D_AccelerationType_Appl: category=STRUCTURE
    application record element s16AxAppl: category=VALUE, type=s16AccelerationType_Appl
    application record element s16AyAppl: category=VALUE, type=s16AccelerationType_Appl
    application record element s16AzAppl: category=VALUE, type=s16AccelerationType_Appl
  app type s16AccelerationSI_UnitType_Appl: category=VALUE
  app type s16AccelerationType_Appl: category=VALUE
  4 x app type, all with category=VALUE:
    u16BallPositionType_Appl
    u8EcsTriggerType_Appl: compu {0=KU8_ECS_ALGO_UNLOCK, 1=KU8_ECS_ALGO_LOCK}
    u8IsSensitivityOptType_Appl: compu {170=KU8_TRUE, 85=KU8_FALSE, 1=KB_TRUE, 0=KB_FALSE, 170=B_TRUE, 85=B_FALSE}  # u8IsSensitivityOptionType_Appl
    u8eCSDiagReqType_Appl: sw-calibration-access=READ-ONLY, compu {0=KU8_NO_DIAG_REQUEST, 1=KU8_UNLOCK_DIAG_REQUEST, 2=KU8_LOCK_DIAG_REQUEST, 3=KU8_DIAG_PROFILE_REQUEST_ON, 4=KU8_DIAG_PROFILE_REQUEST_OFF, 255=KU8_NO_DIAG_REQUEST_COMPLEMENT}, unit=NoUnit
package /AUTOLIV/eCS_DataDictionnary/ComputationMethods
  compu method scAcceleration: phys=raw/512 for raw -64..63.998; unit MtrPerSecSqd
  compu method scBallPositionScaling: phys=raw*0.0001 for raw 0..6.5536; unit mm
package /AUTOLIV/eCS_DataDictionnary/Constants
  4 x constant specification, all with value-spec=85:
    APPLINIT_KU8_NO_DIAG_REQ
    APPLINIT_KU8_SENSITIVITY_OPT_OFF
    IMPLINIT_KU8_NO_DIAG_REQ
    IMPLINIT_KU8_SENSITIVITY_OPT_OFF
package /AUTOLIV/eCS_DataDictionnary/ConstantsMappingSet
  constant specification mapping set ConstantsMappingSet_eCS
    mappings:
      appl-constant=APPLINIT_KU8_SENSITIVITY_OPT_OFF, impl-constant=IMPLINIT_KU8_SENSITIVITY_OPT_OFF
      appl-constant=APPLINIT_KU8_NO_DIAG_REQ, impl-constant=IMPLINIT_KU8_NO_DIAG_REQ
package /AUTOLIV/eCS_DataDictionnary/DataConstraints
  range dc_BallPosition: phys 0..0.0001
  range dc_s16AccelerationInt: raw -32768..32767
package /AUTOLIV/eCS_DataDictionnary/DataTypeMappingSet
  data type mapping set DataTypeMappingSet_eCS
    data-type-maps:
      application-data-type=u8IsSensitivityOptType_Appl, implementation-data-type=u8IsSensitivyOptType
      application-data-type=REC_3D_AccelMtrPerSecSqdType_Appl, implementation-data-type=REC_3D_AccelMtrPerSecSqdType
      application-data-type=s16AccelerationSI_UnitType_Appl, implementation-data-type=s16AccelerationSI_Unit_Type
      application-data-type=u16BallPositionType_Appl, implementation-data-type=u16BallPositionType
      application-data-type=u8EcsTriggerType_Appl, implementation-data-type=u8EcsTriggerType
      application-data-type=s16AccelerationType_Appl, implementation-data-type=s16AccelerationType
      application-data-type=REC_3D_AccelerationType_Appl, implementation-data-type=REC_3D_AccelerationType
package /AUTOLIV/eCS_DataDictionnary/ImplementationDataTypes
  8 x impl type:
    REC_3D_AccelMtrPerSecSqdType: category=STRUCTURE  # REC_3D_Acceleration_In_Meter_Per_Second_Squared
      element s16Ax: implementation-data-type=s16AccelerationSI_Unit_Type
      element s16Ay: implementation-data-type=s16AccelerationSI_Unit_Type
      element s16Az: implementation-data-type=s16AccelerationSI_Unit_Type
    REC_3D_AccelerationType: category=STRUCTURE
      element s16Ax: implementation-data-type=s16AccelerationType
      element s16Ay: implementation-data-type=s16AccelerationType
      element s16Az: implementation-data-type=s16AccelerationType
    s16AccelerationSI_Unit_Type: implementation-data-type=sint16
    s16AccelerationType: implementation-data-type=sint16
    u16BallPositionType: implementation-data-type=uint16
    u8EcsTriggerType: implementation-data-type=uint8
    u8IsSensitivyOptType: implementation-data-type=uint8  # u8IsSensitivyOptionType
    u8eCSDiagReqType: implementation-data-type=uint8
package /AUTOLIV/eCS_DataDictionnary/SenderReceiverInterfaces
  sender receiver interface isrAccelMtrPerSecSqd
    data stAccelMtrPerSecSqd: type=REC_3D_AccelMtrPerSecSqdType_Appl
  sender receiver interface isrEcsAlgoOutputs
    data u16BallPosition: type=u16BallPositionType_Appl
    data u8EcsFlag: type=u8EcsTriggerType_Appl, init-value=KU8_ECS_ALGO_LOCK
  sender receiver interface isrEcsDiagRequest: category=eCS  # isrEcsDiagnosticRequest
    data au8DiagReq: type=au8eCSDiagReqType_Appl, init-value=6 x KU8_NO_DIAG_REQUEST
    data au8DiagReqComplement: type=au8eCSDiagReqType_Appl, init-value=6 x 255
package /AUTOLIV/eCS_DataDictionnary/Units
  unit g: display-name=g, factor-si-to-unit=0.9807, offset-si-to-unit=0.0
  unit mm: display-name=mm, factor-si-to-unit=1.0E-6, offset-si-to-unit=0.0, physical-dimension=Len1  # milimeter
