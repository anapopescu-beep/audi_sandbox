AUTOSAR XML (schema 4-2-2)
package /ComponentTypes
  composition sw component type Geltungsbereich_MQBw_Baseline  # ECU Generic CAN TI Pilot V1 2016
    component Dcm: type=Dcm
    component Dem: type=Dem
    component NvM: type=NvM
    connect DIA.pseCallBackDCMRequestServices_CBReqServInd_1 -> Dcm.CallBackDCMRequestServices_CBReqServInd_1
    connect DIA.pseDID_0236_ProgrammingDataElockEcu -> Dcm.DataServices_DID_0236_ProgrammingDataElockEcuData
    connect DIA.pseDID_023E_WSCForProgrammingElockEcu -> Dcm.DataServices_DID_023E_WSCForProgrammingElockEcuData
    connect DIA.pseDID_0407_VWLogicalSoftwareBlockCounterOfProgrammingAttempts -> Dcm.DataServices_DID_0407_VWLogicalSoftwareBlockCounterOfProgrammingAttemptsData
    connect DIA.pseDID_040F_VWLogicalSoftwareBlockLockValue -> Dcm.DataServices_DID_040F_VWLogicalSoftwareBlockLockValueData
    connect DIA.pseDID_0410_BootloaderTPBlocksize -> Dcm.DataServices_DID_0410_BootloaderTPBlocksizeData
    connect DIA.pseDID_0448_ProgrammingPreconditions -> Dcm.DataServices_DID_0448_ProgrammingPreconditionsData
    connect DIA.pseDID_4024_SWSystemTime -> Dcm.DataServices_DID_4024_SWSystemTimeData
    connect DIA.pseDID_F15B_FingerprintAndProgrammingDateOfLogicalSoftwareBlocks -> Dcm.DataServices_DID_F15B_FingerprintAndProgrammingDateOfLogicalSoftwareBlocksData
    connect DIA.pseDID_F187_VWSparePartNumber -> Dcm.DataServices_DID_F187_VWSparePartNumberData
    connect DIA.pseDID_F18C_ECUSerialNumberData -> Dcm.DataServices_DID_F18C_ECUSerialNumberData
    connect DIA.pseDID_F191_VWECUHardwareNumber -> Dcm.DataServices_DID_F191_VWECUHardwareNumberData
    connect DIA.pseDID_F197_VWSystemNameOrEngineType -> Dcm.DataServices_DID_F197_VWSystemNameOrEngineTypeData
    connect DIA.pseDID_F19E_ASAMODXFileIdentifier -> Dcm.DataServices_DID_F19E_ASAMODXFileIdentifierData
    connect DIA.pseDID_F1A2_ASAMODXFileVersion -> Dcm.DataServices_DID_F1A2_ASAMODXFileVersionData
    connect DIA.pseDID_F1A3_VWECUHardwareVersionNumber -> Dcm.DataServices_DID_F1A3_VWECUHardwareVersionNumberData
    connect DIA.pseDID_F1AB_VWLogicalSoftwareBlockVersion -> Dcm.DataServices_DID_F1AB_VWLogicalSoftwareBlockVersionData
    connect DIA.pseDID_F1B4_TechnicalSpecificationsVersion -> Dcm.DataServices_DID_F1B4_TechnicalSpecificationsVersionData
    connect DIA.pseDID_F1D5_FDSProject -> Dcm.DataServices_DID_F1D5_FDSProjectData
    connect DIA.pseDID_F1DF_ECUProgrammingInformation -> Dcm.DataServices_DID_F1DF_ECUProgrammingInformationData
    connect DIA.pseDID_FD00_HWVersion -> Dcm.DataServices_DID_FD00_HWVersionData
    connect DIA.pseDID_FD01_SWVersion -> Dcm.DataServices_DID_FD01_SWVersionData
    connect DIA.pseDID_FD03_AEETraceabilityNumber -> Dcm.DataServices_DID_FD03_AEETraceabilityNumberData
    connect DIA.pseDID_FD08_ResetCause -> Dcm.DataServices_DID_FD08_ResetCauseData
    connect DIA.pseDID_FD09_LastWarmResetParam -> Dcm.DataServices_DID_FD09_LastWarmResetParamData
    connect DIA.pseDID_FD0F_BatteryMeasure -> Dcm.DataServices_DID_FD0F_BatteryMeasureData
    connect DIA.pseDID_FD10_ECUTemperature -> Dcm.DataServices_DID_FD10_ECUTemperatureData
    connect DIA.pseDID_FD62_EccOccurenceNb -> Dcm.DataServices_DID_FD62_EccOccurenceNbData
    connect DIA.pseDID_FD8B_ECUManufacturingDate -> Dcm.DataServices_DID_FD8B_ECUManufacturingDateData
    connect DIA.pseDID_FD8C_AssemblySerialNumber -> Dcm.DataServices_DID_FD8C_AssemblySerialNumber
    connect DIA.pseDID_FDE0_EcsVariant -> Dcm.DataServices_DID_FDE0_EcsVariantData
    connect DIA.pseDID_FDE1_EcsParameters -> Dcm.DataServices_DID_FDE1_EcsParametersData
    connect DIA.pseDID_FDE2_EcsAccOffsets -> Dcm.DataServices_DID_FDE2_AccOffsetData
    connect DIA.pseDID_FDE3_EcsProfiles -> Dcm.DataServices_DID_FDE3_EcsProfilesData
    connect DIA.pseDID_FDE4_EcsSteps -> Dcm.DataServices_DID_FDE4_EcsStepsData
    connect DIA.pseDID_FDE5_EcsAccLowPass -> Dcm.DataServices_DID_FDE5_EcsAccLowPassData
    connect DIA.pseDID_FDE7_EcsAlgoOutputDelay -> Dcm.DataServices_DID_FDE7_AlgoOutputDelayData
    connect DIA.pseDID_FDE9_SensitivityLutData -> Dcm.DataServices_DID_FDE9_SensitivityLutData
    connect DIA.pseDID_FDEA_SensitivityOptData -> Dcm.DataServices_DID_FDEA_SensitivityOptData
    connect DIA.pseDID_FDFF_MeasurementFrameRamConf -> Dcm.DataServices_DID_FDFF_MeasurementFrameConfDataRam
    connect DIA.pseDID_FE00_AllEventStatusesRead -> Dcm.DataServices_DID_FE00_AllEventStatusesRead
    connect DIA.pseDID_FEFF_MeasurementFramesConf -> Dcm.DataServices_DID_FEFF_MeasurementFramesConfData
    connect DIA.pseDID_F189_VWApplicationSoftwareVersionNumber -> Dcm.DataServices_DID_F189_VWApplicationSoftwareVersionNumberData
    connect DIA.pseRoutineControl_AccAngleOffsetCalibration -> Dcm.RoutineServices_DcmDspRoutineAccAngleOffsetCalibration
    connect DIA.pseRoutineControl_AccCalib -> Dcm.RoutineServices_DcmDspRoutineAccCalib
    connect DIA.pseRoutineControl_CheckProgrammingPreconditions -> Dcm.RoutineServices_DcmDspRoutineRoutineCheckProgrammingPreconditions
    connect DIA.pseRoutineControl_EcuTempCalibration -> Dcm.RoutineServices_DcmDspRoutineEcuTempCalibration
    connect DIA.pseRoutineControl_LockSolenoid -> Dcm.RoutineServices_DcmDspRoutineLockSolenoid
    connect DIA.pseRoutineControl_LockUnlockECU -> Dcm.RoutineServices_DcmDspRoutineCtrl_Lock_UnlockECU
    connect DIA.pseRoutineControl_ProcessModeRoutine -> Dcm.RoutineServices_DcmDspRoutineProcessMode
    connect DIA.pseSecurityAccess -> Dcm.SecurityAccess_DcmDspSecurityAlv
    connect DIA.pseServiceRequestSupplierNotification -> Dcm.ServiceRequestSupplierNotification_DcmDslServiceRequestSupplierNotification
    connect Dem.ASR42_Event_EVENT_ACC_STATUS_FAILURE -> ATM.pclEvtAccStatusFailure
    connect Dem.ASR42_Event_EVENT_ACTUATOR_OPEN_CIRCUIT -> ATM.pclEvtActuatorOpenCircuit
    connect Dem.ASR42_Event_EVENT_ACTUATOR_SHORT_TO_GND -> ATM.pclEvtActuatorShortToGND
    connect Dem.ASR42_Event_EVENT_ACTUATOR_SHORT_TO_VBAT -> ATM.pclEvtActuatorShortToVBAT
    connect Dem.ASR42_Event_EVENT_ACTUATOR_STATUS -> ATM.pclEvtActuatorState
    connect Dem.ASR42_Event_EVENT_ADC_CALIB -> ATM.pclEvtAdcCalibration
    connect Dem.ASR42_Event_EVENT_ADC_OUT_OF_ORDER -> ATM.pclEvtAdcOutOfOrder
    connect Dem.ASR42_Event_EVENT_ADC_OUT_OF_ORDER -> EIM.pclDemDiagMonitor
    connect Dem.ASR42_Event_EVENT_DFLASH_MEM_CORRUPT -> ATM.pclEvtNvmEcc
    connect Dem.ASR42_Event_EVENT_ECU_OVER_TEMPERATURE -> ATM.pclEvtEcuoverTemperature
    connect Dem.ASR42_Event_EVENT_EXT_WDG_OUT_OF_ORDER -> ATM.pclEvtExtWdgOutOfOrder
    connect Dem.ASR42_Event_EVENT_MCU_CRC_REGISTERS -> ATM.pclEvtMcuCrcRegisters
    connect Dem.ASR42_Event_EVENT_MCU_SELFTEST -> ATM.pclEvtMcuSelftest
    connect Dem.ASR42_Event_EVENT_NVM_NOT_PRG -> ATM.pclEvtNvmNotPrg
    connect Dem.ASR42_Event_EVENT_PFLASH_MEM_CORRUPT -> ATM.pclEvtFlsEcc
    connect Dem.ASR42_Event_EVENT_POWER_STAGE_FAILIURE -> ATM.pclEvtPowerStageFailiure
    connect Dem.ASR42_Event_EVENT_POWER_SUPPLY_OV -> ATM.pclEvtPowerSupllyOV
    connect Dem.ASR42_Event_EVENT_POWER_SUPPLY_UV -> ATM.pclEvtPowerSupllyUV
    connect Dem.ASR42_Event_EVENT_RAM_MEM_CORRUPT -> ATM.pclEvtRamEcc
    connect Dem.ASR42_Event_EVENT_SBC_STATUS_FAILURE -> ATM.pclEvtSbcStatusFailiure
    connect Dem.ASR42_Event_EVENT_SOLENOID_OVERVOLTAGE -> ATM.pclEvtSolenoidOvervoltage
    connect Dem.ASR42_Event_EVENT_WARM_RESET -> ATM.pclEvtWarmReset
    connect Dem.ASR42_EvtInfo_EVENT_ACTUATOR_OPEN_CIRCUIT -> SAD.pclEvtActuatorOpenCircuit
    connect Dem.ASR42_EvtInfo_EVENT_ACTUATOR_SHORT_TO_GND -> SAD.pclEvtActuatorShortToGround
    connect Dem.ASR42_EvtInfo_EVENT_ACTUATOR_SHORT_TO_VBAT -> SAD.pclEvtActuatorShortToVbat
    connect Dem.ASR42_EvtInfo_EVENT_SOLENOID_OVERVOLTAGE -> SAD.pclEvtSolenoidOvervoltage
    connect Dem.ASR42_OpCycle_DEM_OPCYC_POWER -> BswMIf.pclDemSetOpCycle
    connect Dem.GeneralEvtInfo -> DIA.pclDemServices
    connect Dem.GeneralEvtInfo -> FSM.pclDemServices
    connect NvM.PS_ASR42_ACC_AXIS_ANGLE_CALIBRATION -> NvmIf.pclNvmService_AccAngleCalibration
    connect NvM.PS_ASR42_AEE_TRACEABILITY_NUMBER -> NvmIf.pclNvmService_AeeTraceabilityNumber
    connect NvM.PS_ASR42_ALV_NVM_VERSION -> NvmIf.pclNvmService_AlvNvmVersion
    connect NvM.PS_ASR42_APP_SOFTWARE_VERSION_NUMBER -> NvmIf.pclNvmService_OemAppSwVersionNumber
    connect NvM.PS_ASR42_AUTOTEST_ENABLE_PARAM -> NvmIf.pclNvmServices_AutotestEnableParam
    connect NvM.PS_ASR42_AUTOTEST_PARAM -> NvmIf.pclNvmServices_AutotestParam
    connect NvM.PS_ASR42_BLOCK_FBL -> NvmIf.pclNvmService_OemFlashBootloader
    connect NvM.PS_ASR42_ECC_COUNTERS -> NvmIf.pclNvmServices_EccCounters
    connect NvM.PS_ASR42_ECS_ACC_LOWPASS -> NvmIf.pclNvmService_EcsAccLowPass
    connect NvM.PS_ASR42_ECS_ACC_OFFSETS -> NvmIf.pclNvmService_EcsAccOffsets
    connect NvM.PS_ASR42_ECS_ALGO_OUTPUT_DELAY -> NvmIf.pclNvmService_EcsAlgoOutputDelay
    connect NvM.PS_ASR42_ECS_PARAMETERS -> NvmIf.pclNvmService_EcsParameters
    connect NvM.PS_ASR42_ECS_PROFILES -> NvmIf.pclNvmService_EcsProfiles
    connect NvM.PS_ASR42_ECS_SENSITIVITY_LUT -> NvmIf.pclNvmService_EcsSensitivityLUT
    connect NvM.PS_ASR42_ECS_SENSITIVITY_OPT -> NvmIf.pclNvmService_EcsSensitivityOPT
    connect NvM.PS_ASR42_ECS_STEPS -> NvmIf.pclNvmService_EcsSteps
    connect NvM.PS_ASR42_ECS_VARIANT -> NvmIf.pclNvmService_EcsVariant
    connect NvM.PS_ASR42_ECU_ASSEMBLY_SERIAL_NUMBER -> NvmIf.pclNvmService_AssemblySerialNumber
    connect NvM.PS_ASR42_ECU_SERIAL_NUMBER -> NvmIf.pclNvmService_OemEcuSerialNumber
    connect NvM.PS_ASR42_ECU_STATE_TIMING_PARAMETERS -> NvmIf.pclNvmService_EcuStateTimingParam
    connect NvM.PS_ASR42_ECU_TEMP_CALIBRATION -> NvmIf.pclNvmServices_EcuTempCalibration
    connect NvM.PS_ASR42_EOL_COUNTERS -> NvmIf.pclNvmService_EolCounters
    connect NvM.PS_ASR42_HARDWARE_NUMBER -> NvmIf.pclNvmService_OemHardwareNumber
    connect NvM.PS_ASR42_HARDWARE_VERSION_NUMBER -> NvmIf.pclNvmService_OemHardwareVersionNumber
    connect NvM.PS_ASR42_HW_PART_NUMBER -> NvmIf.pclNvmService_HwPartNumber
    connect NvM.PS_ASR42_LOCK_UNLOCK_ECU -> NvmIf.pclNvmService_LockUnlockECU
    connect NvM.PS_ASR42_LOGICAL_SW_BLOCK_VERSION -> NvmIf.pclNvmService_OemLogicalBlockVersion
    connect NvM.PS_ASR42_MEASUREMENT_FRAME_CONFIG -> NvmIf.pclNvmServices_MeasFrameCfg
    connect NvM.PS_ASR42_MEAS_FRAME_RAM_ADDR_CFG -> NvmIf.pclNvmServices_MeasFrameRamCfg
    connect NvM.PS_ASR42_NVM_BLOCK_DEM_DEFAULT -> NvmIf.pclNvmServices_DemDefault
    connect NvM.PS_ASR42_ODX_FILE_IDENTIFIER -> NvmIf.pclNvmService_OemOdxIdentifier
    connect NvM.PS_ASR42_ODX_FILE_VERSION -> NvmIf.pclNvmService_OemOdxVersion
    connect NvM.PS_ASR42_PHYS_MEASUREMENTS -> NvmIf.pclNvmService_PhysicalMeasurements
    connect NvM.PS_ASR42_PROCESS_MODE -> NvmIf.pclNvmServices_ProcessMode
    connect NvM.PS_ASR42_SBS_LAST_STATE -> NvmIf.pclNvmService_SBSLastState
    connect NvM.PS_ASR42_SOLENOID_PARAM -> NvmIf.pclNvmService_SolenoidParam
    connect NvM.PS_ASR42_SPARE_PART_NUMBER -> NvmIf.pclNvmService_OemSparePartNumber
    connect NvM.PS_ASR42_SYSTEM_NAME_OR_ENGINE_TYPE -> NvmIf.pclNvmService_OemSystemName
    connect NvM.PS_ASR42_WARM_RESET_COUNTERS -> NvmIf.pclNvmServices_WarmResetCounters
    connect STM.pseSystemTime -> DIA.pclSystemTime
package /MQBw_Baseline
  system System: category=SYSTEM_EXTRACT, container-i-pdu-header-byte-order=big-endian, ecu-extract-version=2022.09.15, system-version=14.08.02
    system mapping System
      sw-impl-mappings:
        34 x swc to impl mapping:
          ACC_ImplMapping1: component-implementation=ACC_imp, component=Geltungsbereich_MQBw_Baseline.ACC
          ATM_ImplMapping1: component-implementation=ATM_imp, component=Geltungsbereich_MQBw_Baseline.ATM
          AdcIf_ImplMapping1: component-implementation=AdcIf_imp, component=Geltungsbereich_MQBw_Baseline.AdcIf
          BswMIf_ImplMapping1: component-implementation=BswMIf_imp, component=Geltungsbereich_MQBw_Baseline.BswMIf
          CIL_ImplMapping1: component-implementation=CIL_impCommunicationInteractionLayer, component=Geltungsbereich_MQBw_Baseline.CIL
          DIA_ImplMapping1: component-implementation=DIA_imp, component=Geltungsbereich_MQBw_Baseline.DIA
          DcmIf_ImplMapping1: component-implementation=DcmIf_imp, component=Geltungsbereich_MQBw_Baseline.DcmIf
          Dcm_ImplMapping: component-implementation=DcmImpl, component=Geltungsbereich_MQBw_Baseline.Dcm
          Dcm_ImplMapping1: component-implementation=DcmImpl, component=Geltungsbereich_MQBw_Baseline.Dcm
          DemIf_ImplMapping1: component-implementation=DemIf_imp, component=Geltungsbereich_MQBw_Baseline.DemIf
          Dem_ImplMapping: component-implementation=DemImpl, component=Geltungsbereich_MQBw_Baseline.Dem
          Dem_ImplMapping1: component-implementation=DemImpl, component=Geltungsbereich_MQBw_Baseline.Dem
          DioIf_ImplMapping1: component-implementation=DioIf_imp, component=Geltungsbereich_MQBw_Baseline.DioIf
          EFX_ImplMapping: component-implementation=EFX_imp, component=Geltungsbereich_MQBw_Baseline.EFX
          EIM_ImplMapping: component-implementation=EIM_imp, component=Geltungsbereich_MQBw_Baseline.EIM
          EcuMIf_ImplMapping1: component-implementation=EcuMIf_imp, component=Geltungsbereich_MQBw_Baseline.EcuMIf
          FSM_ImplMapping1: component-implementation=FSM_imp, component=Geltungsbereich_MQBw_Baseline.FSM
          IoHwAb_ImplMapping1: component-implementation=IoHwAb_imp, component=Geltungsbereich_MQBw_Baseline.IoHwAb
          LPM_ImplMapping: component-implementation=LPM_imp, component=Geltungsbereich_MQBw_Baseline.LPM
          MIC_ImplMapping1: component-implementation=MIC_impMemoryIntegrityControl, component=Geltungsbereich_MQBw_Baseline.MIC
          McuIf_ImplMapping: component-implementation=McuIf_imp, component=Geltungsbereich_MQBw_Baseline.McuIf
          NVP_ImplMapping1: component-implementation=NVP_impNonVolatileParameters, component=Geltungsbereich_MQBw_Baseline.NVP
          NmIf_ImplMapping1: component-implementation=NmIf_imp, component=Geltungsbereich_MQBw_Baseline.NmIf
          NvM_ImplMapping: component-implementation=NvMImpl, component=Geltungsbereich_MQBw_Baseline.NvM
          NvmIf_ImplMapping1: component-implementation=NvmIf_imp, component=Geltungsbereich_MQBw_Baseline.NvmIf
          OsIf_ImplMapping1: component-implementation=OsIf_imp, component=Geltungsbereich_MQBw_Baseline.OsIf
          PwmIf_ImplMapping1: component-implementation=PwmIf_imp, component=Geltungsbereich_MQBw_Baseline.PwmIf
          RCM_ImplMapping1: component-implementation=RCM_imp, component=Geltungsbereich_MQBw_Baseline.RCM
          SAD_ImplMapping1: component-implementation=SAD_imp, component=Geltungsbereich_MQBw_Baseline.SAD
          SBC_ImplMapping1: component-implementation=SBC_imp, component=Geltungsbereich_MQBw_Baseline.SBC
          STM_ImplMapping1: component-implementation=STM_imp, component=Geltungsbereich_MQBw_Baseline.STM
          SpiIf_ImplMapping1: component-implementation=SpiIf_imp, component=Geltungsbereich_MQBw_Baseline.SpiIf
          T1_ImplMapping: component-implementation=T1_imp, component=Geltungsbereich_MQBw_Baseline.T1
          eCS_ImplMapping1: component-implementation=eCS_imp, component=Geltungsbereich_MQBw_Baseline.eCS
      sw-mappings:
        swc to ecu mapping eCSMapping: ecu-instance=eCS
          component:
            Geltungsbereich_MQBw_Baseline.MIC
            Geltungsbereich_MQBw_Baseline.DemIf
            Geltungsbereich_MQBw_Baseline.NmIf
            Geltungsbereich_MQBw_Baseline.SBC
            Geltungsbereich_MQBw_Baseline.DIA
            Geltungsbereich_MQBw_Baseline.AdcIf
            Geltungsbereich_MQBw_Baseline.ATM
            Geltungsbereich_MQBw_Baseline.DcmIf
            Geltungsbereich_MQBw_Baseline.NVP
            Geltungsbereich_MQBw_Baseline.NvmIf
            Geltungsbereich_MQBw_Baseline.SAD
            Geltungsbereich_MQBw_Baseline.BswMIf
            Geltungsbereich_MQBw_Baseline.IoHwAb
            Geltungsbereich_MQBw_Baseline.eCS
            Geltungsbereich_MQBw_Baseline.FSM
            Geltungsbereich_MQBw_Baseline.OsIf
            Geltungsbereich_MQBw_Baseline.STM
            Geltungsbereich_MQBw_Baseline.RCM
            Geltungsbereich_MQBw_Baseline.EcuMIf
            Geltungsbereich_MQBw_Baseline.ACC
            Geltungsbereich_MQBw_Baseline.CIL
            Geltungsbereich_MQBw_Baseline.PwmIf
            Geltungsbereich_MQBw_Baseline.SpiIf
            Geltungsbereich_MQBw_Baseline.DioIf
            Geltungsbereich_MQBw_Baseline.Dem
            Geltungsbereich_MQBw_Baseline.Dcm
            Geltungsbereich_MQBw_Baseline.NvM
            Geltungsbereich_MQBw_Baseline.EFX
            Geltungsbereich_MQBw_Baseline.LPM
            Geltungsbereich_MQBw_Baseline.T1
            Geltungsbereich_MQBw_Baseline.EIM
            Geltungsbereich_MQBw_Baseline.McuIf
    root-software-compositions:
      root sw composition prototype Geltungsbereich_MQBw_Baseline: software-composition=Geltungsbereich_MQBw_Baseline
