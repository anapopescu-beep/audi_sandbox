AUTOSAR XML (schema 4-2-2)
package /AUTOSAR_Dcm/PortInterfaces
  client server interface DcmIf: is-service=true
    operation DcmClearDTC: possible-error=[DEM_MEMORY_ERROR, DcmIf/DEM_CLEAR_BUSY, DcmIf/DEM_CLEAR_FAILED, DcmIf/DEM_CLEAR_PENDING, DcmIf/DEM_CLEAR_WRONG_DTC, DcmIf/DEM_CLEAR_WRONG_DTCORIGIN]
      arg DTC: type=uint32, direction=IN
      arg DTCFormat: type=Dem_DTCFormatType, direction=IN
      arg DTCOrigin: type=Dem_DTCOriginType, direction=IN
    6 x error:
      DEM_CLEAR_BUSY: error-code=5
      DEM_CLEAR_FAILED: error-code=3
      DEM_CLEAR_MEMORY_ERROR: error-code=6
      DEM_CLEAR_PENDING: error-code=4
      DEM_CLEAR_WRONG_DTC: error-code=1
      DEM_CLEAR_WRONG_DTCORIGIN: error-code=2
package /AUTOSAR_Dem/ImplementationDataTypes
  impl type Dem_DTCFormatType: category=VALUE, base-type=uint8, compu {0=DEM_DTC_FORMAT_OBD, 1=DEM_DTC_FORMAT_UDS, 2=DEM_DTC_FORMAT_J1939}, range raw 0..2
  impl type Dem_DTCOriginType: category=VALUE, base-type=uint8, compu {1=DEM_DTC_ORIGIN_PRIMARY_MEMORY, 2=DEM_DTC_ORIGIN_MIRROR_MEMORY, 3=DEM_DTC_ORIGIN_PERMANENT_MEMORY, 4=DEM_DTC_ORIGIN_SECONDARY_MEMORY}, range raw 1..4
package /AUTOSAR_Dem/PortInterfaces
  client server interface DcmIf: is-service=true
    operation DcmClearDTC: possible-error=DcmIf/DEM_CLEAR_BUSY
      arg DTC: type=uint32, direction=IN, server-argument-impl-policy=USE-ARGUMENT-TYPE
      arg DTCFormat: type=Dem_DTCFormatType, direction=IN, server-argument-impl-policy=USE-ARGUMENT-TYPE
      arg DTCOrigin: type=Dem_DTCOriginType, direction=IN, server-argument-impl-policy=USE-ARGUMENT-TYPE
    6 x error:
      DEM_CLEAR_BUSY: error-code=5
      DEM_CLEAR_FAILED: error-code=3
      DEM_CLEAR_MEMORY_ERROR: error-code=6
      DEM_CLEAR_PENDING: error-code=4
      DEM_CLEAR_WRONG_DTC: error-code=1
      DEM_CLEAR_WRONG_DTCORIGIN: error-code=2
