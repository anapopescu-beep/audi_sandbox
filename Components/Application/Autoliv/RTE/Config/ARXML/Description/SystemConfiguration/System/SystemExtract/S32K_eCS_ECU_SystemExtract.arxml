AUTOSAR XML (schema 4-2-2)
# Copyright (c) 2017 Autoliv Electronic SA
standard types defined: boolean, uint16, uint32, uint64, uint8, UInt64
package /AUTOSAR_Platform/BaseTypes
  base type uint512: category=FIXED_LENGTH, base-type-size=512, base-type-encoding=NONE  # unsigned integer 512bit
package /ApplicationDataTypes
  app type DC_BOOL: category=BOOLEAN, sw-calibration-access=READ-ONLY, compu {0=FALSE, 1=TRUE}
package /Constants
  constant specification mapping set ConstantsMappingSet_EcuExtract: constant-specification-mapping{appl-constant=REC_APPLINIT_CAN_DATA_OUT, impl-constant=REC_IMPLINIT_CAN_DATA_OUT}
  6 x constant specification:
    REC_APPLINIT_CAN_DATA: value-spec=fields=[0, 0, 0, 0, 0, 0, 0, 0]
    REC_APPLINIT_CAN_DATA_OUT: value-spec=fields=[0, 0, 0, 0, 0, 0, 0, 0, 0, 0, 0, 0, 0, 0, 0, 0, 0, 0, 0, 0, 0, 0, 0, 0, 0, 0, 0, 0, 0, 0, 0, 0, 0, 0, 0, 0, 0, 0, 0, 0, 0, 0, 0, 0, 0, 0, 0, 0, 0, 0, 0, 0, 0, 0, 0, 0, 0, 0, 0, 0, 0, 0, 0, 0]
    REC_APPLINIT_CAN_DATA_OUT_64: value-spec=fields=[0, 0, 0, 0, 0, 0, 0, 0]
    REC_IMPLINIT_CAN_DATA: value-spec=fields=[0, 0, 0, 0, 0, 0, 0, 0]
    REC_IMPLINIT_CAN_DATA_MF_OUT: value-spec=fields=[0, 0, 0, 0, 0, 0, 0, 0]
    REC_IMPLINIT_CAN_DATA_OUT: value-spec=fields=[0, 0, 0, 0, 0, 0, 0, 0, 0, 0, 0, 0, 0, 0, 0, 0, 0, 0, 0, 0, 0, 0, 0, 0, 0, 0, 0, 0, 0, 0, 0, 0, 0, 0, 0, 0, 0, 0, 0, 0, 0, 0, 0, 0, 0, 0, 0, 0, 0, 0, 0, 0, 0, 0, 0, 0, 0, 0, 0, 0, 0, 0, 0, 0]
package /DataConstraints
  range dc_u8CANByteType: phys 0..255, raw 0..255
  range dc_u8CANNetworkManagementStateType: phys 0..15, raw 0..15
package /DataTypeMappingSets
  data type mapping set DataTypeMappingSet_SystemExtract
    data-type-maps:
      application-data-type=REC_GliwaDataIn, implementation-data-type=REC_GliwaDataIn_Type
      application-data-type=REC_GliwaDataOut, implementation-data-type=REC_GliwaDataOut_Type
      application-data-type=REC_CanDataOut, implementation-data-type=REC_CanDataOut_Type
      application-data-type=REC_NM_EcuToNetwork, implementation-data-type=REC_NM_EcuToNetwork
      application-data-type=REC_NM_NetworkToEcu, implementation-data-type=REC_NM_NetworkToEcu
      application-data-type=REC_CanDataOut64, implementation-data-type=REC_CanDataOut64_Type
package /DiagnosticConnections/G_CAN
  diagnostic connection CAN_TP_SDU_DIAG_R_Generic_CAN
package /EcuInstances
  hw element HwElement_ECU: nested-elements=HwElement_ECU
    hw pin group ECU_HwCommPort
      hw-pin-group-content:
        hw pin ECU_HwPin
package /Frames/G_CAN/PKG_G_CAN
  5 x can frame:
    Can_Frame_CanDataOut_0: frame-length=64
      pdu to frame mapping IPdu_DevByte_Out_0: packing-byte-order=little-endian, pdu=IPdu_Dev_Out_0, start-position=0
    Can_Frame_GliwaIn: frame-length=8
      pdu to frame mapping PduToFrameMapping_0: packing-byte-order=little-endian, pdu=IPdu_Gliwa_In, start-position=0
    Can_Frame_GliwaOut: frame-length=64
      pdu to frame mapping IPdu_Gliwa_Out: packing-byte-order=little-endian, pdu=IPdu_Gliwa_Out, start-position=0
    Can_Frame_MF: frame-length=64  # Can_Frame_MeasurementFrame
      pdu to frame mapping IPdu_MFData: packing-byte-order=little-endian, pdu=IPdu_MFData, start-position=0
    Can_Frame_MF_Logger: frame-length=1
      pdu to frame mapping PduToFrameMapping_1: packing-byte-order=little-endian, pdu=IPdu_MFData_Logger, start-position=0
package /ISignalGroups/G_CAN/PKG_G_CAN
  4 x i signal group:
    DataOutSignalGroup_0: i-signal=[DataOut_Byte_0_7, DataOut_Byte_16_23, DataOut_Byte_24_31, DataOut_Byte_32_39, DataOut_Byte_40_47, DataOut_Byte_48_55, DataOut_Byte_56_63, DataOut_Byte_8_15], system-signal-group=DataOutGroup_0
    GliwaInGroup: i-signal=[GliwaIn_Byte_0, GliwaIn_Byte_1, GliwaIn_Byte_2, GliwaIn_Byte_3, GliwaIn_Byte_4, GliwaIn_Byte_5, GliwaIn_Byte_6, GliwaIn_Byte_7], system-signal-group=GliwaIn_Group
    GliwaOutGroup: i-signal=[GliwaOut_Byte_0_7, GliwaOut_Byte_16_23, GliwaOut_Byte_24_31, GliwaOut_Byte_32_39, GliwaOut_Byte_40_47, GliwaOut_Byte_48_55, GliwaOut_Byte_56_63, GliwaOut_Byte_8_15], system-signal-group=GliwaOutGroup
    MeasurementFrameGroup: i-signal=[MF_Byte_0_7, MF_Byte_16_23, MF_Byte_24_31, MF_Byte_32_39, MF_Byte_40_47, MF_Byte_48_55, MF_Byte_56_63, MF_Byte_8_15], system-signal-group=MeasurementFrameGroup
package /Pdus/G_CAN/PKG_G_CAN
  pdu IPdu_Dev_Out_0: length=64, meta-data-length=0, minimum-delay=0.0, transmission-mode-true-timing=cyclic-timing={time-offset=0.005, time-period=0.01}, unused-bit-pattern=0
    mapping DataOutSignalGroup_toIPdu_IPdu_Dev_Out_0: i-signal-group=DataOutSignalGroup_0, packing-byte-order=little-endian
    signal DataOut_Byte_0_7: start 0, 64 bit, little-endian, data-type-policy=OVERRIDE, handle-out-of-range=IGNORE, init-value=KU64_ZERO:0, base-type=uint64
    signal DataOut_Byte_16_23: start 128, 64 bit, little-endian, data-type-policy=OVERRIDE, handle-out-of-range=IGNORE, init-value=KU64_ZERO:0, base-type=uint64
    signal DataOut_Byte_24_31: start 192, 64 bit, little-endian, data-type-policy=OVERRIDE, handle-out-of-range=IGNORE, init-value=KU64_ZERO:0, base-type=uint64
    signal DataOut_Byte_32_39: start 256, 64 bit, little-endian, data-type-policy=OVERRIDE, handle-out-of-range=IGNORE, init-value=KU64_ZERO:0, base-type=uint64
    signal DataOut_Byte_40_47: start 320, 64 bit, little-endian, data-type-policy=OVERRIDE, init-value=KU64_ZERO:0, base-type=uint64
    signal DataOut_Byte_48_55: start 384, 64 bit, little-endian, data-type-policy=OVERRIDE, handle-out-of-range=IGNORE, init-value=KU64_ZERO:0, base-type=uint64
    signal DataOut_Byte_56_63: start 448, 64 bit, little-endian, data-type-policy=OVERRIDE, handle-out-of-range=IGNORE, init-value=KU64_ZERO:0, base-type=uint64
    signal DataOut_Byte_8_15: start 64, 64 bit, little-endian, data-type-policy=OVERRIDE, handle-out-of-range=IGNORE, init-value=KU64_ZERO:0, base-type=uint64, transfer-property=TRIGGERED
  pdu IPdu_Gliwa_In: length=8, meta-data-length=0, minimum-delay=0.0, transmission-mode-true-timing=cyclic-timing={time-offset=0.1, time-period=0.005}, unused-bit-pattern=0
    mapping GliwaInGroup_toIPdu_IPdu_Gliwa_In: i-signal-group=GliwaInGroup, packing-byte-order=little-endian, start-position=0, transfer-property=TRIGGERED
    signal GliwaIn_Byte_0: start 0, 8 bit, little-endian, data-type-policy=OVERRIDE, handle-out-of-range=IGNORE, init-value=KU8_ZERO:0, base-type=uint8, transfer-property=TRIGGERED, update-indication-bit-position=0
    signal GliwaIn_Byte_1: start 8, 8 bit, little-endian, data-type-policy=OVERRIDE, handle-out-of-range=IGNORE, init-value=KU8_ZERO:0, base-type=uint8, transfer-property=TRIGGERED, update-indication-bit-position=0
    signal GliwaIn_Byte_2: start 16, 8 bit, little-endian, data-type-policy=OVERRIDE, handle-out-of-range=IGNORE, init-value=KU8_ZERO:0, base-type=uint8, transfer-property=TRIGGERED, update-indication-bit-position=0
    signal GliwaIn_Byte_3: start 24, 8 bit, little-endian, data-type-policy=OVERRIDE, handle-out-of-range=IGNORE, init-value=KU8_ZERO:0, base-type=uint8, transfer-property=TRIGGERED, update-indication-bit-position=0
    signal GliwaIn_Byte_4: start 32, 8 bit, little-endian, data-type-policy=OVERRIDE, handle-out-of-range=IGNORE, init-value=KU8_ZERO:0, base-type=uint8, transfer-property=TRIGGERED, update-indication-bit-position=0
    signal GliwaIn_Byte_5: start 40, 8 bit, little-endian, data-type-policy=OVERRIDE, handle-out-of-range=IGNORE, init-value=KU8_ZERO:0, base-type=uint8, transfer-property=TRIGGERED, update-indication-bit-position=0
    signal GliwaIn_Byte_6: start 48, 8 bit, little-endian, data-type-policy=OVERRIDE, handle-out-of-range=IGNORE, init-value=KU8_ZERO:0, base-type=uint8, transfer-property=TRIGGERED, update-indication-bit-position=0
    signal GliwaIn_Byte_7: start 56, 8 bit, little-endian, data-type-policy=OVERRIDE, handle-out-of-range=IGNORE, init-value=KU8_ZERO:0, base-type=uint8, transfer-property=TRIGGERED, update-indication-bit-position=0
  pdu IPdu_Gliwa_Out: length=64, meta-data-length=0, minimum-delay=0.0, transmission-mode-true-timing=cyclic-timing={time-offset=0.1, time-period=0.005}, unused-bit-pattern=0
    mapping GliwaOutGroup_toIPdu_IPdu_Gliwa_Out: i-signal-group=GliwaOutGroup, packing-byte-order=little-endian, start-position=0, transfer-property=TRIGGERED
    signal GliwaOut_Byte_0_7: start 0, 64 bit, little-endian, data-type-policy=OVERRIDE, handle-out-of-range=IGNORE, init-value=KU64_ZERO:0, base-type=uint64, transfer-property=TRIGGERED, update-indication-bit-position=0
    signal GliwaOut_Byte_16_23: start 128, 64 bit, little-endian, data-type-policy=OVERRIDE, handle-out-of-range=IGNORE, init-value=KU64_ZERO:0, base-type=uint64, transfer-property=TRIGGERED, update-indication-bit-position=0
    signal GliwaOut_Byte_24_31: start 192, 64 bit, little-endian, data-type-policy=OVERRIDE, handle-out-of-range=IGNORE, init-value=KU64_ZERO:0, base-type=uint64, transfer-property=TRIGGERED, update-indication-bit-position=0
    signal GliwaOut_Byte_32_39: start 256, 64 bit, little-endian, data-type-policy=OVERRIDE, handle-out-of-range=IGNORE, init-value=KU64_ZERO:0, base-type=uint64, transfer-property=TRIGGERED, update-indication-bit-position=0
    signal GliwaOut_Byte_40_47: start 320, 64 bit, little-endian, data-type-policy=OVERRIDE, handle-out-of-range=IGNORE, init-value=KU64_ZERO:0, base-type=uint64, transfer-property=TRIGGERED, update-indication-bit-position=0
    signal GliwaOut_Byte_48_55: start 384, 64 bit, little-endian, data-type-policy=OVERRIDE, handle-out-of-range=IGNORE, init-value=KU64_ZERO:0, base-type=uint64, transfer-property=TRIGGERED, update-indication-bit-position=0
    signal GliwaOut_Byte_56_63: start 448, 64 bit, little-endian, data-type-policy=OVERRIDE, handle-out-of-range=IGNORE, init-value=KU64_ZERO:0, base-type=uint64, transfer-property=TRIGGERED, update-indication-bit-position=0
    signal GliwaOut_Byte_8_15: start 64, 64 bit, little-endian, data-type-policy=OVERRIDE, handle-out-of-range=IGNORE, init-value=KU64_ZERO:0, base-type=uint64, transfer-property=TRIGGERED, update-indication-bit-position=0
  pdu IPdu_MFData: length=64, meta-data-length=0, minimum-delay=0.0, transmission-mode-true-timing=cyclic-timing={time-offset=0.01, time-period=0.005}, unused-bit-pattern=0  # IPdu_MeasurementFrameData
    signal MF_Byte_0_7: start 0, 64 bit, little-endian, data-type-policy=OVERRIDE, handle-out-of-range=IGNORE, init-value=KU64_ZERO:0, base-type=uint64
    signal MF_Byte_16_23: start 128, 64 bit, little-endian, data-type-policy=OVERRIDE, handle-out-of-range=IGNORE, init-value=KU64_ZERO:0, base-type=uint64
    signal MF_Byte_24_31: start 192, 64 bit, little-endian, data-type-policy=OVERRIDE, handle-out-of-range=IGNORE, init-value=KU64_ZERO:0, base-type=uint64
    signal MF_Byte_32_39: start 256, 64 bit, little-endian, data-type-policy=OVERRIDE, handle-out-of-range=IGNORE, init-value=KU64_ZERO:0, base-type=uint64
    signal MF_Byte_40_47: start 320, 64 bit, little-endian, data-type-policy=OVERRIDE, handle-out-of-range=IGNORE, init-value=KU64_ZERO:0, base-type=uint64
    signal MF_Byte_48_55: start 384, 64 bit, little-endian, data-type-policy=OVERRIDE, handle-out-of-range=IGNORE, init-value=KU64_ZERO:0, base-type=uint64
    signal MF_Byte_56_63: start 448, 64 bit, little-endian, data-type-policy=OVERRIDE, handle-out-of-range=IGNORE, init-value=KU64_ZERO:0, base-type=uint64, transfer-property=TRIGGERED, update-indication-bit-position=0
    signal MF_Byte_8_15: start 64, 64 bit, little-endian, data-type-policy=OVERRIDE, handle-out-of-range=IGNORE, init-value=KU64_ZERO:0, base-type=uint64
    mapping MeasurementFrameGroup_toIPdu_IPdu_MFData: i-signal-group=MeasurementFrameGroup, packing-byte-order=little-endian
  pdu IPdu_MFData_Logger: length=1, meta-data-length=0, unused-bit-pattern=0  # IPdu_MeasurementFrameData_Logger
    mapping MF_Logger_Byte_0_toIPdu_IPdu_MFData: i-signal=MF_Logger_Byte_0, packing-byte-order=little-endian, start-position=0
package /PortInterfaces
  6 x sender receiver interface:
    isrCanDataOut: category=FUNCTIONAL
      data EcuCanDataOut: type=REC_CanDataOut64, init-value=fields=[0, 0, 0, 0, 0, 0, 0, 0]
    isrGliwaDataIn
      data GliwaCanDataIn: type=REC_GliwaDataIn
    isrGliwaDataOut
      data GliwaCanDataOut: type=REC_CanDataOut64, init-value=fields=[0, 0, 0, 0, 0, 0, 0, 0]
    isrMFCanData: category=FUNCTIONAL  # isrMeasurementFrameCanData
      data stMFData: type=REC_CanDataOut64, init-value=fields=[0, 0, 0, 0, 0, 0, 0, 0]
    isrMfLoggerCanData
      data MfLogger: type=u8MFLogger_Appl, init-value=KU8_STARTUP
    isrNvmBlockRestoreFinished
      data u8BlockRestoreStatus: type=uint8, init-value=KU8_FALSE:85
package /SystemSignals
  system signal MF_Logger_Byte_0
package /Units
  unit NoSignalUnit: display-name=-, factor-si-to-unit=1.0, offset-si-to-unit=0.0
  unit m: display-name=m
