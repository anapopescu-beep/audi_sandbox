AUTOSAR XML (schema 4-2-2)
package /AUTOLIV/SoftwareComponents/SAD
  application sw component type SAD: category=SWC  # SAD_AC_SolenoidAbstractionDriver
    behavior SAD_IB_SolenoidAbstractionDriver: constant-value-mapping=ConstantsMappingSet_SAD, data-type-mapping=[DataTypeMappingSet_AdcIf, DataTypeMappingSet_DioIf, DataTypeMappingSet_FSM, DataTypeMappingSet_IoHwAb, DataTypeMappingSet_PwmIf, DataTypeMappingSet_SAD, DataTypeMappingSet_eCS], handle-termination-and-restart=NO-SUPPORT
      timing event ev_SADMainFunctionPeriod: start-on-event=SAD_runMainFunction, period=0.001
      6 x operation invoked event:
        oie_pseCheckActuatorState_AutotestCallback: start-on-event=SAD_checkActuatorState, operation=pseCheckActuatorState.AutotestCallback
        oie_pseCheckPowerStage_AutotestCallback: start-on-event=SAD_CheckPowerStage, operation=pseCheckPowerStage.AutotestCallback
        oie_pseCheckSolenoidOpenCircuit_AutotestCallback: start-on-event=SAD_CheckSolenoidOpenCircuitAutotest, operation=pseCheckSolenoidOpenCircuit.AutotestCallback
        oie_pseCheckSolenoidOvervoltage_AutotestCallback: start-on-event=SAD_CheckSolenoidOvervoltage, operation=pseCheckSolenoidOvervoltage.AutotestCallback
        oie_pseCheckSolenoidShortToGND_AutotestCallback: start-on-event=SAD_CheckSolenoidShortToGNDAutotest, operation=pseCheckSolenoidShortToGND.AutotestCallback
        oie_pseCheckSolenoidShortToVBAT_AutotestCallback: start-on-event=SAD_CheckSolenoidShortToVBATAutotest, operation=pseCheckSolenoidShortToVBAT.AutotestCallback
      explicit-inter-runnable-variables:
        data stProfileCfg: type=REC_ProfileCfgType_Appl, init-value=fields=[au8FollowingProfile:[0, 0, 0, 0], au8LastStep:[0, 0, 0, 0]]
      8 x runnable, all with sw-addr-method=CODE_ASIL_A:
        SAD_CheckPowerStage
          sync call scp_ReadChannel: operation=pclDioIfServices.ReadChannel, timeout=0.0
        SAD_CheckSolenoidOpenCircuitAutotest
          data-send-points:
            access dsp_au8SolenoidAutotestStatus: accessed-variable=psrSolenoidOpenCircutStatus.au8SolenoidAutotestStatus
          sync call scp_GetEventStatus: operation=pclEvtActuatorOpenCircuit.GetEventStatus, timeout=0.0
        SAD_CheckSolenoidOvervoltage
          data-send-points:
            access dsp_au8SolenoidOvervoltageSt: accessed-variable=psrSolenoidOvervoltageStatus.au8SolenoidOvervoltageStatus
          sync call scp_GetEventStatus: operation=pclEvtSolenoidOvervoltage.GetEventStatus, timeout=0.0
        SAD_CheckSolenoidShortToGNDAutotest
          data-send-points:
            access dsp_au8SolenoidAutotestStatus: accessed-variable=psrSolenoidShortToGndStatus.au8SolenoidAutotestStatus
          sync call scp_GetEventStatus: operation=pclEvtActuatorShortToGround.GetEventStatus, timeout=0.0
        SAD_CheckSolenoidShortToVBATAutotest
          data-send-points:
            access dsp_au8SolenoidAutotestStatus: accessed-variable=psrSolenoidShortToVccStatus.au8SolenoidAutotestStatus
          sync call scp_GetEventStatus: operation=pclEvtActuatorShortToVbat.GetEventStatus, timeout=0.0
          sync call scp_GetTestResult: operation=pclAutotestServices.GetTestResult, timeout=0.0
        SAD_Init: external-triggering-point=ptrpSadServicesBswMIf.SAD_Init
          written-local-variables:
            access stProfileCfg: accessed-variable=stProfileCfg
        SAD_checkActuatorState
        SAD_runMainFunction: external-triggering-point=ptrpAsrOsServicesSAD.SAD_runMainFunction
          data-receive-point-by-arguments:
            access drparg_au8SelectedProfile: accessed-variable=prrSolenoidProfile.au8SelectedProfile
            access drparg_au8SolenoidNbOfBackups: accessed-variable=prrSolenoidStuckStatus.au8SolenoidIsStuck
            access drparg_au8SolenoidState: accessed-variable=prrSolenoidState.au8SolenoidState
          data-send-points:
            5 x access:
              dsp_au16Pwm: accessed-variable=pseSolenoidPWM.au16Pwm
              dsp_au16SolenoidmATarget: accessed-variable=psrSolenoidElectricalCharacteristics.au32SolenoidmATarget
              dsp_au8CurrentStep: accessed-variable=pseSolenoidStep.au8CurrentStep
              dsp_au8DiagReq: accessed-variable=pseDiagRequestServices.au8DiagReq
              dsp_au8DiagReqComplement: accessed-variable=pseDiagRequestServices.au8DiagReqComplement
          read-local-variables:
            access stProfileCfg: accessed-variable=stProfileCfg
          4 x sync call, all with timeout=0.0:
            scp_CheckModeStatus: operation=pclModeManagement.CheckModeStatus
            scp_SetDutyCycle: operation=pclPwmServices.SetDutyCycle
            scp_WriteChannel: operation=pclDioIfServices.WriteChannel
            scp_getMeasure1: operation=pclConvAdcService.getMeasure
  swc implementation SAD_imp: category=SWC, programming-language=C, sw-version=1.0.0, vendor-id=0, behavior=SAD_IB_SolenoidAbstractionDriver
    code-descriptors:
      code SAD_Impl_Code: artifact-descriptors=autosar-engineering-object={short-label=SAD_Impl_Code_CodeDesc, category=SWSRC}
    resource consumption SAD_Impl_ResCons
      33 x memory section:
        CODE: size=0, sw-addrmethod=CODE
        CODE_ASIL_A: size=0, sw-addrmethod=CODE_ASIL_A
        CONST_16: alignment=16, size=16, sw-addrmethod=CONST
        CONST_16_ASIL_A: alignment=16, size=16, sw-addrmethod=CONST_ASIL_A
        CONST_32: alignment=32, size=32, sw-addrmethod=CONST
        CONST_32_ASIL_A: alignment=32, size=32, sw-addrmethod=CONST_ASIL_A
        CONST_8: alignment=8, size=8, sw-addrmethod=CONST
        CONST_8_ASIL_A: alignment=8, size=8, sw-addrmethod=CONST_ASIL_A
        CONST_BOOL: alignment=8, size=1, sw-addrmethod=CONST
        CONST_BOOL_ASIL_A: alignment=8, size=1, sw-addrmethod=CONST_ASIL_A
        CONST_UNSPECIFIED: alignment=UNSPECIFIED, size=0, sw-addrmethod=CONST
        CONST_UNSPECIFIED_ASIL_A: alignment=UNSPECIFIED, size=0, sw-addrmethod=CONST_ASIL_A
        VAR_INIT_16: alignment=16, size=16, sw-addrmethod=VAR_INIT
        VAR_INIT_16_ASIL_A: alignment=16, size=16, sw-addrmethod=VAR_INIT_ASIL_A
        VAR_INIT_32: alignment=32, size=32, sw-addrmethod=VAR_INIT
        VAR_INIT_32_ASIL_A: alignment=32, size=32, sw-addrmethod=VAR_INIT_ASIL_A
        VAR_INIT_8: alignment=8, size=8, sw-addrmethod=VAR_INIT
        VAR_INIT_8_ASIL_A: alignment=8, size=8, sw-addrmethod=VAR_INIT_ASIL_A
        VAR_INIT_BOOL: alignment=8, size=1, sw-addrmethod=VAR_INIT
        VAR_INIT_BOOL_ASIL_A: alignment=8, size=1, sw-addrmethod=VAR_INIT_ASIL_A
        VAR_INIT_UNSPECIFIED: alignment=UNSPECIFIED, size=0, sw-addrmethod=VAR_INIT
        VAR_INIT_UNSPECIFIED_ASIL_A: alignment=UNSPECIFIED, size=0, sw-addrmethod=VAR_INIT_ASIL_A
        VAR_NO_INIT_16: alignment=16, size=16, sw-addrmethod=VAR_NOINIT
        VAR_NO_INIT_16_ASIL_A: alignment=16, size=16, sw-addrmethod=VAR_NOINIT_ASIL_A
        VAR_NO_INIT_32: alignment=32, size=32, sw-addrmethod=VAR_NOINIT
        VAR_NO_INIT_32_ASIL_A: alignment=32, size=32, sw-addrmethod=VAR_NOINIT_ASIL_A
        VAR_NO_INIT_8: alignment=8, size=8, sw-addrmethod=VAR_NOINIT
        VAR_NO_INIT_8_ASIL_A: alignment=8, size=8, sw-addrmethod=VAR_NOINIT_ASIL_A
        VAR_NO_INIT_BOOL: alignment=8, size=1, sw-addrmethod=VAR_NOINIT
        VAR_NO_INIT_BOOL_ASIL_A: alignment=8, size=1, sw-addrmethod=VAR_NOINIT_ASIL_A
        VAR_NO_INIT_UNSPECIFIED: alignment=UNSPECIFIED, size=0, sw-addrmethod=VAR_NOINIT
        VAR_NO_INIT_UNSPECIFIED_ASIL_A: alignment=UNSPECIFIED, size=0, sw-addrmethod=VAR_NOINIT_ASIL_A
        VAR_POWER_ON_CLEARED: alignment=UNSPECIFIED, size=0, sw-addrmethod=VAR_POWER_ON_CLEARED
