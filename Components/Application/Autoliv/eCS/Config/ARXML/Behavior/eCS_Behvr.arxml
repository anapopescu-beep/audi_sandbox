AUTOSAR XML (schema 4-2-2)
package /AUTOLIV/SoftwareComponents/eCS
  application sw component type eCS: category=SWC  # eCS_AC_ElectricalCarSensor
    behavior eCS_IB_ElectricalCarSensor: constant-value-mapping=ConstantsMappingSet_eCS, data-type-mapping=[DataTypeMappingSet_ATM, DataTypeMappingSet_FSM, DataTypeMappingSet_NVP, DataTypeMappingSet_eCS], handle-termination-and-restart=NO-SUPPORT
      timing event ev_eCSMainFunction: start-on-event=eCS_runMainFunction, period=0.001
      runnable eCS_runMainFunction: sw-addr-method=CODE_ASIL_A, external-triggering-point=ptrpAsrOsServicesECS.eCS_runMainFunction
        data-receive-point-by-arguments:
          access drparg_stAccelMtrPerSecSqd: accessed-variable=prrAccelMtrPerSecSqd.stAccelMtrPerSecSqd
        data-send-points:
          access dsp_u16BallPosition: accessed-variable=psrEcsAlgoData.u16BallPosition
          access dsp_u8EcsFlag: accessed-variable=psrEcsAlgoData.u8EcsFlag
        sync call scp_CheckModeStatus: operation=pclModeManagement.CheckModeStatus, timeout=0.0
  swc implementation eCS_imp: category=SWC, programming-language=C, sw-version=1.0.0, vendor-id=0, behavior=eCS_IB_ElectricalCarSensor
    code-descriptors:
      code eCS_Impl_Code: artifact-descriptors=autosar-engineering-object={short-label=eCS_Impl_Code_CodeDesc, category=SWSRC}
    resource consumption eCS_Impl_ResCons
      33 x memory section:
        CODE: size=0, sw-addrmethod=CODE
        CODE_ASIL_A: size=0, sw-addrmethod=CODE_ASIL_A
        CONST_16: alignment=16, size=16, sw-addrmethod=CONST
        CONST_16_ASIL_A: alignment=16, size=16, sw-addrmethod=CONST_ASIL_A
        CONST_32: alignment=32, size=32, sw-addrmethod=CONST
        CONST_32_ASIL_A: alignment=32, size=32, sw-addrmethod=CONST_ASIL_A
        CONST_8: alignment=8, size=8, sw-addrmethod=CONST
        CONST_8_ASIL_A: alignment=8, size=8, sw-addrmethod=CONST_ASIL_A
        CONST_BOOL: alignment=8, size=1, sw-addrmethod=CONST
        CONST_BOOL_ASIL_A: alignment=8, size=1, sw-addrmethod=CONST_ASIL_A
        CONST_UNSPECIFIED: alignment=UNSPECIFIED, size=0, sw-addrmethod=CONST
        CONST_UNSPECIFIED_ASIL_A: alignment=UNSPECIFIED, size=0, sw-addrmethod=CONST_ASIL_A
        VAR_INIT_16: alignment=16, size=16, sw-addrmethod=VAR_INIT
        VAR_INIT_16_ASIL_A: alignment=16, size=16, sw-addrmethod=VAR_INIT_ASIL_A
        VAR_INIT_32: alignment=32, size=32, sw-addrmethod=VAR_INIT
        VAR_INIT_32_ASIL_A: alignment=32, size=32, sw-addrmethod=VAR_INIT_ASIL_A
        VAR_INIT_8: alignment=8, size=8, sw-addrmethod=VAR_INIT
        VAR_INIT_8_ASIL_A: alignment=8, size=8, sw-addrmethod=VAR_INIT_ASIL_A
        VAR_INIT_BOOL: alignment=8, size=1, sw-addrmethod=VAR_INIT
        VAR_INIT_BOOL_ASIL_A: alignment=8, size=1, sw-addrmethod=VAR_INIT_ASIL_A
        VAR_INIT_UNSPECIFIED: alignment=UNSPECIFIED, size=0, sw-addrmethod=VAR_INIT
        VAR_INIT_UNSPECIFIED_ASIL_A: alignment=UNSPECIFIED, size=0, sw-addrmethod=VAR_INIT_ASIL_A
        VAR_NO_INIT_16: alignment=16, size=16, sw-addrmethod=VAR_NOINIT
        VAR_NO_INIT_16_ASIL_A: alignment=16, size=16, sw-addrmethod=VAR_NOINIT_ASIL_A
        VAR_NO_INIT_32: alignment=32, size=32, sw-addrmethod=VAR_NOINIT
        VAR_NO_INIT_32_ASIL_A: alignment=32, size=32, sw-addrmethod=VAR_NOINIT_ASIL_A
        VAR_NO_INIT_8: alignment=8, size=8, sw-addrmethod=VAR_NOINIT
        VAR_NO_INIT_8_ASIL_A: alignment=8, size=8, sw-addrmethod=VAR_NOINIT_ASIL_A
        VAR_NO_INIT_BOOL: alignment=8, size=1, sw-addrmethod=VAR_NOINIT
        VAR_NO_INIT_BOOL_ASIL_A: alignment=8, size=1, sw-addrmethod=VAR_NOINIT_ASIL_A
        VAR_NO_INIT_UNSPECIFIED: alignment=UNSPECIFIED, size=0, sw-addrmethod=VAR_NOINIT
        VAR_NO_INIT_UNSPECIFIED_ASIL_A: alignment=UNSPECIFIED, size=0, sw-addrmethod=VAR_NOINIT_ASIL_A
        VAR_POWER_ON_CLEARED: alignment=UNSPECIFIED, size=0, sw-addrmethod=VAR_POWER_ON_CLEARED
