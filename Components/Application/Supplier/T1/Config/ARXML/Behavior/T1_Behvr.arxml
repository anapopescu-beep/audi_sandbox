AUTOSAR XML (schema 4-2-2)
package /AUTOLIV/SoftwareComponents/T1
  application sw component type T1: category=SWC  # T1_AC_GliwaTool
    behavior T1_IB_0: handle-termination-and-restart=NO-SUPPORT
      timing event T1_evAppHandler: start-on-event=T1_AppHandler, period=0.01
      runnable T1_AppHandler
  swc implementation T1_imp: programming-language=C, sw-version=1.0.0, vendor-id=0, behavior=T1_IB_0
    code-descriptors:
      code T1_Impl_Code: artifact-descriptors=autosar-engineering-object={short-label=T1_Impl_Code_CodeDesc, category=SWSRC}
