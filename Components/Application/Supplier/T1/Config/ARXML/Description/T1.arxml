AUTOSAR XML (schema 4-2-2)
package /AUTOLIV/SoftwareComponents/T1
  application sw component type T1: category=SWC  # T1_AC_GliwaTool
