AUTOSAR XML (schema 4-0-3)
package /AUTOSAR_Fls/BswModuleDescriptions
  bsw module description Fls: module-id=92, provided-entrys=[Fls_Init, Fls_MainFunction]
    bsw internal behavior InternalBehavior_0
      6 x exclusive area:
        FLS_EXCLUSIVE_AREA_00
        FLS_EXCLUSIVE_AREA_{10..14}
      bsw called entity Fls_Init: can-enter-exclusive-area=[FLS_EXCLUSIVE_AREA_00, FLS_EXCLUSIVE_AREA_10, FLS_EXCLUSIVE_AREA_11, FLS_EXCLUSIVE_AREA_12, FLS_EXCLUSIVE_AREA_13, FLS_EXCLUSIVE_AREA_14], implemented-entry=Fls_Init, scheduler-name-prefix=Prefix_Fls
      bsw schedulable entity Fls_MainFunction: implemented-entry=Fls_MainFunction, scheduler-name-prefix=Prefix_Fls
      bsw timing event TimingEvent_MainFunction: starts-on-event=Fls_MainFunction, period=0.01
      bsw scheduler name prefix Prefix_Fls: symbol=Fls
package /AUTOSAR_Fls/BswModuleEntrys
  bsw module entry Fls_Init: service-id=0, is-reentrant=false, is-synchronous=true, call-type=REGULAR, execution-context=UNSPECIFIED, sw-service-impl-policy=STANDARD
  bsw module entry Fls_MainFunction: service-id=6, is-reentrant=false, is-synchronous=true, call-type=SCHEDULED, execution-context=TASK, sw-service-impl-policy=STANDARD
package /Fls_TS_T40D2M10I2R0/Implementations
  bsw implementation BswImplementation_0: programming-language=C, sw-version=1.0.2, vendor-id=43, ar-release-version=4.2.2, behavior=InternalBehavior_0, vendor-specific-module-def=Fls
    code-descriptors:
      code Files: artifact-descriptors=[{short-label=make::Fls_defs.mak, category=SWMAKE}, {short-label=make::Fls_rules.mak, category=SWMAKE}]
    resource consumption ResourceConsumption
      13 x memory section:
        FLS_CODE: sw-addrmethod=CODE, symbol=CODE
        FLS_CODE_AC: sw-addrmethod=CODE, symbol=CODE_AC
        FLS_CONFIG_DATA_8: alignment=8, sw-addrmethod=CONFIG_DATA, symbol=CONFIG_DATA_8
        FLS_CONFIG_DATA_UNSPECIFIED: alignment=UNSPECIFIED, sw-addrmethod=CONFIG_DATA, symbol=CONFIG_DATA_UNSPECIFIED
        FLS_CONST_32: alignment=32, sw-addrmethod=CONST, symbol=CONST_32
        FLS_CONST_UNSPECIFIED: alignment=UNSPECIFIED, sw-addrmethod=CONST, symbol=CONST_UNSPECIFIED
        FLS_RAMCODE: sw-addrmethod=CODE, symbol=RAMCODE
        FLS_VAR_INIT_32: alignment=32, sw-addrmethod=VAR_INIT, symbol=VAR_INIT_32
        FLS_VAR_INIT_8: alignment=8, sw-addrmethod=VAR_INIT, symbol=VAR_INIT_8
        FLS_VAR_INIT_BOOLEAN: alignment=BOOLEAN, sw-addrmethod=VAR_INIT, symbol=VAR_INIT_BOOLEAN
        FLS_VAR_INIT_UNSPECIFIED: alignment=UNSPECIFIED, sw-addrmethod=VAR_INIT, symbol=VAR_INIT_UNSPECIFIED
        FLS_VAR_NO_INIT_8: alignment=8, sw-addrmethod=VAR, symbol=VAR_NO_INIT_8
        FLS_VAR_NO_INIT_UNSPECIFIED: alignment=UNSPECIFIED, sw-addrmethod=VAR, symbol=VAR_NO_INIT_UNSPECIFIED
