AUTOSAR XML (schema 4-0-3)
package /AUTOSAR_Gpt/BswModuleDescriptions
  bsw module description Gpt: module-id=100, provided-entrys=Gpt_Init
    bsw internal behavior InternalBehavior_0
      25 x exclusive area:
        GPT_EXCLUSIVE_AREA_{00..08}
        GPT_EXCLUSIVE_AREA_{14..29}
      bsw called entity Gpt_Init: can-enter-exclusive-area=[GPT_EXCLUSIVE_AREA_00, GPT_EXCLUSIVE_AREA_01, GPT_EXCLUSIVE_AREA_02, GPT_EXCLUSIVE_AREA_03, GPT_EXCLUSIVE_AREA_04, GPT_EXCLUSIVE_AREA_05, GPT_EXCLUSIVE_AREA_06, GPT_EXCLUSIVE_AREA_07, GPT_EXCLUSIVE_AREA_08, GPT_EXCLUSIVE_AREA_14, GPT_EXCLUSIVE_AREA_15, GPT_EXCLUSIVE_AREA_16, GPT_EXCLUSIVE_AREA_17, GPT_EXCLUSIVE_AREA_18, GPT_EXCLUSIVE_AREA_19, GPT_EXCLUSIVE_AREA_20, GPT_EXCLUSIVE_AREA_21, GPT_EXCLUSIVE_AREA_22, GPT_EXCLUSIVE_AREA_23, GPT_EXCLUSIVE_AREA_24, GPT_EXCLUSIVE_AREA_25, GPT_EXCLUSIVE_AREA_26, GPT_EXCLUSIVE_AREA_27, GPT_EXCLUSIVE_AREA_28, GPT_EXCLUSIVE_AREA_29], implemented-entry=Gpt_Init
package /AUTOSAR_Gpt/BswModuleEntrys
  bsw module entry Gpt_Init: service-id=1, is-reentrant=false, is-synchronous=true, call-type=REGULAR, execution-context=UNSPECIFIED, sw-service-impl-policy=STANDARD
package /Gpt_TS_T40D2M10I2R0/Implementations
  bsw implementation BswImplementation_0: programming-language=C, sw-version=1.0.2, vendor-id=43, ar-release-version=4.2.2, behavior=InternalBehavior_0, vendor-specific-module-def=Gpt
    code-descriptors:
      code Files: artifact-descriptors=[{short-label=make::Gpt_defs.mak, category=SWMAKE}, {short-label=make::Gpt_rules.mak, category=SWMAKE}]
    resource consumption ResourceConsumption
      5 x memory section:
        GPT_CODE: sw-addrmethod=CODE, symbol=CODE
        GPT_CONFIG_DATA_UNSPECIFIED: alignment=UNSPECIFIED, sw-addrmethod=CONFIG_DATA, symbol=CONFIG_DATA_UNSPECIFIED
        GPT_VAR_INIT_32: alignment=32, sw-addrmethod=VAR_INIT, symbol=VAR_INIT_32
        GPT_VAR_INIT_UNSPECIFIED: alignment=UNSPECIFIED, sw-addrmethod=VAR_INIT, symbol=VAR_INIT_UNSPECIFIED
        GPT_VAR_NO_INIT_UNSPECIFIED: alignment=UNSPECIFIED, sw-addrmethod=VAR, symbol=VAR_NO_INIT_UNSPECIFIED
