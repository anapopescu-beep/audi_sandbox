AUTOSAR XML (schema 4-0-3)
package /AUTOSAR_Mcu/BswModuleDescriptions
  bsw module description Mcu: module-id=101, provided-entrys=Mcu_Init
    bsw internal behavior InternalBehavior_0
      bsw called entity Mcu_Init: implemented-entry=Mcu_Init
package /AUTOSAR_Mcu/BswModuleEntrys
  bsw module entry Mcu_Init: service-id=0, is-reentrant=false, is-synchronous=true, call-type=REGULAR, execution-context=UNSPECIFIED, sw-service-impl-policy=STANDARD
package /Mcu_TS_T40D2M10I2R0/Implementations
  bsw implementation BswImplementation_0: programming-language=C, sw-version=1.0.2, vendor-id=43, ar-release-version=4.2.2, behavior=InternalBehavior_0, vendor-specific-module-def=Mcu
    code-descriptors:
      code Files: artifact-descriptors=[{short-label=make::Mcu_defs.mak, category=SWMAKE}, {short-label=make::Mcu_rules.mak, category=SWMAKE}]
    resource consumption ResourceConsumption
      7 x memory section:
        MCU_CODE: sw-addrmethod=CODE, symbol=CODE
        MCU_CONFIG_DATA_UNSPECIFIED: alignment=UNSPECIFIED, sw-addrmethod=CONFIG_DATA, symbol=CONFIG_DATA_UNSPECIFIED
        MCU_CONST_32: alignment=32, sw-addrmethod=CONST, symbol=CONST_32
        MCU_CONST_UNSPECIFIED: alignment=UNSPECIFIED, sw-addrmethod=CONST, symbol=CONST_UNSPECIFIED
        MCU_VAR_INIT_32: alignment=32, sw-addrmethod=VAR_INIT, symbol=VAR_INIT_32
        MCU_VAR_INIT_UNSPECIFIED: alignment=UNSPECIFIED, sw-addrmethod=VAR_INIT, symbol=VAR_INIT_UNSPECIFIED
        MCU_VAR_NO_INIT_8: alignment=8, sw-addrmethod=VAR, symbol=VAR_NO_INIT_8
