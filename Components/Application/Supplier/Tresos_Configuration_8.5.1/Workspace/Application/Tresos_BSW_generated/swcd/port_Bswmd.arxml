AUTOSAR XML (schema 4-0-3)
package /AUTOSAR_Port/BswModuleDescriptions
  bsw module description Port: module-id=124, provided-entrys=Port_Init
    bsw internal behavior InternalBehavior_0
      5 x exclusive area:
        PORT_EXCLUSIVE_AREA_{00..04}
      bsw called entity Port_Init: can-enter-exclusive-area=[PORT_EXCLUSIVE_AREA_00, PORT_EXCLUSIVE_AREA_01, PORT_EXCLUSIVE_AREA_02, PORT_EXCLUSIVE_AREA_03, PORT_EXCLUSIVE_AREA_04], implemented-entry=Port_Init, scheduler-name-prefix=Prefix_Port
      bsw scheduler name prefix Prefix_Port: symbol=Port
package /AUTOSAR_Port/BswModuleEntrys
  bsw module entry Port_Init: service-id=0, is-reentrant=false, is-synchronous=true, call-type=REGULAR, execution-context=UNSPECIFIED, sw-service-impl-policy=STANDARD
package /Port_TS_T40D2M10I2R0/Implementations
  bsw implementation BswImplementation_0: programming-language=C, sw-version=1.0.2, vendor-id=43, ar-release-version=4.2.2, behavior=InternalBehavior_0, vendor-specific-module-def=Port
    code-descriptors:
      code Files
        artifact-descriptors:
          short-label=make::Port_defs.mak, category=SWMAKE
          short-label=make::Port_rules.mak, category=SWMAKE
    resource consumption ResourceConsumption
      6 x memory section:
        PORT_CODE: sw-addrmethod=CODE, symbol=CODE
        PORT_CONFIG_DATA_16: alignment=16, sw-addrmethod=CONFIG_DATA, symbol=CONFIG_DATA_16
        PORT_CONFIG_DATA_UNSPECIFIED: alignment=UNSPECIFIED, sw-addrmethod=CONFIG_DATA, symbol=CONFIG_DATA_UNSPECIFIED
        PORT_CONST_16: alignment=16, sw-addrmethod=CONST, symbol=CONST_16
        PORT_VAR_INIT_UNSPECIFIED: alignment=UNSPECIFIED, sw-addrmethod=VAR_INIT, symbol=VAR_INIT_UNSPECIFIED
        PORT_VAR_NO_INIT_16: alignment=16, sw-addrmethod=VAR, symbol=VAR_NO_INIT_16
