AUTOSAR XML (schema 4-0-3)
package /AUTOSAR_Pwm/BswModuleDescriptions
  bsw module description Pwm: module-id=121, provided-entrys=Pwm_Init
    bsw internal behavior InternalBehavior_0
      18 x exclusive area:
        PWM_EXCLUSIVE_AREA_{00..12}
        PWM_EXCLUSIVE_AREA_{47..51}
      bsw called entity Pwm_Init: can-enter-exclusive-area=[PWM_EXCLUSIVE_AREA_00, PWM_EXCLUSIVE_AREA_01, PWM_EXCLUSIVE_AREA_02, PWM_EXCLUSIVE_AREA_03, PWM_EXCLUSIVE_AREA_04, PWM_EXCLUSIVE_AREA_05, PWM_EXCLUSIVE_AREA_06, PWM_EXCLUSIVE_AREA_07, PWM_EXCLUSIVE_AREA_08, PWM_EXCLUSIVE_AREA_09, PWM_EXCLUSIVE_AREA_10, PWM_EXCLUSIVE_AREA_11, PWM_EXCLUSIVE_AREA_12, PWM_EXCLUSIVE_AREA_47, PWM_EXCLUSIVE_AREA_48, PWM_EXCLUSIVE_AREA_49, PWM_EXCLUSIVE_AREA_50, PWM_EXCLUSIVE_AREA_51], implemented-entry=Pwm_Init
package /AUTOSAR_Pwm/BswModuleEntrys
  bsw module entry Pwm_Init: service-id=0, is-reentrant=false, is-synchronous=true, call-type=REGULAR, execution-context=UNSPECIFIED, sw-service-impl-policy=STANDARD
package /Pwm_TS_T40D2M10I2R0/Implementations
  bsw implementation BswImplementation_0: programming-language=C, sw-version=1.0.2, vendor-id=43, ar-release-version=4.2.2, behavior=InternalBehavior_0, vendor-specific-module-def=Pwm
    code-descriptors:
      code Files: artifact-descriptors=[{short-label=make::Pwm_defs.mak, category=SWMAKE}, {short-label=make::Pwm_rules.mak, category=SWMAKE}]
    resource consumption ResourceConsumption
      6 x memory section:
        PWM_CODE: sw-addrmethod=CODE, symbol=CODE
        PWM_CONFIG_DATA_UNSPECIFIED: alignment=UNSPECIFIED, sw-addrmethod=CONFIG_DATA, symbol=CONFIG_DATA_UNSPECIFIED
        PWM_VAR_INIT_UNSPECIFIED: alignment=UNSPECIFIED, sw-addrmethod=VAR_INIT, symbol=VAR_INIT_UNSPECIFIED
        PWM_VAR_NO_INIT_16: alignment=16, sw-addrmethod=VAR, symbol=VAR_NO_INIT_16
        PWM_VAR_NO_INIT_8: alignment=8, sw-addrmethod=VAR, symbol=VAR_NO_INIT_8
        PWM_VAR_NO_INIT_UNSPECIFIED: alignment=UNSPECIFIED, sw-addrmethod=VAR, symbol=VAR_NO_INIT_UNSPECIFIED
