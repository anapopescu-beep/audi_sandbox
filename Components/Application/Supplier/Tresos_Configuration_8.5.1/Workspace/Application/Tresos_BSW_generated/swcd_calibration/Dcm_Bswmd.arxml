AUTOSAR XML (schema 4-2-1)
package /EB_Dcm/Implementations
  bsw implementation BswImplementation_0: programming-language=C, sw-version=4.14.7, swc-bsw-mapping=SwcBswMapping_0, vendor-id=1, ar-release-version=4.0.3, behavior=InternalBehavior_0, vendor-specific-module-def=Dcm
    mc-parameter-instances:
      mc data instance Dcm_DsdServiceUsed: category=ARRAY, array-size=2
        12 x mc data instance, all with category=VALUE:
          ServiceTable_0_SID10_DiagnosticSessionControl_ServiceId_16: resulting-properties={base-type=uint8, sw-bit-representation={bit-position=0, number-of-bits=1}, sw-calibration-access=READ-WRITE, data-constr=uint8}, symbol=[0][0]  # DcmDsdServiceUsed parameter for service SID10_DiagnosticSessionControl in Servicetable DcmDsdServiceTable_0
          ServiceTable_0_SID11_ECUReset_ServiceId_17: resulting-properties={base-type=uint8, sw-bit-representation={bit-position=1, number-of-bits=1}, sw-calibration-access=READ-WRITE, data-constr=uint8}, symbol=[0][0]  # DcmDsdServiceUsed parameter for service SID11_ECUReset in Servicetable DcmDsdServiceTable_0
          ServiceTable_0_SID14_ClearDiagnosticInformation_ServiceId_20: resulting-properties={base-type=uint8, sw-bit-representation={bit-position=2, number-of-bits=1}, sw-calibration-access=READ-WRITE, data-constr=uint8}, symbol=[0][0]  # DcmDsdServiceUsed parameter for service SID14_ClearDiagnosticInformation in Servicetable DcmDsdServiceTable_0
          ServiceTable_0_SID22_ReadDataByIdentifier_ServiceId_34: resulting-properties={base-type=uint8, sw-bit-representation={bit-position=3, number-of-bits=1}, sw-calibration-access=READ-WRITE, data-constr=uint8}, symbol=[0][0]  # DcmDsdServiceUsed parameter for service SID22_ReadDataByIdentifier in Servicetable DcmDsdServiceTable_0
          ServiceTable_0_SID23_ReadMemoryByAddress_ServiceId_35: resulting-properties={base-type=uint8, sw-bit-representation={bit-position=4, number-of-bits=1}, sw-calibration-access=READ-WRITE, data-constr=uint8}, symbol=[0][0]  # DcmDsdServiceUsed parameter for service SID23_ReadMemoryByAddress in Servicetable DcmDsdServiceTable_0
          ServiceTable_0_SID27_SecurityAccess_ServiceId_39: resulting-properties={base-type=uint8, sw-bit-representation={bit-position=5, number-of-bits=1}, sw-calibration-access=READ-WRITE, data-constr=uint8}, symbol=[0][0]  # DcmDsdServiceUsed parameter for service SID27_SecurityAccess in Servicetable DcmDsdServiceTable_0
          ServiceTable_0_SID28_CommunicationControl_ServiceId_40: resulting-properties={base-type=uint8, sw-bit-representation={bit-position=6, number-of-bits=1}, sw-calibration-access=READ-WRITE, data-constr=uint8}, symbol=[0][0]  # DcmDsdServiceUsed parameter for service SID28_CommunicationControl in Servicetable DcmDsdServiceTable_0
          ServiceTable_0_SID2E_WriteDataByIdentifier_ServiceId_46: resulting-properties={base-type=uint8, sw-bit-representation={bit-position=7, number-of-bits=1}, sw-calibration-access=READ-WRITE, data-constr=uint8}, symbol=[0][0]  # DcmDsdServiceUsed parameter for service SID2E_WriteDataByIdentifier in Servicetable DcmDsdServiceTable_0
          ServiceTable_0_SID31_RoutineControl_ServiceId_49: resulting-properties={base-type=uint8, sw-bit-representation={bit-position=0, number-of-bits=1}, sw-calibration-access=READ-WRITE, data-constr=uint8}, symbol=[0][1]  # DcmDsdServiceUsed parameter for service SID31_RoutineControl in Servicetable DcmDsdServiceTable_0
          ServiceTable_0_SID3D_WriteMemoryByAddress_ServiceId_61: resulting-properties={base-type=uint8, sw-bit-representation={bit-position=1, number-of-bits=1}, sw-calibration-access=READ-WRITE, data-constr=uint8}, symbol=[0][1]  # DcmDsdServiceUsed parameter for service SID3D_WriteMemoryByAddress in Servicetable DcmDsdServiceTable_0
          ServiceTable_0_SID3E_TesterPresent_ServiceId_62: resulting-properties={base-type=uint8, sw-bit-representation={bit-position=2, number-of-bits=1}, sw-calibration-access=READ-WRITE, data-constr=uint8}, symbol=[0][1]  # DcmDsdServiceUsed parameter for service SID3E_TesterPresent in Servicetable DcmDsdServiceTable_0
          ServiceTable_0_SID85_ControlDTCSetting_ServiceId_133: resulting-properties={base-type=uint8, sw-bit-representation={bit-position=3, number-of-bits=1}, sw-calibration-access=READ-WRITE, data-constr=uint8}, symbol=[0][1]  # DcmDsdServiceUsed parameter for service SID85_ControlDTCSetting in Servicetable DcmDsdServiceTable_0
    resource consumption ResourceConsumption
      15 x memory section:
        CONST_UNSPECIFIED: alignment=UNSPECIFIED, sw-addrmethod=CONST
        CONST_32: alignment=32, sw-addrmethod=CONST
        CONST_16: alignment=16, sw-addrmethod=CONST
        VAR_NO_INIT_8: alignment=8, sw-addrmethod=VAR_NOINIT
        CONST_8: alignment=8, sw-addrmethod=CONST
        CODE: sw-addrmethod=CODE
        CALLOUT_CODE: sw-addrmethod=CODE
        VAR_INIT_UNSPECIFIED: alignment=UNSPECIFIED, sw-addrmethod=VAR
        VAR_NO_INIT_UNSPECIFIED: alignment=UNSPECIFIED, sw-addrmethod=VAR_NOINIT
        VAR_POWER_ON_CLEARED_UNSPECIFIED: alignment=UNSPECIFIED, sw-addrmethod=VAR
        VAR_INIT_8: alignment=8, sw-addrmethod=VAR
        VAR_INIT_16: alignment=16, sw-addrmethod=VAR
        VAR_NO_INIT_16: alignment=16, sw-addrmethod=VAR_NOINIT
        VAR_NO_INIT_32: alignment=32, sw-addrmethod=VAR_NOINIT
        VAR_INIT_32: alignment=32, sw-addrmethod=VAR
