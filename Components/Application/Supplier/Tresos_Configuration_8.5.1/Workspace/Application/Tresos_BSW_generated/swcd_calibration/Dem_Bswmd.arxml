AUTOSAR XML (schema 4-1-3)
package /EB_Dem/Implementations
  bsw implementation BswImplementation_0: programming-language=C, sw-version=5.18.7, swc-bsw-mapping=SwcBswMapping_0, vendor-id=1, ar-release-version=4.0.3, behavior=InternalBehavior_0
    code-descriptors:
      code Files
        artifact-descriptors:
          short-label=Autosar::include::Dem.h, category=SWHDR
          short-label=Autosar::include::Dem_BSW_Types.h, category=SWHDR
          short-label=Autosar::include::Dem_Int.h, category=SWHDR
          short-label=Autosar::include::Dem_Int_Stc.h, category=SWHDR
          short-label=Autosar::include::Dem_NvMCbk.h, category=SWHDR
          short-label=Autosar::include::Dem_Stc.h, category=SWHDR
          short-label=Autosar::include::Dem_Trace.h, category=SWHDR
          short-label=Autosar::include::Dem_Types.h, category=SWHDR
          short-label=Autosar::include::Dem_Version.h, category=SWHDR
          short-label=Autosar::src::Dem.c, category=SWSRC
          short-label=Autosar::src::Dem_Core.c, category=SWSRC
          short-label=Autosar::src::Dem_DcmIfAccess.c, category=SWSRC
          short-label=Autosar::src::Dem_DcmIfFFandED.c, category=SWSRC
          short-label=Autosar::src::Dem_DcmIfOBD.c, category=SWSRC
          short-label=Autosar::src::Dem_DcmIfStatusInfo.c, category=SWSRC
          short-label=make::Dem_defs.mak, category=SWMAKE
          short-label=make::Dem_rules.mak, category=SWMAKE
    mc-parameter-instances:
      5 x mc data instance, all with category=ARRAY:
        Dem_EventDesc: array-size=23
          23 x mc data instance, all with category=STRUCTURE:
            EVENT_CANSM_E_BUS_OFF: symbol=[1]
              mc data instance EvConf1: category=STRUCTURE
                mc data instance DemUdsDTC: category=VALUE, resulting-properties={base-type=uint32, sw-bit-representation={bit-position=0, number-of-bits=24}, sw-calibration-access=READ-WRITE, data-constr=uint32}, symbol=EvConf1  # UDS DTC value of the current event (special value: 0 means DTC off) - If re-calibration is performed during Dcm service request processing, the Dem may return still with the DTC, although the DTC is switched off already until a request for a different DTC. For service 0x19, if the DTC is identified by the algorithm the value of the DTC will be returned. In case calibration occurs with DTC off and the service is called again, the DTC being identified by the algorithm , the DTC returned by the service is DEM_NO_DTC.
                mc data instance DemDTCSeverity: category=VALUE, resulting-properties={base-type=uint32, sw-bit-representation={bit-position=26, number-of-bits=2}, sw-calibration-access=READ-WRITE, data-constr=uint32}, symbol=EvConf1  # Internal representation: '0' == 'DEM_DTC_SEV_NO_SEVERITY' - '1' == 'DEM_DTC_SEV_MAINTENANCE_ONLY'- '2' == 'DEM_DTC_SEV_CHECK_AT_NEXT_HALT'- '3' == 'DEM_DTC_SEV_IMMEDIATELY'
              mc data instance EvConf2: category=STRUCTURE
                mc data instance FFClassIdx: category=VALUE, resulting-properties={base-type=uint32, sw-bit-representation={bit-position=1, number-of-bits=2}, sw-calibration-access=READ-WRITE, data-constr=uint32}, symbol=EvConf2  # Index of used Freeze Frame class
                mc data instance DemAgingCycleCounterThreshold: category=VALUE, resulting-properties={base-type=uint32, sw-bit-representation={bit-position=6, number-of-bits=1}, sw-calibration-access=READ-WRITE, data-constr=uint32}, symbol=EvConf2  # Aging of an event can be disabled by setting DemAgingCycleCounterThreshold to 0 - If the threshold will be re-calibrated the effect will be considered at the next processing and not during initialization.
              mc data instance EvConf3: category=STRUCTURE
                mc data instance DemDebounceCounterBased: category=VALUE, resulting-properties={base-type=uint32, sw-bit-representation={bit-position=5, number-of-bits=5}, sw-calibration-access=READ-WRITE, data-constr=uint32}, symbol=EvConf3
                mc data instance DemDTCFunctionalUnit: category=VALUE, resulting-properties={base-type=uint32, sw-bit-representation={bit-position=10, number-of-bits=1}, sw-calibration-access=READ-WRITE, data-constr=uint32}, symbol=EvConf3
            EVENT_ADC_OUT_OF_ORDER: symbol=[2]
              mc data instance EvConf1: category=STRUCTURE
                mc data instance DemUdsDTC: category=VALUE, resulting-properties={base-type=uint32, sw-bit-representation={bit-position=0, number-of-bits=24}, sw-calibration-access=READ-WRITE, data-constr=uint32}, symbol=EvConf1  # UDS DTC value of the current event (special value: 0 means DTC off) - If re-calibration is performed during Dcm service request processing, the Dem may return still with the DTC, although the DTC is switched off already until a request for a different DTC. For service 0x19, if the DTC is identified by the algorithm the value of the DTC will be returned. In case calibration occurs with DTC off and the service is called again, the DTC being identified by the algorithm , the DTC returned by the service is DEM_NO_DTC.
                mc data instance DemDTCSeverity: category=VALUE, resulting-properties={base-type=uint32, sw-bit-representation={bit-position=26, number-of-bits=2}, sw-calibration-access=READ-WRITE, data-constr=uint32}, symbol=EvConf1  # Internal representation: '0' == 'DEM_DTC_SEV_NO_SEVERITY' - '1' == 'DEM_DTC_SEV_MAINTENANCE_ONLY'- '2' == 'DEM_DTC_SEV_CHECK_AT_NEXT_HALT'- '3' == 'DEM_DTC_SEV_IMMEDIATELY'
              mc data instance EvConf2: category=STRUCTURE
                mc data instance FFClassIdx: category=VALUE, resulting-properties={base-type=uint32, sw-bit-representation={bit-position=1, number-of-bits=2}, sw-calibration-access=READ-WRITE, data-constr=uint32}, symbol=EvConf2  # Index of used Freeze Frame class
                mc data instance DemAgingCycleCounterThreshold: category=VALUE, resulting-properties={base-type=uint32, sw-bit-representation={bit-position=6, number-of-bits=1}, sw-calibration-access=READ-WRITE, data-constr=uint32}, symbol=EvConf2  # Aging of an event can be disabled by setting DemAgingCycleCounterThreshold to 0 - If the threshold will be re-calibrated the effect will be considered at the next processing and not during initialization.
              mc data instance EvConf3: category=STRUCTURE
                mc data instance DemDebounceCounterBased: category=VALUE, resulting-properties={base-type=uint32, sw-bit-representation={bit-position=5, number-of-bits=5}, sw-calibration-access=READ-WRITE, data-constr=uint32}, symbol=EvConf3
                mc data instance DemDTCFunctionalUnit: category=VALUE, resulting-properties={base-type=uint32, sw-bit-representation={bit-position=10, number-of-bits=1}, sw-calibration-access=READ-WRITE, data-constr=uint32}, symbol=EvConf3
            EVENT_WARM_RESET: symbol=[3]
              mc data instance EvConf1: category=STRUCTURE
                mc data instance DemUdsDTC: category=VALUE, resulting-properties={base-type=uint32, sw-bit-representation={bit-position=0, number-of-bits=24}, sw-calibration-access=READ-WRITE, data-constr=uint32}, symbol=EvConf1  # UDS DTC value of the current event (special value: 0 means DTC off) - If re-calibration is performed during Dcm service request processing, the Dem may return still with the DTC, although the DTC is switched off already until a request for a different DTC. For service 0x19, if the DTC is identified by the algorithm the value of the DTC will be returned. In case calibration occurs with DTC off and the service is called again, the DTC being identified by the algorithm , the DTC returned by the service is DEM_NO_DTC.
                mc data instance DemDTCSeverity: category=VALUE, resulting-properties={base-type=uint32, sw-bit-representation={bit-position=26, number-of-bits=2}, sw-calibration-access=READ-WRITE, data-constr=uint32}, symbol=EvConf1  # Internal representation: '0' == 'DEM_DTC_SEV_NO_SEVERITY' - '1' == 'DEM_DTC_SEV_MAINTENANCE_ONLY'- '2' == 'DEM_DTC_SEV_CHECK_AT_NEXT_HALT'- '3' == 'DEM_DTC_SEV_IMMEDIATELY'
              mc data instance EvConf2: category=STRUCTURE
                mc data instance FFClassIdx: category=VALUE, resulting-properties={base-type=uint32, sw-bit-representation={bit-position=1, number-of-bits=2}, sw-calibration-access=READ-WRITE, data-constr=uint32}, symbol=EvConf2  # Index of used Freeze Frame class
                mc data instance DemAgingCycleCounterThreshold: category=VALUE, resulting-properties={base-type=uint32, sw-bit-representation={bit-position=6, number-of-bits=1}, sw-calibration-access=READ-WRITE, data-constr=uint32}, symbol=EvConf2  # Aging of an event can be disabled by setting DemAgingCycleCounterThreshold to 0 - If the threshold will be re-calibrated the effect will be considered at the next processing and not during initialization.
              mc data instance EvConf3: category=STRUCTURE
                mc data instance DemDebounceCounterBased: category=VALUE, resulting-properties={base-type=uint32, sw-bit-representation={bit-position=5, number-of-bits=5}, sw-calibration-access=READ-WRITE, data-constr=uint32}, symbol=EvConf3
                mc data instance DemDTCFunctionalUnit: category=VALUE, resulting-properties={base-type=uint32, sw-bit-representation={bit-position=10, number-of-bits=1}, sw-calibration-access=READ-WRITE, data-constr=uint32}, symbol=EvConf3
            EVENT_PFLASH_MEM_CORRUPT: symbol=[4]
              mc data instance EvConf1: category=STRUCTURE
                mc data instance DemUdsDTC: category=VALUE, resulting-properties={base-type=uint32, sw-bit-representation={bit-position=0, number-of-bits=24}, sw-calibration-access=READ-WRITE, data-constr=uint32}, symbol=EvConf1  # UDS DTC value of the current event (special value: 0 means DTC off) - If re-calibration is performed during Dcm service request processing, the Dem may return still with the DTC, although the DTC is switched off already until a request for a different DTC. For service 0x19, if the DTC is identified by the algorithm the value of the DTC will be returned. In case calibration occurs with DTC off and the service is called again, the DTC being identified by the algorithm , the DTC returned by the service is DEM_NO_DTC.
                mc data instance DemDTCSeverity: category=VALUE, resulting-properties={base-type=uint32, sw-bit-representation={bit-position=26, number-of-bits=2}, sw-calibration-access=READ-WRITE, data-constr=uint32}, symbol=EvConf1  # Internal representation: '0' == 'DEM_DTC_SEV_NO_SEVERITY' - '1' == 'DEM_DTC_SEV_MAINTENANCE_ONLY'- '2' == 'DEM_DTC_SEV_CHECK_AT_NEXT_HALT'- '3' == 'DEM_DTC_SEV_IMMEDIATELY'
              mc data instance EvConf2: category=STRUCTURE
                mc data instance FFClassIdx: category=VALUE, resulting-properties={base-type=uint32, sw-bit-representation={bit-position=1, number-of-bits=2}, sw-calibration-access=READ-WRITE, data-constr=uint32}, symbol=EvConf2  # Index of used Freeze Frame class
                mc data instance DemAgingCycleCounterThreshold: category=VALUE, resulting-properties={base-type=uint32, sw-bit-representation={bit-position=6, number-of-bits=1}, sw-calibration-access=READ-WRITE, data-constr=uint32}, symbol=EvConf2  # Aging of an event can be disabled by setting DemAgingCycleCounterThreshold to 0 - If the threshold will be re-calibrated the effect will be considered at the next processing and not during initialization.
              mc data instance EvConf3: category=STRUCTURE
                mc data instance DemDebounceCounterBased: category=VALUE, resulting-properties={base-type=uint32, sw-bit-representation={bit-position=5, number-of-bits=5}, sw-calibration-access=READ-WRITE, data-constr=uint32}, symbol=EvConf3
                mc data instance DemDTCFunctionalUnit: category=VALUE, resulting-properties={base-type=uint32, sw-bit-representation={bit-position=10, number-of-bits=1}, sw-calibration-access=READ-WRITE, data-constr=uint32}, symbol=EvConf3
            EVENT_EXT_WDG_OUT_OF_ORDER: symbol=[5]
              mc data instance EvConf1: category=STRUCTURE
                mc data instance DemUdsDTC: category=VALUE, resulting-properties={base-type=uint32, sw-bit-representation={bit-position=0, number-of-bits=24}, sw-calibration-access=READ-WRITE, data-constr=uint32}, symbol=EvConf1  # UDS DTC value of the current event (special value: 0 means DTC off) - If re-calibration is performed during Dcm service request processing, the Dem may return still with the DTC, although the DTC is switched off already until a request for a different DTC. For service 0x19, if the DTC is identified by the algorithm the value of the DTC will be returned. In case calibration occurs with DTC off and the service is called again, the DTC being identified by the algorithm , the DTC returned by the service is DEM_NO_DTC.
                mc data instance DemDTCSeverity: category=VALUE, resulting-properties={base-type=uint32, sw-bit-representation={bit-position=26, number-of-bits=2}, sw-calibration-access=READ-WRITE, data-constr=uint32}, symbol=EvConf1  # Internal representation: '0' == 'DEM_DTC_SEV_NO_SEVERITY' - '1' == 'DEM_DTC_SEV_MAINTENANCE_ONLY'- '2' == 'DEM_DTC_SEV_CHECK_AT_NEXT_HALT'- '3' == 'DEM_DTC_SEV_IMMEDIATELY'
              mc data instance EvConf2: category=STRUCTURE
                mc data instance FFClassIdx: category=VALUE, resulting-properties={base-type=uint32, sw-bit-representation={bit-position=1, number-of-bits=2}, sw-calibration-access=READ-WRITE, data-constr=uint32}, symbol=EvConf2  # Index of used Freeze Frame class
                mc data instance DemAgingCycleCounterThreshold: category=VALUE, resulting-properties={base-type=uint32, sw-bit-representation={bit-position=6, number-of-bits=1}, sw-calibration-access=READ-WRITE, data-constr=uint32}, symbol=EvConf2  # Aging of an event can be disabled by setting DemAgingCycleCounterThreshold to 0 - If the threshold will be re-calibrated the effect will be considered at the next processing and not during initialization.
              mc data instance EvConf3: category=STRUCTURE
                mc data instance DemDebounceCounterBased: category=VALUE, resulting-properties={base-type=uint32, sw-bit-representation={bit-position=5, number-of-bits=5}, sw-calibration-access=READ-WRITE, data-constr=uint32}, symbol=EvConf3
                mc data instance DemDTCFunctionalUnit: category=VALUE, resulting-properties={base-type=uint32, sw-bit-representation={bit-position=10, number-of-bits=1}, sw-calibration-access=READ-WRITE, data-constr=uint32}, symbol=EvConf3
            EVENT_NVM_NOT_PRG: symbol=[6]
              mc data instance EvConf1: category=STRUCTURE
                mc data instance DemUdsDTC: category=VALUE, resulting-properties={base-type=uint32, sw-bit-representation={bit-position=0, number-of-bits=24}, sw-calibration-access=READ-WRITE, data-constr=uint32}, symbol=EvConf1  # UDS DTC value of the current event (special value: 0 means DTC off) - If re-calibration is performed during Dcm service request processing, the Dem may return still with the DTC, although the DTC is switched off already until a request for a different DTC. For service 0x19, if the DTC is identified by the algorithm the value of the DTC will be returned. In case calibration occurs with DTC off and the service is called again, the DTC being identified by the algorithm , the DTC returned by the service is DEM_NO_DTC.
                mc data instance DemDTCSeverity: category=VALUE, resulting-properties={base-type=uint32, sw-bit-representation={bit-position=26, number-of-bits=2}, sw-calibration-access=READ-WRITE, data-constr=uint32}, symbol=EvConf1  # Internal representation: '0' == 'DEM_DTC_SEV_NO_SEVERITY' - '1' == 'DEM_DTC_SEV_MAINTENANCE_ONLY'- '2' == 'DEM_DTC_SEV_CHECK_AT_NEXT_HALT'- '3' == 'DEM_DTC_SEV_IMMEDIATELY'
              mc data instance EvConf2: category=STRUCTURE
                mc data instance FFClassIdx: category=VALUE, resulting-properties={base-type=uint32, sw-bit-representation={bit-position=1, number-of-bits=2}, sw-calibration-access=READ-WRITE, data-constr=uint32}, symbol=EvConf2  # Index of used Freeze Frame class
                mc data instance DemAgingCycleCounterThreshold: category=VALUE, resulting-properties={base-type=uint32, sw-bit-representation={bit-position=6, number-of-bits=1}, sw-calibration-access=READ-WRITE, data-constr=uint32}, symbol=EvConf2  # Aging of an event can be disabled by setting DemAgingCycleCounterThreshold to 0 - If the threshold will be re-calibrated the effect will be considered at the next processing and not during initialization.
              mc data instance EvConf3: category=STRUCTURE
                mc data instance DemDebounceCounterBased: category=VALUE, resulting-properties={base-type=uint32, sw-bit-representation={bit-position=5, number-of-bits=5}, sw-calibration-access=READ-WRITE, data-constr=uint32}, symbol=EvConf3
                mc data instance DemDTCFunctionalUnit: category=VALUE, resulting-properties={base-type=uint32, sw-bit-representation={bit-position=10, number-of-bits=1}, sw-calibration-access=READ-WRITE, data-constr=uint32}, symbol=EvConf3
            EVENT_RAM_MEM_CORRUPT: symbol=[7]
              mc data instance EvConf1: category=STRUCTURE
                mc data instance DemUdsDTC: category=VALUE, resulting-properties={base-type=uint32, sw-bit-representation={bit-position=0, number-of-bits=24}, sw-calibration-access=READ-WRITE, data-constr=uint32}, symbol=EvConf1  # UDS DTC value of the current event (special value: 0 means DTC off) - If re-calibration is performed during Dcm service request processing, the Dem may return still with the DTC, although the DTC is switched off already until a request for a different DTC. For service 0x19, if the DTC is identified by the algorithm the value of the DTC will be returned. In case calibration occurs with DTC off and the service is called again, the DTC being identified by the algorithm , the DTC returned by the service is DEM_NO_DTC.
                mc data instance DemDTCSeverity: category=VALUE, resulting-properties={base-type=uint32, sw-bit-representation={bit-position=26, number-of-bits=2}, sw-calibration-access=READ-WRITE, data-constr=uint32}, symbol=EvConf1  # Internal representation: '0' == 'DEM_DTC_SEV_NO_SEVERITY' - '1' == 'DEM_DTC_SEV_MAINTENANCE_ONLY'- '2' == 'DEM_DTC_SEV_CHECK_AT_NEXT_HALT'- '3' == 'DEM_DTC_SEV_IMMEDIATELY'
              mc data instance EvConf2: category=STRUCTURE
                mc data instance FFClassIdx: category=VALUE, resulting-properties={base-type=uint32, sw-bit-representation={bit-position=1, number-of-bits=2}, sw-calibration-access=READ-WRITE, data-constr=uint32}, symbol=EvConf2  # Index of used Freeze Frame class
                mc data instance DemAgingCycleCounterThreshold: category=VALUE, resulting-properties={base-type=uint32, sw-bit-representation={bit-position=6, number-of-bits=1}, sw-calibration-access=READ-WRITE, data-constr=uint32}, symbol=EvConf2  # Aging of an event can be disabled by setting DemAgingCycleCounterThreshold to 0 - If the threshold will be re-calibrated the effect will be considered at the next processing and not during initialization.
              mc data instance EvConf3: category=STRUCTURE
                mc data instance DemDebounceCounterBased: category=VALUE, resulting-properties={base-type=uint32, sw-bit-representation={bit-position=5, number-of-bits=5}, sw-calibration-access=READ-WRITE, data-constr=uint32}, symbol=EvConf3
                mc data instance DemDTCFunctionalUnit: category=VALUE, resulting-properties={base-type=uint32, sw-bit-representation={bit-position=10, number-of-bits=1}, sw-calibration-access=READ-WRITE, data-constr=uint32}, symbol=EvConf3
            EVENT_ADC_CALIB: symbol=[8]
              mc data instance EvConf1: category=STRUCTURE
                mc data instance DemUdsDTC: category=VALUE, resulting-properties={base-type=uint32, sw-bit-representation={bit-position=0, number-of-bits=24}, sw-calibration-access=READ-WRITE, data-constr=uint32}, symbol=EvConf1  # UDS DTC value of the current event (special value: 0 means DTC off) - If re-calibration is performed during Dcm service request processing, the Dem may return still with the DTC, although the DTC is switched off already until a request for a different DTC. For service 0x19, if the DTC is identified by the algorithm the value of the DTC will be returned. In case calibration occurs with DTC off and the service is called again, the DTC being identified by the algorithm , the DTC returned by the service is DEM_NO_DTC.
                mc data instance DemDTCSeverity: category=VALUE, resulting-properties={base-type=uint32, sw-bit-representation={bit-position=26, number-of-bits=2}, sw-calibration-access=READ-WRITE, data-constr=uint32}, symbol=EvConf1  # Internal representation: '0' == 'DEM_DTC_SEV_NO_SEVERITY' - '1' == 'DEM_DTC_SEV_MAINTENANCE_ONLY'- '2' == 'DEM_DTC_SEV_CHECK_AT_NEXT_HALT'- '3' == 'DEM_DTC_SEV_IMMEDIATELY'
              mc data instance EvConf2: category=STRUCTURE
                mc data instance FFClassIdx: category=VALUE, resulting-properties={base-type=uint32, sw-bit-representation={bit-position=1, number-of-bits=2}, sw-calibration-access=READ-WRITE, data-constr=uint32}, symbol=EvConf2  # Index of used Freeze Frame class
                mc data instance DemAgingCycleCounterThreshold: category=VALUE, resulting-properties={base-type=uint32, sw-bit-representation={bit-position=6, number-of-bits=1}, sw-calibration-access=READ-WRITE, data-constr=uint32}, symbol=EvConf2  # Aging of an event can be disabled by setting DemAgingCycleCounterThreshold to 0 - If the threshold will be re-calibrated the effect will be considered at the next processing and not during initialization.
              mc data instance EvConf3: category=STRUCTURE
                mc data instance DemDebounceCounterBased: category=VALUE, resulting-properties={base-type=uint32, sw-bit-representation={bit-position=5, number-of-bits=5}, sw-calibration-access=READ-WRITE, data-constr=uint32}, symbol=EvConf3
                mc data instance DemDTCFunctionalUnit: category=VALUE, resulting-properties={base-type=uint32, sw-bit-representation={bit-position=10, number-of-bits=1}, sw-calibration-access=READ-WRITE, data-constr=uint32}, symbol=EvConf3
            EVENT_ECU_OVER_TEMPERATURE: symbol=[9]
              mc data instance EvConf1: category=STRUCTURE
                mc data instance DemUdsDTC: category=VALUE, resulting-properties={base-type=uint32, sw-bit-representation={bit-position=0, number-of-bits=24}, sw-calibration-access=READ-WRITE, data-constr=uint32}, symbol=EvConf1  # UDS DTC value of the current event (special value: 0 means DTC off) - If re-calibration is performed during Dcm service request processing, the Dem may return still with the DTC, although the DTC is switched off already until a request for a different DTC. For service 0x19, if the DTC is identified by the algorithm the value of the DTC will be returned. In case calibration occurs with DTC off and the service is called again, the DTC being identified by the algorithm , the DTC returned by the service is DEM_NO_DTC.
                mc data instance DemDTCSeverity: category=VALUE, resulting-properties={base-type=uint32, sw-bit-representation={bit-position=26, number-of-bits=2}, sw-calibration-access=READ-WRITE, data-constr=uint32}, symbol=EvConf1  # Internal representation: '0' == 'DEM_DTC_SEV_NO_SEVERITY' - '1' == 'DEM_DTC_SEV_MAINTENANCE_ONLY'- '2' == 'DEM_DTC_SEV_CHECK_AT_NEXT_HALT'- '3' == 'DEM_DTC_SEV_IMMEDIATELY'
              mc data instance EvConf2: category=STRUCTURE
                mc data instance FFClassIdx: category=VALUE, resulting-properties={base-type=uint32, sw-bit-representation={bit-position=1, number-of-bits=2}, sw-calibration-access=READ-WRITE, data-constr=uint32}, symbol=EvConf2  # Index of used Freeze Frame class
                mc data instance DemAgingCycleCounterThreshold: category=VALUE, resulting-properties={base-type=uint32, sw-bit-representation={bit-position=6, number-of-bits=1}, sw-calibration-access=READ-WRITE, data-constr=uint32}, symbol=EvConf2  # Aging of an event can be disabled by setting DemAgingCycleCounterThreshold to 0 - If the threshold will be re-calibrated the effect will be considered at the next processing and not during initialization.
              mc data instance EvConf3: category=STRUCTURE
                mc data instance DemDebounceCounterBased: category=VALUE, resulting-properties={base-type=uint32, sw-bit-representation={bit-position=5, number-of-bits=5}, sw-calibration-access=READ-WRITE, data-constr=uint32}, symbol=EvConf3
                mc data instance DemDTCFunctionalUnit: category=VALUE, resulting-properties={base-type=uint32, sw-bit-representation={bit-position=10, number-of-bits=1}, sw-calibration-access=READ-WRITE, data-constr=uint32}, symbol=EvConf3
            EVENT_DFLASH_MEM_CORRUPT: symbol=[10]
              mc data instance EvConf1: category=STRUCTURE
                mc data instance DemUdsDTC: category=VALUE, resulting-properties={base-type=uint32, sw-bit-representation={bit-position=0, number-of-bits=24}, sw-calibration-access=READ-WRITE, data-constr=uint32}, symbol=EvConf1  # UDS DTC value of the current event (special value: 0 means DTC off) - If re-calibration is performed during Dcm service request processing, the Dem may return still with the DTC, although the DTC is switched off already until a request for a different DTC. For service 0x19, if the DTC is identified by the algorithm the value of the DTC will be returned. In case calibration occurs with DTC off and the service is called again, the DTC being identified by the algorithm , the DTC returned by the service is DEM_NO_DTC.
                mc data instance DemDTCSeverity: category=VALUE, resulting-properties={base-type=uint32, sw-bit-representation={bit-position=26, number-of-bits=2}, sw-calibration-access=READ-WRITE, data-constr=uint32}, symbol=EvConf1  # Internal representation: '0' == 'DEM_DTC_SEV_NO_SEVERITY' - '1' == 'DEM_DTC_SEV_MAINTENANCE_ONLY'- '2' == 'DEM_DTC_SEV_CHECK_AT_NEXT_HALT'- '3' == 'DEM_DTC_SEV_IMMEDIATELY'
              mc data instance EvConf2: category=STRUCTURE
                mc data instance FFClassIdx: category=VALUE, resulting-properties={base-type=uint32, sw-bit-representation={bit-position=1, number-of-bits=2}, sw-calibration-access=READ-WRITE, data-constr=uint32}, symbol=EvConf2  # Index of used Freeze Frame class
                mc data instance DemAgingCycleCounterThreshold: category=VALUE, resulting-properties={base-type=uint32, sw-bit-representation={bit-position=6, number-of-bits=1}, sw-calibration-access=READ-WRITE, data-constr=uint32}, symbol=EvConf2  # Aging of an event can be disabled by setting DemAgingCycleCounterThreshold to 0 - If the threshold will be re-calibrated the effect will be considered at the next processing and not during initialization.
              mc data instance EvConf3: category=STRUCTURE
                mc data instance DemDebounceCounterBased: category=VALUE, resulting-properties={base-type=uint32, sw-bit-representation={bit-position=5, number-of-bits=5}, sw-calibration-access=READ-WRITE, data-constr=uint32}, symbol=EvConf3
                mc data instance DemDTCFunctionalUnit: category=VALUE, resulting-properties={base-type=uint32, sw-bit-representation={bit-position=10, number-of-bits=1}, sw-calibration-access=READ-WRITE, data-constr=uint32}, symbol=EvConf3
            EVENT_SBC_STATUS_FAILURE: symbol=[11]
              mc data instance EvConf1: category=STRUCTURE
                mc data instance DemUdsDTC: category=VALUE, resulting-properties={base-type=uint32, sw-bit-representation={bit-position=0, number-of-bits=24}, sw-calibration-access=READ-WRITE, data-constr=uint32}, symbol=EvConf1  # UDS DTC value of the current event (special value: 0 means DTC off) - If re-calibration is performed during Dcm service request processing, the Dem may return still with the DTC, although the DTC is switched off already until a request for a different DTC. For service 0x19, if the DTC is identified by the algorithm the value of the DTC will be returned. In case calibration occurs with DTC off and the service is called again, the DTC being identified by the algorithm , the DTC returned by the service is DEM_NO_DTC.
                mc data instance DemDTCSeverity: category=VALUE, resulting-properties={base-type=uint32, sw-bit-representation={bit-position=26, number-of-bits=2}, sw-calibration-access=READ-WRITE, data-constr=uint32}, symbol=EvConf1  # Internal representation: '0' == 'DEM_DTC_SEV_NO_SEVERITY' - '1' == 'DEM_DTC_SEV_MAINTENANCE_ONLY'- '2' == 'DEM_DTC_SEV_CHECK_AT_NEXT_HALT'- '3' == 'DEM_DTC_SEV_IMMEDIATELY'
              mc data instance EvConf2: category=STRUCTURE
                mc data instance FFClassIdx: category=VALUE, resulting-properties={base-type=uint32, sw-bit-representation={bit-position=1, number-of-bits=2}, sw-calibration-access=READ-WRITE, data-constr=uint32}, symbol=EvConf2  # Index of used Freeze Frame class
                mc data instance DemAgingCycleCounterThreshold: category=VALUE, resulting-properties={base-type=uint32, sw-bit-representation={bit-position=6, number-of-bits=1}, sw-calibration-access=READ-WRITE, data-constr=uint32}, symbol=EvConf2  # Aging of an event can be disabled by setting DemAgingCycleCounterThreshold to 0 - If the threshold will be re-calibrated the effect will be considered at the next processing and not during initialization.
              mc data instance EvConf3: category=STRUCTURE
                mc data instance DemDebounceCounterBased: category=VALUE, resulting-properties={base-type=uint32, sw-bit-representation={bit-position=5, number-of-bits=5}, sw-calibration-access=READ-WRITE, data-constr=uint32}, symbol=EvConf3
                mc data instance DemDTCFunctionalUnit: category=VALUE, resulting-properties={base-type=uint32, sw-bit-representation={bit-position=10, number-of-bits=1}, sw-calibration-access=READ-WRITE, data-constr=uint32}, symbol=EvConf3
            EVENT_POWER_SUPPLY_OV: symbol=[12]
              mc data instance EvConf1: category=STRUCTURE
                mc data instance DemUdsDTC: category=VALUE, resulting-properties={base-type=uint32, sw-bit-representation={bit-position=0, number-of-bits=24}, sw-calibration-access=READ-WRITE, data-constr=uint32}, symbol=EvConf1  # UDS DTC value of the current event (special value: 0 means DTC off) - If re-calibration is performed during Dcm service request processing, the Dem may return still with the DTC, although the DTC is switched off already until a request for a different DTC. For service 0x19, if the DTC is identified by the algorithm the value of the DTC will be returned. In case calibration occurs with DTC off and the service is called again, the DTC being identified by the algorithm , the DTC returned by the service is DEM_NO_DTC.
                mc data instance DemDTCSeverity: category=VALUE, resulting-properties={base-type=uint32, sw-bit-representation={bit-position=26, number-of-bits=2}, sw-calibration-access=READ-WRITE, data-constr=uint32}, symbol=EvConf1  # Internal representation: '0' == 'DEM_DTC_SEV_NO_SEVERITY' - '1' == 'DEM_DTC_SEV_MAINTENANCE_ONLY'- '2' == 'DEM_DTC_SEV_CHECK_AT_NEXT_HALT'- '3' == 'DEM_DTC_SEV_IMMEDIATELY'
              mc data instance EvConf2: category=STRUCTURE
                mc data instance FFClassIdx: category=VALUE, resulting-properties={base-type=uint32, sw-bit-representation={bit-position=1, number-of-bits=2}, sw-calibration-access=READ-WRITE, data-constr=uint32}, symbol=EvConf2  # Index of used Freeze Frame class
                mc data instance DemAgingCycleCounterThreshold: category=VALUE, resulting-properties={base-type=uint32, sw-bit-representation={bit-position=6, number-of-bits=1}, sw-calibration-access=READ-WRITE, data-constr=uint32}, symbol=EvConf2  # Aging of an event can be disabled by setting DemAgingCycleCounterThreshold to 0 - If the threshold will be re-calibrated the effect will be considered at the next processing and not during initialization.
              mc data instance EvConf3: category=STRUCTURE
                mc data instance DemDebounceCounterBased: category=VALUE, resulting-properties={base-type=uint32, sw-bit-representation={bit-position=5, number-of-bits=5}, sw-calibration-access=READ-WRITE, data-constr=uint32}, symbol=EvConf3
                mc data instance DemDTCFunctionalUnit: category=VALUE, resulting-properties={base-type=uint32, sw-bit-representation={bit-position=10, number-of-bits=1}, sw-calibration-access=READ-WRITE, data-constr=uint32}, symbol=EvConf3
            EVENT_POWER_SUPPLY_UV: symbol=[13]
              mc data instance EvConf1: category=STRUCTURE
                mc data instance DemUdsDTC: category=VALUE, resulting-properties={base-type=uint32, sw-bit-representation={bit-position=0, number-of-bits=24}, sw-calibration-access=READ-WRITE, data-constr=uint32}, symbol=EvConf1  # UDS DTC value of the current event (special value: 0 means DTC off) - If re-calibration is performed during Dcm service request processing, the Dem may return still with the DTC, although the DTC is switched off already until a request for a different DTC. For service 0x19, if the DTC is identified by the algorithm the value of the DTC will be returned. In case calibration occurs with DTC off and the service is called again, the DTC being identified by the algorithm , the DTC returned by the service is DEM_NO_DTC.
                mc data instance DemDTCSeverity: category=VALUE, resulting-properties={base-type=uint32, sw-bit-representation={bit-position=26, number-of-bits=2}, sw-calibration-access=READ-WRITE, data-constr=uint32}, symbol=EvConf1  # Internal representation: '0' == 'DEM_DTC_SEV_NO_SEVERITY' - '1' == 'DEM_DTC_SEV_MAINTENANCE_ONLY'- '2' == 'DEM_DTC_SEV_CHECK_AT_NEXT_HALT'- '3' == 'DEM_DTC_SEV_IMMEDIATELY'
              mc data instance EvConf2: category=STRUCTURE
                mc data instance FFClassIdx: category=VALUE, resulting-properties={base-type=uint32, sw-bit-representation={bit-position=1, number-of-bits=2}, sw-calibration-access=READ-WRITE, data-constr=uint32}, symbol=EvConf2  # Index of used Freeze Frame class
                mc data instance DemAgingCycleCounterThreshold: category=VALUE, resulting-properties={base-type=uint32, sw-bit-representation={bit-position=6, number-of-bits=1}, sw-calibration-access=READ-WRITE, data-constr=uint32}, symbol=EvConf2  # Aging of an event can be disabled by setting DemAgingCycleCounterThreshold to 0 - If the threshold will be re-calibrated the effect will be considered at the next processing and not during initialization.
              mc data instance EvConf3: category=STRUCTURE
                mc data instance DemDebounceCounterBased: category=VALUE, resulting-properties={base-type=uint32, sw-bit-representation={bit-position=5, number-of-bits=5}, sw-calibration-access=READ-WRITE, data-constr=uint32}, symbol=EvConf3
                mc data instance DemDTCFunctionalUnit: category=VALUE, resulting-properties={base-type=uint32, sw-bit-representation={bit-position=10, number-of-bits=1}, sw-calibration-access=READ-WRITE, data-constr=uint32}, symbol=EvConf3
            EVENT_ACTUATOR_STATUS: symbol=[14]
              mc data instance EvConf1: category=STRUCTURE
                mc data instance DemUdsDTC: category=VALUE, resulting-properties={base-type=uint32, sw-bit-representation={bit-position=0, number-of-bits=24}, sw-calibration-access=READ-WRITE, data-constr=uint32}, symbol=EvConf1  # UDS DTC value of the current event (special value: 0 means DTC off) - If re-calibration is performed during Dcm service request processing, the Dem may return still with the DTC, although the DTC is switched off already until a request for a different DTC. For service 0x19, if the DTC is identified by the algorithm the value of the DTC will be returned. In case calibration occurs with DTC off and the service is called again, the DTC being identified by the algorithm , the DTC returned by the service is DEM_NO_DTC.
                mc data instance DemDTCSeverity: category=VALUE, resulting-properties={base-type=uint32, sw-bit-representation={bit-position=26, number-of-bits=2}, sw-calibration-access=READ-WRITE, data-constr=uint32}, symbol=EvConf1  # Internal representation: '0' == 'DEM_DTC_SEV_NO_SEVERITY' - '1' == 'DEM_DTC_SEV_MAINTENANCE_ONLY'- '2' == 'DEM_DTC_SEV_CHECK_AT_NEXT_HALT'- '3' == 'DEM_DTC_SEV_IMMEDIATELY'
              mc data instance EvConf2: category=STRUCTURE
                mc data instance FFClassIdx: category=VALUE, resulting-properties={base-type=uint32, sw-bit-representation={bit-position=1, number-of-bits=2}, sw-calibration-access=READ-WRITE, data-constr=uint32}, symbol=EvConf2  # Index of used Freeze Frame class
                mc data instance DemAgingCycleCounterThreshold: category=VALUE, resulting-properties={base-type=uint32, sw-bit-representation={bit-position=6, number-of-bits=1}, sw-calibration-access=READ-WRITE, data-constr=uint32}, symbol=EvConf2  # Aging of an event can be disabled by setting DemAgingCycleCounterThreshold to 0 - If the threshold will be re-calibrated the effect will be considered at the next processing and not during initialization.
              mc data instance EvConf3: category=STRUCTURE
                mc data instance DemDebounceCounterBased: category=VALUE, resulting-properties={base-type=uint32, sw-bit-representation={bit-position=5, number-of-bits=5}, sw-calibration-access=READ-WRITE, data-constr=uint32}, symbol=EvConf3
                mc data instance DemDTCFunctionalUnit: category=VALUE, resulting-properties={base-type=uint32, sw-bit-representation={bit-position=10, number-of-bits=1}, sw-calibration-access=READ-WRITE, data-constr=uint32}, symbol=EvConf3
            EVENT_MCU_SELFTEST: symbol=[15]
              mc data instance EvConf1: category=STRUCTURE
                mc data instance DemUdsDTC: category=VALUE, resulting-properties={base-type=uint32, sw-bit-representation={bit-position=0, number-of-bits=24}, sw-calibration-access=READ-WRITE, data-constr=uint32}, symbol=EvConf1  # UDS DTC value of the current event (special value: 0 means DTC off) - If re-calibration is performed during Dcm service request processing, the Dem may return still with the DTC, although the DTC is switched off already until a request for a different DTC. For service 0x19, if the DTC is identified by the algorithm the value of the DTC will be returned. In case calibration occurs with DTC off and the service is called again, the DTC being identified by the algorithm , the DTC returned by the service is DEM_NO_DTC.
                mc data instance DemDTCSeverity: category=VALUE, resulting-properties={base-type=uint32, sw-bit-representation={bit-position=26, number-of-bits=2}, sw-calibration-access=READ-WRITE, data-constr=uint32}, symbol=EvConf1  # Internal representation: '0' == 'DEM_DTC_SEV_NO_SEVERITY' - '1' == 'DEM_DTC_SEV_MAINTENANCE_ONLY'- '2' == 'DEM_DTC_SEV_CHECK_AT_NEXT_HALT'- '3' == 'DEM_DTC_SEV_IMMEDIATELY'
              mc data instance EvConf2: category=STRUCTURE
                mc data instance FFClassIdx: category=VALUE, resulting-properties={base-type=uint32, sw-bit-representation={bit-position=1, number-of-bits=2}, sw-calibration-access=READ-WRITE, data-constr=uint32}, symbol=EvConf2  # Index of used Freeze Frame class
                mc data instance DemAgingCycleCounterThreshold: category=VALUE, resulting-properties={base-type=uint32, sw-bit-representation={bit-position=6, number-of-bits=1}, sw-calibration-access=READ-WRITE, data-constr=uint32}, symbol=EvConf2  # Aging of an event can be disabled by setting DemAgingCycleCounterThreshold to 0 - If the threshold will be re-calibrated the effect will be considered at the next processing and not during initialization.
              mc data instance EvConf3: category=STRUCTURE
                mc data instance DemDebounceCounterBased: category=VALUE, resulting-properties={base-type=uint32, sw-bit-representation={bit-position=5, number-of-bits=5}, sw-calibration-access=READ-WRITE, data-constr=uint32}, symbol=EvConf3
                mc data instance DemDTCFunctionalUnit: category=VALUE, resulting-properties={base-type=uint32, sw-bit-representation={bit-position=10, number-of-bits=1}, sw-calibration-access=READ-WRITE, data-constr=uint32}, symbol=EvConf3
            EVENT_ACTUATOR_OPEN_CIRCUIT: symbol=[16]
              mc data instance EvConf1: category=STRUCTURE
                mc data instance DemUdsDTC: category=VALUE, resulting-properties={base-type=uint32, sw-bit-representation={bit-position=0, number-of-bits=24}, sw-calibration-access=READ-WRITE, data-constr=uint32}, symbol=EvConf1  # UDS DTC value of the current event (special value: 0 means DTC off) - If re-calibration is performed during Dcm service request processing, the Dem may return still with the DTC, although the DTC is switched off already until a request for a different DTC. For service 0x19, if the DTC is identified by the algorithm the value of the DTC will be returned. In case calibration occurs with DTC off and the service is called again, the DTC being identified by the algorithm , the DTC returned by the service is DEM_NO_DTC.
                mc data instance DemDTCSeverity: category=VALUE, resulting-properties={base-type=uint32, sw-bit-representation={bit-position=26, number-of-bits=2}, sw-calibration-access=READ-WRITE, data-constr=uint32}, symbol=EvConf1  # Internal representation: '0' == 'DEM_DTC_SEV_NO_SEVERITY' - '1' == 'DEM_DTC_SEV_MAINTENANCE_ONLY'- '2' == 'DEM_DTC_SEV_CHECK_AT_NEXT_HALT'- '3' == 'DEM_DTC_SEV_IMMEDIATELY'
              mc data instance EvConf2: category=STRUCTURE
                mc data instance FFClassIdx: category=VALUE, resulting-properties={base-type=uint32, sw-bit-representation={bit-position=1, number-of-bits=2}, sw-calibration-access=READ-WRITE, data-constr=uint32}, symbol=EvConf2  # Index of used Freeze Frame class
                mc data instance DemAgingCycleCounterThreshold: category=VALUE, resulting-properties={base-type=uint32, sw-bit-representation={bit-position=6, number-of-bits=1}, sw-calibration-access=READ-WRITE, data-constr=uint32}, symbol=EvConf2  # Aging of an event can be disabled by setting DemAgingCycleCounterThreshold to 0 - If the threshold will be re-calibrated the effect will be considered at the next processing and not during initialization.
              mc data instance EvConf3: category=STRUCTURE
                mc data instance DemDebounceCounterBased: category=VALUE, resulting-properties={base-type=uint32, sw-bit-representation={bit-position=5, number-of-bits=5}, sw-calibration-access=READ-WRITE, data-constr=uint32}, symbol=EvConf3
                mc data instance DemDTCFunctionalUnit: category=VALUE, resulting-properties={base-type=uint32, sw-bit-representation={bit-position=10, number-of-bits=1}, sw-calibration-access=READ-WRITE, data-constr=uint32}, symbol=EvConf3
            EVENT_ACTUATOR_SHORT_TO_GND: symbol=[17]
              mc data instance EvConf1: category=STRUCTURE
                mc data instance DemUdsDTC: category=VALUE, resulting-properties={base-type=uint32, sw-bit-representation={bit-position=0, number-of-bits=24}, sw-calibration-access=READ-WRITE, data-constr=uint32}, symbol=EvConf1  # UDS DTC value of the current event (special value: 0 means DTC off) - If re-calibration is performed during Dcm service request processing, the Dem may return still with the DTC, although the DTC is switched off already until a request for a different DTC. For service 0x19, if the DTC is identified by the algorithm the value of the DTC will be returned. In case calibration occurs with DTC off and the service is called again, the DTC being identified by the algorithm , the DTC returned by the service is DEM_NO_DTC.
                mc data instance DemDTCSeverity: category=VALUE, resulting-properties={base-type=uint32, sw-bit-representation={bit-position=26, number-of-bits=2}, sw-calibration-access=READ-WRITE, data-constr=uint32}, symbol=EvConf1  # Internal representation: '0' == 'DEM_DTC_SEV_NO_SEVERITY' - '1' == 'DEM_DTC_SEV_MAINTENANCE_ONLY'- '2' == 'DEM_DTC_SEV_CHECK_AT_NEXT_HALT'- '3' == 'DEM_DTC_SEV_IMMEDIATELY'
              mc data instance EvConf2: category=STRUCTURE
                mc data instance FFClassIdx: category=VALUE, resulting-properties={base-type=uint32, sw-bit-representation={bit-position=1, number-of-bits=2}, sw-calibration-access=READ-WRITE, data-constr=uint32}, symbol=EvConf2  # Index of used Freeze Frame class
                mc data instance DemAgingCycleCounterThreshold: category=VALUE, resulting-properties={base-type=uint32, sw-bit-representation={bit-position=6, number-of-bits=1}, sw-calibration-access=READ-WRITE, data-constr=uint32}, symbol=EvConf2  # Aging of an event can be disabled by setting DemAgingCycleCounterThreshold to 0 - If the threshold will be re-calibrated the effect will be considered at the next processing and not during initialization.
              mc data instance EvConf3: category=STRUCTURE
                mc data instance DemDebounceCounterBased: category=VALUE, resulting-properties={base-type=uint32, sw-bit-representation={bit-position=5, number-of-bits=5}, sw-calibration-access=READ-WRITE, data-constr=uint32}, symbol=EvConf3
                mc data instance DemDTCFunctionalUnit: category=VALUE, resulting-properties={base-type=uint32, sw-bit-representation={bit-position=10, number-of-bits=1}, sw-calibration-access=READ-WRITE, data-constr=uint32}, symbol=EvConf3
            EVENT_ACTUATOR_SHORT_TO_VBAT: symbol=[18]
              mc data instance EvConf1: category=STRUCTURE
                mc data instance DemUdsDTC: category=VALUE, resulting-properties={base-type=uint32, sw-bit-representation={bit-position=0, number-of-bits=24}, sw-calibration-access=READ-WRITE, data-constr=uint32}, symbol=EvConf1  # UDS DTC value of the current event (special value: 0 means DTC off) - If re-calibration is performed during Dcm service request processing, the Dem may return still with the DTC, although the DTC is switched off already until a request for a different DTC. For service 0x19, if the DTC is identified by the algorithm the value of the DTC will be returned. In case calibration occurs with DTC off and the service is called again, the DTC being identified by the algorithm , the DTC returned by the service is DEM_NO_DTC.
                mc data instance DemDTCSeverity: category=VALUE, resulting-properties={base-type=uint32, sw-bit-representation={bit-position=26, number-of-bits=2}, sw-calibration-access=READ-WRITE, data-constr=uint32}, symbol=EvConf1  # Internal representation: '0' == 'DEM_DTC_SEV_NO_SEVERITY' - '1' == 'DEM_DTC_SEV_MAINTENANCE_ONLY'- '2' == 'DEM_DTC_SEV_CHECK_AT_NEXT_HALT'- '3' == 'DEM_DTC_SEV_IMMEDIATELY'
              mc data instance EvConf2: category=STRUCTURE
                mc data instance FFClassIdx: category=VALUE, resulting-properties={base-type=uint32, sw-bit-representation={bit-position=1, number-of-bits=2}, sw-calibration-access=READ-WRITE, data-constr=uint32}, symbol=EvConf2  # Index of used Freeze Frame class
                mc data instance DemAgingCycleCounterThreshold: category=VALUE, resulting-properties={base-type=uint32, sw-bit-representation={bit-position=6, number-of-bits=1}, sw-calibration-access=READ-WRITE, data-constr=uint32}, symbol=EvConf2  # Aging of an event can be disabled by setting DemAgingCycleCounterThreshold to 0 - If the threshold will be re-calibrated the effect will be considered at the next processing and not during initialization.
              mc data instance EvConf3: category=STRUCTURE
                mc data instance DemDebounceCounterBased: category=VALUE, resulting-properties={base-type=uint32, sw-bit-representation={bit-position=5, number-of-bits=5}, sw-calibration-access=READ-WRITE, data-constr=uint32}, symbol=EvConf3
                mc data instance DemDTCFunctionalUnit: category=VALUE, resulting-properties={base-type=uint32, sw-bit-representation={bit-position=10, number-of-bits=1}, sw-calibration-access=READ-WRITE, data-constr=uint32}, symbol=EvConf3
            EVENT_ACC_STATUS_FAILURE: symbol=[19]
              mc data instance EvConf1: category=STRUCTURE
                mc data instance DemUdsDTC: category=VALUE, resulting-properties={base-type=uint32, sw-bit-representation={bit-position=0, number-of-bits=24}, sw-calibration-access=READ-WRITE, data-constr=uint32}, symbol=EvConf1  # UDS DTC value of the current event (special value: 0 means DTC off) - If re-calibration is performed during Dcm service request processing, the Dem may return still with the DTC, although the DTC is switched off already until a request for a different DTC. For service 0x19, if the DTC is identified by the algorithm the value of the DTC will be returned. In case calibration occurs with DTC off and the service is called again, the DTC being identified by the algorithm , the DTC returned by the service is DEM_NO_DTC.
                mc data instance DemDTCSeverity: category=VALUE, resulting-properties={base-type=uint32, sw-bit-representation={bit-position=26, number-of-bits=2}, sw-calibration-access=READ-WRITE, data-constr=uint32}, symbol=EvConf1  # Internal representation: '0' == 'DEM_DTC_SEV_NO_SEVERITY' - '1' == 'DEM_DTC_SEV_MAINTENANCE_ONLY'- '2' == 'DEM_DTC_SEV_CHECK_AT_NEXT_HALT'- '3' == 'DEM_DTC_SEV_IMMEDIATELY'
              mc data instance EvConf2: category=STRUCTURE
                mc data instance FFClassIdx: category=VALUE, resulting-properties={base-type=uint32, sw-bit-representation={bit-position=1, number-of-bits=2}, sw-calibration-access=READ-WRITE, data-constr=uint32}, symbol=EvConf2  # Index of used Freeze Frame class
                mc data instance DemAgingCycleCounterThreshold: category=VALUE, resulting-properties={base-type=uint32, sw-bit-representation={bit-position=6, number-of-bits=1}, sw-calibration-access=READ-WRITE, data-constr=uint32}, symbol=EvConf2  # Aging of an event can be disabled by setting DemAgingCycleCounterThreshold to 0 - If the threshold will be re-calibrated the effect will be considered at the next processing and not during initialization.
              mc data instance EvConf3: category=STRUCTURE
                mc data instance DemDebounceCounterBased: category=VALUE, resulting-properties={base-type=uint32, sw-bit-representation={bit-position=5, number-of-bits=5}, sw-calibration-access=READ-WRITE, data-constr=uint32}, symbol=EvConf3
                mc data instance DemDTCFunctionalUnit: category=VALUE, resulting-properties={base-type=uint32, sw-bit-representation={bit-position=10, number-of-bits=1}, sw-calibration-access=READ-WRITE, data-constr=uint32}, symbol=EvConf3
            EVENT_SPI_E_HW_ERROR: symbol=[20]
              mc data instance EvConf1: category=STRUCTURE
                mc data instance DemUdsDTC: category=VALUE, resulting-properties={base-type=uint32, sw-bit-representation={bit-position=0, number-of-bits=24}, sw-calibration-access=READ-WRITE, data-constr=uint32}, symbol=EvConf1  # UDS DTC value of the current event (special value: 0 means DTC off) - If re-calibration is performed during Dcm service request processing, the Dem may return still with the DTC, although the DTC is switched off already until a request for a different DTC. For service 0x19, if the DTC is identified by the algorithm the value of the DTC will be returned. In case calibration occurs with DTC off and the service is called again, the DTC being identified by the algorithm , the DTC returned by the service is DEM_NO_DTC.
                mc data instance DemDTCSeverity: category=VALUE, resulting-properties={base-type=uint32, sw-bit-representation={bit-position=26, number-of-bits=2}, sw-calibration-access=READ-WRITE, data-constr=uint32}, symbol=EvConf1  # Internal representation: '0' == 'DEM_DTC_SEV_NO_SEVERITY' - '1' == 'DEM_DTC_SEV_MAINTENANCE_ONLY'- '2' == 'DEM_DTC_SEV_CHECK_AT_NEXT_HALT'- '3' == 'DEM_DTC_SEV_IMMEDIATELY'
              mc data instance EvConf2: category=STRUCTURE
                mc data instance FFClassIdx: category=VALUE, resulting-properties={base-type=uint32, sw-bit-representation={bit-position=1, number-of-bits=2}, sw-calibration-access=READ-WRITE, data-constr=uint32}, symbol=EvConf2  # Index of used Freeze Frame class
                mc data instance DemAgingCycleCounterThreshold: category=VALUE, resulting-properties={base-type=uint32, sw-bit-representation={bit-position=6, number-of-bits=1}, sw-calibration-access=READ-WRITE, data-constr=uint32}, symbol=EvConf2  # Aging of an event can be disabled by setting DemAgingCycleCounterThreshold to 0 - If the threshold will be re-calibrated the effect will be considered at the next processing and not during initialization.
              mc data instance EvConf3: category=STRUCTURE
                mc data instance DemDebounceCounterBased: category=VALUE, resulting-properties={base-type=uint32, sw-bit-representation={bit-position=5, number-of-bits=5}, sw-calibration-access=READ-WRITE, data-constr=uint32}, symbol=EvConf3
                mc data instance DemDTCFunctionalUnit: category=VALUE, resulting-properties={base-type=uint32, sw-bit-representation={bit-position=10, number-of-bits=1}, sw-calibration-access=READ-WRITE, data-constr=uint32}, symbol=EvConf3
            EVENT_SOLENOID_OVERVOLTAGE: symbol=[21]
              mc data instance EvConf1: category=STRUCTURE
                mc data instance DemUdsDTC: category=VALUE, resulting-properties={base-type=uint32, sw-bit-representation={bit-position=0, number-of-bits=24}, sw-calibration-access=READ-WRITE, data-constr=uint32}, symbol=EvConf1  # UDS DTC value of the current event (special value: 0 means DTC off) - If re-calibration is performed during Dcm service request processing, the Dem may return still with the DTC, although the DTC is switched off already until a request for a different DTC. For service 0x19, if the DTC is identified by the algorithm the value of the DTC will be returned. In case calibration occurs with DTC off and the service is called again, the DTC being identified by the algorithm , the DTC returned by the service is DEM_NO_DTC.
                mc data instance DemDTCSeverity: category=VALUE, resulting-properties={base-type=uint32, sw-bit-representation={bit-position=26, number-of-bits=2}, sw-calibration-access=READ-WRITE, data-constr=uint32}, symbol=EvConf1  # Internal representation: '0' == 'DEM_DTC_SEV_NO_SEVERITY' - '1' == 'DEM_DTC_SEV_MAINTENANCE_ONLY'- '2' == 'DEM_DTC_SEV_CHECK_AT_NEXT_HALT'- '3' == 'DEM_DTC_SEV_IMMEDIATELY'
              mc data instance EvConf2: category=STRUCTURE
                mc data instance FFClassIdx: category=VALUE, resulting-properties={base-type=uint32, sw-bit-representation={bit-position=1, number-of-bits=2}, sw-calibration-access=READ-WRITE, data-constr=uint32}, symbol=EvConf2  # Index of used Freeze Frame class
                mc data instance DemAgingCycleCounterThreshold: category=VALUE, resulting-properties={base-type=uint32, sw-bit-representation={bit-position=6, number-of-bits=1}, sw-calibration-access=READ-WRITE, data-constr=uint32}, symbol=EvConf2  # Aging of an event can be disabled by setting DemAgingCycleCounterThreshold to 0 - If the threshold will be re-calibrated the effect will be considered at the next processing and not during initialization.
              mc data instance EvConf3: category=STRUCTURE
                mc data instance DemDebounceCounterBased: category=VALUE, resulting-properties={base-type=uint32, sw-bit-representation={bit-position=5, number-of-bits=5}, sw-calibration-access=READ-WRITE, data-constr=uint32}, symbol=EvConf3
                mc data instance DemDTCFunctionalUnit: category=VALUE, resulting-properties={base-type=uint32, sw-bit-representation={bit-position=10, number-of-bits=1}, sw-calibration-access=READ-WRITE, data-constr=uint32}, symbol=EvConf3
            EVENT_POWER_STAGE_FAILIURE: symbol=[22]
              mc data instance EvConf1: category=STRUCTURE
                mc data instance DemUdsDTC: category=VALUE, resulting-properties={base-type=uint32, sw-bit-representation={bit-position=0, number-of-bits=24}, sw-calibration-access=READ-WRITE, data-constr=uint32}, symbol=EvConf1  # UDS DTC value of the current event (special value: 0 means DTC off) - If re-calibration is performed during Dcm service request processing, the Dem may return still with the DTC, although the DTC is switched off already until a request for a different DTC. For service 0x19, if the DTC is identified by the algorithm the value of the DTC will be returned. In case calibration occurs with DTC off and the service is called again, the DTC being identified by the algorithm , the DTC returned by the service is DEM_NO_DTC.
                mc data instance DemDTCSeverity: category=VALUE, resulting-properties={base-type=uint32, sw-bit-representation={bit-position=26, number-of-bits=2}, sw-calibration-access=READ-WRITE, data-constr=uint32}, symbol=EvConf1  # Internal representation: '0' == 'DEM_DTC_SEV_NO_SEVERITY' - '1' == 'DEM_DTC_SEV_MAINTENANCE_ONLY'- '2' == 'DEM_DTC_SEV_CHECK_AT_NEXT_HALT'- '3' == 'DEM_DTC_SEV_IMMEDIATELY'
              mc data instance EvConf2: category=STRUCTURE
                mc data instance FFClassIdx: category=VALUE, resulting-properties={base-type=uint32, sw-bit-representation={bit-position=1, number-of-bits=2}, sw-calibration-access=READ-WRITE, data-constr=uint32}, symbol=EvConf2  # Index of used Freeze Frame class
                mc data instance DemAgingCycleCounterThreshold: category=VALUE, resulting-properties={base-type=uint32, sw-bit-representation={bit-position=6, number-of-bits=1}, sw-calibration-access=READ-WRITE, data-constr=uint32}, symbol=EvConf2  # Aging of an event can be disabled by setting DemAgingCycleCounterThreshold to 0 - If the threshold will be re-calibrated the effect will be considered at the next processing and not during initialization.
              mc data instance EvConf3: category=STRUCTURE
                mc data instance DemDebounceCounterBased: category=VALUE, resulting-properties={base-type=uint32, sw-bit-representation={bit-position=5, number-of-bits=5}, sw-calibration-access=READ-WRITE, data-constr=uint32}, symbol=EvConf3
                mc data instance DemDTCFunctionalUnit: category=VALUE, resulting-properties={base-type=uint32, sw-bit-representation={bit-position=10, number-of-bits=1}, sw-calibration-access=READ-WRITE, data-constr=uint32}, symbol=EvConf3
            EVENT_MCU_CRC_REGISTERS: symbol=[23]
              mc data instance EvConf1: category=STRUCTURE
                mc data instance DemUdsDTC: category=VALUE, resulting-properties={base-type=uint32, sw-bit-representation={bit-position=0, number-of-bits=24}, sw-calibration-access=READ-WRITE, data-constr=uint32}, symbol=EvConf1  # UDS DTC value of the current event (special value: 0 means DTC off) - If re-calibration is performed during Dcm service request processing, the Dem may return still with the DTC, although the DTC is switched off already until a request for a different DTC. For service 0x19, if the DTC is identified by the algorithm the value of the DTC will be returned. In case calibration occurs with DTC off and the service is called again, the DTC being identified by the algorithm , the DTC returned by the service is DEM_NO_DTC.
                mc data instance DemDTCSeverity: category=VALUE, resulting-properties={base-type=uint32, sw-bit-representation={bit-position=26, number-of-bits=2}, sw-calibration-access=READ-WRITE, data-constr=uint32}, symbol=EvConf1  # Internal representation: '0' == 'DEM_DTC_SEV_NO_SEVERITY' - '1' == 'DEM_DTC_SEV_MAINTENANCE_ONLY'- '2' == 'DEM_DTC_SEV_CHECK_AT_NEXT_HALT'- '3' == 'DEM_DTC_SEV_IMMEDIATELY'
              mc data instance EvConf2: category=STRUCTURE
                mc data instance FFClassIdx: category=VALUE, resulting-properties={base-type=uint32, sw-bit-representation={bit-position=1, number-of-bits=2}, sw-calibration-access=READ-WRITE, data-constr=uint32}, symbol=EvConf2  # Index of used Freeze Frame class
                mc data instance DemAgingCycleCounterThreshold: category=VALUE, resulting-properties={base-type=uint32, sw-bit-representation={bit-position=6, number-of-bits=1}, sw-calibration-access=READ-WRITE, data-constr=uint32}, symbol=EvConf2  # Aging of an event can be disabled by setting DemAgingCycleCounterThreshold to 0 - If the threshold will be re-calibrated the effect will be considered at the next processing and not during initialization.
              mc data instance EvConf3: category=STRUCTURE
                mc data instance DemDebounceCounterBased: category=VALUE, resulting-properties={base-type=uint32, sw-bit-representation={bit-position=5, number-of-bits=5}, sw-calibration-access=READ-WRITE, data-constr=uint32}, symbol=EvConf3
                mc data instance DemDTCFunctionalUnit: category=VALUE, resulting-properties={base-type=uint32, sw-bit-representation={bit-position=10, number-of-bits=1}, sw-calibration-access=READ-WRITE, data-constr=uint32}, symbol=EvConf3
        Dem_DebounceCounterClassIdx: array-size=23
          23 x mc data instance, all with category=VALUE, resulting-properties={base-type=uint8, sw-bit-representation={bit-position=0, number-of-bits=7}, sw-calibration-access=READ-WRITE, data-constr=uint8}:
            EVENT_CANSM_E_BUS_OFF: symbol=[0]  # Debounce counter based class index must be in range of 0 to 8.0.
            EVENT_ADC_OUT_OF_ORDER: symbol=[1]  # Debounce counter based class index must be in range of 0 to 8.0.
            EVENT_WARM_RESET: symbol=[2]  # Debounce counter based class index must be in range of 0 to 8.0.
            EVENT_PFLASH_MEM_CORRUPT: symbol=[3]  # Debounce counter based class index must be in range of 0 to 8.0.
            EVENT_EXT_WDG_OUT_OF_ORDER: symbol=[4]  # Debounce counter based class index must be in range of 0 to 8.0.
            EVENT_NVM_NOT_PRG: symbol=[5]  # Debounce counter based class index must be in range of 0 to 8.0.
            EVENT_RAM_MEM_CORRUPT: symbol=[6]  # Debounce counter based class index must be in range of 0 to 8.0.
            EVENT_ADC_CALIB: symbol=[7]  # Debounce counter based class index must be in range of 0 to 8.0.
            EVENT_ECU_OVER_TEMPERATURE: symbol=[8]  # Debounce counter based class index must be in range of 0 to 8.0.
            EVENT_DFLASH_MEM_CORRUPT: symbol=[9]  # Debounce counter based class index must be in range of 0 to 8.0.
            EVENT_SBC_STATUS_FAILURE: symbol=[10]  # Debounce counter based class index must be in range of 0 to 8.0.
            EVENT_POWER_SUPPLY_OV: symbol=[11]  # Debounce counter based class index must be in range of 0 to 8.0.
            EVENT_POWER_SUPPLY_UV: symbol=[12]  # Debounce counter based class index must be in range of 0 to 8.0.
            EVENT_ACTUATOR_STATUS: symbol=[13]  # Debounce counter based class index must be in range of 0 to 8.0.
            EVENT_MCU_SELFTEST: symbol=[14]  # Debounce counter based class index must be in range of 0 to 8.0.
            EVENT_ACTUATOR_OPEN_CIRCUIT: symbol=[15]  # Debounce counter based class index must be in range of 0 to 8.0.
            EVENT_ACTUATOR_SHORT_TO_GND: symbol=[16]  # Debounce counter based class index must be in range of 0 to 8.0.
            EVENT_ACTUATOR_SHORT_TO_VBAT: symbol=[17]  # Debounce counter based class index must be in range of 0 to 8.0.
            EVENT_ACC_STATUS_FAILURE: symbol=[18]  # Debounce counter based class index must be in range of 0 to 8.0.
            EVENT_SPI_E_HW_ERROR: symbol=[19]  # Debounce counter based class index must be in range of 0 to 8.0.
            EVENT_SOLENOID_OVERVOLTAGE: symbol=[20]  # Debounce counter based class index must be in range of 0 to 8.0.
            EVENT_POWER_STAGE_FAILIURE: symbol=[21]  # Debounce counter based class index must be in range of 0 to 8.0.
            EVENT_MCU_CRC_REGISTERS: symbol=[22]  # Debounce counter based class index must be in range of 0 to 8.0.
        Dem_DebounceCounterClass: array-size=9
          9 x mc data instance, all with category=STRUCTURE:
            DemDebounceCounterBasedClass_0: symbol=[0]
              8 x mc data instance, all with category=VALUE:
                DemDebounceCounterDecrementStepSize: resulting-properties={base-type=uint16, sw-calibration-access=READ-WRITE, data-constr=uint16}, symbol=CountDecStepSize
                DemDebounceCounterIncrementStepSize: resulting-properties={base-type=uint16, sw-calibration-access=READ-WRITE, data-constr=uint16}, symbol=CountIncStepSize
                DemDebounceCounterPassedThreshold: resulting-properties={base-type=sint16, sw-calibration-access=READ-WRITE, data-constr=sint16}, symbol=CounterPassedThreshold
                DemDebounceCounterFailedThreshold: resulting-properties={base-type=sint16, sw-calibration-access=READ-WRITE, data-constr=sint16}, symbol=CounterFailedThreshold
                DemDebounceCounterJumpDownValue: resulting-properties={base-type=sint16, sw-calibration-access=READ-WRITE, data-constr=sint16}, symbol=JumpDownValue
                DemDebounceCounterJumpUpValue: resulting-properties={base-type=sint16, sw-calibration-access=READ-WRITE, data-constr=sint16}, symbol=JumpUpValue
                DemDebounceCounterJumpDown: resulting-properties={base-type=uint8, sw-calibration-access=READ-WRITE, data-constr=uint8}, symbol=JumpDown
                DemDebounceCounterJumpUp: resulting-properties={base-type=uint8, sw-calibration-access=READ-WRITE, data-constr=uint8}, symbol=JumpUp
            DemDebounceCounterBasedClass_1: symbol=[1]
              8 x mc data instance, all with category=VALUE:
                DemDebounceCounterDecrementStepSize: resulting-properties={base-type=uint16, sw-calibration-access=READ-WRITE, data-constr=uint16}, symbol=CountDecStepSize
                DemDebounceCounterIncrementStepSize: resulting-properties={base-type=uint16, sw-calibration-access=READ-WRITE, data-constr=uint16}, symbol=CountIncStepSize
                DemDebounceCounterPassedThreshold: resulting-properties={base-type=sint16, sw-calibration-access=READ-WRITE, data-constr=sint16}, symbol=CounterPassedThreshold
                DemDebounceCounterFailedThreshold: resulting-properties={base-type=sint16, sw-calibration-access=READ-WRITE, data-constr=sint16}, symbol=CounterFailedThreshold
                DemDebounceCounterJumpDownValue: resulting-properties={base-type=sint16, sw-calibration-access=READ-WRITE, data-constr=sint16}, symbol=JumpDownValue
                DemDebounceCounterJumpUpValue: resulting-properties={base-type=sint16, sw-calibration-access=READ-WRITE, data-constr=sint16}, symbol=JumpUpValue
                DemDebounceCounterJumpDown: resulting-properties={base-type=uint8, sw-calibration-access=READ-WRITE, data-constr=uint8}, symbol=JumpDown
                DemDebounceCounterJumpUp: resulting-properties={base-type=uint8, sw-calibration-access=READ-WRITE, data-constr=uint8}, symbol=JumpUp
            DemDebounceCounterBasedClass_2: symbol=[2]
              8 x mc data instance, all with category=VALUE:
                DemDebounceCounterDecrementStepSize: resulting-properties={base-type=uint16, sw-calibration-access=READ-WRITE, data-constr=uint16}, symbol=CountDecStepSize
                DemDebounceCounterIncrementStepSize: resulting-properties={base-type=uint16, sw-calibration-access=READ-WRITE, data-constr=uint16}, symbol=CountIncStepSize
                DemDebounceCounterPassedThreshold: resulting-properties={base-type=sint16, sw-calibration-access=READ-WRITE, data-constr=sint16}, symbol=CounterPassedThreshold
                DemDebounceCounterFailedThreshold: resulting-properties={base-type=sint16, sw-calibration-access=READ-WRITE, data-constr=sint16}, symbol=CounterFailedThreshold
                DemDebounceCounterJumpDownValue: resulting-properties={base-type=sint16, sw-calibration-access=READ-WRITE, data-constr=sint16}, symbol=JumpDownValue
                DemDebounceCounterJumpUpValue: resulting-properties={base-type=sint16, sw-calibration-access=READ-WRITE, data-constr=sint16}, symbol=JumpUpValue
                DemDebounceCounterJumpDown: resulting-properties={base-type=uint8, sw-calibration-access=READ-WRITE, data-constr=uint8}, symbol=JumpDown
                DemDebounceCounterJumpUp: resulting-properties={base-type=uint8, sw-calibration-access=READ-WRITE, data-constr=uint8}, symbol=JumpUp
            DemDebounceCounterBasedClass_3: symbol=[3]
              8 x mc data instance, all with category=VALUE:
                DemDebounceCounterDecrementStepSize: resulting-properties={base-type=uint16, sw-calibration-access=READ-WRITE, data-constr=uint16}, symbol=CountDecStepSize
                DemDebounceCounterIncrementStepSize: resulting-properties={base-type=uint16, sw-calibration-access=READ-WRITE, data-constr=uint16}, symbol=CountIncStepSize
                DemDebounceCounterPassedThreshold: resulting-properties={base-type=sint16, sw-calibration-access=READ-WRITE, data-constr=sint16}, symbol=CounterPassedThreshold
                DemDebounceCounterFailedThreshold: resulting-properties={base-type=sint16, sw-calibration-access=READ-WRITE, data-constr=sint16}, symbol=CounterFailedThreshold
                DemDebounceCounterJumpDownValue: resulting-properties={base-type=sint16, sw-calibration-access=READ-WRITE, data-constr=sint16}, symbol=JumpDownValue
                DemDebounceCounterJumpUpValue: resulting-properties={base-type=sint16, sw-calibration-access=READ-WRITE, data-constr=sint16}, symbol=JumpUpValue
                DemDebounceCounterJumpDown: resulting-properties={base-type=uint8, sw-calibration-access=READ-WRITE, data-constr=uint8}, symbol=JumpDown
                DemDebounceCounterJumpUp: resulting-properties={base-type=uint8, sw-calibration-access=READ-WRITE, data-constr=uint8}, symbol=JumpUp
            DemDebounceCounterBasedClass_4: symbol=[4]
              8 x mc data instance, all with category=VALUE:
                DemDebounceCounterDecrementStepSize: resulting-properties={base-type=uint16, sw-calibration-access=READ-WRITE, data-constr=uint16}, symbol=CountDecStepSize
                DemDebounceCounterIncrementStepSize: resulting-properties={base-type=uint16, sw-calibration-access=READ-WRITE, data-constr=uint16}, symbol=CountIncStepSize
                DemDebounceCounterPassedThreshold: resulting-properties={base-type=sint16, sw-calibration-access=READ-WRITE, data-constr=sint16}, symbol=CounterPassedThreshold
                DemDebounceCounterFailedThreshold: resulting-properties={base-type=sint16, sw-calibration-access=READ-WRITE, data-constr=sint16}, symbol=CounterFailedThreshold
                DemDebounceCounterJumpDownValue: resulting-properties={base-type=sint16, sw-calibration-access=READ-WRITE, data-constr=sint16}, symbol=JumpDownValue
                DemDebounceCounterJumpUpValue: resulting-properties={base-type=sint16, sw-calibration-access=READ-WRITE, data-constr=sint16}, symbol=JumpUpValue
                DemDebounceCounterJumpDown: resulting-properties={base-type=uint8, sw-calibration-access=READ-WRITE, data-constr=uint8}, symbol=JumpDown
                DemDebounceCounterJumpUp: resulting-properties={base-type=uint8, sw-calibration-access=READ-WRITE, data-constr=uint8}, symbol=JumpUp
            DemDebounceCounterBasedClass_5: symbol=[5]
              8 x mc data instance, all with category=VALUE:
                DemDebounceCounterDecrementStepSize: resulting-properties={base-type=uint16, sw-calibration-access=READ-WRITE, data-constr=uint16}, symbol=CountDecStepSize
                DemDebounceCounterIncrementStepSize: resulting-properties={base-type=uint16, sw-calibration-access=READ-WRITE, data-constr=uint16}, symbol=CountIncStepSize
                DemDebounceCounterPassedThreshold: resulting-properties={base-type=sint16, sw-calibration-access=READ-WRITE, data-constr=sint16}, symbol=CounterPassedThreshold
                DemDebounceCounterFailedThreshold: resulting-properties={base-type=sint16, sw-calibration-access=READ-WRITE, data-constr=sint16}, symbol=CounterFailedThreshold
                DemDebounceCounterJumpDownValue: resulting-properties={base-type=sint16, sw-calibration-access=READ-WRITE, data-constr=sint16}, symbol=JumpDownValue
                DemDebounceCounterJumpUpValue: resulting-properties={base-type=sint16, sw-calibration-access=READ-WRITE, data-constr=sint16}, symbol=JumpUpValue
                DemDebounceCounterJumpDown: resulting-properties={base-type=uint8, sw-calibration-access=READ-WRITE, data-constr=uint8}, symbol=JumpDown
                DemDebounceCounterJumpUp: resulting-properties={base-type=uint8, sw-calibration-access=READ-WRITE, data-constr=uint8}, symbol=JumpUp
            DemDebounceCounterBasedClass_6: symbol=[6]
              8 x mc data instance, all with category=VALUE:
                DemDebounceCounterDecrementStepSize: resulting-properties={base-type=uint16, sw-calibration-access=READ-WRITE, data-constr=uint16}, symbol=CountDecStepSize
                DemDebounceCounterIncrementStepSize: resulting-properties={base-type=uint16, sw-calibration-access=READ-WRITE, data-constr=uint16}, symbol=CountIncStepSize
                DemDebounceCounterPassedThreshold: resulting-properties={base-type=sint16, sw-calibration-access=READ-WRITE, data-constr=sint16}, symbol=CounterPassedThreshold
                DemDebounceCounterFailedThreshold: resulting-properties={base-type=sint16, sw-calibration-access=READ-WRITE, data-constr=sint16}, symbol=CounterFailedThreshold
                DemDebounceCounterJumpDownValue: resulting-properties={base-type=sint16, sw-calibration-access=READ-WRITE, data-constr=sint16}, symbol=JumpDownValue
                DemDebounceCounterJumpUpValue: resulting-properties={base-type=sint16, sw-calibration-access=READ-WRITE, data-constr=sint16}, symbol=JumpUpValue
                DemDebounceCounterJumpDown: resulting-properties={base-type=uint8, sw-calibration-access=READ-WRITE, data-constr=uint8}, symbol=JumpDown
                DemDebounceCounterJumpUp: resulting-properties={base-type=uint8, sw-calibration-access=READ-WRITE, data-constr=uint8}, symbol=JumpUp
            DemDebounceCounterBasedClass_7: symbol=[7]
              8 x mc data instance, all with category=VALUE:
                DemDebounceCounterDecrementStepSize: resulting-properties={base-type=uint16, sw-calibration-access=READ-WRITE, data-constr=uint16}, symbol=CountDecStepSize
                DemDebounceCounterIncrementStepSize: resulting-properties={base-type=uint16, sw-calibration-access=READ-WRITE, data-constr=uint16}, symbol=CountIncStepSize
                DemDebounceCounterPassedThreshold: resulting-properties={base-type=sint16, sw-calibration-access=READ-WRITE, data-constr=sint16}, symbol=CounterPassedThreshold
                DemDebounceCounterFailedThreshold: resulting-properties={base-type=sint16, sw-calibration-access=READ-WRITE, data-constr=sint16}, symbol=CounterFailedThreshold
                DemDebounceCounterJumpDownValue: resulting-properties={base-type=sint16, sw-calibration-access=READ-WRITE, data-constr=sint16}, symbol=JumpDownValue
                DemDebounceCounterJumpUpValue: resulting-properties={base-type=sint16, sw-calibration-access=READ-WRITE, data-constr=sint16}, symbol=JumpUpValue
                DemDebounceCounterJumpDown: resulting-properties={base-type=uint8, sw-calibration-access=READ-WRITE, data-constr=uint8}, symbol=JumpDown
                DemDebounceCounterJumpUp: resulting-properties={base-type=uint8, sw-calibration-access=READ-WRITE, data-constr=uint8}, symbol=JumpUp
            DemDebounceCounterBasedClass_8: symbol=[8]
              8 x mc data instance, all with category=VALUE:
                DemDebounceCounterDecrementStepSize: resulting-properties={base-type=uint16, sw-calibration-access=READ-WRITE, data-constr=uint16}, symbol=CountDecStepSize
                DemDebounceCounterIncrementStepSize: resulting-properties={base-type=uint16, sw-calibration-access=READ-WRITE, data-constr=uint16}, symbol=CountIncStepSize
                DemDebounceCounterPassedThreshold: resulting-properties={base-type=sint16, sw-calibration-access=READ-WRITE, data-constr=sint16}, symbol=CounterPassedThreshold
                DemDebounceCounterFailedThreshold: resulting-properties={base-type=sint16, sw-calibration-access=READ-WRITE, data-constr=sint16}, symbol=CounterFailedThreshold
                DemDebounceCounterJumpDownValue: resulting-properties={base-type=sint16, sw-calibration-access=READ-WRITE, data-constr=sint16}, symbol=JumpDownValue
                DemDebounceCounterJumpUpValue: resulting-properties={base-type=sint16, sw-calibration-access=READ-WRITE, data-constr=sint16}, symbol=JumpUpValue
                DemDebounceCounterJumpDown: resulting-properties={base-type=uint8, sw-calibration-access=READ-WRITE, data-constr=uint8}, symbol=JumpDown
                DemDebounceCounterJumpUp: resulting-properties={base-type=uint8, sw-calibration-access=READ-WRITE, data-constr=uint8}, symbol=JumpUp
        Dem_EventFailureCycleCfg: array-size=23
          23 x mc data instance, all with category=STRUCTURE:
            EVENT_CANSM_E_BUS_OFF: symbol=[0]
              mc data instance EventFailureCycleIdx: category=VALUE, resulting-properties={base-type=uint8, data-constr=uint8}
              mc data instance EventFailureCycleCounterThreshold: category=VALUE, resulting-properties={base-type=uint8, sw-calibration-access=READ-WRITE, data-constr=uint8}
            EVENT_ADC_OUT_OF_ORDER: symbol=[1]
              mc data instance EventFailureCycleIdx: category=VALUE, resulting-properties={base-type=uint8, data-constr=uint8}
              mc data instance EventFailureCycleCounterThreshold: category=VALUE, resulting-properties={base-type=uint8, sw-calibration-access=READ-WRITE, data-constr=uint8}
            EVENT_WARM_RESET: symbol=[2]
              mc data instance EventFailureCycleIdx: category=VALUE, resulting-properties={base-type=uint8, data-constr=uint8}
              mc data instance EventFailureCycleCounterThreshold: category=VALUE, resulting-properties={base-type=uint8, sw-calibration-access=READ-WRITE, data-constr=uint8}
            EVENT_PFLASH_MEM_CORRUPT: symbol=[3]
              mc data instance EventFailureCycleIdx: category=VALUE, resulting-properties={base-type=uint8, data-constr=uint8}
              mc data instance EventFailureCycleCounterThreshold: category=VALUE, resulting-properties={base-type=uint8, sw-calibration-access=READ-WRITE, data-constr=uint8}
            EVENT_EXT_WDG_OUT_OF_ORDER: symbol=[4]
              mc data instance EventFailureCycleIdx: category=VALUE, resulting-properties={base-type=uint8, data-constr=uint8}
              mc data instance EventFailureCycleCounterThreshold: category=VALUE, resulting-properties={base-type=uint8, sw-calibration-access=READ-WRITE, data-constr=uint8}
            EVENT_NVM_NOT_PRG: symbol=[5]
              mc data instance EventFailureCycleIdx: category=VALUE, resulting-properties={base-type=uint8, data-constr=uint8}
              mc data instance EventFailureCycleCounterThreshold: category=VALUE, resulting-properties={base-type=uint8, sw-calibration-access=READ-WRITE, data-constr=uint8}
            EVENT_RAM_MEM_CORRUPT: symbol=[6]
              mc data instance EventFailureCycleIdx: category=VALUE, resulting-properties={base-type=uint8, data-constr=uint8}
              mc data instance EventFailureCycleCounterThreshold: category=VALUE, resulting-properties={base-type=uint8, sw-calibration-access=READ-WRITE, data-constr=uint8}
            EVENT_ADC_CALIB: symbol=[7]
              mc data instance EventFailureCycleIdx: category=VALUE, resulting-properties={base-type=uint8, data-constr=uint8}
              mc data instance EventFailureCycleCounterThreshold: category=VALUE, resulting-properties={base-type=uint8, sw-calibration-access=READ-WRITE, data-constr=uint8}
            EVENT_ECU_OVER_TEMPERATURE: symbol=[8]
              mc data instance EventFailureCycleIdx: category=VALUE, resulting-properties={base-type=uint8, data-constr=uint8}
              mc data instance EventFailureCycleCounterThreshold: category=VALUE, resulting-properties={base-type=uint8, sw-calibration-access=READ-WRITE, data-constr=uint8}
            EVENT_DFLASH_MEM_CORRUPT: symbol=[9]
              mc data instance EventFailureCycleIdx: category=VALUE, resulting-properties={base-type=uint8, data-constr=uint8}
              mc data instance EventFailureCycleCounterThreshold: category=VALUE, resulting-properties={base-type=uint8, sw-calibration-access=READ-WRITE, data-constr=uint8}
            EVENT_SBC_STATUS_FAILURE: symbol=[10]
              mc data instance EventFailureCycleIdx: category=VALUE, resulting-properties={base-type=uint8, data-constr=uint8}
              mc data instance EventFailureCycleCounterThreshold: category=VALUE, resulting-properties={base-type=uint8, sw-calibration-access=READ-WRITE, data-constr=uint8}
            EVENT_POWER_SUPPLY_OV: symbol=[11]
              mc data instance EventFailureCycleIdx: category=VALUE, resulting-properties={base-type=uint8, data-constr=uint8}
              mc data instance EventFailureCycleCounterThreshold: category=VALUE, resulting-properties={base-type=uint8, sw-calibration-access=READ-WRITE, data-constr=uint8}
            EVENT_POWER_SUPPLY_UV: symbol=[12]
              mc data instance EventFailureCycleIdx: category=VALUE, resulting-properties={base-type=uint8, data-constr=uint8}
              mc data instance EventFailureCycleCounterThreshold: category=VALUE, resulting-properties={base-type=uint8, sw-calibration-access=READ-WRITE, data-constr=uint8}
            EVENT_ACTUATOR_STATUS: symbol=[13]
              mc data instance EventFailureCycleIdx: category=VALUE, resulting-properties={base-type=uint8, data-constr=uint8}
              mc data instance EventFailureCycleCounterThreshold: category=VALUE, resulting-properties={base-type=uint8, sw-calibration-access=READ-WRITE, data-constr=uint8}
            EVENT_MCU_SELFTEST: symbol=[14]
              mc data instance EventFailureCycleIdx: category=VALUE, resulting-properties={base-type=uint8, data-constr=uint8}
              mc data instance EventFailureCycleCounterThreshold: category=VALUE, resulting-properties={base-type=uint8, sw-calibration-access=READ-WRITE, data-constr=uint8}
            EVENT_ACTUATOR_OPEN_CIRCUIT: symbol=[15]
              mc data instance EventFailureCycleIdx: category=VALUE, resulting-properties={base-type=uint8, data-constr=uint8}
              mc data instance EventFailureCycleCounterThreshold: category=VALUE, resulting-properties={base-type=uint8, sw-calibration-access=READ-WRITE, data-constr=uint8}
            EVENT_ACTUATOR_SHORT_TO_GND: symbol=[16]
              mc data instance EventFailureCycleIdx: category=VALUE, resulting-properties={base-type=uint8, data-constr=uint8}
              mc data instance EventFailureCycleCounterThreshold: category=VALUE, resulting-properties={base-type=uint8, sw-calibration-access=READ-WRITE, data-constr=uint8}
            EVENT_ACTUATOR_SHORT_TO_VBAT: symbol=[17]
              mc data instance EventFailureCycleIdx: category=VALUE, resulting-properties={base-type=uint8, data-constr=uint8}
              mc data instance EventFailureCycleCounterThreshold: category=VALUE, resulting-properties={base-type=uint8, sw-calibration-access=READ-WRITE, data-constr=uint8}
            EVENT_ACC_STATUS_FAILURE: symbol=[18]
              mc data instance EventFailureCycleIdx: category=VALUE, resulting-properties={base-type=uint8, data-constr=uint8}
              mc data instance EventFailureCycleCounterThreshold: category=VALUE, resulting-properties={base-type=uint8, sw-calibration-access=READ-WRITE, data-constr=uint8}
            EVENT_SPI_E_HW_ERROR: symbol=[19]
              mc data instance EventFailureCycleIdx: category=VALUE, resulting-properties={base-type=uint8, data-constr=uint8}
              mc data instance EventFailureCycleCounterThreshold: category=VALUE, resulting-properties={base-type=uint8, sw-calibration-access=READ-WRITE, data-constr=uint8}
            EVENT_SOLENOID_OVERVOLTAGE: symbol=[20]
              mc data instance EventFailureCycleIdx: category=VALUE, resulting-properties={base-type=uint8, data-constr=uint8}
              mc data instance EventFailureCycleCounterThreshold: category=VALUE, resulting-properties={base-type=uint8, sw-calibration-access=READ-WRITE, data-constr=uint8}
            EVENT_POWER_STAGE_FAILIURE: symbol=[21]
              mc data instance EventFailureCycleIdx: category=VALUE, resulting-properties={base-type=uint8, data-constr=uint8}
              mc data instance EventFailureCycleCounterThreshold: category=VALUE, resulting-properties={base-type=uint8, sw-calibration-access=READ-WRITE, data-constr=uint8}
            EVENT_MCU_CRC_REGISTERS: symbol=[22]
              mc data instance EventFailureCycleIdx: category=VALUE, resulting-properties={base-type=uint8, data-constr=uint8}
              mc data instance EventFailureCycleCounterThreshold: category=VALUE, resulting-properties={base-type=uint8, sw-calibration-access=READ-WRITE, data-constr=uint8}
        Dem_EventEnabled: array-size=3
          23 x mc data instance, all with category=VALUE:
            EventAvailable_1: resulting-properties={base-type=uint8, sw-bit-representation={bit-position=1, number-of-bits=1}, sw-calibration-access=READ-WRITE, data-constr=uint8}, symbol=[0]  # Availability of event EVENT_CANSM_E_BUS_OFF (1 means enabled, 0 means disabled) - Calibration of this value is only allowed before Dem_PreInit() is called. - If the event which provides the OBD freeze frame is disabled the OBD freeze frame will not be updated and no OBD freeze frame will be provided to the Dcm. - If an event which is stored in event memory is disabled the event memory entry is not available anymore. - The Dem NvM-blocks has to be invalidated after re-calibration was performed (in order to avoid data inconsistency). - For service 0x19, if the DTC referenced by the event ID is identified by the algorithm, the value of the DTC will be returned. In case calibration occurs with 0 for the event ID and the service is called again, the DTC referenced by the disabled event is identified by the algorithm, the DTC returned by the service is DEM_NO_DTC. - If re-calibration is performed during Dem processing or without invalidation of outdated Dem NvM-blocks the Dem behavior is undefined (can lead e.g. to segmentation faults in the worst case).
            EventAvailable_2: resulting-properties={base-type=uint8, sw-bit-representation={bit-position=2, number-of-bits=1}, sw-calibration-access=READ-WRITE, data-constr=uint8}, symbol=[0]  # Availability of event EVENT_ADC_OUT_OF_ORDER (1 means enabled, 0 means disabled) - Calibration of this value is only allowed before Dem_PreInit() is called. - If the event which provides the OBD freeze frame is disabled the OBD freeze frame will not be updated and no OBD freeze frame will be provided to the Dcm. - If an event which is stored in event memory is disabled the event memory entry is not available anymore. - The Dem NvM-blocks has to be invalidated after re-calibration was performed (in order to avoid data inconsistency). - For service 0x19, if the DTC referenced by the event ID is identified by the algorithm, the value of the DTC will be returned. In case calibration occurs with 0 for the event ID and the service is called again, the DTC referenced by the disabled event is identified by the algorithm, the DTC returned by the service is DEM_NO_DTC. - If re-calibration is performed during Dem processing or without invalidation of outdated Dem NvM-blocks the Dem behavior is undefined (can lead e.g. to segmentation faults in the worst case).
            EventAvailable_3: resulting-properties={base-type=uint8, sw-bit-representation={bit-position=3, number-of-bits=1}, sw-calibration-access=READ-WRITE, data-constr=uint8}, symbol=[0]  # Availability of event EVENT_WARM_RESET (1 means enabled, 0 means disabled) - Calibration of this value is only allowed before Dem_PreInit() is called. - If the event which provides the OBD freeze frame is disabled the OBD freeze frame will not be updated and no OBD freeze frame will be provided to the Dcm. - If an event which is stored in event memory is disabled the event memory entry is not available anymore. - The Dem NvM-blocks has to be invalidated after re-calibration was performed (in order to avoid data inconsistency). - For service 0x19, if the DTC referenced by the event ID is identified by the algorithm, the value of the DTC will be returned. In case calibration occurs with 0 for the event ID and the service is called again, the DTC referenced by the disabled event is identified by the algorithm, the DTC returned by the service is DEM_NO_DTC. - If re-calibration is performed during Dem processing or without invalidation of outdated Dem NvM-blocks the Dem behavior is undefined (can lead e.g. to segmentation faults in the worst case).
            EventAvailable_4: resulting-properties={base-type=uint8, sw-bit-representation={bit-position=4, number-of-bits=1}, sw-calibration-access=READ-WRITE, data-constr=uint8}, symbol=[0]  # Availability of event EVENT_PFLASH_MEM_CORRUPT (1 means enabled, 0 means disabled) - Calibration of this value is only allowed before Dem_PreInit() is called. - If the event which provides the OBD freeze frame is disabled the OBD freeze frame will not be updated and no OBD freeze frame will be provided to the Dcm. - If an event which is stored in event memory is disabled the event memory entry is not available anymore. - The Dem NvM-blocks has to be invalidated after re-calibration was performed (in order to avoid data inconsistency). - For service 0x19, if the DTC referenced by the event ID is identified by the algorithm, the value of the DTC will be returned. In case calibration occurs with 0 for the event ID and the service is called again, the DTC referenced by the disabled event is identified by the algorithm, the DTC returned by the service is DEM_NO_DTC. - If re-calibration is performed during Dem processing or without invalidation of outdated Dem NvM-blocks the Dem behavior is undefined (can lead e.g. to segmentation faults in the worst case).
            EventAvailable_5: resulting-properties={base-type=uint8, sw-bit-representation={bit-position=5, number-of-bits=1}, sw-calibration-access=READ-WRITE, data-constr=uint8}, symbol=[0]  # Availability of event EVENT_EXT_WDG_OUT_OF_ORDER (1 means enabled, 0 means disabled) - Calibration of this value is only allowed before Dem_PreInit() is called. - If the event which provides the OBD freeze frame is disabled the OBD freeze frame will not be updated and no OBD freeze frame will be provided to the Dcm. - If an event which is stored in event memory is disabled the event memory entry is not available anymore. - The Dem NvM-blocks has to be invalidated after re-calibration was performed (in order to avoid data inconsistency). - For service 0x19, if the DTC referenced by the event ID is identified by the algorithm, the value of the DTC will be returned. In case calibration occurs with 0 for the event ID and the service is called again, the DTC referenced by the disabled event is identified by the algorithm, the DTC returned by the service is DEM_NO_DTC. - If re-calibration is performed during Dem processing or without invalidation of outdated Dem NvM-blocks the Dem behavior is undefined (can lead e.g. to segmentation faults in the worst case).
            EventAvailable_6: resulting-properties={base-type=uint8, sw-bit-representation={bit-position=6, number-of-bits=1}, sw-calibration-access=READ-WRITE, data-constr=uint8}, symbol=[0]  # Availability of event EVENT_NVM_NOT_PRG (1 means enabled, 0 means disabled) - Calibration of this value is only allowed before Dem_PreInit() is called. - If the event which provides the OBD freeze frame is disabled the OBD freeze frame will not be updated and no OBD freeze frame will be provided to the Dcm. - If an event which is stored in event memory is disabled the event memory entry is not available anymore. - The Dem NvM-blocks has to be invalidated after re-calibration was performed (in order to avoid data inconsistency). - For service 0x19, if the DTC referenced by the event ID is identified by the algorithm, the value of the DTC will be returned. In case calibration occurs with 0 for the event ID and the service is called again, the DTC referenced by the disabled event is identified by the algorithm, the DTC returned by the service is DEM_NO_DTC. - If re-calibration is performed during Dem processing or without invalidation of outdated Dem NvM-blocks the Dem behavior is undefined (can lead e.g. to segmentation faults in the worst case).
            EventAvailable_7: resulting-properties={base-type=uint8, sw-bit-representation={bit-position=7, number-of-bits=1}, sw-calibration-access=READ-WRITE, data-constr=uint8}, symbol=[0]  # Availability of event EVENT_RAM_MEM_CORRUPT (1 means enabled, 0 means disabled) - Calibration of this value is only allowed before Dem_PreInit() is called. - If the event which provides the OBD freeze frame is disabled the OBD freeze frame will not be updated and no OBD freeze frame will be provided to the Dcm. - If an event which is stored in event memory is disabled the event memory entry is not available anymore. - The Dem NvM-blocks has to be invalidated after re-calibration was performed (in order to avoid data inconsistency). - For service 0x19, if the DTC referenced by the event ID is identified by the algorithm, the value of the DTC will be returned. In case calibration occurs with 0 for the event ID and the service is called again, the DTC referenced by the disabled event is identified by the algorithm, the DTC returned by the service is DEM_NO_DTC. - If re-calibration is performed during Dem processing or without invalidation of outdated Dem NvM-blocks the Dem behavior is undefined (can lead e.g. to segmentation faults in the worst case).
            EventAvailable_8: resulting-properties={base-type=uint8, sw-bit-representation={bit-position=0, number-of-bits=1}, sw-calibration-access=READ-WRITE, data-constr=uint8}, symbol=[1]  # Availability of event EVENT_ADC_CALIB (1 means enabled, 0 means disabled) - Calibration of this value is only allowed before Dem_PreInit() is called. - If the event which provides the OBD freeze frame is disabled the OBD freeze frame will not be updated and no OBD freeze frame will be provided to the Dcm. - If an event which is stored in event memory is disabled the event memory entry is not available anymore. - The Dem NvM-blocks has to be invalidated after re-calibration was performed (in order to avoid data inconsistency). - For service 0x19, if the DTC referenced by the event ID is identified by the algorithm, the value of the DTC will be returned. In case calibration occurs with 0 for the event ID and the service is called again, the DTC referenced by the disabled event is identified by the algorithm, the DTC returned by the service is DEM_NO_DTC. - If re-calibration is performed during Dem processing or without invalidation of outdated Dem NvM-blocks the Dem behavior is undefined (can lead e.g. to segmentation faults in the worst case).
            EventAvailable_9: resulting-properties={base-type=uint8, sw-bit-representation={bit-position=1, number-of-bits=1}, sw-calibration-access=READ-WRITE, data-constr=uint8}, symbol=[1]  # Availability of event EVENT_ECU_OVER_TEMPERATURE (1 means enabled, 0 means disabled) - Calibration of this value is only allowed before Dem_PreInit() is called. - If the event which provides the OBD freeze frame is disabled the OBD freeze frame will not be updated and no OBD freeze frame will be provided to the Dcm. - If an event which is stored in event memory is disabled the event memory entry is not available anymore. - The Dem NvM-blocks has to be invalidated after re-calibration was performed (in order to avoid data inconsistency). - For service 0x19, if the DTC referenced by the event ID is identified by the algorithm, the value of the DTC will be returned. In case calibration occurs with 0 for the event ID and the service is called again, the DTC referenced by the disabled event is identified by the algorithm, the DTC returned by the service is DEM_NO_DTC. - If re-calibration is performed during Dem processing or without invalidation of outdated Dem NvM-blocks the Dem behavior is undefined (can lead e.g. to segmentation faults in the worst case).
            EventAvailable_10: resulting-properties={base-type=uint8, sw-bit-representation={bit-position=2, number-of-bits=1}, sw-calibration-access=READ-WRITE, data-constr=uint8}, symbol=[1]  # Availability of event EVENT_DFLASH_MEM_CORRUPT (1 means enabled, 0 means disabled) - Calibration of this value is only allowed before Dem_PreInit() is called. - If the event which provides the OBD freeze frame is disabled the OBD freeze frame will not be updated and no OBD freeze frame will be provided to the Dcm. - If an event which is stored in event memory is disabled the event memory entry is not available anymore. - The Dem NvM-blocks has to be invalidated after re-calibration was performed (in order to avoid data inconsistency). - For service 0x19, if the DTC referenced by the event ID is identified by the algorithm, the value of the DTC will be returned. In case calibration occurs with 0 for the event ID and the service is called again, the DTC referenced by the disabled event is identified by the algorithm, the DTC returned by the service is DEM_NO_DTC. - If re-calibration is performed during Dem processing or without invalidation of outdated Dem NvM-blocks the Dem behavior is undefined (can lead e.g. to segmentation faults in the worst case).
            EventAvailable_11: resulting-properties={base-type=uint8, sw-bit-representation={bit-position=3, number-of-bits=1}, sw-calibration-access=READ-WRITE, data-constr=uint8}, symbol=[1]  # Availability of event EVENT_SBC_STATUS_FAILURE (1 means enabled, 0 means disabled) - Calibration of this value is only allowed before Dem_PreInit() is called. - If the event which provides the OBD freeze frame is disabled the OBD freeze frame will not be updated and no OBD freeze frame will be provided to the Dcm. - If an event which is stored in event memory is disabled the event memory entry is not available anymore. - The Dem NvM-blocks has to be invalidated after re-calibration was performed (in order to avoid data inconsistency). - For service 0x19, if the DTC referenced by the event ID is identified by the algorithm, the value of the DTC will be returned. In case calibration occurs with 0 for the event ID and the service is called again, the DTC referenced by the disabled event is identified by the algorithm, the DTC returned by the service is DEM_NO_DTC. - If re-calibration is performed during Dem processing or without invalidation of outdated Dem NvM-blocks the Dem behavior is undefined (can lead e.g. to segmentation faults in the worst case).
            EventAvailable_12: resulting-properties={base-type=uint8, sw-bit-representation={bit-position=4, number-of-bits=1}, sw-calibration-access=READ-WRITE, data-constr=uint8}, symbol=[1]  # Availability of event EVENT_POWER_SUPPLY_OV (1 means enabled, 0 means disabled) - Calibration of this value is only allowed before Dem_PreInit() is called. - If the event which provides the OBD freeze frame is disabled the OBD freeze frame will not be updated and no OBD freeze frame will be provided to the Dcm. - If an event which is stored in event memory is disabled the event memory entry is not available anymore. - The Dem NvM-blocks has to be invalidated after re-calibration was performed (in order to avoid data inconsistency). - For service 0x19, if the DTC referenced by the event ID is identified by the algorithm, the value of the DTC will be returned. In case calibration occurs with 0 for the event ID and the service is called again, the DTC referenced by the disabled event is identified by the algorithm, the DTC returned by the service is DEM_NO_DTC. - If re-calibration is performed during Dem processing or without invalidation of outdated Dem NvM-blocks the Dem behavior is undefined (can lead e.g. to segmentation faults in the worst case).
            EventAvailable_13: resulting-properties={base-type=uint8, sw-bit-representation={bit-position=5, number-of-bits=1}, sw-calibration-access=READ-WRITE, data-constr=uint8}, symbol=[1]  # Availability of event EVENT_POWER_SUPPLY_UV (1 means enabled, 0 means disabled) - Calibration of this value is only allowed before Dem_PreInit() is called. - If the event which provides the OBD freeze frame is disabled the OBD freeze frame will not be updated and no OBD freeze frame will be provided to the Dcm. - If an event which is stored in event memory is disabled the event memory entry is not available anymore. - The Dem NvM-blocks has to be invalidated after re-calibration was performed (in order to avoid data inconsistency). - For service 0x19, if the DTC referenced by the event ID is identified by the algorithm, the value of the DTC will be returned. In case calibration occurs with 0 for the event ID and the service is called again, the DTC referenced by the disabled event is identified by the algorithm, the DTC returned by the service is DEM_NO_DTC. - If re-calibration is performed during Dem processing or without invalidation of outdated Dem NvM-blocks the Dem behavior is undefined (can lead e.g. to segmentation faults in the worst case).
            EventAvailable_14: resulting-properties={base-type=uint8, sw-bit-representation={bit-position=6, number-of-bits=1}, sw-calibration-access=READ-WRITE, data-constr=uint8}, symbol=[1]  # Availability of event EVENT_ACTUATOR_STATUS (1 means enabled, 0 means disabled) - Calibration of this value is only allowed before Dem_PreInit() is called. - If the event which provides the OBD freeze frame is disabled the OBD freeze frame will not be updated and no OBD freeze frame will be provided to the Dcm. - If an event which is stored in event memory is disabled the event memory entry is not available anymore. - The Dem NvM-blocks has to be invalidated after re-calibration was performed (in order to avoid data inconsistency). - For service 0x19, if the DTC referenced by the event ID is identified by the algorithm, the value of the DTC will be returned. In case calibration occurs with 0 for the event ID and the service is called again, the DTC referenced by the disabled event is identified by the algorithm, the DTC returned by the service is DEM_NO_DTC. - If re-calibration is performed during Dem processing or without invalidation of outdated Dem NvM-blocks the Dem behavior is undefined (can lead e.g. to segmentation faults in the worst case).
            EventAvailable_15: resulting-properties={base-type=uint8, sw-bit-representation={bit-position=7, number-of-bits=1}, sw-calibration-access=READ-WRITE, data-constr=uint8}, symbol=[1]  # Availability of event EVENT_MCU_SELFTEST (1 means enabled, 0 means disabled) - Calibration of this value is only allowed before Dem_PreInit() is called. - If the event which provides the OBD freeze frame is disabled the OBD freeze frame will not be updated and no OBD freeze frame will be provided to the Dcm. - If an event which is stored in event memory is disabled the event memory entry is not available anymore. - The Dem NvM-blocks has to be invalidated after re-calibration was performed (in order to avoid data inconsistency). - For service 0x19, if the DTC referenced by the event ID is identified by the algorithm, the value of the DTC will be returned. In case calibration occurs with 0 for the event ID and the service is called again, the DTC referenced by the disabled event is identified by the algorithm, the DTC returned by the service is DEM_NO_DTC. - If re-calibration is performed during Dem processing or without invalidation of outdated Dem NvM-blocks the Dem behavior is undefined (can lead e.g. to segmentation faults in the worst case).
            EventAvailable_16: resulting-properties={base-type=uint8, sw-bit-representation={bit-position=0, number-of-bits=1}, sw-calibration-access=READ-WRITE, data-constr=uint8}, symbol=[2]  # Availability of event EVENT_ACTUATOR_OPEN_CIRCUIT (1 means enabled, 0 means disabled) - Calibration of this value is only allowed before Dem_PreInit() is called. - If the event which provides the OBD freeze frame is disabled the OBD freeze frame will not be updated and no OBD freeze frame will be provided to the Dcm. - If an event which is stored in event memory is disabled the event memory entry is not available anymore. - The Dem NvM-blocks has to be invalidated after re-calibration was performed (in order to avoid data inconsistency). - For service 0x19, if the DTC referenced by the event ID is identified by the algorithm, the value of the DTC will be returned. In case calibration occurs with 0 for the event ID and the service is called again, the DTC referenced by the disabled event is identified by the algorithm, the DTC returned by the service is DEM_NO_DTC. - If re-calibration is performed during Dem processing or without invalidation of outdated Dem NvM-blocks the Dem behavior is undefined (can lead e.g. to segmentation faults in the worst case).
            EventAvailable_17: resulting-properties={base-type=uint8, sw-bit-representation={bit-position=1, number-of-bits=1}, sw-calibration-access=READ-WRITE, data-constr=uint8}, symbol=[2]  # Availability of event EVENT_ACTUATOR_SHORT_TO_GND (1 means enabled, 0 means disabled) - Calibration of this value is only allowed before Dem_PreInit() is called. - If the event which provides the OBD freeze frame is disabled the OBD freeze frame will not be updated and no OBD freeze frame will be provided to the Dcm. - If an event which is stored in event memory is disabled the event memory entry is not available anymore. - The Dem NvM-blocks has to be invalidated after re-calibration was performed (in order to avoid data inconsistency). - For service 0x19, if the DTC referenced by the event ID is identified by the algorithm, the value of the DTC will be returned. In case calibration occurs with 0 for the event ID and the service is called again, the DTC referenced by the disabled event is identified by the algorithm, the DTC returned by the service is DEM_NO_DTC. - If re-calibration is performed during Dem processing or without invalidation of outdated Dem NvM-blocks the Dem behavior is undefined (can lead e.g. to segmentation faults in the worst case).
            EventAvailable_18: resulting-properties={base-type=uint8, sw-bit-representation={bit-position=2, number-of-bits=1}, sw-calibration-access=READ-WRITE, data-constr=uint8}, symbol=[2]  # Availability of event EVENT_ACTUATOR_SHORT_TO_VBAT (1 means enabled, 0 means disabled) - Calibration of this value is only allowed before Dem_PreInit() is called. - If the event which provides the OBD freeze frame is disabled the OBD freeze frame will not be updated and no OBD freeze frame will be provided to the Dcm. - If an event which is stored in event memory is disabled the event memory entry is not available anymore. - The Dem NvM-blocks has to be invalidated after re-calibration was performed (in order to avoid data inconsistency). - For service 0x19, if the DTC referenced by the event ID is identified by the algorithm, the value of the DTC will be returned. In case calibration occurs with 0 for the event ID and the service is called again, the DTC referenced by the disabled event is identified by the algorithm, the DTC returned by the service is DEM_NO_DTC. - If re-calibration is performed during Dem processing or without invalidation of outdated Dem NvM-blocks the Dem behavior is undefined (can lead e.g. to segmentation faults in the worst case).
            EventAvailable_19: resulting-properties={base-type=uint8, sw-bit-representation={bit-position=3, number-of-bits=1}, sw-calibration-access=READ-WRITE, data-constr=uint8}, symbol=[2]  # Availability of event EVENT_ACC_STATUS_FAILURE (1 means enabled, 0 means disabled) - Calibration of this value is only allowed before Dem_PreInit() is called. - If the event which provides the OBD freeze frame is disabled the OBD freeze frame will not be updated and no OBD freeze frame will be provided to the Dcm. - If an event which is stored in event memory is disabled the event memory entry is not available anymore. - The Dem NvM-blocks has to be invalidated after re-calibration was performed (in order to avoid data inconsistency). - For service 0x19, if the DTC referenced by the event ID is identified by the algorithm, the value of the DTC will be returned. In case calibration occurs with 0 for the event ID and the service is called again, the DTC referenced by the disabled event is identified by the algorithm, the DTC returned by the service is DEM_NO_DTC. - If re-calibration is performed during Dem processing or without invalidation of outdated Dem NvM-blocks the Dem behavior is undefined (can lead e.g. to segmentation faults in the worst case).
            EventAvailable_20: resulting-properties={base-type=uint8, sw-bit-representation={bit-position=4, number-of-bits=1}, sw-calibration-access=READ-WRITE, data-constr=uint8}, symbol=[2]  # Availability of event EVENT_SPI_E_HW_ERROR (1 means enabled, 0 means disabled) - Calibration of this value is only allowed before Dem_PreInit() is called. - If the event which provides the OBD freeze frame is disabled the OBD freeze frame will not be updated and no OBD freeze frame will be provided to the Dcm. - If an event which is stored in event memory is disabled the event memory entry is not available anymore. - The Dem NvM-blocks has to be invalidated after re-calibration was performed (in order to avoid data inconsistency). - For service 0x19, if the DTC referenced by the event ID is identified by the algorithm, the value of the DTC will be returned. In case calibration occurs with 0 for the event ID and the service is called again, the DTC referenced by the disabled event is identified by the algorithm, the DTC returned by the service is DEM_NO_DTC. - If re-calibration is performed during Dem processing or without invalidation of outdated Dem NvM-blocks the Dem behavior is undefined (can lead e.g. to segmentation faults in the worst case).
            EventAvailable_21: resulting-properties={base-type=uint8, sw-bit-representation={bit-position=5, number-of-bits=1}, sw-calibration-access=READ-WRITE, data-constr=uint8}, symbol=[2]  # Availability of event EVENT_SOLENOID_OVERVOLTAGE (1 means enabled, 0 means disabled) - Calibration of this value is only allowed before Dem_PreInit() is called. - If the event which provides the OBD freeze frame is disabled the OBD freeze frame will not be updated and no OBD freeze frame will be provided to the Dcm. - If an event which is stored in event memory is disabled the event memory entry is not available anymore. - The Dem NvM-blocks has to be invalidated after re-calibration was performed (in order to avoid data inconsistency). - For service 0x19, if the DTC referenced by the event ID is identified by the algorithm, the value of the DTC will be returned. In case calibration occurs with 0 for the event ID and the service is called again, the DTC referenced by the disabled event is identified by the algorithm, the DTC returned by the service is DEM_NO_DTC. - If re-calibration is performed during Dem processing or without invalidation of outdated Dem NvM-blocks the Dem behavior is undefined (can lead e.g. to segmentation faults in the worst case).
            EventAvailable_22: resulting-properties={base-type=uint8, sw-bit-representation={bit-position=6, number-of-bits=1}, sw-calibration-access=READ-WRITE, data-constr=uint8}, symbol=[2]  # Availability of event EVENT_POWER_STAGE_FAILIURE (1 means enabled, 0 means disabled) - Calibration of this value is only allowed before Dem_PreInit() is called. - If the event which provides the OBD freeze frame is disabled the OBD freeze frame will not be updated and no OBD freeze frame will be provided to the Dcm. - If an event which is stored in event memory is disabled the event memory entry is not available anymore. - The Dem NvM-blocks has to be invalidated after re-calibration was performed (in order to avoid data inconsistency). - For service 0x19, if the DTC referenced by the event ID is identified by the algorithm, the value of the DTC will be returned. In case calibration occurs with 0 for the event ID and the service is called again, the DTC referenced by the disabled event is identified by the algorithm, the DTC returned by the service is DEM_NO_DTC. - If re-calibration is performed during Dem processing or without invalidation of outdated Dem NvM-blocks the Dem behavior is undefined (can lead e.g. to segmentation faults in the worst case).
            EventAvailable_23: resulting-properties={base-type=uint8, sw-bit-representation={bit-position=7, number-of-bits=1}, sw-calibration-access=READ-WRITE, data-constr=uint8}, symbol=[2]  # Availability of event EVENT_MCU_CRC_REGISTERS (1 means enabled, 0 means disabled) - Calibration of this value is only allowed before Dem_PreInit() is called. - If the event which provides the OBD freeze frame is disabled the OBD freeze frame will not be updated and no OBD freeze frame will be provided to the Dcm. - If an event which is stored in event memory is disabled the event memory entry is not available anymore. - The Dem NvM-blocks has to be invalidated after re-calibration was performed (in order to avoid data inconsistency). - For service 0x19, if the DTC referenced by the event ID is identified by the algorithm, the value of the DTC will be returned. In case calibration occurs with 0 for the event ID and the service is called again, the DTC referenced by the disabled event is identified by the algorithm, the DTC returned by the service is DEM_NO_DTC. - If re-calibration is performed during Dem processing or without invalidation of outdated Dem NvM-blocks the Dem behavior is undefined (can lead e.g. to segmentation faults in the worst case).
    resource consumption ResourceConsumption
      11 x memory section:
        VAR_NO_INIT_32: alignment=32, sw-addrmethod=VAR_NOINIT
        VAR_NO_INIT_16: alignment=16, sw-addrmethod=VAR_NOINIT
        VAR_NO_INIT_8: alignment=8, sw-addrmethod=VAR_NOINIT
        VAR_SAVED_ZONE_16: alignment=16, sw-addrmethod=VAR_NOINIT
        VAR_SAVED_ZONE_UNSPECIFIED: alignment=UNSPECIFIED, sw-addrmethod=VAR_NOINIT
        VAR_NO_INIT_UNSPECIFIED: alignment=UNSPECIFIED, sw-addrmethod=VAR_NOINIT
        VAR_INIT_UNSPECIFIED: alignment=UNSPECIFIED, sw-addrmethod=VAR
        VAR_CLEARED_8: alignment=8, sw-addrmethod=VAR_CLEARED
        CONST_UNSPECIFIED: alignment=UNSPECIFIED, sw-addrmethod=CONST
        CONST_8: alignment=8, sw-addrmethod=CONST
        CODE: sw-addrmethod=CODE
