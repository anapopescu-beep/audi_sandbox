AUTOSAR XML (schema 4-0-3)
package /AUTOSAR_BaseNXP/BswModuleDescriptions
  bsw module description BaseNXP: module-id=0, provided-entrys=BaseNXP_Init
    bsw internal behavior InternalBehavior_0
      bsw called entity BaseNXP_Init: implemented-entry=BaseNXP_Init
package /AUTOSAR_BaseNXP/BswModuleEntrys
  bsw module entry BaseNXP_Init: service-id=16, is-reentrant=false, is-synchronous=true, call-type=REGULAR, execution-context=UNSPECIFIED, sw-service-impl-policy=STANDARD
package /BaseNXP_TS_T40D2M10I1R0/Implementations
  bsw implementation BswImplementation_0: programming-language=C, sw-version=1.0.1, vendor-id=43, ar-release-version=4.4.0, behavior=InternalBehavior_0, vendor-specific-module-def=BaseNXP
    code-descriptors:
      code Files
        artifact-descriptors:
          short-label=make::BaseNXP_defs.mak, category=SWMAKE
          short-label=make::BaseNXP_rules.mak, category=SWMAKE
    resource consumption ResourceConsumption
      7 x memory section:
        BASENXP_CODE: sw-addrmethod=CODE, symbol=CODE
        BASENXP_CONFIG_DATA_UNSPECIFIED: alignment=UNSPECIFIED, sw-addrmethod=CONFIG_DATA, symbol=CONFIG_DATA_UNSPECIFIED
        BASENXP_VAR_CLEARED_32: alignment=32, sw-addrmethod=VAR_CLEARED, symbol=VAR_CLEARED_32
        BASENXP_VAR_CLEARED_BOOLEAN: alignment=BOOLEAN, sw-addrmethod=VAR_CLEARED, symbol=VAR_CLEARED_BOOLEAN
        BASENXP_VAR_CLEARED_UNSPECIFIED: alignment=UNSPECIFIED, sw-addrmethod=VAR_CLEARED, symbol=VAR_CLEARED_UNSPECIFIED
        MCU_CODE: prefix=MCU, sw-addrmethod=CODE, symbol=CODE
        MCU_CONFIG_DATA_UNSPECIFIED: alignment=UNSPECIFIED, prefix=MCU, sw-addrmethod=CONFIG_DATA, symbol=CONFIG_DATA_UNSPECIFIED
      section name prefix MCU
