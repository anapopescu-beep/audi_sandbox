AUTOSAR XML (schema 4-0-3)
standard types defined: Std_ReturnType, void, boolean, uint8, uint16, uint32, sint8, sint16, sint32, float32, float64, sint64, uint64, sint8_least, sint16_least, sint32_least, uint8_least, uint16_least, uint32_least
package /AUTOSAR_Std/ImplementationDataTypes
  impl type Std_VersionInfoType: category=STRUCTURE, type-emitter=Std_Types.h
    5 x element, all with category=TYPE_REFERENCE:
      vendorID: implementation-data-type=ImplementationDataTypes/uint16
      moduleID: implementation-data-type=ImplementationDataTypes/uint16
      sw_major_version: implementation-data-type=ImplementationDataTypes/uint8
      sw_minor_version: implementation-data-type=ImplementationDataTypes/uint8
      sw_patch_version: implementation-data-type=ImplementationDataTypes/uint8
  impl type Std_MessageTypeType: compu {0=STD_MESSAGETYPE_REQUEST, 1=STD_MESSAGETYPE_RESPONSE}, implementation-data-type=ImplementationDataTypes/uint8, type-emitter=Std_Types.h
  impl type Std_MessageResultType: compu {0=STD_MESSAGRESULT_OK, 1=STD_MESSAGERESULT_ERROR}, implementation-data-type=ImplementationDataTypes/uint8, type-emitter=Std_Types.h
package /AUTOSAR_Platform/ImplementationDataTypes
  impl type ConstVoidPtr: category=DATA_REFERENCE, sw-pointer-target-props={target-category=VALUE, base-type=BaseTypes/void, sw-impl-policy=CONST}, type-emitter=BSW
  impl type VoidPtr: category=DATA_REFERENCE, sw-pointer-target-props={target-category=VALUE, base-type=BaseTypes/void}, type-emitter=BSW
package /AUTOSAR_Comtype/ImplementationDataTypes
  13 x impl type, all with type-emitter=BSW:
    IcomConfigIdType: range raw 0x00..0xFF, implementation-data-type=ImplementationDataTypes/uint8
    IcomSwitch_ErrorType: compu {0x00=ICOM_SWITCH_E_OK, 0x01=ICOM_SWITCH_E_FAILED}, range raw 0..1, implementation-data-type=ImplementationDataTypes/uint8
    NetworkHandleType: range raw 0x00..0xFF, implementation-data-type=ImplementationDataTypes/uint8
    PduInfoType: category=STRUCTURE
      element SduDataPtr: category=DATA_REFERENCE, sw-pointer-target-props={target-category=TYPE_REFERENCE, implementation-data-type=ImplementationDataTypes/uint8}
      element SduLength: implementation-data-type=ImplementationDataTypes/PduLengthType
    PNCHandleType: range raw 0..503, implementation-data-type=ImplementationDataTypes/uint16
    RetryInfoType: category=STRUCTURE
      element TpDataState: implementation-data-type=ImplementationDataTypes/TpDataStateType
      element TxTpDataCnt: implementation-data-type=ImplementationDataTypes/PduLengthType
    TpDataStateType: compu {0x00=TP_DATACONF, 0x01=TP_DATARETRY, 0x02=TP_CONFPENDING}, range raw 0..2, implementation-data-type=ImplementationDataTypes/uint8
    TPParameterType: compu {0=TP_STMIN, 1=TP_BS, 2=TP_BC}, range raw 0..2, implementation-data-type=ImplementationDataTypes/uint8
    PduIdType: range raw 0..65535, implementation-data-type=ImplementationDataTypes/uint16
    PduLengthType: range raw 0..65535, implementation-data-type=ImplementationDataTypes/uint16
    BufReq_ReturnType: compu {0=BUFREQ_OK, 1=BUFREQ_E_NOT_OK, 2=BUFREQ_E_BUSY, 3=BUFREQ_E_OVFL}, range raw 0..3, implementation-data-type=ImplementationDataTypes/uint8
    NotifResultType: implementation-data-type=ImplementationDataTypes/uint8
    BusTrcvErrorType: compu {0x00=BUSTRCV_OK, 0x01=BUSTRCV_E_ERROR}, range raw 0x00..0x78, implementation-data-type=ImplementationDataTypes/uint8
package /AUTOSAR_Comtype/CompuMethods
  compu method TPParameterType_Literals: 0=TP_STMIN, 1=TP_BS, 2=TP_BC
  compu method BufReq_ReturnType_Literals: 0=BUFREQ_OK, 1=BUFREQ_E_NOT_OK, 2=BUFREQ_E_BUSY, 3=BUFREQ_E_OVFL
  compu method TpDataStateType_Literals: 0=TP_DATACONF, 1=TP_DATARETRY, 2=TP_CONFPENDING
package /AUTOSAR_ComStack_Types/ImplementationDataTypes
  13 x impl type, all with type-emitter=BSW:
    IcomConfigIdType: range raw 0x00..0xFF, implementation-data-type=ImplementationDataTypes/uint8
    IcomSwitch_ErrorType: compu {0x00=ICOM_SWITCH_E_OK, 0x01=ICOM_SWITCH_E_FAILED}, range raw 0..1, implementation-data-type=ImplementationDataTypes/uint8
    NetworkHandleType: range raw 0x00..0xFF, implementation-data-type=ImplementationDataTypes/uint8
    PduInfoType: category=STRUCTURE
      element SduDataPtr: category=DATA_REFERENCE, sw-pointer-target-props={target-category=TYPE_REFERENCE, implementation-data-type=ImplementationDataTypes/uint8}
      element SduLength: implementation-data-type=ImplementationDataTypes/PduLengthType
    PNCHandleType: range raw 0..503, implementation-data-type=ImplementationDataTypes/uint16
    RetryInfoType: category=STRUCTURE
      element TpDataState: implementation-data-type=ImplementationDataTypes/TpDataStateType
      element TxTpDataCnt: implementation-data-type=ImplementationDataTypes/PduLengthType
    TpDataStateType: compu {0x00=TP_DATACONF, 0x01=TP_DATARETRY, 0x02=TP_CONFPENDING}, range raw 0..2, implementation-data-type=ImplementationDataTypes/uint8
    TPParameterType: compu {0=TP_STMIN, 1=TP_BS, 2=TP_BC}, range raw 0..2, implementation-data-type=ImplementationDataTypes/uint8
    PduIdType: range raw 0..65535, implementation-data-type=ImplementationDataTypes/uint16
    PduLengthType: range raw 0..65535, implementation-data-type=ImplementationDataTypes/uint16
    BufReq_ReturnType: compu {0=BUFREQ_OK, 1=BUFREQ_E_NOT_OK, 2=BUFREQ_E_BUSY, 3=BUFREQ_E_OVFL}, range raw 0..3, implementation-data-type=ImplementationDataTypes/uint8
    NotifResultType: implementation-data-type=ImplementationDataTypes/uint8
    BusTrcvErrorType: compu {0x00=BUSTRCV_OK, 0x01=BUSTRCV_E_ERROR}, range raw 0x00..0x78, implementation-data-type=ImplementationDataTypes/uint8
package /AUTOSAR_GenDef/ImplementationDataTypes
  impl type ConstVoidPtr: category=DATA_REFERENCE, sw-pointer-target-props={target-category=VALUE, base-type=BaseTypes/void, sw-impl-policy=CONST}, type-emitter=BSW
  impl type VoidPtr: category=DATA_REFERENCE, sw-pointer-target-props={target-category=VALUE, base-type=BaseTypes/void}, type-emitter=BSW
package /AUTOSAR_Can/ImplementationDataTypes
  7 x impl type, all with type-emitter=BSW:
    Can_IdType: implementation-data-type=ImplementationDataTypes/uint32
    Can_HwHandleType: implementation-data-type=ImplementationDataTypes/uint8
    Can_PduType: category=STRUCTURE
      4 x element:
        id: implementation-data-type=ImplementationDataTypes/Can_IdType
        length: implementation-data-type=ImplementationDataTypes/uint8
        sdu: category=DATA_REFERENCE, sw-pointer-target-props={target-category=TYPE_REFERENCE, implementation-data-type=ImplementationDataTypes/uint8}
        swPduHandle: implementation-data-type=ImplementationDataTypes/PduIdType
    Can_StateTransitionType: compu {0=CAN_T_START, 1=CAN_T_STOP, 2=CAN_T_SLEEP, 3=CAN_T_WAKEUP}, implementation-data-type=ImplementationDataTypes/uint32
    Can_ReturnType: compu {0=CAN_OK, 1=CAN_NOT_OK, 2=CAN_BUSY}, implementation-data-type=ImplementationDataTypes/uint32
    Can_ErrorStateType: compu-method=Can_ErrorStateType, implementation-data-type=ImplementationDataTypes/uint32
    Can_ControllerStateType: compu {0=CAN_CS_UNINIT, 1=CAN_CS_STARTED, 2=CAN_CS_STOPPED, 3=CAN_CS_SLEEP}, implementation-data-type=ImplementationDataTypes/uint32
package /AUTOSAR_Can/CompuMethods
  compu method Can_ErrorStateType: 0=CAN_ERRORSTATE_ACTIVE, 1=CAN_ERRORSTATE_PASSIVE, 2=CAN_ERRORSTATE_BUSOFF
package /AUTOSAR_CanTrcv/ImplementationDataTypes
  5 x impl type, all with category=TYPE_REFERENCE, implementation-data-type=ImplementationDataTypes/uint32, type-emitter=BSW:
    CanTrcv_TrcvModeType: compu-method=CanTrcv_TrcvModeType_Literals
    CanTrcv_TrcvWakeupReasonType: compu-method=CanTrcv_TrcvWakeupReasonType_Literals
    CanTrcv_TrcvWakeupModeType: compu-method=CanTrcv_TrcvWakeupModeType_Literals
    CanTrcv_PNActivationType: compu {0=PN_ENABLED, 1=PN_DISABLED}
    CanTrcv_TrcvFlagStateType: compu {0=CANTRCV_FLAG_SET, 1=CANTRCV_FLAG_CLEARED}
package /AUTOSAR_CanTrcv/CompuMethods
  compu method CanTrcv_TrcvModeType_Literals: 0=CANTRCV_TRCVMODE_NORMAL, 1=CANTRCV_TRCVMODE_SLEEP, 2=CANTRCV_TRCVMODE_STANDBY
  compu method CanTrcv_TrcvWakeupReasonType_Literals: 0=CANTRCV_WU_BY_BUS, 1=CANTRCV_WU_BY_PIN, 2=CANTRCV_WU_ERROR, 3=CANTRCV_WU_INTERNALLY, 4=CANTRCV_WU_NOT_SUPPORTED, 5=CANTRCV_WU_POWER_ON, 6=CANTRCV_WU_RESET
  compu method CanTrcv_TrcvWakeupModeType_Literals: 0=CANTRCV_WUMODE_CLEAR, 1=CANTRCV_WUMODE_DISABLE, 2=CANTRCV_WUMODE_ENABLE
package /AUTOSAR_MemMap/SwAddrMethods
  87 x sw addr method:
    CODE: memory-allocation-keyword-policy=ADDR-METHOD-SHORT-NAME, section-type=CODE
    CODE_ASIL_A: memory-allocation-keyword-policy=ADDR-METHOD-SHORT-NAME, options=safetyAsilA, section-type=CODE
    CODE_ASIL_B: memory-allocation-keyword-policy=ADDR-METHOD-SHORT-NAME, options=safetyAsilB, section-type=CODE
    CODE_ASIL_C: memory-allocation-keyword-policy=ADDR-METHOD-SHORT-NAME, options=safetyAsilC, section-type=CODE
    CODE_ASIL_D: memory-allocation-keyword-policy=ADDR-METHOD-SHORT-NAME, options=safetyAsilD, section-type=CODE
    CODE_LOCAL: memory-allocation-keyword-policy=ADDR-METHOD-SHORT-NAME, options=coreLocal, section-type=CODE
    CODE_ASIL_A_LOCAL: memory-allocation-keyword-policy=ADDR-METHOD-SHORT-NAME, options=[safetyAsilA, coreLocal], section-type=CODE
    CODE_ASIL_B_LOCAL: memory-allocation-keyword-policy=ADDR-METHOD-SHORT-NAME, options=[safetyAsilB, coreLocal], section-type=CODE
    CODE_ASIL_C_LOCAL: memory-allocation-keyword-policy=ADDR-METHOD-SHORT-NAME, options=[safetyAsilC, coreLocal], section-type=CODE
    CODE_ASIL_D_LOCAL: memory-allocation-keyword-policy=ADDR-METHOD-SHORT-NAME, options=[safetyAsilD, coreLocal], section-type=CODE
    CALLOUT_CODE: memory-allocation-keyword-policy=ADDR-METHOD-SHORT-NAME, section-type=CODE
    CALLOUT_CODE_ASIL_A: memory-allocation-keyword-policy=ADDR-METHOD-SHORT-NAME, options=safetyAsilA, section-type=CODE
    CALLOUT_CODE_ASIL_B: memory-allocation-keyword-policy=ADDR-METHOD-SHORT-NAME, options=safetyAsilB, section-type=CODE
    CALLOUT_CODE_ASIL_C: memory-allocation-keyword-policy=ADDR-METHOD-SHORT-NAME, options=safetyAsilC, section-type=CODE
    CALLOUT_CODE_ASIL_D: memory-allocation-keyword-policy=ADDR-METHOD-SHORT-NAME, options=safetyAsilD, section-type=CODE
    CALLOUT_CODE_LOCAL: memory-allocation-keyword-policy=ADDR-METHOD-SHORT-NAME, options=coreLocal, section-type=CODE
    CALLOUT_CODE_ASIL_A_LOCAL: memory-allocation-keyword-policy=ADDR-METHOD-SHORT-NAME, options=[safetyAsilA, coreLocal], section-type=CODE
    CALLOUT_CODE_ASIL_B_LOCAL: memory-allocation-keyword-policy=ADDR-METHOD-SHORT-NAME, options=[safetyAsilB, coreLocal], section-type=CODE
    CALLOUT_CODE_ASIL_C_LOCAL: memory-allocation-keyword-policy=ADDR-METHOD-SHORT-NAME, options=[safetyAsilC, coreLocal], section-type=CODE
    CALLOUT_CODE_ASIL_D_LOCAL: memory-allocation-keyword-policy=ADDR-METHOD-SHORT-NAME, options=[safetyAsilD, coreLocal], section-type=CODE
    VAR: memory-allocation-keyword-policy=ADDR-METHOD-SHORT-NAME-AND-ALIGNMENT, section-initialization-policy=INIT, section-type=VAR
    VAR_INIT: memory-allocation-keyword-policy=ADDR-METHOD-SHORT-NAME-AND-ALIGNMENT, section-initialization-policy=INIT, section-type=VAR
    VAR_INIT_ASIL_A: memory-allocation-keyword-policy=ADDR-METHOD-SHORT-NAME-AND-ALIGNMENT, options=safetyAsilA, section-initialization-policy=INIT, section-type=VAR
    VAR_INIT_ASIL_B: memory-allocation-keyword-policy=ADDR-METHOD-SHORT-NAME-AND-ALIGNMENT, options=safetyAsilB, section-initialization-policy=INIT, section-type=VAR
    VAR_INIT_ASIL_C: memory-allocation-keyword-policy=ADDR-METHOD-SHORT-NAME-AND-ALIGNMENT, options=safetyAsilC, section-initialization-policy=INIT, section-type=VAR
    VAR_INIT_ASIL_D: memory-allocation-keyword-policy=ADDR-METHOD-SHORT-NAME-AND-ALIGNMENT, options=safetyAsilD, section-initialization-policy=INIT, section-type=VAR
    VAR_INIT_LOCAL: memory-allocation-keyword-policy=ADDR-METHOD-SHORT-NAME-AND-ALIGNMENT, options=coreLocal, section-initialization-policy=INIT, section-type=VAR
    VAR_INIT_ASIL_A_LOCAL: memory-allocation-keyword-policy=ADDR-METHOD-SHORT-NAME-AND-ALIGNMENT, options=[safetyAsilA, coreLocal], section-initialization-policy=INIT, section-type=VAR
    VAR_INIT_ASIL_B_LOCAL: memory-allocation-keyword-policy=ADDR-METHOD-SHORT-NAME-AND-ALIGNMENT, options=[safetyAsilB, coreLocal], section-initialization-policy=INIT, section-type=VAR
    VAR_INIT_ASIL_C_LOCAL: memory-allocation-keyword-policy=ADDR-METHOD-SHORT-NAME-AND-ALIGNMENT, options=[safetyAsilC, coreLocal], section-initialization-policy=INIT, section-type=VAR
    VAR_INIT_ASIL_D_LOCAL: memory-allocation-keyword-policy=ADDR-METHOD-SHORT-NAME-AND-ALIGNMENT, options=[safetyAsilD, coreLocal], section-initialization-policy=INIT, section-type=VAR
    VAR_NOINIT: memory-allocation-keyword-policy=ADDR-METHOD-SHORT-NAME-AND-ALIGNMENT, section-initialization-policy=NO-INIT, section-type=VAR
    VAR_NO_INIT: memory-allocation-keyword-policy=ADDR-METHOD-SHORT-NAME-AND-ALIGNMENT, section-initialization-policy=NO-INIT, section-type=VAR
    VAR_NO_INIT_ASIL_A: memory-allocation-keyword-policy=ADDR-METHOD-SHORT-NAME-AND-ALIGNMENT, options=safetyAsilA, section-initialization-policy=NO-INIT, section-type=VAR
    VAR_NO_INIT_ASIL_B: memory-allocation-keyword-policy=ADDR-METHOD-SHORT-NAME-AND-ALIGNMENT, options=safetyAsilB, section-initialization-policy=NO-INIT, section-type=VAR
    VAR_NO_INIT_ASIL_C: memory-allocation-keyword-policy=ADDR-METHOD-SHORT-NAME-AND-ALIGNMENT, options=safetyAsilC, section-initialization-policy=NO-INIT, section-type=VAR
    VAR_NO_INIT_ASIL_D: memory-allocation-keyword-policy=ADDR-METHOD-SHORT-NAME-AND-ALIGNMENT, options=safetyAsilD, section-initialization-policy=NO-INIT, section-type=VAR
    VAR_SAVED_ZONE: memory-allocation-keyword-policy=ADDR-METHOD-SHORT-NAME-AND-ALIGNMENT, section-initialization-policy=NO-INIT, section-type=VAR
    VAR_SAVED_ZONE_ASIL_A: memory-allocation-keyword-policy=ADDR-METHOD-SHORT-NAME-AND-ALIGNMENT, options=safetyAsilA, section-initialization-policy=NO-INIT, section-type=VAR
    VAR_SAVED_ZONE_ASIL_B: memory-allocation-keyword-policy=ADDR-METHOD-SHORT-NAME-AND-ALIGNMENT, options=safetyAsilB, section-initialization-policy=NO-INIT, section-type=VAR
    VAR_SAVED_ZONE_ASIL_C: memory-allocation-keyword-policy=ADDR-METHOD-SHORT-NAME-AND-ALIGNMENT, options=safetyAsilC, section-initialization-policy=NO-INIT, section-type=VAR
    VAR_SAVED_ZONE_ASIL_D: memory-allocation-keyword-policy=ADDR-METHOD-SHORT-NAME-AND-ALIGNMENT, options=safetyAsilD, section-initialization-policy=NO-INIT, section-type=VAR
    VAR_CLEARED: memory-allocation-keyword-policy=ADDR-METHOD-SHORT-NAME-AND-ALIGNMENT, section-initialization-policy=CLEARED, section-type=VAR
    VAR_CLEARED_ASIL_A: memory-allocation-keyword-policy=ADDR-METHOD-SHORT-NAME-AND-ALIGNMENT, options=safetyAsilA, section-initialization-policy=CLEARED, section-type=VAR
    VAR_CLEARED_ASIL_B: memory-allocation-keyword-policy=ADDR-METHOD-SHORT-NAME-AND-ALIGNMENT, options=safetyAsilB, section-initialization-policy=CLEARED, section-type=VAR
    VAR_CLEARED_ASIL_C: memory-allocation-keyword-policy=ADDR-METHOD-SHORT-NAME-AND-ALIGNMENT, options=safetyAsilC, section-initialization-policy=CLEARED, section-type=VAR
    VAR_CLEARED_ASIL_D: memory-allocation-keyword-policy=ADDR-METHOD-SHORT-NAME-AND-ALIGNMENT, options=safetyAsilD, section-initialization-policy=CLEARED, section-type=VAR
    VAR_CLEARED_LOCAL: memory-allocation-keyword-policy=ADDR-METHOD-SHORT-NAME-AND-ALIGNMENT, options=coreLocal, section-initialization-policy=CLEARED, section-type=VAR
    VAR_CLEARED_ASIL_A_LOCAL: memory-allocation-keyword-policy=ADDR-METHOD-SHORT-NAME-AND-ALIGNMENT, options=[safetyAsilA, coreLocal], section-initialization-policy=CLEARED, section-type=VAR
    VAR_CLEARED_ASIL_B_LOCAL: memory-allocation-keyword-policy=ADDR-METHOD-SHORT-NAME-AND-ALIGNMENT, options=[safetyAsilB, coreLocal], section-initialization-policy=CLEARED, section-type=VAR
    VAR_CLEARED_ASIL_C_LOCAL: memory-allocation-keyword-policy=ADDR-METHOD-SHORT-NAME-AND-ALIGNMENT, options=[safetyAsilC, coreLocal], section-initialization-policy=CLEARED, section-type=VAR
    VAR_CLEARED_ASIL_D_LOCAL: memory-allocation-keyword-policy=ADDR-METHOD-SHORT-NAME-AND-ALIGNMENT, options=[safetyAsilD, coreLocal], section-initialization-policy=CLEARED, section-type=VAR
    VAR_POWER_ON_INIT: memory-allocation-keyword-policy=ADDR-METHOD-SHORT-NAME-AND-ALIGNMENT, section-initialization-policy=POWER-ON-INIT, section-type=VAR
    VAR_POWER_ON_INIT_ASIL_A: memory-allocation-keyword-policy=ADDR-METHOD-SHORT-NAME-AND-ALIGNMENT, options=safetyAsilA, section-initialization-policy=POWER-ON-INIT, section-type=VAR
    VAR_POWER_ON_INIT_ASIL_B: memory-allocation-keyword-policy=ADDR-METHOD-SHORT-NAME-AND-ALIGNMENT, options=safetyAsilB, section-initialization-policy=POWER-ON-INIT, section-type=VAR
    VAR_POWER_ON_INIT_ASIL_C: memory-allocation-keyword-policy=ADDR-METHOD-SHORT-NAME-AND-ALIGNMENT, options=safetyAsilC, section-initialization-policy=POWER-ON-INIT, section-type=VAR
    VAR_POWER_ON_INIT_ASIL_D: memory-allocation-keyword-policy=ADDR-METHOD-SHORT-NAME-AND-ALIGNMENT, options=safetyAsilD, section-initialization-policy=POWER-ON-INIT, section-type=VAR
    VAR_POWER_ON_CLEARED: memory-allocation-keyword-policy=ADDR-METHOD-SHORT-NAME-AND-ALIGNMENT, section-initialization-policy=POWER-ON-CLEARED, section-type=VAR
    VAR_POWER_ON_CLEARED_ASIL_A: memory-allocation-keyword-policy=ADDR-METHOD-SHORT-NAME-AND-ALIGNMENT, options=safetyAsilA, section-initialization-policy=POWER-ON-CLEARED, section-type=VAR
    VAR_POWER_ON_CLEARED_ASIL_B: memory-allocation-keyword-policy=ADDR-METHOD-SHORT-NAME-AND-ALIGNMENT, options=safetyAsilB, section-initialization-policy=POWER-ON-CLEARED, section-type=VAR
    VAR_POWER_ON_CLEARED_ASIL_C: memory-allocation-keyword-policy=ADDR-METHOD-SHORT-NAME-AND-ALIGNMENT, options=safetyAsilC, section-initialization-policy=POWER-ON-CLEARED, section-type=VAR
    VAR_POWER_ON_CLEARED_ASIL_D: memory-allocation-keyword-policy=ADDR-METHOD-SHORT-NAME-AND-ALIGNMENT, options=safetyAsilD, section-initialization-policy=POWER-ON-CLEARED, section-type=VAR
    VAR_FAST: memory-allocation-keyword-policy=ADDR-METHOD-SHORT-NAME-AND-ALIGNMENT, section-initialization-policy=INIT, section-type=VAR-FAST
    VAR_FAST_ASIL_A: memory-allocation-keyword-policy=ADDR-METHOD-SHORT-NAME-AND-ALIGNMENT, options=safetyAsilA, section-initialization-policy=INIT, section-type=VAR-FAST
    VAR_FAST_ASIL_B: memory-allocation-keyword-policy=ADDR-METHOD-SHORT-NAME-AND-ALIGNMENT, options=safetyAsilB, section-initialization-policy=INIT, section-type=VAR-FAST
    VAR_FAST_ASIL_C: memory-allocation-keyword-policy=ADDR-METHOD-SHORT-NAME-AND-ALIGNMENT, options=safetyAsilC, section-initialization-policy=INIT, section-type=VAR-FAST
    VAR_FAST_ASIL_D: memory-allocation-keyword-policy=ADDR-METHOD-SHORT-NAME-AND-ALIGNMENT, options=safetyAsilD, section-initialization-policy=INIT, section-type=VAR-FAST
    VAR_FAST_LOCAL: memory-allocation-keyword-policy=ADDR-METHOD-SHORT-NAME-AND-ALIGNMENT, options=coreLocal, section-initialization-policy=INIT, section-type=VAR-FAST
    VAR_FAST_ASIL_A_LOCAL: memory-allocation-keyword-policy=ADDR-METHOD-SHORT-NAME-AND-ALIGNMENT, options=[safetyAsilA, coreLocal], section-initialization-policy=INIT, section-type=VAR-FAST
    VAR_FAST_ASIL_B_LOCAL: memory-allocation-keyword-policy=ADDR-METHOD-SHORT-NAME-AND-ALIGNMENT, options=[safetyAsilB, coreLocal], section-initialization-policy=INIT, section-type=VAR-FAST
    VAR_FAST_ASIL_C_LOCAL: memory-allocation-keyword-policy=ADDR-METHOD-SHORT-NAME-AND-ALIGNMENT, options=[safetyAsilC, coreLocal], section-initialization-policy=INIT, section-type=VAR-FAST
    VAR_FAST_ASIL_D_LOCAL: memory-allocation-keyword-policy=ADDR-METHOD-SHORT-NAME-AND-ALIGNMENT, options=[safetyAsilD, coreLocal], section-initialization-policy=INIT, section-type=VAR-FAST
    CONST: memory-allocation-keyword-policy=ADDR-METHOD-SHORT-NAME-AND-ALIGNMENT, section-type=CONST
    CONST_ASIL_A: memory-allocation-keyword-policy=ADDR-METHOD-SHORT-NAME-AND-ALIGNMENT, options=safetyAsilA, section-type=CONST
    CONST_ASIL_B: memory-allocation-keyword-policy=ADDR-METHOD-SHORT-NAME-AND-ALIGNMENT, options=safetyAsilB, section-type=CONST
    CONST_ASIL_C: memory-allocation-keyword-policy=ADDR-METHOD-SHORT-NAME-AND-ALIGNMENT, options=safetyAsilC, section-type=CONST
    CONST_ASIL_D: memory-allocation-keyword-policy=ADDR-METHOD-SHORT-NAME-AND-ALIGNMENT, options=safetyAsilD, section-type=CONST
    CALIB: memory-allocation-keyword-policy=ADDR-METHOD-SHORT-NAME-AND-ALIGNMENT, section-initialization-policy=INIT, section-type=CALPRM
    CALIB_ASIL_A: memory-allocation-keyword-policy=ADDR-METHOD-SHORT-NAME-AND-ALIGNMENT, options=safetyAsilA, section-initialization-policy=INIT, section-type=CALPRM
    CALIB_ASIL_B: memory-allocation-keyword-policy=ADDR-METHOD-SHORT-NAME-AND-ALIGNMENT, options=safetyAsilB, section-initialization-policy=INIT, section-type=CALPRM
    CALIB_ASIL_C: memory-allocation-keyword-policy=ADDR-METHOD-SHORT-NAME-AND-ALIGNMENT, options=safetyAsilC, section-initialization-policy=INIT, section-type=CALPRM
    CALIB_ASIL_D: memory-allocation-keyword-policy=ADDR-METHOD-SHORT-NAME-AND-ALIGNMENT, options=safetyAsilD, section-initialization-policy=INIT, section-type=CALPRM
    CONFIG_DATA: memory-allocation-keyword-policy=ADDR-METHOD-SHORT-NAME-AND-ALIGNMENT, section-type=CONFIG-DATA
    CONFIG_DATA_ASIL_A: memory-allocation-keyword-policy=ADDR-METHOD-SHORT-NAME-AND-ALIGNMENT, options=safetyAsilA, section-type=CONFIG-DATA
    CONFIG_DATA_ASIL_B: memory-allocation-keyword-policy=ADDR-METHOD-SHORT-NAME-AND-ALIGNMENT, options=safetyAsilB, section-type=CONFIG-DATA
    CONFIG_DATA_ASIL_C: memory-allocation-keyword-policy=ADDR-METHOD-SHORT-NAME-AND-ALIGNMENT, options=safetyAsilC, section-type=CONFIG-DATA
    CONFIG_DATA_ASIL_D: memory-allocation-keyword-policy=ADDR-METHOD-SHORT-NAME-AND-ALIGNMENT, options=safetyAsilD, section-type=CONFIG-DATA
package /AUTOSAR/Std/ImplementationDataTypes
  impl type Std_VersionInfoType: category=STRUCTURE, type-emitter=Std_Types.h
    5 x element, all with category=TYPE_REFERENCE:
      vendorID: implementation-data-type=ImplementationDataTypes/uint16
      moduleID: implementation-data-type=ImplementationDataTypes/uint16
      sw_major_version: implementation-data-type=ImplementationDataTypes/uint8
      sw_minor_version: implementation-data-type=ImplementationDataTypes/uint8
      sw_patch_version: implementation-data-type=ImplementationDataTypes/uint8
  impl type Std_MessageTypeType: compu {0=STD_MESSAGETYPE_REQUEST, 1=STD_MESSAGETYPE_RESPONSE}, implementation-data-type=ImplementationDataTypes/uint8, type-emitter=Std_Types.h
  impl type Std_MessageResultType: compu {0=STD_MESSAGRESULT_OK, 1=STD_MESSAGERESULT_ERROR}, implementation-data-type=ImplementationDataTypes/uint8, type-emitter=Std_Types.h
package /AUTOSAR/Platform/ImplementationDataTypes
  impl type ConstVoidPtr: category=DATA_REFERENCE, sw-pointer-target-props={target-category=VALUE, base-type=BaseTypes/void, sw-impl-policy=CONST}, type-emitter=BSW
  impl type VoidPtr: category=DATA_REFERENCE, sw-pointer-target-props={target-category=VALUE, base-type=BaseTypes/void}, type-emitter=BSW
package /AUTOSAR/Comtype/ImplementationDataTypes
  13 x impl type, all with type-emitter=BSW:
    IcomConfigIdType: range raw 0x00..0xFF, implementation-data-type=ImplementationDataTypes/uint8
    IcomSwitch_ErrorType: compu {0x00=ICOM_SWITCH_E_OK, 0x01=ICOM_SWITCH_E_FAILED}, range raw 0..1, implementation-data-type=ImplementationDataTypes/uint8
    NetworkHandleType: range raw 0x00..0xFF, implementation-data-type=ImplementationDataTypes/uint8
    PduInfoType: category=STRUCTURE
      element SduDataPtr: category=DATA_REFERENCE, sw-pointer-target-props={target-category=TYPE_REFERENCE, implementation-data-type=ImplementationDataTypes/uint8}
      element SduLength: implementation-data-type=ImplementationDataTypes/PduLengthType
    PNCHandleType: range raw 0..503, implementation-data-type=ImplementationDataTypes/uint16
    RetryInfoType: category=STRUCTURE
      element TpDataState: implementation-data-type=ImplementationDataTypes/TpDataStateType
      element TxTpDataCnt: implementation-data-type=ImplementationDataTypes/PduLengthType
    TpDataStateType: compu {0x00=TP_DATACONF, 0x01=TP_DATARETRY, 0x02=TP_CONFPENDING}, range raw 0..2, implementation-data-type=ImplementationDataTypes/uint8
    TPParameterType: compu {0=TP_STMIN, 1=TP_BS, 2=TP_BC}, range raw 0..2, implementation-data-type=ImplementationDataTypes/uint8
    PduIdType: range raw 0..65535, implementation-data-type=ImplementationDataTypes/uint16
    PduLengthType: range raw 0..65535, implementation-data-type=ImplementationDataTypes/uint16
    BufReq_ReturnType: compu {0=BUFREQ_OK, 1=BUFREQ_E_NOT_OK, 2=BUFREQ_E_BUSY, 3=BUFREQ_E_OVFL}, range raw 0..3, implementation-data-type=ImplementationDataTypes/uint8
    NotifResultType: implementation-data-type=ImplementationDataTypes/uint8
    BusTrcvErrorType: compu {0x00=BUSTRCV_OK, 0x01=BUSTRCV_E_ERROR}, range raw 0x00..0x78, implementation-data-type=ImplementationDataTypes/uint8
package /AUTOSAR/Can/ImplementationDataTypes
  7 x impl type, all with type-emitter=BSW:
    Can_IdType: implementation-data-type=ImplementationDataTypes/uint32
    Can_HwHandleType: implementation-data-type=ImplementationDataTypes/uint8
    Can_PduType: category=STRUCTURE
      4 x element:
        id: implementation-data-type=ImplementationDataTypes/Can_IdType
        length: implementation-data-type=ImplementationDataTypes/uint8
        sdu: category=DATA_REFERENCE, sw-pointer-target-props={target-category=TYPE_REFERENCE, implementation-data-type=ImplementationDataTypes/uint8}
        swPduHandle: implementation-data-type=ImplementationDataTypes/PduIdType
    Can_StateTransitionType: compu {0=CAN_T_START, 1=CAN_T_STOP, 2=CAN_T_SLEEP, 3=CAN_T_WAKEUP}, implementation-data-type=ImplementationDataTypes/uint32
    Can_ReturnType: compu {0=CAN_OK, 1=CAN_NOT_OK, 2=CAN_BUSY}, implementation-data-type=ImplementationDataTypes/uint32
    Can_ErrorStateType: compu-method=Can_ErrorStateType, implementation-data-type=ImplementationDataTypes/uint32
    Can_ControllerStateType: compu {0=CAN_CS_UNINIT, 1=CAN_CS_STARTED, 2=CAN_CS_STOPPED, 3=CAN_CS_SLEEP}, implementation-data-type=ImplementationDataTypes/uint32
package /AUTOSAR/CanTrcv/ImplementationDataTypes
  5 x impl type, all with category=TYPE_REFERENCE, implementation-data-type=ImplementationDataTypes/uint32, type-emitter=BSW:
    CanTrcv_TrcvModeType: compu-method=CanTrcv_TrcvModeType_Literals
    CanTrcv_TrcvWakeupReasonType: compu-method=CanTrcv_TrcvWakeupReasonType_Literals
    CanTrcv_TrcvWakeupModeType: compu-method=CanTrcv_TrcvWakeupModeType_Literals
    CanTrcv_PNActivationType: compu {0=PN_ENABLED, 1=PN_DISABLED}
    CanTrcv_TrcvFlagStateType: compu {0=CANTRCV_FLAG_SET, 1=CANTRCV_FLAG_CLEARED}
package /AUTOSAR/MemMap/SwAddrMethods
  87 x sw addr method:
    CODE: memory-allocation-keyword-policy=ADDR-METHOD-SHORT-NAME, section-type=CODE
    CODE_ASIL_A: memory-allocation-keyword-policy=ADDR-METHOD-SHORT-NAME, options=safetyAsilA, section-type=CODE
    CODE_ASIL_B: memory-allocation-keyword-policy=ADDR-METHOD-SHORT-NAME, options=safetyAsilB, section-type=CODE
    CODE_ASIL_C: memory-allocation-keyword-policy=ADDR-METHOD-SHORT-NAME, options=safetyAsilC, section-type=CODE
    CODE_ASIL_D: memory-allocation-keyword-policy=ADDR-METHOD-SHORT-NAME, options=safetyAsilD, section-type=CODE
    CODE_LOCAL: memory-allocation-keyword-policy=ADDR-METHOD-SHORT-NAME, options=coreLocal, section-type=CODE
    CODE_ASIL_A_LOCAL: memory-allocation-keyword-policy=ADDR-METHOD-SHORT-NAME, options=[safetyAsilA, coreLocal], section-type=CODE
    CODE_ASIL_B_LOCAL: memory-allocation-keyword-policy=ADDR-METHOD-SHORT-NAME, options=[safetyAsilB, coreLocal], section-type=CODE
    CODE_ASIL_C_LOCAL: memory-allocation-keyword-policy=ADDR-METHOD-SHORT-NAME, options=[safetyAsilC, coreLocal], section-type=CODE
    CODE_ASIL_D_LOCAL: memory-allocation-keyword-policy=ADDR-METHOD-SHORT-NAME, options=[safetyAsilD, coreLocal], section-type=CODE
    CALLOUT_CODE: memory-allocation-keyword-policy=ADDR-METHOD-SHORT-NAME, section-type=CODE
    CALLOUT_CODE_ASIL_A: memory-allocation-keyword-policy=ADDR-METHOD-SHORT-NAME, options=safetyAsilA, section-type=CODE
    CALLOUT_CODE_ASIL_B: memory-allocation-keyword-policy=ADDR-METHOD-SHORT-NAME, options=safetyAsilB, section-type=CODE
    CALLOUT_CODE_ASIL_C: memory-allocation-keyword-policy=ADDR-METHOD-SHORT-NAME, options=safetyAsilC, section-type=CODE
    CALLOUT_CODE_ASIL_D: memory-allocation-keyword-policy=ADDR-METHOD-SHORT-NAME, options=safetyAsilD, section-type=CODE
    CALLOUT_CODE_LOCAL: memory-allocation-keyword-policy=ADDR-METHOD-SHORT-NAME, options=coreLocal, section-type=CODE
    CALLOUT_CODE_ASIL_A_LOCAL: memory-allocation-keyword-policy=ADDR-METHOD-SHORT-NAME, options=[safetyAsilA, coreLocal], section-type=CODE
    CALLOUT_CODE_ASIL_B_LOCAL: memory-allocation-keyword-policy=ADDR-METHOD-SHORT-NAME, options=[safetyAsilB, coreLocal], section-type=CODE
    CALLOUT_CODE_ASIL_C_LOCAL: memory-allocation-keyword-policy=ADDR-METHOD-SHORT-NAME, options=[safetyAsilC, coreLocal], section-type=CODE
    CALLOUT_CODE_ASIL_D_LOCAL: memory-allocation-keyword-policy=ADDR-METHOD-SHORT-NAME, options=[safetyAsilD, coreLocal], section-type=CODE
    VAR: memory-allocation-keyword-policy=ADDR-METHOD-SHORT-NAME-AND-ALIGNMENT, section-initialization-policy=INIT, section-type=VAR
    VAR_INIT: memory-allocation-keyword-policy=ADDR-METHOD-SHORT-NAME-AND-ALIGNMENT, section-initialization-policy=INIT, section-type=VAR
    VAR_INIT_ASIL_A: memory-allocation-keyword-policy=ADDR-METHOD-SHORT-NAME-AND-ALIGNMENT, options=safetyAsilA, section-initialization-policy=INIT, section-type=VAR
    VAR_INIT_ASIL_B: memory-allocation-keyword-policy=ADDR-METHOD-SHORT-NAME-AND-ALIGNMENT, options=safetyAsilB, section-initialization-policy=INIT, section-type=VAR
    VAR_INIT_ASIL_C: memory-allocation-keyword-policy=ADDR-METHOD-SHORT-NAME-AND-ALIGNMENT, options=safetyAsilC, section-initialization-policy=INIT, section-type=VAR
    VAR_INIT_ASIL_D: memory-allocation-keyword-policy=ADDR-METHOD-SHORT-NAME-AND-ALIGNMENT, options=safetyAsilD, section-initialization-policy=INIT, section-type=VAR
    VAR_INIT_LOCAL: memory-allocation-keyword-policy=ADDR-METHOD-SHORT-NAME-AND-ALIGNMENT, options=coreLocal, section-initialization-policy=INIT, section-type=VAR
    VAR_INIT_ASIL_A_LOCAL: memory-allocation-keyword-policy=ADDR-METHOD-SHORT-NAME-AND-ALIGNMENT, options=[safetyAsilA, coreLocal], section-initialization-policy=INIT, section-type=VAR
    VAR_INIT_ASIL_B_LOCAL: memory-allocation-keyword-policy=ADDR-METHOD-SHORT-NAME-AND-ALIGNMENT, options=[safetyAsilB, coreLocal], section-initialization-policy=INIT, section-type=VAR
    VAR_INIT_ASIL_C_LOCAL: memory-allocation-keyword-policy=ADDR-METHOD-SHORT-NAME-AND-ALIGNMENT, options=[safetyAsilC, coreLocal], section-initialization-policy=INIT, section-type=VAR
    VAR_INIT_ASIL_D_LOCAL: memory-allocation-keyword-policy=ADDR-METHOD-SHORT-NAME-AND-ALIGNMENT, options=[safetyAsilD, coreLocal], section-initialization-policy=INIT, section-type=VAR
    VAR_NOINIT: memory-allocation-keyword-policy=ADDR-METHOD-SHORT-NAME-AND-ALIGNMENT, section-initialization-policy=NO-INIT, section-type=VAR
    VAR_NO_INIT: memory-allocation-keyword-policy=ADDR-METHOD-SHORT-NAME-AND-ALIGNMENT, section-initialization-policy=NO-INIT, section-type=VAR
    VAR_NO_INIT_ASIL_A: memory-allocation-keyword-policy=ADDR-METHOD-SHORT-NAME-AND-ALIGNMENT, options=safetyAsilA, section-initialization-policy=NO-INIT, section-type=VAR
    VAR_NO_INIT_ASIL_B: memory-allocation-keyword-policy=ADDR-METHOD-SHORT-NAME-AND-ALIGNMENT, options=safetyAsilB, section-initialization-policy=NO-INIT, section-type=VAR
    VAR_NO_INIT_ASIL_C: memory-allocation-keyword-policy=ADDR-METHOD-SHORT-NAME-AND-ALIGNMENT, options=safetyAsilC, section-initialization-policy=NO-INIT, section-type=VAR
    VAR_NO_INIT_ASIL_D: memory-allocation-keyword-policy=ADDR-METHOD-SHORT-NAME-AND-ALIGNMENT, options=safetyAsilD, section-initialization-policy=NO-INIT, section-type=VAR
    VAR_SAVED_ZONE: memory-allocation-keyword-policy=ADDR-METHOD-SHORT-NAME-AND-ALIGNMENT, section-initialization-policy=NO-INIT, section-type=VAR
    VAR_SAVED_ZONE_ASIL_A: memory-allocation-keyword-policy=ADDR-METHOD-SHORT-NAME-AND-ALIGNMENT, options=safetyAsilA, section-initialization-policy=NO-INIT, section-type=VAR
    VAR_SAVED_ZONE_ASIL_B: memory-allocation-keyword-policy=ADDR-METHOD-SHORT-NAME-AND-ALIGNMENT, options=safetyAsilB, section-initialization-policy=NO-INIT, section-type=VAR
    VAR_SAVED_ZONE_ASIL_C: memory-allocation-keyword-policy=ADDR-METHOD-SHORT-NAME-AND-ALIGNMENT, options=safetyAsilC, section-initialization-policy=NO-INIT, section-type=VAR
    VAR_SAVED_ZONE_ASIL_D: memory-allocation-keyword-policy=ADDR-METHOD-SHORT-NAME-AND-ALIGNMENT, options=safetyAsilD, section-initialization-policy=NO-INIT, section-type=VAR
    VAR_CLEARED: memory-allocation-keyword-policy=ADDR-METHOD-SHORT-NAME-AND-ALIGNMENT, section-initialization-policy=CLEARED, section-type=VAR
    VAR_CLEARED_ASIL_A: memory-allocation-keyword-policy=ADDR-METHOD-SHORT-NAME-AND-ALIGNMENT, options=safetyAsilA, section-initialization-policy=CLEARED, section-type=VAR
    VAR_CLEARED_ASIL_B: memory-allocation-keyword-policy=ADDR-METHOD-SHORT-NAME-AND-ALIGNMENT, options=safetyAsilB, section-initialization-policy=CLEARED, section-type=VAR
    VAR_CLEARED_ASIL_C: memory-allocation-keyword-policy=ADDR-METHOD-SHORT-NAME-AND-ALIGNMENT, options=safetyAsilC, section-initialization-policy=CLEARED, section-type=VAR
    VAR_CLEARED_ASIL_D: memory-allocation-keyword-policy=ADDR-METHOD-SHORT-NAME-AND-ALIGNMENT, options=safetyAsilD, section-initialization-policy=CLEARED, section-type=VAR
    VAR_CLEARED_LOCAL: memory-allocation-keyword-policy=ADDR-METHOD-SHORT-NAME-AND-ALIGNMENT, options=coreLocal, section-initialization-policy=CLEARED, section-type=VAR
    VAR_CLEARED_ASIL_A_LOCAL: memory-allocation-keyword-policy=ADDR-METHOD-SHORT-NAME-AND-ALIGNMENT, options=[safetyAsilA, coreLocal], section-initialization-policy=CLEARED, section-type=VAR
    VAR_CLEARED_ASIL_B_LOCAL: memory-allocation-keyword-policy=ADDR-METHOD-SHORT-NAME-AND-ALIGNMENT, options=[safetyAsilB, coreLocal], section-initialization-policy=CLEARED, section-type=VAR
    VAR_CLEARED_ASIL_C_LOCAL: memory-allocation-keyword-policy=ADDR-METHOD-SHORT-NAME-AND-ALIGNMENT, options=[safetyAsilC, coreLocal], section-initialization-policy=CLEARED, section-type=VAR
    VAR_CLEARED_ASIL_D_LOCAL: memory-allocation-keyword-policy=ADDR-METHOD-SHORT-NAME-AND-ALIGNMENT, options=[safetyAsilD, coreLocal], section-initialization-policy=CLEARED, section-type=VAR
    VAR_POWER_ON_INIT: memory-allocation-keyword-policy=ADDR-METHOD-SHORT-NAME-AND-ALIGNMENT, section-initialization-policy=POWER-ON-INIT, section-type=VAR
    VAR_POWER_ON_INIT_ASIL_A: memory-allocation-keyword-policy=ADDR-METHOD-SHORT-NAME-AND-ALIGNMENT, options=safetyAsilA, section-initialization-policy=POWER-ON-INIT, section-type=VAR
    VAR_POWER_ON_INIT_ASIL_B: memory-allocation-keyword-policy=ADDR-METHOD-SHORT-NAME-AND-ALIGNMENT, options=safetyAsilB, section-initialization-policy=POWER-ON-INIT, section-type=VAR
    VAR_POWER_ON_INIT_ASIL_C: memory-allocation-keyword-policy=ADDR-METHOD-SHORT-NAME-AND-ALIGNMENT, options=safetyAsilC, section-initialization-policy=POWER-ON-INIT, section-type=VAR
    VAR_POWER_ON_INIT_ASIL_D: memory-allocation-keyword-policy=ADDR-METHOD-SHORT-NAME-AND-ALIGNMENT, options=safetyAsilD, section-initialization-policy=POWER-ON-INIT, section-type=VAR
    VAR_POWER_ON_CLEARED: memory-allocation-keyword-policy=ADDR-METHOD-SHORT-NAME-AND-ALIGNMENT, section-initialization-policy=POWER-ON-CLEARED, section-type=VAR
    VAR_POWER_ON_CLEARED_ASIL_A: memory-allocation-keyword-policy=ADDR-METHOD-SHORT-NAME-AND-ALIGNMENT, options=safetyAsilA, section-initialization-policy=POWER-ON-CLEARED, section-type=VAR
    VAR_POWER_ON_CLEARED_ASIL_B: memory-allocation-keyword-policy=ADDR-METHOD-SHORT-NAME-AND-ALIGNMENT, options=safetyAsilB, section-initialization-policy=POWER-ON-CLEARED, section-type=VAR
    VAR_POWER_ON_CLEARED_ASIL_C: memory-allocation-keyword-policy=ADDR-METHOD-SHORT-NAME-AND-ALIGNMENT, options=safetyAsilC, section-initialization-policy=POWER-ON-CLEARED, section-type=VAR
    VAR_POWER_ON_CLEARED_ASIL_D: memory-allocation-keyword-policy=ADDR-METHOD-SHORT-NAME-AND-ALIGNMENT, options=safetyAsilD, section-initialization-policy=POWER-ON-CLEARED, section-type=VAR
    VAR_FAST: memory-allocation-keyword-policy=ADDR-METHOD-SHORT-NAME-AND-ALIGNMENT, section-initialization-policy=INIT, section-type=VAR-FAST
    VAR_FAST_ASIL_A: memory-allocation-keyword-policy=ADDR-METHOD-SHORT-NAME-AND-ALIGNMENT, options=safetyAsilA, section-initialization-policy=INIT, section-type=VAR-FAST
    VAR_FAST_ASIL_B: memory-allocation-keyword-policy=ADDR-METHOD-SHORT-NAME-AND-ALIGNMENT, options=safetyAsilB, section-initialization-policy=INIT, section-type=VAR-FAST
    VAR_FAST_ASIL_C: memory-allocation-keyword-policy=ADDR-METHOD-SHORT-NAME-AND-ALIGNMENT, options=safetyAsilC, section-initialization-policy=INIT, section-type=VAR-FAST
    VAR_FAST_ASIL_D: memory-allocation-keyword-policy=ADDR-METHOD-SHORT-NAME-AND-ALIGNMENT, options=safetyAsilD, section-initialization-policy=INIT, section-type=VAR-FAST
    VAR_FAST_LOCAL: memory-allocation-keyword-policy=ADDR-METHOD-SHORT-NAME-AND-ALIGNMENT, options=coreLocal, section-initialization-policy=INIT, section-type=VAR-FAST
    VAR_FAST_ASIL_A_LOCAL: memory-allocation-keyword-policy=ADDR-METHOD-SHORT-NAME-AND-ALIGNMENT, options=[safetyAsilA, coreLocal], section-initialization-policy=INIT, section-type=VAR-FAST
    VAR_FAST_ASIL_B_LOCAL: memory-allocation-keyword-policy=ADDR-METHOD-SHORT-NAME-AND-ALIGNMENT, options=[safetyAsilB, coreLocal], section-initialization-policy=INIT, section-type=VAR-FAST
    VAR_FAST_ASIL_C_LOCAL: memory-allocation-keyword-policy=ADDR-METHOD-SHORT-NAME-AND-ALIGNMENT, options=[safetyAsilC, coreLocal], section-initialization-policy=INIT, section-type=VAR-FAST
    VAR_FAST_ASIL_D_LOCAL: memory-allocation-keyword-policy=ADDR-METHOD-SHORT-NAME-AND-ALIGNMENT, options=[safetyAsilD, coreLocal], section-initialization-policy=INIT, section-type=VAR-FAST
    CONST: memory-allocation-keyword-policy=ADDR-METHOD-SHORT-NAME-AND-ALIGNMENT, section-type=CONST
    CONST_ASIL_A: memory-allocation-keyword-policy=ADDR-METHOD-SHORT-NAME-AND-ALIGNMENT, options=safetyAsilA, section-type=CONST
    CONST_ASIL_B: memory-allocation-keyword-policy=ADDR-METHOD-SHORT-NAME-AND-ALIGNMENT, options=safetyAsilB, section-type=CONST
    CONST_ASIL_C: memory-allocation-keyword-policy=ADDR-METHOD-SHORT-NAME-AND-ALIGNMENT, options=safetyAsilC, section-type=CONST
    CONST_ASIL_D: memory-allocation-keyword-policy=ADDR-METHOD-SHORT-NAME-AND-ALIGNMENT, options=safetyAsilD, section-type=CONST
    CALIB: memory-allocation-keyword-policy=ADDR-METHOD-SHORT-NAME-AND-ALIGNMENT, section-initialization-policy=INIT, section-type=CALPRM
    CALIB_ASIL_A: memory-allocation-keyword-policy=ADDR-METHOD-SHORT-NAME-AND-ALIGNMENT, options=safetyAsilA, section-initialization-policy=INIT, section-type=CALPRM
    CALIB_ASIL_B: memory-allocation-keyword-policy=ADDR-METHOD-SHORT-NAME-AND-ALIGNMENT, options=safetyAsilB, section-initialization-policy=INIT, section-type=CALPRM
    CALIB_ASIL_C: memory-allocation-keyword-policy=ADDR-METHOD-SHORT-NAME-AND-ALIGNMENT, options=safetyAsilC, section-initialization-policy=INIT, section-type=CALPRM
    CALIB_ASIL_D: memory-allocation-keyword-policy=ADDR-METHOD-SHORT-NAME-AND-ALIGNMENT, options=safetyAsilD, section-initialization-policy=INIT, section-type=CALPRM
    CONFIG_DATA: memory-allocation-keyword-policy=ADDR-METHOD-SHORT-NAME-AND-ALIGNMENT, section-type=CONFIG-DATA
    CONFIG_DATA_ASIL_A: memory-allocation-keyword-policy=ADDR-METHOD-SHORT-NAME-AND-ALIGNMENT, options=safetyAsilA, section-type=CONFIG-DATA
    CONFIG_DATA_ASIL_B: memory-allocation-keyword-policy=ADDR-METHOD-SHORT-NAME-AND-ALIGNMENT, options=safetyAsilB, section-type=CONFIG-DATA
    CONFIG_DATA_ASIL_C: memory-allocation-keyword-policy=ADDR-METHOD-SHORT-NAME-AND-ALIGNMENT, options=safetyAsilC, section-type=CONFIG-DATA
    CONFIG_DATA_ASIL_D: memory-allocation-keyword-policy=ADDR-METHOD-SHORT-NAME-AND-ALIGNMENT, options=safetyAsilD, section-type=CONFIG-DATA
package /AUTOSAR_Base/BswModuleDescriptions
  bsw module description Base: module-id=0, provided-entrys=TS_PlatformSigIsValid
    bsw internal behavior InternalBehavior_0
      bsw called entity TS_PlatformSigIsValid: implemented-entry=TS_PlatformSigIsValid
package /AUTOSAR_Base/BswModuleEntrys
  bsw module entry TS_PlatformSigIsValid: is-reentrant=false, is-synchronous=true, call-type=REGULAR, execution-context=TASK, sw-service-impl-policy=STANDARD
package /EB_Base/Implementations
  bsw implementation BswImplementation_0: programming-language=C, sw-version=5.2.1, vendor-id=1, ar-release-version=4.0.3, behavior=InternalBehavior_0, vendor-specific-module-def=Base
    code-descriptors:
      code Files
        artifact-descriptors:
          short-label=Autosar::include::Base.h, category=SWHDR
          short-label=Autosar::include::Base_Version.h, category=SWHDR
          short-label=Autosar::include::Can_GeneralTypes.h, category=SWHDR
          short-label=Autosar::include::ComStackTypes.h, category=SWHDR
          short-label=Autosar::include::ComStack_Helpers.h, category=SWHDR
          short-label=Autosar::include::ComStack_Types.h, category=SWHDR
          short-label=Autosar::include::Compiler_Common.h, category=SWHDR
          short-label=Autosar::include::Eth_GeneralTypes.h, category=SWHDR
          short-label=Autosar::include::Fr_GeneralTypes.h, category=SWHDR
          short-label=Autosar::include::Lin_GeneralTypes.h, category=SWHDR
          short-label=Autosar::include::StandardTypes.h, category=SWHDR
          short-label=Autosar::include::Std_Types.h, category=SWHDR
          short-label=Autosar::include::TSAtomic_Assign.h, category=SWHDR
          short-label=Autosar::include::TSAutosar.h, category=SWHDR
          short-label=Autosar::include::TSCompiler_Default.h, category=SWHDR
          short-label=Autosar::include::TSMem.h, category=SWHDR
          short-label=Autosar::include::TSMemS.h, category=SWHDR
          short-label=Autosar::include::TSPBConfig.h, category=SWHDR
          short-label=Autosar::include::TSPBConfig_Access.h, category=SWHDR
          short-label=Autosar::include::TSPBConfig_BasicTypes.h, category=SWHDR
          short-label=Autosar::include::TSPBConfig_Init.h, category=SWHDR
          short-label=Autosar::include::TSPBConfig_OffsetAlignment.h, category=SWHDR
          short-label=Autosar::include::TSPBConfig_Signature.h, category=SWHDR
          short-label=Autosar::include::TSPBConfig_Types.h, category=SWHDR
          short-label=Autosar::include::TransformerTypes.h, category=SWHDR
          short-label=Autosar::src::ComStack_Helpers.c, category=SWSRC
          short-label=Autosar::src::TSMem.c, category=SWSRC
          short-label=Autosar::src::TSMemS.c, category=SWSRC
          short-label=Autosar::src::TSPBConfig.c, category=SWSRC
          short-label=make::Base_defs.mak, category=SWMAKE
          short-label=make::Base_rules.mak, category=SWMAKE
    resource consumption ResourceConsumption
      memory section CODE: sw-addrmethod=SwAddrMethods/CODE
