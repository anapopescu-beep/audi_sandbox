AUTOSAR XML (schema 4-0-3)
package /AUTOSAR_BswM/BswModuleDescriptions
  bsw module description BswM: module-id=042
    provided-entrys:
      BswM_MainFunction
      BswM_Init
      BswM_MRPFunc_BswM_Dcm_RequestPort_JUMPTOSYSSUPPLIERBOOTLOADER
      BswM_MRPFunc_BswM_Dcm_ComM_RequestPort_DCM_DISABLE_RX_TX_NORM_NM
      BswM_MRPFunc_BswM_Dcm_RequestPort_SOFT
      BswM_MRPFunc_BswM_Dcm_ComM_RequestPort_DCM_ENABLE_RX_TX_NORM
      BswM_MRPFunc_BswM_Dcm_ComM_RequestPort_DCM_ENABLE_RX_DISABLE_TX_NORM_NM
      BswM_MRPFunc_BswM_Dcm_ComM_RequestPort_DCM_DISABLE_RX_ENABLE_TX_NM
      BswM_MRPFunc_BswM_Dcm_RequestPort_EXECUTE
      BswM_MRPFunc_BswM_Dcm_ComM_RequestPort_DCM_DISABLE_RX_ENABLE_TX_NORM_NM
      BswM_MRPFunc_BswM_Dcm_RequestPort_NONE
      BswM_MRPFunc_BswM_Dcm_ComM_RequestPort_DCM_DISABLE_RX_ENABLE_TX_NORM
      BswM_MRPFunc_BswM_Dcm_ComM_RequestPort_DCM_ENABLE_RX_DISABLE_TX_NM
      BswM_MRPFunc_BswM_Dcm_ComM_RequestPort_DCM_ENABLE_RX_TX_NM
      BswM_MRPFunc_BswM_Dcm_ComM_RequestPort_DCM_ENABLE_RX_TX_NORM_NM
      BswM_MRPFunc_BswM_Dcm_ComM_RequestPort_DCM_ENABLE_RX_DISABLE_TX_NORM
      BswM_MRPFunc_BswM_Dcm_ComM_RequestPort_DCM_DISABLE_RX_TX_NM
      BswM_MRPFunc_BswM_Dcm_RequestPort_JUMPTOBOOTLOADER
      BswM_MRPFunc_BswM_Dcm_ComM_RequestPort_DCM_DISABLE_RX_TX_NORM
      BswM_MRPFunc_BswM_Dcm_RequestPort_HARD
      BswM_MRPFunc_BswM_Dcm_RequestPort_KEYONOFF
    required-mode-groups:
      mode declaration group prototype BswM_ModeNotificationPort_BswM_Dcm_RequestPort: type=DcmEcuReset
      mode declaration group prototype BswM_ModeNotificationPort_BswM_Dcm_ComM_RequestPort: type=DcmCommunicationControl
    bsw internal behavior InternalBehavior_0: data-type-mapping=[DataTypeMappingSet_SystemExtract, ModeMapping]
      exclusive area SCHM_BSWM_EXCLUSIVE_AREA
      20 x bsw schedulable entity:
        SE_BswM_Dcm_RequestPort_NONE: accessed-mode-groups=BswM_ModeNotificationPort_BswM_Dcm_RequestPort, implemented-entry=BswM_MRPFunc_BswM_Dcm_RequestPort_NONE
        SE_BswM_Dcm_RequestPort_HARD: accessed-mode-groups=BswM_ModeNotificationPort_BswM_Dcm_RequestPort, implemented-entry=BswM_MRPFunc_BswM_Dcm_RequestPort_HARD
        SE_BswM_Dcm_RequestPort_KEYONOFF: accessed-mode-groups=BswM_ModeNotificationPort_BswM_Dcm_RequestPort, implemented-entry=BswM_MRPFunc_BswM_Dcm_RequestPort_KEYONOFF
        SE_BswM_Dcm_RequestPort_SOFT: accessed-mode-groups=BswM_ModeNotificationPort_BswM_Dcm_RequestPort, implemented-entry=BswM_MRPFunc_BswM_Dcm_RequestPort_SOFT
        SE_BswM_Dcm_RequestPort_JUMPTOBOOTLOADER: accessed-mode-groups=BswM_ModeNotificationPort_BswM_Dcm_RequestPort, implemented-entry=BswM_MRPFunc_BswM_Dcm_RequestPort_JUMPTOBOOTLOADER
        SE_BswM_Dcm_RequestPort_JUMPTOSYSSUPPLIERBOOTLOADER: accessed-mode-groups=BswM_ModeNotificationPort_BswM_Dcm_RequestPort, implemented-entry=BswM_MRPFunc_BswM_Dcm_RequestPort_JUMPTOSYSSUPPLIERBOOTLOADER
        SE_BswM_Dcm_RequestPort_EXECUTE: accessed-mode-groups=BswM_ModeNotificationPort_BswM_Dcm_RequestPort, implemented-entry=BswM_MRPFunc_BswM_Dcm_RequestPort_EXECUTE
        SE_BswM_Dcm_ComM_RequestPort_DCM_ENABLE_RX_TX_NORM: accessed-mode-groups=BswM_ModeNotificationPort_BswM_Dcm_ComM_RequestPort, implemented-entry=BswM_MRPFunc_BswM_Dcm_ComM_RequestPort_DCM_ENABLE_RX_TX_NORM
        SE_BswM_Dcm_ComM_RequestPort_DCM_ENABLE_RX_DISABLE_TX_NORM: accessed-mode-groups=BswM_ModeNotificationPort_BswM_Dcm_ComM_RequestPort, implemented-entry=BswM_MRPFunc_BswM_Dcm_ComM_RequestPort_DCM_ENABLE_RX_DISABLE_TX_NORM
        SE_BswM_Dcm_ComM_RequestPort_DCM_DISABLE_RX_ENABLE_TX_NORM: accessed-mode-groups=BswM_ModeNotificationPort_BswM_Dcm_ComM_RequestPort, implemented-entry=BswM_MRPFunc_BswM_Dcm_ComM_RequestPort_DCM_DISABLE_RX_ENABLE_TX_NORM
        SE_BswM_Dcm_ComM_RequestPort_DCM_DISABLE_RX_TX_NORM: accessed-mode-groups=BswM_ModeNotificationPort_BswM_Dcm_ComM_RequestPort, implemented-entry=BswM_MRPFunc_BswM_Dcm_ComM_RequestPort_DCM_DISABLE_RX_TX_NORM
        SE_BswM_Dcm_ComM_RequestPort_DCM_ENABLE_RX_TX_NM: accessed-mode-groups=BswM_ModeNotificationPort_BswM_Dcm_ComM_RequestPort, implemented-entry=BswM_MRPFunc_BswM_Dcm_ComM_RequestPort_DCM_ENABLE_RX_TX_NM
        SE_BswM_Dcm_ComM_RequestPort_DCM_ENABLE_RX_DISABLE_TX_NM: accessed-mode-groups=BswM_ModeNotificationPort_BswM_Dcm_ComM_RequestPort, implemented-entry=BswM_MRPFunc_BswM_Dcm_ComM_RequestPort_DCM_ENABLE_RX_DISABLE_TX_NM
        SE_BswM_Dcm_ComM_RequestPort_DCM_DISABLE_RX_ENABLE_TX_NM: accessed-mode-groups=BswM_ModeNotificationPort_BswM_Dcm_ComM_RequestPort, implemented-entry=BswM_MRPFunc_BswM_Dcm_ComM_RequestPort_DCM_DISABLE_RX_ENABLE_TX_NM
        SE_BswM_Dcm_ComM_RequestPort_DCM_DISABLE_RX_TX_NM: accessed-mode-groups=BswM_ModeNotificationPort_BswM_Dcm_ComM_RequestPort, implemented-entry=BswM_MRPFunc_BswM_Dcm_ComM_RequestPort_DCM_DISABLE_RX_TX_NM
        SE_BswM_Dcm_ComM_RequestPort_DCM_ENABLE_RX_TX_NORM_NM: accessed-mode-groups=BswM_ModeNotificationPort_BswM_Dcm_ComM_RequestPort, implemented-entry=BswM_MRPFunc_BswM_Dcm_ComM_RequestPort_DCM_ENABLE_RX_TX_NORM_NM
        SE_BswM_Dcm_ComM_RequestPort_DCM_ENABLE_RX_DISABLE_TX_NORM_NM: accessed-mode-groups=BswM_ModeNotificationPort_BswM_Dcm_ComM_RequestPort, implemented-entry=BswM_MRPFunc_BswM_Dcm_ComM_RequestPort_DCM_ENABLE_RX_DISABLE_TX_NORM_NM
        SE_BswM_Dcm_ComM_RequestPort_DCM_DISABLE_RX_ENABLE_TX_NORM_NM: accessed-mode-groups=BswM_ModeNotificationPort_BswM_Dcm_ComM_RequestPort, implemented-entry=BswM_MRPFunc_BswM_Dcm_ComM_RequestPort_DCM_DISABLE_RX_ENABLE_TX_NORM_NM
        SE_BswM_Dcm_ComM_RequestPort_DCM_DISABLE_RX_TX_NORM_NM: accessed-mode-groups=BswM_ModeNotificationPort_BswM_Dcm_ComM_RequestPort, implemented-entry=BswM_MRPFunc_BswM_Dcm_ComM_RequestPort_DCM_DISABLE_RX_TX_NORM_NM
        BswM_MainFunction: can-enter-exclusive-area=SCHM_BSWM_EXCLUSIVE_AREA, implemented-entry=BswM_MainFunction
      19 x bsw mode switch event, all with activation=ON-ENTRY:
        MSE_BswM_Dcm_RequestPort_NONE: starts-on-event=SE_BswM_Dcm_RequestPort_NONE, mode=BswM_ModeNotificationPort_BswM_Dcm_RequestPort.NONE
        MSE_BswM_Dcm_RequestPort_HARD: starts-on-event=SE_BswM_Dcm_RequestPort_HARD, mode=BswM_ModeNotificationPort_BswM_Dcm_RequestPort.HARD
        MSE_BswM_Dcm_RequestPort_KEYONOFF: starts-on-event=SE_BswM_Dcm_RequestPort_KEYONOFF, mode=BswM_ModeNotificationPort_BswM_Dcm_RequestPort.KEYONOFF
        MSE_BswM_Dcm_RequestPort_SOFT: starts-on-event=SE_BswM_Dcm_RequestPort_SOFT, mode=BswM_ModeNotificationPort_BswM_Dcm_RequestPort.SOFT
        MSE_BswM_Dcm_RequestPort_JUMPTOBOOTLOADER: starts-on-event=SE_BswM_Dcm_RequestPort_JUMPTOBOOTLOADER, mode=BswM_ModeNotificationPort_BswM_Dcm_RequestPort.JUMPTOBOOTLOADER
        MSE_BswM_Dcm_RequestPort_JUMPTOSYSSUPPLIERBOOTLOADER: starts-on-event=SE_BswM_Dcm_RequestPort_JUMPTOSYSSUPPLIERBOOTLOADER, mode=BswM_ModeNotificationPort_BswM_Dcm_RequestPort.JUMPTOSYSSUPPLIERBOOTLOADER
        MSE_BswM_Dcm_RequestPort_EXECUTE: starts-on-event=SE_BswM_Dcm_RequestPort_EXECUTE, mode=BswM_ModeNotificationPort_BswM_Dcm_RequestPort.EXECUTE
        MSE_BswM_Dcm_ComM_RequestPort_DCM_ENABLE_RX_TX_NORM: starts-on-event=SE_BswM_Dcm_ComM_RequestPort_DCM_ENABLE_RX_TX_NORM, mode=BswM_ModeNotificationPort_BswM_Dcm_ComM_RequestPort.DCM_ENABLE_RX_TX_NORM
        MSE_BswM_Dcm_ComM_RequestPort_DCM_ENABLE_RX_DISABLE_TX_NORM: starts-on-event=SE_BswM_Dcm_ComM_RequestPort_DCM_ENABLE_RX_DISABLE_TX_NORM, mode=BswM_ModeNotificationPort_BswM_Dcm_ComM_RequestPort.DCM_ENABLE_RX_DISABLE_TX_NORM
        MSE_BswM_Dcm_ComM_RequestPort_DCM_DISABLE_RX_ENABLE_TX_NORM: starts-on-event=SE_BswM_Dcm_ComM_RequestPort_DCM_DISABLE_RX_ENABLE_TX_NORM, mode=BswM_ModeNotificationPort_BswM_Dcm_ComM_RequestPort.DCM_DISABLE_RX_ENABLE_TX_NORM
        MSE_BswM_Dcm_ComM_RequestPort_DCM_DISABLE_RX_TX_NORM: starts-on-event=SE_BswM_Dcm_ComM_RequestPort_DCM_DISABLE_RX_TX_NORM, mode=BswM_ModeNotificationPort_BswM_Dcm_ComM_RequestPort.DCM_DISABLE_RX_TX_NORM
        MSE_BswM_Dcm_ComM_RequestPort_DCM_ENABLE_RX_TX_NM: starts-on-event=SE_BswM_Dcm_ComM_RequestPort_DCM_ENABLE_RX_TX_NM, mode=BswM_ModeNotificationPort_BswM_Dcm_ComM_RequestPort.DCM_ENABLE_RX_TX_NM
        MSE_BswM_Dcm_ComM_RequestPort_DCM_ENABLE_RX_DISABLE_TX_NM: starts-on-event=SE_BswM_Dcm_ComM_RequestPort_DCM_ENABLE_RX_DISABLE_TX_NM, mode=BswM_ModeNotificationPort_BswM_Dcm_ComM_RequestPort.DCM_ENABLE_RX_DISABLE_TX_NM
        MSE_BswM_Dcm_ComM_RequestPort_DCM_DISABLE_RX_ENABLE_TX_NM: starts-on-event=SE_BswM_Dcm_ComM_RequestPort_DCM_DISABLE_RX_ENABLE_TX_NM, mode=BswM_ModeNotificationPort_BswM_Dcm_ComM_RequestPort.DCM_DISABLE_RX_ENABLE_TX_NM
        MSE_BswM_Dcm_ComM_RequestPort_DCM_DISABLE_RX_TX_NM: starts-on-event=SE_BswM_Dcm_ComM_RequestPort_DCM_DISABLE_RX_TX_NM, mode=BswM_ModeNotificationPort_BswM_Dcm_ComM_RequestPort.DCM_DISABLE_RX_TX_NM
        MSE_BswM_Dcm_ComM_RequestPort_DCM_ENABLE_RX_TX_NORM_NM: starts-on-event=SE_BswM_Dcm_ComM_RequestPort_DCM_ENABLE_RX_TX_NORM_NM, mode=BswM_ModeNotificationPort_BswM_Dcm_ComM_RequestPort.DCM_ENABLE_RX_TX_NORM_NM
        MSE_BswM_Dcm_ComM_RequestPort_DCM_ENABLE_RX_DISABLE_TX_NORM_NM: starts-on-event=SE_BswM_Dcm_ComM_RequestPort_DCM_ENABLE_RX_DISABLE_TX_NORM_NM, mode=BswM_ModeNotificationPort_BswM_Dcm_ComM_RequestPort.DCM_ENABLE_RX_DISABLE_TX_NORM_NM
        MSE_BswM_Dcm_ComM_RequestPort_DCM_DISABLE_RX_ENABLE_TX_NORM_NM: starts-on-event=SE_BswM_Dcm_ComM_RequestPort_DCM_DISABLE_RX_ENABLE_TX_NORM_NM, mode=BswM_ModeNotificationPort_BswM_Dcm_ComM_RequestPort.DCM_DISABLE_RX_ENABLE_TX_NORM_NM
        MSE_BswM_Dcm_ComM_RequestPort_DCM_DISABLE_RX_TX_NORM_NM: starts-on-event=SE_BswM_Dcm_ComM_RequestPort_DCM_DISABLE_RX_TX_NORM_NM, mode=BswM_ModeNotificationPort_BswM_Dcm_ComM_RequestPort.DCM_DISABLE_RX_TX_NORM_NM
      bsw timing event TimingEvent_MainFunction: starts-on-event=BswM_MainFunction, period=0.01
package /AUTOSAR_BswM/BswModuleEntrys
  21 x bsw module entry, all with is-reentrant=false, sw-service-impl-policy=STANDARD:
    BswM_MainFunction: service-id=3, is-synchronous=true, call-type=SCHEDULED, execution-context=TASK
    BswM_Init: service-id=0, is-synchronous=true, call-type=REGULAR, execution-context=UNSPECIFIED
    BswM_MRPFunc_BswM_Dcm_RequestPort_JUMPTOSYSSUPPLIERBOOTLOADER: service-id=0, is-synchronous=false, call-type=SCHEDULED, execution-context=TASK
    BswM_MRPFunc_BswM_Dcm_ComM_RequestPort_DCM_DISABLE_RX_TX_NORM_NM: service-id=0, is-synchronous=false, call-type=SCHEDULED, execution-context=TASK
    BswM_MRPFunc_BswM_Dcm_RequestPort_SOFT: service-id=0, is-synchronous=false, call-type=SCHEDULED, execution-context=TASK
    BswM_MRPFunc_BswM_Dcm_ComM_RequestPort_DCM_ENABLE_RX_TX_NORM: service-id=0, is-synchronous=false, call-type=SCHEDULED, execution-context=TASK
    BswM_MRPFunc_BswM_Dcm_ComM_RequestPort_DCM_ENABLE_RX_DISABLE_TX_NORM_NM: service-id=0, is-synchronous=false, call-type=SCHEDULED, execution-context=TASK
    BswM_MRPFunc_BswM_Dcm_ComM_RequestPort_DCM_DISABLE_RX_ENABLE_TX_NM: service-id=0, is-synchronous=false, call-type=SCHEDULED, execution-context=TASK
    BswM_MRPFunc_BswM_Dcm_RequestPort_EXECUTE: service-id=0, is-synchronous=false, call-type=SCHEDULED, execution-context=TASK
    BswM_MRPFunc_BswM_Dcm_ComM_RequestPort_DCM_DISABLE_RX_ENABLE_TX_NORM_NM: service-id=0, is-synchronous=false, call-type=SCHEDULED, execution-context=TASK
    BswM_MRPFunc_BswM_Dcm_RequestPort_NONE: service-id=0, is-synchronous=false, call-type=SCHEDULED, execution-context=TASK
    BswM_MRPFunc_BswM_Dcm_ComM_RequestPort_DCM_DISABLE_RX_ENABLE_TX_NORM: service-id=0, is-synchronous=false, call-type=SCHEDULED, execution-context=TASK
    BswM_MRPFunc_BswM_Dcm_ComM_RequestPort_DCM_ENABLE_RX_DISABLE_TX_NM: service-id=0, is-synchronous=false, call-type=SCHEDULED, execution-context=TASK
    BswM_MRPFunc_BswM_Dcm_ComM_RequestPort_DCM_ENABLE_RX_TX_NM: service-id=0, is-synchronous=false, call-type=SCHEDULED, execution-context=TASK
    BswM_MRPFunc_BswM_Dcm_ComM_RequestPort_DCM_ENABLE_RX_TX_NORM_NM: service-id=0, is-synchronous=false, call-type=SCHEDULED, execution-context=TASK
    BswM_MRPFunc_BswM_Dcm_ComM_RequestPort_DCM_ENABLE_RX_DISABLE_TX_NORM: service-id=0, is-synchronous=false, call-type=SCHEDULED, execution-context=TASK
    BswM_MRPFunc_BswM_Dcm_ComM_RequestPort_DCM_DISABLE_RX_TX_NM: service-id=0, is-synchronous=false, call-type=SCHEDULED, execution-context=TASK
    BswM_MRPFunc_BswM_Dcm_RequestPort_JUMPTOBOOTLOADER: service-id=0, is-synchronous=false, call-type=SCHEDULED, execution-context=TASK
    BswM_MRPFunc_BswM_Dcm_ComM_RequestPort_DCM_DISABLE_RX_TX_NORM: service-id=0, is-synchronous=false, call-type=SCHEDULED, execution-context=TASK
    BswM_MRPFunc_BswM_Dcm_RequestPort_HARD: service-id=0, is-synchronous=false, call-type=SCHEDULED, execution-context=TASK
    BswM_MRPFunc_BswM_Dcm_RequestPort_KEYONOFF: service-id=0, is-synchronous=false, call-type=SCHEDULED, execution-context=TASK
package /EB_BswM/Implementations
  bsw implementation BswImplementation_0: programming-language=C, sw-version=1.17.1, vendor-id=1, ar-release-version=4.0.3, behavior=InternalBehavior_0, vendor-specific-module-def=BswM
    code-descriptors:
      code Files
        artifact-descriptors:
          short-label=Autosar::src::BswM.c, category=SWSRC
          short-label=generated::src::BswM_Cfg.c, category=SWSRC
          short-label=generated::src::BswM_PBcfg.c, category=SWSRC
          short-label=generated::src::BswM_Lcfg.c, category=SWSRC
          short-label=Autosar::include::BswM.h, category=SWHDR
          short-label=Autosar::include::BswM_Int.h, category=SWHDR
          short-label=Autosar::include::BswM_SymbolicNames_PBcfg.h, category=SWHDR
          short-label=Autosar::include::BswM_Types.h, category=SWHDR
          short-label=Autosar::include::BswM_Version.h, category=SWHDR
          short-label=generated::include::BswM_Cfg.h, category=SWHDR
          short-label=generated::include::BswM_Int_Cfg.h, category=SWHDR
          short-label=generated::include::BswM_CfgTypes.h, category=SWHDR
          short-label=generated::include::BswM_PBcfg.h, category=SWHDR
          short-label=generated::include::BswM_MemMap.h, category=SWHDR
          short-label=generated::include::BswM_Trace.h, category=SWHDR
          short-label=generated::include::BswM_Lcfg.h, category=SWHDR
          short-label=generated::include::BswM_CanSM.h, category=SWHDR
          short-label=generated::include::BswM_ComM.h, category=SWHDR
          short-label=generated::include::BswM_DCM.h, category=SWHDR
          short-label=generated::include::BswM_EcuM.h, category=SWHDR
          short-label=generated::include::BswM_NvM.h, category=SWHDR
          short-label=make::BswM_defs.mak, category=SWMAKE
          short-label=make::BswM_rules.mak, category=SWMAKE
    resource consumption ResourceConsumption
      8 x memory section:
        CONFIG_DATA_UNSPECIFIED: alignment=UNSPECIFIED, sw-addrmethod=CONFIG_DATA
        VAR_INIT_UNSPECIFIED: alignment=UNSPECIFIED, sw-addrmethod=VAR_INIT
        VAR_CLEARED_UNSPECIFIED: alignment=UNSPECIFIED, sw-addrmethod=VAR_CLEARED
        CONST_UNSPECIFIED: alignment=UNSPECIFIED, sw-addrmethod=CONST
        CONST_8: alignment=8, sw-addrmethod=CONST
        CONST_16: alignment=16, sw-addrmethod=CONST
        CONST_32: alignment=16, sw-addrmethod=CONST
        CODE: sw-addrmethod=CODE
