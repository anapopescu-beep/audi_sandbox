AUTOSAR XML (schema 4-2-1)
package /AUTOSAR_CanIf/BswModuleDescriptions
  bsw module description CanIf: module-id=60, provided-entrys=CanIf_Init
    bsw internal behavior InternalBehavior_0
      exclusive area SCHM_CANIF_EXCLUSIVE_AREA_0
      static-memorys:
        13 x data:
          CanIf_CanControllerMode_{0..3}: type=CanIf_ControllerModeType
          CanIf_CanControllerFlags_{0..3}: type=uint8
          CanIf_PduMode_{0..3}: type=CanIf_PduGetModeType
          CanIf_State: type=uint8
      bsw called entity CanIf_Init: can-enter-exclusive-area=SCHM_CANIF_EXCLUSIVE_AREA_0, implemented-entry=CanIf_Init
package /AUTOSAR_CanIf/BswModuleEntrys
  bsw module entry CanIf_Init: service-id=1, is-reentrant=false, is-synchronous=true, call-type=REGULAR, execution-context=TASK, sw-service-impl-policy=STANDARD
    sw service arg ConfigPtr: direction=IN, implementation-data-type=VoidPtr
package /AUTOSAR_CanIf/ImplementationDataTypes
  impl type CanIf_ControllerModeType: compu {0=CANIF_CS_UNINIT, 1=CANIF_CS_SLEEP, 2=CANIF_CS_STARTED, 3=CANIF_CS_STOPPED}, implementation-data-type=uint32, type-emitter=BSW
  impl type CanIf_PduGetModeType: compu {0=CANIF_GET_OFFLINE, 1=CANIF_GET_OFFLINE_ACTIVE, 2=CANIF_GET_OFFLINE_ACTIVE_RX_ONLINE, 3=CANIF_GET_ONLINE, 4=CANIF_GET_RX_ONLINE, 5=CANIF_GET_TX_ONLINE}, implementation-data-type=uint32, type-emitter=BSW
package /EB_CanIf/Implementations
  bsw implementation BswImplementation_0: programming-language=C, sw-version=6.10.31, vendor-id=1, ar-release-version=4.0.3, behavior=InternalBehavior_0, vendor-specific-module-def=CanIf
    code-descriptors:
      code Files
        artifact-descriptors:
          short-label=Autosar::include::CanIf.h, category=SWHDR
          short-label=Autosar::include::CanIf_Api.h, category=SWHDR
          short-label=Autosar::include::CanIf_Int.h, category=SWHDR
          short-label=Autosar::include::CanIf_Trace.h, category=SWHDR
          short-label=Autosar::include::CanIf_Trace_Internal.h, category=SWHDR
          short-label=Autosar::include::CanIf_Version.h, category=SWHDR
          short-label=Autosar::src::CanIf.c, category=SWSRC
          short-label=make::CanIf_defs.mak, category=SWMAKE
          short-label=make::CanIf_rules.mak, category=SWMAKE
    resource consumption ResourceConsumption
      13 x memory section:
        CONST_32: alignment=32, sw-addrmethod=CONST
        VAR_INIT_8: alignment=8, sw-addrmethod=VAR
        CONST_8: alignment=8, sw-addrmethod=CONST
        VAR_INIT_UNSPECIFIED: alignment=UNSPECIFIED, sw-addrmethod=VAR
        VAR_FAST_INIT_UNSPECIFIED: alignment=UNSPECIFIED, sw-addrmethod=VAR_FAST
        VAR_CLEARED_8: alignment=8, sw-addrmethod=VAR_CLEARED
        VAR_CLEARED_16: alignment=16, sw-addrmethod=VAR_CLEARED
        VAR_CLEARED_32: alignment=32, sw-addrmethod=VAR_CLEARED
        VAR_CLEARED_UNSPECIFIED: alignment=UNSPECIFIED, sw-addrmethod=VAR_CLEARED
        CONST_UNSPECIFIED: alignment=UNSPECIFIED, sw-addrmethod=CONST
        CODE: sw-addrmethod=CODE
        CONFIG_DATA_UNSPECIFIED: alignment=UNSPECIFIED, sw-addrmethod=CONFIG_DATA
        CODE_CC_BLOCK: alignment=UNSPECIFIED, sw-addrmethod=CODE
