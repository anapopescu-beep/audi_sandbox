AUTOSAR XML (schema 4-2-1)
package /AUTOSAR_CanSM/BswModuleDescriptions
  bsw module description CanSM: module-id=140, provided-entrys=CanSM_MainFunction
    bsw internal behavior InternalBehavior_0
      exclusive area SCHM_CANSM_EXCLUSIVE_AREA_0
      bsw schedulable entity CanSM_MainFunction: can-enter-exclusive-area=SCHM_CANSM_EXCLUSIVE_AREA_0, implemented-entry=CanSM_MainFunction
      bsw timing event TimingEvent_MainFunction: starts-on-event=CanSM_MainFunction, period=0.005
package /AUTOSAR_CanSM/BswModuleEntrys
  bsw module entry CanSM_MainFunction: service-id=5, is-reentrant=false, is-synchronous=true, call-type=SCHEDULED, execution-context=TASK, sw-service-impl-policy=STANDARD
package /EB_CanSM/Implementations
  bsw implementation BswImplementation_0: programming-language=C, sw-version=3.7.13, vendor-id=1, ar-release-version=4.0.3, behavior=InternalBehavior_0, vendor-specific-module-def=CanSM
    code-descriptors:
      code Files
        artifact-descriptors:
          short-label=Autosar::include::CanSM.h, category=SWHDR
          short-label=Autosar::include::CanSM_Api.h, category=SWHDR
          short-label=Autosar::include::CanSM_Api_Static.h, category=SWHDR
          short-label=Autosar::include::CanSM_BswM.h, category=SWHDR
          short-label=Autosar::include::CanSM_Cbk.h, category=SWHDR
          short-label=Autosar::include::CanSM_ComM.h, category=SWHDR
          short-label=Autosar::include::CanSM_Dcm.h, category=SWHDR
          short-label=Autosar::include::CanSM_Int_Stc.h, category=SWHDR
          short-label=Autosar::include::CanSM_Internal.h, category=SWHDR
          short-label=Autosar::include::CanSM_SchM.h, category=SWHDR
          short-label=Autosar::include::CanSM_Trace.h, category=SWHDR
          short-label=Autosar::include::CanSM_Trace_Internal.h, category=SWHDR
          short-label=Autosar::include::CanSM_TxTimeoutException.h, category=SWHDR
          short-label=Autosar::include::CanSM_Version.h, category=SWHDR
          short-label=Autosar::src::CanSM.c, category=SWSRC
          short-label=Autosar::src::CanSM_Cbk.c, category=SWSRC
          short-label=Autosar::src::CanSM_GetCurrentComMode.c, category=SWSRC
          short-label=Autosar::src::CanSM_GetVersionInfo.c, category=SWSRC
          short-label=Autosar::src::CanSM_Init.c, category=SWSRC
          short-label=Autosar::src::CanSM_MainFunction.c, category=SWSRC
          short-label=Autosar::src::CanSM_Merged.c, category=SWSRC
          short-label=Autosar::src::CanSM_RequestComMode.c, category=SWSRC
          short-label=Autosar::src::CanSM_SetBaudrate.c, category=SWSRC
          short-label=Autosar::src::CanSM_StateMachine.c, category=SWSRC
          short-label=make::CanSM_defs.mak, category=SWMAKE
          short-label=make::CanSM_rules.mak, category=SWMAKE
    resource consumption ResourceConsumption
      8 x memory section:
        VAR_INIT_UNSPECIFIED: alignment=UNSPECIFIED, sw-addrmethod=VAR
        VAR_INIT_8: alignment=8, sw-addrmethod=VAR
        VAR_CLEARED_8: alignment=8, sw-addrmethod=VAR_CLEARED
        VAR_CLEARED_UNSPECIFIED: alignment=UNSPECIFIED, sw-addrmethod=VAR_CLEARED
        CONST_8: alignment=8, sw-addrmethod=CONST
        CODE: sw-addrmethod=CODE
        CONFIG_DATA_8: alignment=8, sw-addrmethod=CONFIG_DATA
        CONFIG_DATA_UNSPECIFIED: alignment=UNSPECIFIED, sw-addrmethod=CONFIG_DATA
