AUTOSAR XML (schema 4-0-3)
package /AUTOSAR_Com/BswModuleDescriptions
  bsw module description Com: module-id=50, provided-entrys=[Com_MainFunctionRx, Com_MainFunctionTx, Com_MainFunctionRouteSignals, Com_RxIndication, Com_TxConfirmation]
    bsw internal behavior BswImplementation_0
      exclusive area SCHM_COM_EXCLUSIVE_AREA_0
      exclusive area SCHM_COM_EXCLUSIVE_AREA_1
      bsw schedulable entity Com_MainFunctionRx: can-enter-exclusive-area=SCHM_COM_EXCLUSIVE_AREA_0, implemented-entry=Com_MainFunctionRx
      bsw schedulable entity Com_MainFunctionTx: can-enter-exclusive-area=SCHM_COM_EXCLUSIVE_AREA_0, implemented-entry=Com_MainFunctionTx
      bsw schedulable entity Com_MainFunctionRouteSignals: can-enter-exclusive-area=SCHM_COM_EXCLUSIVE_AREA_0, implemented-entry=Com_MainFunctionRouteSignals
      bsw called entity Com_RxIndication: can-enter-exclusive-area=SCHM_COM_EXCLUSIVE_AREA_1, implemented-entry=Com_RxIndication
      bsw called entity Com_TxConfirmation: can-enter-exclusive-area=SCHM_COM_EXCLUSIVE_AREA_1, implemented-entry=Com_TxConfirmation
      bsw timing event TimingEvent_MainFunctionRx: starts-on-event=Com_MainFunctionRx, period=0.005
      bsw timing event TimingEvent_MainFunctionTx: starts-on-event=Com_MainFunctionTx, period=0.005
      bsw timing event TimingEvent_MainFunctionRouteSignals: starts-on-event=Com_MainFunctionRouteSignals, period=0.005
package /AUTOSAR_Com/BswModuleEntrys
  34 x bsw module entry, all with sw-service-impl-policy=STANDARD:
    Com_GetVersionInfo: service-id=9, is-reentrant=true, is-synchronous=true, call-type=REGULAR, execution-context=TASK
      sw service arg versionInfoPtr: direction=OUT, implementation-data-type=VoidPtr
    Com_SetIpduGroup: service-id=0x1d, is-reentrant=true, is-synchronous=true, call-type=REGULAR, execution-context=TASK
      sw service arg ipduGroupVector: direction=IN, implementation-data-type=Com_IpduGroupVector
      sw service arg ipduGroupId: direction=IN, implementation-data-type=Com_IpduGroupIdType
      sw service arg bitval: direction=IN, implementation-data-type=boolean
    Com_SendSignal: service-id=10, is-reentrant=false, is-synchronous=false, call-type=REGULAR, execution-context=TASK
      return type retval: direction=OUT, implementation-data-type=uint8
      sw service arg SignalId: direction=IN, implementation-data-type=Com_SignalIdType
      sw service arg SignalDataPtr: direction=IN, implementation-data-type=VoidPtr
    Com_SendDynSignal: service-id=33, is-reentrant=false, is-synchronous=false, call-type=REGULAR, execution-context=TASK
      return type retval: direction=OUT, implementation-data-type=uint8
      sw service arg SignalId: direction=IN, implementation-data-type=Com_SignalIdType
      sw service arg SignalDataPtr: direction=IN, implementation-data-type=ConstVoidPtr
      sw service arg Length: direction=IN, implementation-data-type=uint16
    Com_ReceiveSignal: service-id=11, is-reentrant=false, is-synchronous=true, call-type=REGULAR, execution-context=TASK
      return type retval: direction=OUT, implementation-data-type=uint8
      sw service arg SignalId: direction=IN, implementation-data-type=Com_SignalIdType
      sw service arg SignalDataPtr: direction=OUT, implementation-data-type=VoidPtr
    Com_ReceiveDynSignal: service-id=34, is-reentrant=false, is-synchronous=true, call-type=REGULAR, execution-context=TASK
      return type retval: direction=OUT, implementation-data-type=uint8
      sw service arg SignalId: direction=IN, implementation-data-type=Com_SignalIdType
      sw service arg SignalDataPtr: direction=OUT, implementation-data-type=VoidPtr
      sw service arg LengthPtr: direction=OUT, implementation-data-type=VoidPtr
    Com_ReceiveShadowSignal: service-id=15, is-reentrant=false, is-synchronous=true, call-type=REGULAR, execution-context=TASK
      sw service arg SignalId: direction=IN, implementation-data-type=Com_SignalIdType
      sw service arg SignalDataPtr: direction=OUT, implementation-data-type=VoidPtr
    Com_UpdateShadowSignal: service-id=12, is-reentrant=false, is-synchronous=true, call-type=REGULAR, execution-context=TASK
      sw service arg SignalId: direction=IN, implementation-data-type=Com_SignalIdType
      sw service arg SignalDataPtr: direction=IN, implementation-data-type=VoidPtr
    Com_SendSignalGroupArray: service-id=67, is-reentrant=false, is-synchronous=false, call-type=REGULAR, execution-context=TASK
      return type retval: direction=OUT, implementation-data-type=uint8
      sw service arg SignalGroupId: direction=IN, implementation-data-type=Com_SignalGroupIdType
      sw service arg SignalGroupArrayPtr: direction=IN, implementation-data-type=VoidPtr
      sw service arg SignalGroupArrayLength: direction=IN, implementation-data-type=uint16
    Com_ReceiveSignalGroupArray: service-id=68, is-reentrant=false, is-synchronous=true, call-type=REGULAR, execution-context=TASK
      return type retval: direction=OUT, implementation-data-type=uint8
      sw service arg SignalGroupId: direction=IN, implementation-data-type=Com_SignalGroupIdType
      sw service arg SignalGroupArrayPtr: direction=OUT, implementation-data-type=VoidPtr
      sw service arg SignalGroupArrayLengthPtr: direction=OUT, implementation-data-type=VoidPtr
    Com_ClearIpduGroupVector: service-id=28, is-reentrant=true, is-synchronous=true, call-type=REGULAR, execution-context=TASK
      sw service arg ipduGroupVector: direction=IN, implementation-data-type=Com_IpduGroupVector
    Com_TriggerTransmit: service-id=0x41, is-reentrant=false, is-synchronous=true, call-type=REGULAR, execution-context=TASK
      return type retval: direction=OUT, implementation-data-type=Std_ReturnType
      sw service arg ComTxPduId: direction=IN, implementation-data-type=PduIdType
      sw service arg PduInfoPtr: direction=IN, implementation-data-type=VoidPtr
    Com_IsValidConfig: service-id=255, is-reentrant=true, is-synchronous=true, call-type=REGULAR, execution-context=TASK
      return type retval: direction=OUT, implementation-data-type=Std_ReturnType
      sw service arg ConfigPtr: direction=IN, implementation-data-type=VoidPtr
    Com_SwitchIpduTxMode: service-id=0x27, is-reentrant=false, is-synchronous=true, call-type=REGULAR, execution-context=TASK
      sw service arg PduId: direction=IN, implementation-data-type=PduIdType
      sw service arg Mode: direction=IN, implementation-data-type=boolean
    Com_RxIndication: service-id=0x42, is-reentrant=false, is-synchronous=true, call-type=REGULAR, execution-context=UNSPECIFIED
      sw service arg ComRxPduId: direction=IN, implementation-data-type=PduIdType
      sw service arg PduInfoPtr: direction=IN, implementation-data-type=VoidPtr
    Com_TpRxIndication: service-id=0x1e, is-reentrant=false, is-synchronous=true, call-type=REGULAR, execution-context=UNSPECIFIED
      sw service arg PduId: direction=IN, implementation-data-type=PduIdType
      sw service arg Result: direction=IN, implementation-data-type=NotifResultType
    Com_GetRxIPduBuffer: service-id=0xfe, is-reentrant=false, is-synchronous=true, call-type=REGULAR, execution-context=UNSPECIFIED
      sw service arg ComRxPduId: direction=IN, implementation-data-type=PduIdType
      sw service arg PduInfoPtr: direction=IN, implementation-data-type=VoidPtr
    Com_MainFunctionTx: service-id=25, is-reentrant=false, is-synchronous=true, call-type=SCHEDULED, execution-context=TASK
    Com_GetStatus: service-id=7, is-reentrant=true, is-synchronous=true, call-type=REGULAR, execution-context=TASK
      return type Com_InitStatus: direction=OUT, implementation-data-type=Com_StatusType
    Com_TriggerIPDUSend: service-id=23, is-reentrant=false, is-synchronous=true, call-type=REGULAR, execution-context=TASK
      sw service arg ComTxPduId: direction=IN, implementation-data-type=PduIdType
    Com_DeInit: service-id=2, is-reentrant=false, is-synchronous=true, call-type=REGULAR, execution-context=TASK
    Com_TxConfirmation: service-id=0x40, is-reentrant=false, is-synchronous=true, call-type=REGULAR, execution-context=UNSPECIFIED
      sw service arg ComTxPduId: direction=IN, implementation-data-type=PduIdType
    Com_TpTxConfirmation: service-id=0x26, is-reentrant=false, is-synchronous=true, call-type=REGULAR, execution-context=UNSPECIFIED
      sw service arg PduId: direction=IN, implementation-data-type=PduIdType
      sw service arg Result: direction=IN, implementation-data-type=NotifResultType
    Com_CopyTxData: service-id=0x24, is-reentrant=false, is-synchronous=true, call-type=REGULAR, execution-context=UNSPECIFIED
      return type retval: direction=OUT, implementation-data-type=BufReq_ReturnType
      4 x sw service arg, all with direction=IN:
        PduId: implementation-data-type=PduIdType
        PduInfoPtr: implementation-data-type=VoidPtr
        RetryInfoPtr: implementation-data-type=VoidPtr
        TxDataCntPtr: implementation-data-type=VoidPtr
    Com_CopyRxData: service-id=0x23, is-reentrant=false, is-synchronous=true, call-type=REGULAR, execution-context=UNSPECIFIED
      return type retval: direction=OUT, implementation-data-type=BufReq_ReturnType
      sw service arg PduId: direction=IN, implementation-data-type=PduIdType
      sw service arg PduInfoPointer: direction=IN, implementation-data-type=ConstVoidPtr
      sw service arg RxBufferSizePtr: direction=OUT, implementation-data-type=VoidPtr
    Com_StartOfReception: service-id=0x25, is-reentrant=false, is-synchronous=true, call-type=REGULAR, execution-context=UNSPECIFIED
      return type retval: direction=OUT, implementation-data-type=BufReq_ReturnType
      sw service arg ComRxPduId: direction=IN, implementation-data-type=PduIdType
      sw service arg TpSduLength: direction=IN, implementation-data-type=PduLengthType
      sw service arg RxBufferSizePtr: direction=OUT, implementation-data-type=VoidPtr
    Com_MainFunctionRx: service-id=24, is-reentrant=false, is-synchronous=true, call-type=SCHEDULED, execution-context=TASK
    Com_ReceiveSignalGroup: service-id=14, is-reentrant=false, is-synchronous=true, call-type=REGULAR, execution-context=TASK
      return type retval: direction=OUT, implementation-data-type=uint8
      sw service arg SignalGroupId: direction=IN, implementation-data-type=Com_SignalGroupIdType
    Com_GetConfigurationId: service-id=8, is-reentrant=true, is-synchronous=true, call-type=REGULAR, execution-context=TASK
      return type ConfigId: direction=OUT, implementation-data-type=uint32
    Com_ReceptionDMControl: service-id=6, is-reentrant=false, is-synchronous=true, call-type=REGULAR, execution-context=TASK
      sw service arg ipduGroupVector: direction=IN, implementation-data-type=Com_IpduGroupVector
    Com_SendSignalGroup: service-id=13, is-reentrant=false, is-synchronous=false, call-type=REGULAR, execution-context=TASK
      return type retval: direction=OUT, implementation-data-type=uint8
      sw service arg SignalGroupId: direction=IN, implementation-data-type=Com_SignalGroupIdType
    Com_Init: service-id=1, is-reentrant=false, is-synchronous=true, call-type=REGULAR, execution-context=TASK
      sw service arg Com_ConfigPtr: direction=IN, implementation-data-type=VoidPtr
    Com_MainFunctionRouteSignals: service-id=26, is-reentrant=false, is-synchronous=true, call-type=SCHEDULED, execution-context=TASK
    Com_IpduGroupControl: service-id=3, is-reentrant=false, is-synchronous=true, call-type=REGULAR, execution-context=TASK
      sw service arg ipduGroupVector: direction=IN, implementation-data-type=Com_IpduGroupVector
      sw service arg Initialize: direction=IN, implementation-data-type=boolean
package /AUTOSAR_Com/ImplementationDataTypes
  5 x impl type, all with category=TYPE_REFERENCE, type-emitter=BSW:
    Com_IpduGroupVector: implementation-data-type=VoidPtr
    Com_IpduGroupIdType: implementation-data-type=uint16
    Com_SignalIdType: implementation-data-type=uint16
    Com_StatusType: compu {0=COM_UNINIT, 1=COM_INIT}, implementation-data-type=uint32
    Com_SignalGroupIdType: implementation-data-type=uint16
package /EB_Com/Implementations
  bsw implementation Implementation_0: programming-language=C, sw-version=6.3.54, vendor-id=1, ar-release-version=4.0.3, behavior=BswImplementation_0, vendor-specific-module-def=Com
    code-descriptors:
      code Files
        artifact-descriptors:
          short-label=Autosar::include::Com.h, category=SWHDR
          short-label=Autosar::include::Com_Api.h, category=SWHDR
          short-label=Autosar::include::Com_Api_Static.h, category=SWHDR
          short-label=Autosar::include::Com_Callout.h, category=SWHDR
          short-label=Autosar::include::Com_Cbk.h, category=SWHDR
          short-label=Autosar::include::Com_Cbk_Static.h, category=SWHDR
          short-label=Autosar::include::Com_ComXf.h, category=SWHDR
          short-label=Autosar::include::Com_Core_IPduGroup.h, category=SWHDR
          short-label=Autosar::include::Com_Core_Read.h, category=SWHDR
          short-label=Autosar::include::Com_Core_Read_hlp.h, category=SWHDR
          short-label=Autosar::include::Com_Core_RxIPdu.h, category=SWHDR
          short-label=Autosar::include::Com_Core_RxUpdateBit.h, category=SWHDR
          short-label=Autosar::include::Com_Core_TM.h, category=SWHDR
          short-label=Autosar::include::Com_Core_TxIPdu.h, category=SWHDR
          short-label=Autosar::include::Com_Core_TxSignal.h, category=SWHDR
          short-label=Autosar::include::Com_Core_TxSignalGroup.h, category=SWHDR
          short-label=Autosar::include::Com_Core_Write.h, category=SWHDR
          short-label=Autosar::include::Com_Defs.h, category=SWHDR
          short-label=Autosar::include::Com_Extension.h, category=SWHDR
          short-label=Autosar::include::Com_Filter.h, category=SWHDR
          short-label=Autosar::include::Com_GenApi_Static.h, category=SWHDR
          short-label=Autosar::include::Com_Int_Types.h, category=SWHDR
          short-label=Autosar::include::Com_Lcfg_Static.h, category=SWHDR
          short-label=Autosar::include::Com_Local_Cfg.h, category=SWHDR
          short-label=Autosar::include::Com_Priv.h, category=SWHDR
          short-label=Autosar::include::Com_Rules.h, category=SWHDR
          short-label=Autosar::include::Com_Trace.h, category=SWHDR
          short-label=Autosar::include::Com_Trace_Internal.h, category=SWHDR
          short-label=Autosar::include::Com_Version.h, category=SWHDR
          short-label=Autosar::src::Com.c, category=SWSRC
          short-label=Autosar::src::Com_ClearIpduGroupVector.c, category=SWSRC
          short-label=Autosar::src::Com_CopyRxData.c, category=SWSRC
          short-label=Autosar::src::Com_CopyTxData.c, category=SWSRC
          short-label=Autosar::src::Com_Core_IPduGroup.c, category=SWSRC
          short-label=Autosar::src::Com_Core_Read.c, category=SWSRC
          short-label=Autosar::src::Com_Core_RxIPdu.c, category=SWSRC
          short-label=Autosar::src::Com_Core_RxUpdateBit.c, category=SWSRC
          short-label=Autosar::src::Com_Core_TM.c, category=SWSRC
          short-label=Autosar::src::Com_Core_TxIPdu.c, category=SWSRC
          short-label=Autosar::src::Com_Core_TxSignal.c, category=SWSRC
          short-label=Autosar::src::Com_Core_TxSignalGroup.c, category=SWSRC
          short-label=Autosar::src::Com_Core_Write.c, category=SWSRC
          short-label=Autosar::src::Com_DeInit.c, category=SWSRC
          short-label=Autosar::src::Com_Filter.c, category=SWSRC
          short-label=Autosar::src::Com_GetConfigurationId.c, category=SWSRC
          short-label=Autosar::src::Com_GetStatus.c, category=SWSRC
          short-label=Autosar::src::Com_GetVersionInfo.c, category=SWSRC
          short-label=Autosar::src::Com_Init.c, category=SWSRC
          short-label=Autosar::src::Com_IpduGroupControl.c, category=SWSRC
          short-label=Autosar::src::Com_IsValidConfig.c, category=SWSRC
          short-label=Autosar::src::Com_MainFunctionRouteSignals.c, category=SWSRC
          short-label=Autosar::src::Com_MainFunctionRx.c, category=SWSRC
          short-label=Autosar::src::Com_MainFunctionTx.c, category=SWSRC
          short-label=Autosar::src::Com_Merged.c, category=SWSRC
          short-label=Autosar::src::Com_ReceiveShadowSignal.c, category=SWSRC
          short-label=Autosar::src::Com_ReceiveSignal.c, category=SWSRC
          short-label=Autosar::src::Com_ReceiveSignalGroup.c, category=SWSRC
          short-label=Autosar::src::Com_ReceptionDMControl.c, category=SWSRC
          short-label=Autosar::src::Com_RxIndication.c, category=SWSRC
          short-label=Autosar::src::Com_SendSignal.c, category=SWSRC
          short-label=Autosar::src::Com_SendSignalGroup.c, category=SWSRC
          short-label=Autosar::src::Com_SetIpduGroup.c, category=SWSRC
          short-label=Autosar::src::Com_StartOfReception.c, category=SWSRC
          short-label=Autosar::src::Com_SwitchIpduTxMode.c, category=SWSRC
          short-label=Autosar::src::Com_TriggerIPDUSend.c, category=SWSRC
          short-label=Autosar::src::Com_TriggerTransmit.c, category=SWSRC
          short-label=Autosar::src::Com_TxConfirmation.c, category=SWSRC
          short-label=Autosar::src::Com_UpdateShadowSignal.c, category=SWSRC
          short-label=make::Com_defs.mak, category=SWMAKE
          short-label=make::Com_rules.mak, category=SWMAKE
    resource consumption ResourceConsumption_0
      11 x memory section:
        CODE: sw-addrmethod=CODE
        CALLOUT_CODE: sw-addrmethod=CALLOUT_CODE
        CONST_32: alignment=32, sw-addrmethod=CONST
        CONST_UNSPECIFIED: alignment=UNSPECIFIED, sw-addrmethod=CONST
        VAR_CLEARED_UNSPECIFIED: alignment=UNSPECIFIED, sw-addrmethod=VAR_CLEARED
        VAR_CLEARED_16: alignment=16, sw-addrmethod=VAR_CLEARED
        VAR_CLEARED_32: alignment=32, sw-addrmethod=VAR_CLEARED
        VAR_INIT_8: alignment=8, sw-addrmethod=VAR
        VAR_CLEARED_8: alignment=8, sw-addrmethod=VAR_CLEARED
        CONFIG_DATA_UNSPECIFIED: alignment=UNSPECIFIED, sw-addrmethod=CONFIG_DATA
        CODE_CC_BLOCK: alignment=UNSPECIFIED, sw-addrmethod=CODE
