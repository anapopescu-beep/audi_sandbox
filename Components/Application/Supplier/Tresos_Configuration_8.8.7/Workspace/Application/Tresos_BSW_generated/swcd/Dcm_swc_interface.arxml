AUTOSAR XML (schema 4-2-1)
package /AUTOSAR_Dcm/ASR42/ImplementationDataTypes
  151 x impl type:
    Dcm_ASR42_SecLevelType: compu {49=DcmConf_DcmDspSecurity_DcmDspSecurityAlv}, implementation-data-type=uint8
    Dcm_ASR42_SesCtrlType: compu {1=DcmConf_DcmDspSession_DCM_DEFAULT_SESSION, 2=DcmConf_DcmDspSession_DCM_PROGRAMMING_SESSION, 3=DcmConf_DcmDspSession_DCM_EXTENDED_SESSION, 126=DcmConf_DcmDspSession_DCM_SUPPLIER_SESSION, 96=DcmConf_DcmDspSession_DCM_ELE_MANUFACTURING_SESSION, 97=DcmConf_DcmDspSession_DCM_SYSTEM_MANUFACTURING_SESSION}, implementation-data-type=uint8
    Dcm_ASR42_ProtocolType: compu {0=DCM_OBD_ON_CAN, 1=DCM_OBD_ON_FLEXRAY, 2=DCM_OBD_ON_IP, 3=DCM_UDS_ON_CAN, 4=DCM_UDS_ON_FLEXRAY, 5=DCM_UDS_ON_IP, 6=DCM_ROE_ON_CAN, 7=DCM_ROE_ON_FLEXRAY, 8=DCM_ROE_ON_IP, 9=DCM_PERIODICTRANS_ON_CAN, 10=DCM_PERIODICTRANS_ON_FLEXRAY, 11=DCM_PERIODICTRANS_ON_IP, 12=DCM_NO_ACTIVE_PROTOCOL, 240..254=DCM_SUPPLIER_1..DCM_SUPPLIER_15}, implementation-data-type=uint8
    Dcm_ASR42_OpStatusType: compu {0=DCM_INITIAL, 1=DCM_PENDING, 2=DCM_CANCEL, 3=DCM_FORCE_RCRRP_OK}, implementation-data-type=uint8
    Dcm_ASR42_ConfirmationStatusType: compu {0=DCM_RES_POS_OK, 1=DCM_RES_POS_NOT_OK, 2=DCM_RES_NEG_OK, 3=DCM_RES_NEG_NOT_OK}, implementation-data-type=uint8
    Dcm_ASR42_NegativeResponseCodeType: compu {0=DCM_E_POSITIVERESPONSE, 16=DCM_E_GENERALREJECT, 17=DCM_E_SERVICENOTSUPPORTED, 18=DCM_E_SUBFUNCTIONNOTSUPPORTED, 19=DCM_E_INCORRECTMESSAGELENGTHORINVALIDFORMAT, 20=DCM_E_RESPONSETOOLONG, 33=DCM_E_BUSYREPEATREQUEST, 34=DCM_E_CONDITIONSNOTCORRECT, 36=DCM_E_REQUESTSEQUENCEERROR, 37=DCM_E_NORESPONSEFROMSUBNETCOMPONENT, 38=DCM_E_FAILUREPREVENTSEXECUTIONOFREQUESTEDACTION, 49=DCM_E_REQUESTOUTOFRANGE, 51=DCM_E_SECURITYACCESSDENIED, 52=DCM_E_AUTHENTICATIONREQUIRED, 53=DCM_E_INVALIDKEY, 54=DCM_E_EXCEEDNUMBEROFATTEMPTS, 55=DCM_E_REQUIREDTIMEDELAYNOTEXPIRED, 80=DCM_E_CERTIFICATEVERIFICATIONFAILEDINVALIDTIMEPERIOD, 81=DCM_E_CERTIFICATEVERIFICATIONFAILEDINVALIDSIGNATURE, 82=DCM_E_CERTIFICATEVERIFICATIONFAILEDINVALIDCHAINOFTRUST, 83=DCM_E_CERTIFICATEVERIFICATIONFAILEDINVALIDTYPE, 84=DCM_E_CERTIFICATEVERIFICATIONFAILEDINVALIDFORMAT, 85=DCM_E_CERTIFICATEVERIFICATIONFAILEDINVALIDCONTENT, 86=DCM_E_CERTIFICATEVERIFICATIONFAILEDINVALIDSCOPE, 87=DCM_E_CERTIFICATEVERIFICATIONFAILEDREVOKED, 88=DCM_E_OWNERSHIPVERIFICATIONFAILED, 112=DCM_E_UPLOADDOWNLOADNOTACCEPTED, 113=DCM_E_TRANSFERDATASUSPENDED, 114=DCM_E_GENERALPROGRAMMINGFAILURE, 115=DCM_E_WRONGBLOCKSEQUENCECOUNTER, 120=DCM_E_REQUESTCORRECTLYRECEIVEDRESPONSEPENDING, 126=DCM_E_SUBFUNCTIONNOTSUPPORTEDINACTIVESESSION, 127=DCM_E_SERVICENOTSUPPORTEDINACTIVESESSION, 129=DCM_E_RPMTOOHIGH, 130=DCM_E_RPMTOOLOW, 131=DCM_E_ENGINEISRUNNING, 132=DCM_E_ENGINEISNOTRUNNING, 133=DCM_E_ENGINERUNTIMETOOLOW, 134=DCM_E_TEMPERATURETOOHIGH, 135=DCM_E_TEMPERATURETOOLOW, 136=DCM_E_VEHICLESPEEDTOOHIGH, 137=DCM_E_VEHICLESPEEDTOOLOW, 138=DCM_E_THROTTLE_PEDALTOOHIGH, 139=DCM_E_THROTTLE_PEDALTOOLOW, 140=DCM_E_TRANSMISSIONRANGENOTINNEUTRAL, 141=DCM_E_TRANSMISSIONRANGENOTINGEAR, 143=DCM_E_BRAKESWITCH_NOTCLOSED, 144=DCM_E_SHIFTERLEVERNOTINPARK, 145=DCM_E_TORQUECONVERTERCLUTCHLOCKED, 146=DCM_E_VOLTAGETOOHIGH, 147=DCM_E_VOLTAGETOOLOW}, implementation-data-type=uint8
    Dcm_ASR42_SecSeedDcmDspSecurityAlv_ArrayType: category=ARRAY
      element AuxU8_Dcm_SecSeedDcmDspSecurityAlv_ArrayType: array-size=8, array-size-semantics=FIXED-SIZE, implementation-data-type=uint8
    Dcm_ASR42_SecKeyDcmDspSecurityAlv_ArrayType: category=ARRAY
      element AuxU8_Dcm_SecKeyDcmDspSecurityAlv_ArrayType: array-size=8, array-size-semantics=FIXED-SIZE, implementation-data-type=uint8
    ASR42_DataArrayTypeUint8_DID_4024_SWSystemTimeData: category=ARRAY
      element AuxU8_Dcm_DataDID_4024_SWSystemTimeData_ArrayType: array-size=5, array-size-semantics=FIXED-SIZE, implementation-data-type=uint8
    Dcm_ASR42_DataDID_4024_SWSystemTimeData_ArrayType: category=ARRAY
      element AuxU8_Dcm_DataDID_4024_SWSystemTimeData_ArrayType: array-size=5, array-size-semantics=FIXED-SIZE, implementation-data-type=uint8
    ASR42_DataArrayTypeUint8_DID_FD00_HWVersionData: category=ARRAY
      element AuxU8_Dcm_DataDID_FD00_HWVersionData_ArrayType: array-size=10, array-size-semantics=FIXED-SIZE, implementation-data-type=uint8
    Dcm_ASR42_DataDID_FD00_HWVersionData_ArrayType: category=ARRAY
      element AuxU8_Dcm_DataDID_FD00_HWVersionData_ArrayType: array-size=10, array-size-semantics=FIXED-SIZE, implementation-data-type=uint8
    ASR42_DataArrayTypeUint8_DID_FD01_SWVersionData: category=ARRAY
      element AuxU8_Dcm_DataDID_FD01_SWVersionData_ArrayType: array-size=12, array-size-semantics=FIXED-SIZE, implementation-data-type=uint8
    Dcm_ASR42_DataDID_FD01_SWVersionData_ArrayType: category=ARRAY
      element AuxU8_Dcm_DataDID_FD01_SWVersionData_ArrayType: array-size=12, array-size-semantics=FIXED-SIZE, implementation-data-type=uint8
    ASR42_DataArrayTypeUint8_DID_FD03_AEETraceabilityNumberData: category=ARRAY
      element AuxU8_Dcm_DataDID_FD03_AEETraceabilityNumberData_ArrayType: array-size=12, array-size-semantics=FIXED-SIZE, implementation-data-type=uint8
    Dcm_ASR42_DataDID_FD03_AEETraceabilityNumberData_ArrayType: category=ARRAY
      element AuxU8_Dcm_DataDID_FD03_AEETraceabilityNumberData_ArrayType: array-size=12, array-size-semantics=FIXED-SIZE, implementation-data-type=uint8
    ASR42_DataArrayTypeUint8_DID_FD08_ResetCauseData: category=ARRAY
      element AuxU8_Dcm_DataDID_FD08_ResetCauseData_ArrayType: array-size=4, array-size-semantics=FIXED-SIZE, implementation-data-type=uint8
    Dcm_ASR42_DataDID_FD08_ResetCauseData_ArrayType: category=ARRAY
      element AuxU8_Dcm_DataDID_FD08_ResetCauseData_ArrayType: array-size=4, array-size-semantics=FIXED-SIZE, implementation-data-type=uint8
    ASR42_DataArrayTypeUint8_DID_FD09_LastWarmResetParamData: category=ARRAY
      element AuxU8_Dcm_DataDID_FD09_LastWarmResetParamData_ArrayType: array-size=8, array-size-semantics=FIXED-SIZE, implementation-data-type=uint8
    Dcm_ASR42_DataDID_FD09_LastWarmResetParamData_ArrayType: category=ARRAY
      element AuxU8_Dcm_DataDID_FD09_LastWarmResetParamData_ArrayType: array-size=8, array-size-semantics=FIXED-SIZE, implementation-data-type=uint8
    ASR42_DataArrayTypeUint8_DID_FD62_EccOccurenceNbData: category=ARRAY
      element AuxU8_Dcm_DataDID_FD62_EccOccurenceNbData_ArrayType: array-size=16, array-size-semantics=FIXED-SIZE, implementation-data-type=uint8
    Dcm_ASR42_DataDID_FD62_EccOccurenceNbData_ArrayType: category=ARRAY
      element AuxU8_Dcm_DataDID_FD62_EccOccurenceNbData_ArrayType: array-size=16, array-size-semantics=FIXED-SIZE, implementation-data-type=uint8
    ASR42_DataArrayTypeUint8_DID_FEFF_MeasurementFramesConfData: category=ARRAY
      element AuxU8_Dcm_DataDID_FEFF_MeasurementFramesConfData_ArrayType: array-size=5, array-size-semantics=FIXED-SIZE, implementation-data-type=uint8
    Dcm_ASR42_DataDID_FEFF_MeasurementFramesConfData_ArrayType: category=ARRAY
      element AuxU8_Dcm_DataDID_FEFF_MeasurementFramesConfData_ArrayType: array-size=5, array-size-semantics=FIXED-SIZE, implementation-data-type=uint8
    ASR42_DataArrayTypeUint8_DID_FE00_AllEventStatusesRead: category=ARRAY
      element AuxU8_Dcm_DataDID_FE00_AllEventStatusesRead_ArrayType: array-size=69, array-size-semantics=FIXED-SIZE, implementation-data-type=uint8
    Dcm_ASR42_DataDID_FE00_AllEventStatusesRead_ArrayType: category=ARRAY
      element AuxU8_Dcm_DataDID_FE00_AllEventStatusesRead_ArrayType: array-size=69, array-size-semantics=FIXED-SIZE, implementation-data-type=uint8
    ASR42_DataArrayTypeUint8_DID_F186_ActiveDiagnosticSessionData: category=ARRAY
      element AuxU8_Dcm_DataDID_F186_ActiveDiagnosticSessionData_ArrayType: array-size=1, array-size-semantics=FIXED-SIZE, implementation-data-type=uint8
    Dcm_ASR42_DataDID_F186_ActiveDiagnosticSessionData_ArrayType: category=ARRAY
      element AuxU8_Dcm_DataDID_F186_ActiveDiagnosticSessionData_ArrayType: array-size=1, array-size-semantics=FIXED-SIZE, implementation-data-type=uint8
    ASR42_DataArrayTypeUint8_DID_FD8B_ECUManufacturingDateData: category=ARRAY
      element AuxU8_Dcm_DataDID_FD8B_ECUManufacturingDateData_ArrayType: array-size=3, array-size-semantics=FIXED-SIZE, implementation-data-type=uint8
    Dcm_ASR42_DataDID_FD8B_ECUManufacturingDateData_ArrayType: category=ARRAY
      element AuxU8_Dcm_DataDID_FD8B_ECUManufacturingDateData_ArrayType: array-size=3, array-size-semantics=FIXED-SIZE, implementation-data-type=uint8
    ASR42_DataArrayTypeUint8_DID_FD8C_AssemblySerialNumber: category=ARRAY
      element AuxU8_Dcm_DataDID_FD8C_AssemblySerialNumber_ArrayType: array-size=20, array-size-semantics=FIXED-SIZE, implementation-data-type=uint8
    Dcm_ASR42_DataDID_FD8C_AssemblySerialNumber_ArrayType: category=ARRAY
      element AuxU8_Dcm_DataDID_FD8C_AssemblySerialNumber_ArrayType: array-size=20, array-size-semantics=FIXED-SIZE, implementation-data-type=uint8
    ASR42_DataArrayTypeUint8_DID_FD0F_BatteryMeasureData: category=ARRAY
      element AuxU8_Dcm_DataDID_FD0F_BatteryMeasureData_ArrayType: array-size=2, array-size-semantics=FIXED-SIZE, implementation-data-type=uint8
    Dcm_ASR42_DataDID_FD0F_BatteryMeasureData_ArrayType: category=ARRAY
      element AuxU8_Dcm_DataDID_FD0F_BatteryMeasureData_ArrayType: array-size=2, array-size-semantics=FIXED-SIZE, implementation-data-type=uint8
    ASR42_DataArrayTypeUint8_DID_FD10_ECUTemperatureData: category=ARRAY
      element AuxU8_Dcm_DataDID_FD10_ECUTemperatureData_ArrayType: array-size=2, array-size-semantics=FIXED-SIZE, implementation-data-type=uint8
    Dcm_ASR42_DataDID_FD10_ECUTemperatureData_ArrayType: category=ARRAY
      element AuxU8_Dcm_DataDID_FD10_ECUTemperatureData_ArrayType: array-size=2, array-size-semantics=FIXED-SIZE, implementation-data-type=uint8
    ASR42_DataArrayTypeUint8_DID_FDE0_EcsVariantData: category=ARRAY
      element AuxU8_Dcm_DataDID_FDE0_EcsVariantData_ArrayType: array-size=4, array-size-semantics=FIXED-SIZE, implementation-data-type=uint8
    Dcm_ASR42_DataDID_FDE0_EcsVariantData_ArrayType: category=ARRAY
      element AuxU8_Dcm_DataDID_FDE0_EcsVariantData_ArrayType: array-size=4, array-size-semantics=FIXED-SIZE, implementation-data-type=uint8
    ASR42_DataArrayTypeUint8_DID_FDE1_EcsParametersData: category=ARRAY
      element AuxU8_Dcm_DataDID_FDE1_EcsParametersData_ArrayType: array-size=49, array-size-semantics=FIXED-SIZE, implementation-data-type=uint8
    Dcm_ASR42_DataDID_FDE1_EcsParametersData_ArrayType: category=ARRAY
      element AuxU8_Dcm_DataDID_FDE1_EcsParametersData_ArrayType: array-size=49, array-size-semantics=FIXED-SIZE, implementation-data-type=uint8
    ASR42_DataArrayTypeUint8_DID_FDE2_AccOffsetData: category=ARRAY
      element AuxU8_Dcm_DataDID_FDE2_AccOffsetData_ArrayType: array-size=6, array-size-semantics=FIXED-SIZE, implementation-data-type=uint8
    Dcm_ASR42_DataDID_FDE2_AccOffsetData_ArrayType: category=ARRAY
      element AuxU8_Dcm_DataDID_FDE2_AccOffsetData_ArrayType: array-size=6, array-size-semantics=FIXED-SIZE, implementation-data-type=uint8
    ASR42_DataArrayTypeUint8_DID_FDE3_EcsProfilesData: category=ARRAY
      element AuxU8_Dcm_DataDID_FDE3_EcsProfilesData_ArrayType: array-size=48, array-size-semantics=FIXED-SIZE, implementation-data-type=uint8
    Dcm_ASR42_DataDID_FDE3_EcsProfilesData_ArrayType: category=ARRAY
      element AuxU8_Dcm_DataDID_FDE3_EcsProfilesData_ArrayType: array-size=48, array-size-semantics=FIXED-SIZE, implementation-data-type=uint8
    ASR42_DataArrayTypeUint8_DID_FDE4_EcsStepsData: category=ARRAY
      element AuxU8_Dcm_DataDID_FDE4_EcsStepsData_ArrayType: array-size=56, array-size-semantics=FIXED-SIZE, implementation-data-type=uint8
    Dcm_ASR42_DataDID_FDE4_EcsStepsData_ArrayType: category=ARRAY
      element AuxU8_Dcm_DataDID_FDE4_EcsStepsData_ArrayType: array-size=56, array-size-semantics=FIXED-SIZE, implementation-data-type=uint8
    ASR42_DataArrayTypeUint8_DID_FDE5_EcsAccLowPassData: category=ARRAY
      element AuxU8_Dcm_DataDID_FDE5_EcsAccLowPassData_ArrayType: array-size=3, array-size-semantics=FIXED-SIZE, implementation-data-type=uint8
    Dcm_ASR42_DataDID_FDE5_EcsAccLowPassData_ArrayType: category=ARRAY
      element AuxU8_Dcm_DataDID_FDE5_EcsAccLowPassData_ArrayType: array-size=3, array-size-semantics=FIXED-SIZE, implementation-data-type=uint8
    ASR42_DataArrayTypeUint8_DID_FDE7_AlgoOutputDelayData: category=ARRAY
      element AuxU8_Dcm_DataDID_FDE7_AlgoOutputDelayData_ArrayType: array-size=2, array-size-semantics=FIXED-SIZE, implementation-data-type=uint8
    Dcm_ASR42_DataDID_FDE7_AlgoOutputDelayData_ArrayType: category=ARRAY
      element AuxU8_Dcm_DataDID_FDE7_AlgoOutputDelayData_ArrayType: array-size=2, array-size-semantics=FIXED-SIZE, implementation-data-type=uint8
    ASR42_DataArrayTypeUint8_DID_FDE9_SensitivityLutData: category=ARRAY
      element AuxU8_Dcm_DataDID_FDE9_SensitivityLutData_ArrayType: array-size=20, array-size-semantics=FIXED-SIZE, implementation-data-type=uint8
    Dcm_ASR42_DataDID_FDE9_SensitivityLutData_ArrayType: category=ARRAY
      element AuxU8_Dcm_DataDID_FDE9_SensitivityLutData_ArrayType: array-size=20, array-size-semantics=FIXED-SIZE, implementation-data-type=uint8
    ASR42_DataArrayTypeUint8_DID_FDEA_SensitivityOptData: category=ARRAY
      element AuxU8_Dcm_DataDID_FDEA_SensitivityOptData_ArrayType: array-size=1, array-size-semantics=FIXED-SIZE, implementation-data-type=uint8
    Dcm_ASR42_DataDID_FDEA_SensitivityOptData_ArrayType: category=ARRAY
      element AuxU8_Dcm_DataDID_FDEA_SensitivityOptData_ArrayType: array-size=1, array-size-semantics=FIXED-SIZE, implementation-data-type=uint8
    ASR42_DataArrayTypeUint8_DID_FDFF_MeasurementFrameConfDataRam: category=ARRAY
      element AuxU8_Dcm_DataDID_FDFF_MeasurementFrameConfDataRam_ArrayType: array-size=75, array-size-semantics=FIXED-SIZE, implementation-data-type=uint8
    Dcm_ASR42_DataDID_FDFF_MeasurementFrameConfDataRam_ArrayType: category=ARRAY
      element AuxU8_Dcm_DataDID_FDFF_MeasurementFrameConfDataRam_ArrayType: array-size=75, array-size-semantics=FIXED-SIZE, implementation-data-type=uint8
    ASR42_DataArrayTypeUint8_DID_F187_VWSparePartNumberData: category=ARRAY
      element AuxU8_Dcm_DataDID_F187_VWSparePartNumberData_ArrayType: array-size=11, array-size-semantics=FIXED-SIZE, implementation-data-type=uint8
    Dcm_ASR42_DataDID_F187_VWSparePartNumberData_ArrayType: category=ARRAY
      element AuxU8_Dcm_DataDID_F187_VWSparePartNumberData_ArrayType: array-size=11, array-size-semantics=FIXED-SIZE, implementation-data-type=uint8
    ASR42_DataArrayTypeUint8_DID_F189_VWApplicationSoftwareVersionNumberData: category=ARRAY
      element AuxU8_Dcm_DataDID_F189_VWApplicationSoftwareVersionNumberData_ArrayType: array-size=4, array-size-semantics=FIXED-SIZE, implementation-data-type=uint8
    Dcm_ASR42_DataDID_F189_VWApplicationSoftwareVersionNumberData_ArrayType: category=ARRAY
      element AuxU8_Dcm_DataDID_F189_VWApplicationSoftwareVersionNumberData_ArrayType: array-size=4, array-size-semantics=FIXED-SIZE, implementation-data-type=uint8
    ASR42_DataArrayTypeUint8_DID_F191_VWECUHardwareNumberData: category=ARRAY
      element AuxU8_Dcm_DataDID_F191_VWECUHardwareNumberData_ArrayType: array-size=11, array-size-semantics=FIXED-SIZE, implementation-data-type=uint8
    Dcm_ASR42_DataDID_F191_VWECUHardwareNumberData_ArrayType: category=ARRAY
      element AuxU8_Dcm_DataDID_F191_VWECUHardwareNumberData_ArrayType: array-size=11, array-size-semantics=FIXED-SIZE, implementation-data-type=uint8
    ASR42_DataArrayTypeUint8_DID_F197_VWSystemNameOrEngineTypeData: category=ARRAY
      element AuxU8_Dcm_DataDID_F197_VWSystemNameOrEngineTypeData_ArrayType: array-size=13, array-size-semantics=FIXED-SIZE, implementation-data-type=uint8
    Dcm_ASR42_DataDID_F197_VWSystemNameOrEngineTypeData_ArrayType: category=ARRAY
      element AuxU8_Dcm_DataDID_F197_VWSystemNameOrEngineTypeData_ArrayType: array-size=13, array-size-semantics=FIXED-SIZE, implementation-data-type=uint8
    ASR42_DataArrayTypeUint8_DID_F1B4_TechnicalSpecificationsVersionData: category=ARRAY
      element AuxU8_Dcm_DataDID_F1B4_TechnicalSpecificationsVersionData_ArrayType: array-size=26, array-size-semantics=FIXED-SIZE, implementation-data-type=uint8
    Dcm_ASR42_DataDID_F1B4_TechnicalSpecificationsVersionData_ArrayType: category=ARRAY
      element AuxU8_Dcm_DataDID_F1B4_TechnicalSpecificationsVersionData_ArrayType: array-size=26, array-size-semantics=FIXED-SIZE, implementation-data-type=uint8
    ASR42_DataArrayTypeUint8_DID_0407_VWLogicalSoftwareBlockCounterOfProgrammingAttemptsData: category=ARRAY
      element AuxU8_Dcm_DataDID_0407_VWLogicalSoftwareBlockCounterOfProgrammingAttemptsData_ArrayType: array-size=6, array-size-semantics=FIXED-SIZE, implementation-data-type=uint8
    Dcm_ASR42_DataDID_0407_VWLogicalSoftwareBlockCounterOfProgrammingAttemptsData_ArrayType: category=ARRAY
      element AuxU8_Dcm_DataDID_0407_VWLogicalSoftwareBlockCounterOfProgrammingAttemptsData_ArrayType: array-size=6, array-size-semantics=FIXED-SIZE, implementation-data-type=uint8
    ASR42_DataArrayTypeUint8_DID_040F_VWLogicalSoftwareBlockLockValueData: category=ARRAY
      element AuxU8_Dcm_DataDID_040F_VWLogicalSoftwareBlockLockValueData_ArrayType: array-size=6, array-size-semantics=FIXED-SIZE, implementation-data-type=uint8
    Dcm_ASR42_DataDID_040F_VWLogicalSoftwareBlockLockValueData_ArrayType: category=ARRAY
      element AuxU8_Dcm_DataDID_040F_VWLogicalSoftwareBlockLockValueData_ArrayType: array-size=6, array-size-semantics=FIXED-SIZE, implementation-data-type=uint8
    ASR42_DataArrayTypeUint8_DID_0410_BootloaderTPBlocksizeData: category=ARRAY
      element AuxU8_Dcm_DataDID_0410_BootloaderTPBlocksizeData_ArrayType: array-size=1, array-size-semantics=FIXED-SIZE, implementation-data-type=uint8
    Dcm_ASR42_DataDID_0410_BootloaderTPBlocksizeData_ArrayType: category=ARRAY
      element AuxU8_Dcm_DataDID_0410_BootloaderTPBlocksizeData_ArrayType: array-size=1, array-size-semantics=FIXED-SIZE, implementation-data-type=uint8
    ASR42_DataArrayTypeUint8_DID_0448_ProgrammingPreconditionsData: category=ARRAY
      element AuxU8_Dcm_DataDID_0448_ProgrammingPreconditionsData_ArrayType: array-size=5, array-size-semantics=FIXED-SIZE, implementation-data-type=uint8
    Dcm_ASR42_DataDID_0448_ProgrammingPreconditionsData_ArrayType: category=ARRAY
      element AuxU8_Dcm_DataDID_0448_ProgrammingPreconditionsData_ArrayType: array-size=5, array-size-semantics=FIXED-SIZE, implementation-data-type=uint8
    ASR42_DataArrayTypeUint8_DID_F1DF_ECUProgrammingInformationData: category=ARRAY
      element AuxU8_Dcm_DataDID_F1DF_ECUProgrammingInformationData_ArrayType: array-size=1, array-size-semantics=FIXED-SIZE, implementation-data-type=uint8
    Dcm_ASR42_DataDID_F1DF_ECUProgrammingInformationData_ArrayType: category=ARRAY
      element AuxU8_Dcm_DataDID_F1DF_ECUProgrammingInformationData_ArrayType: array-size=1, array-size-semantics=FIXED-SIZE, implementation-data-type=uint8
    ASR42_DataArrayTypeUint8_DID_F19E_ASAMODXFileIdentifierData: category=ARRAY
      element AuxU8_Dcm_DataDID_F19E_ASAMODXFileIdentifierData_ArrayType: array-size=24, array-size-semantics=FIXED-SIZE, implementation-data-type=uint8
    Dcm_ASR42_DataDID_F19E_ASAMODXFileIdentifierData_ArrayType: category=ARRAY
      element AuxU8_Dcm_DataDID_F19E_ASAMODXFileIdentifierData_ArrayType: array-size=24, array-size-semantics=FIXED-SIZE, implementation-data-type=uint8
    ASR42_DataArrayTypeUint8_DID_F1A2_ASAMODXFileVersionData: category=ARRAY
      element AuxU8_Dcm_DataDID_F1A2_ASAMODXFileVersionData_ArrayType: array-size=6, array-size-semantics=FIXED-SIZE, implementation-data-type=uint8
    Dcm_ASR42_DataDID_F1A2_ASAMODXFileVersionData_ArrayType: category=ARRAY
      element AuxU8_Dcm_DataDID_F1A2_ASAMODXFileVersionData_ArrayType: array-size=6, array-size-semantics=FIXED-SIZE, implementation-data-type=uint8
    ASR42_DataArrayTypeUint8_DID_F1D5_FDSProjectData: category=ARRAY
      element AuxU8_Dcm_DataDID_F1D5_FDSProjectData_ArrayType: array-size=7, array-size-semantics=FIXED-SIZE, implementation-data-type=uint8
    Dcm_ASR42_DataDID_F1D5_FDSProjectData_ArrayType: category=ARRAY
      element AuxU8_Dcm_DataDID_F1D5_FDSProjectData_ArrayType: array-size=7, array-size-semantics=FIXED-SIZE, implementation-data-type=uint8
    ASR42_DataArrayTypeUint8_DID_F1A3_VWECUHardwareVersionNumberData: category=ARRAY
      element AuxU8_Dcm_DataDID_F1A3_VWECUHardwareVersionNumberData_ArrayType: array-size=3, array-size-semantics=FIXED-SIZE, implementation-data-type=uint8
    Dcm_ASR42_DataDID_F1A3_VWECUHardwareVersionNumberData_ArrayType: category=ARRAY
      element AuxU8_Dcm_DataDID_F1A3_VWECUHardwareVersionNumberData_ArrayType: array-size=3, array-size-semantics=FIXED-SIZE, implementation-data-type=uint8
    ASR42_DataArrayTypeUint8_DID_F18C_ECUSerialNumberData: category=ARRAY
      element AuxU8_Dcm_DataDID_F18C_ECUSerialNumberData_ArrayType: array-size=20, array-size-semantics=FIXED-SIZE, implementation-data-type=uint8
    Dcm_ASR42_DataDID_F18C_ECUSerialNumberData_ArrayType: category=ARRAY
      element AuxU8_Dcm_DataDID_F18C_ECUSerialNumberData_ArrayType: array-size=20, array-size-semantics=FIXED-SIZE, implementation-data-type=uint8
    ASR42_DataArrayTypeUint8_DID_F1AB_VWLogicalSoftwareBlockVersionData: category=ARRAY
      element AuxU8_Dcm_DataDID_F1AB_VWLogicalSoftwareBlockVersionData_ArrayType: array-size=12, array-size-semantics=FIXED-SIZE, implementation-data-type=uint8
    Dcm_ASR42_DataDID_F1AB_VWLogicalSoftwareBlockVersionData_ArrayType: category=ARRAY
      element AuxU8_Dcm_DataDID_F1AB_VWLogicalSoftwareBlockVersionData_ArrayType: array-size=12, array-size-semantics=FIXED-SIZE, implementation-data-type=uint8
    ASR42_DataArrayTypeUint8_DID_F15B_FingerprintAndProgrammingDateOfLogicalSoftwareBlocksData: category=ARRAY
      element AuxU8_Dcm_DataDID_F15B_FingerprintAndProgrammingDateOfLogicalSoftwareBlocksData_ArrayType: array-size=30, array-size-semantics=FIXED-SIZE, implementation-data-type=uint8
    Dcm_ASR42_DataDID_F15B_FingerprintAndProgrammingDateOfLogicalSoftwareBlocksData_ArrayType: category=ARRAY
      element AuxU8_Dcm_DataDID_F15B_FingerprintAndProgrammingDateOfLogicalSoftwareBlocksData_ArrayType: array-size=30, array-size-semantics=FIXED-SIZE, implementation-data-type=uint8
    ASR42_DataArrayTypeUint8_DID_0236_ProgrammingDataElockEcuData: category=ARRAY
      element AuxU8_Dcm_DataDID_0236_ProgrammingDataElockEcuData_ArrayType: array-size=59, array-size-semantics=FIXED-SIZE, implementation-data-type=uint8
    Dcm_ASR42_DataDID_0236_ProgrammingDataElockEcuData_ArrayType: category=ARRAY
      element AuxU8_Dcm_DataDID_0236_ProgrammingDataElockEcuData_ArrayType: array-size=59, array-size-semantics=FIXED-SIZE, implementation-data-type=uint8
    ASR42_DataArrayTypeUint8_DID_023E_WSCForProgrammingElockEcuData: category=ARRAY
      element AuxU8_Dcm_DataDID_023E_WSCForProgrammingElockEcuData_ArrayType: array-size=6, array-size-semantics=FIXED-SIZE, implementation-data-type=uint8
    Dcm_ASR42_DataDID_023E_WSCForProgrammingElockEcuData_ArrayType: category=ARRAY
      element AuxU8_Dcm_DataDID_023E_WSCForProgrammingElockEcuData_ArrayType: array-size=6, array-size-semantics=FIXED-SIZE, implementation-data-type=uint8
    Dcm_ASR42_DidSupportedType: compu {0=DCM_DID_SUPPORTED, 1=DCM_DID_NOT_SUPPORTED}, implementation-data-type=uint8
    Dcm_StartDataOut_DcmDspRoutineCtrl_Lock_UnlockECU_DcmDspStartRoutineOutSignal_0PrimitivType: implementation-data-type=uint8
    Dcm_StartDataOut_DcmDspRoutineCtrl_Lock_UnlockECU_DcmDspStartRoutineOutSignal_0Type: implementation-data-type=ImplementationDataTypes/Dcm_StartDataOut_DcmDspRoutineCtrl_Lock_UnlockECU_DcmDspStartRoutineOutSignal_0PrimitivType
    StartDataOutType_DcmDspRoutineCtrl_Lock_UnlockECU_DcmDspStartRoutineOutSignal_0: implementation-data-type=uint8
    Dcm_StopDataOut_DcmDspRoutineCtrl_Lock_UnlockECU_DcmDspRoutineStopOutSignal_0PrimitivType: implementation-data-type=uint8
    Dcm_StopDataOut_DcmDspRoutineCtrl_Lock_UnlockECU_DcmDspRoutineStopOutSignal_0Type: implementation-data-type=ImplementationDataTypes/Dcm_StopDataOut_DcmDspRoutineCtrl_Lock_UnlockECU_DcmDspRoutineStopOutSignal_0PrimitivType
    StopDataOutType_DcmDspRoutineCtrl_Lock_UnlockECU_DcmDspRoutineStopOutSignal_0: implementation-data-type=uint8
    Dcm_RequestDataOut_DcmDspRoutineCtrl_Lock_UnlockECU_DcmDspRoutineRequestResOutSignalPrimitivType: implementation-data-type=uint8
    Dcm_RequestDataOut_DcmDspRoutineCtrl_Lock_UnlockECU_DcmDspRoutineRequestResOutSignalType: implementation-data-type=ImplementationDataTypes/Dcm_RequestDataOut_DcmDspRoutineCtrl_Lock_UnlockECU_DcmDspRoutineRequestResOutSignalPrimitivType
    RequestDataOutType_DcmDspRoutineCtrl_Lock_UnlockECU_DcmDspRoutineRequestResOutSignal: implementation-data-type=uint8
    Dcm_RequestDataOut_DcmDspRoutineCtrl_Lock_UnlockECU_DcmDspRoutineRequestResOutSignalInformationLockPrimitivType: implementation-data-type=uint16
    Dcm_RequestDataOut_DcmDspRoutineCtrl_Lock_UnlockECU_DcmDspRoutineRequestResOutSignalInformationLockType: implementation-data-type=ImplementationDataTypes/Dcm_RequestDataOut_DcmDspRoutineCtrl_Lock_UnlockECU_DcmDspRoutineRequestResOutSignalInformationLockPrimitivType
    RequestDataOutType_DcmDspRoutineCtrl_Lock_UnlockECU_DcmDspRoutineRequestResOutSignalInformationLock: implementation-data-type=uint16
    Dcm_StartDataOut_DcmDspRoutineProcessMode_DcmDspStartRoutineOutSignal_RoutineInfoPrimitivType: implementation-data-type=uint8
    Dcm_StartDataOut_DcmDspRoutineProcessMode_DcmDspStartRoutineOutSignal_RoutineInfoType: implementation-data-type=ImplementationDataTypes/Dcm_StartDataOut_DcmDspRoutineProcessMode_DcmDspStartRoutineOutSignal_RoutineInfoPrimitivType
    StartDataOutType_DcmDspRoutineProcessMode_DcmDspStartRoutineOutSignal_RoutineInfo: implementation-data-type=uint8
    Dcm_StopDataOut_DcmDspRoutineProcessMode_DcmDspRoutineStopOutSignal_RoutineInfoPrimitivType: implementation-data-type=uint8
    Dcm_StopDataOut_DcmDspRoutineProcessMode_DcmDspRoutineStopOutSignal_RoutineInfoType: implementation-data-type=ImplementationDataTypes/Dcm_StopDataOut_DcmDspRoutineProcessMode_DcmDspRoutineStopOutSignal_RoutineInfoPrimitivType
    StopDataOutType_DcmDspRoutineProcessMode_DcmDspRoutineStopOutSignal_RoutineInfo: implementation-data-type=uint8
    Dcm_RequestDataOut_DcmDspRoutineProcessMode_DcmDspRoutineRequestResOutSignal_RoutineInfoPrimitivType: implementation-data-type=uint8
    Dcm_RequestDataOut_DcmDspRoutineProcessMode_DcmDspRoutineRequestResOutSignal_RoutineInfoType: implementation-data-type=ImplementationDataTypes/Dcm_RequestDataOut_DcmDspRoutineProcessMode_DcmDspRoutineRequestResOutSignal_RoutineInfoPrimitivType
    RequestDataOutType_DcmDspRoutineProcessMode_DcmDspRoutineRequestResOutSignal_RoutineInfo: implementation-data-type=uint8
    Dcm_RequestDataOut_DcmDspRoutineProcessMode_DcmDspRoutineRequestResOutSignal_PROCESSPrimitivType: implementation-data-type=uint8
    Dcm_RequestDataOut_DcmDspRoutineProcessMode_DcmDspRoutineRequestResOutSignal_PROCESSType: implementation-data-type=ImplementationDataTypes/Dcm_RequestDataOut_DcmDspRoutineProcessMode_DcmDspRoutineRequestResOutSignal_PROCESSPrimitivType
    RequestDataOutType_DcmDspRoutineProcessMode_DcmDspRoutineRequestResOutSignal_PROCESS: implementation-data-type=uint8
    Dcm_StartDataOut_DcmDspRoutineAccCalib_DcmDspStartRoutineOutSignal_RoutineInfoPrimitivType: implementation-data-type=uint8
    Dcm_StartDataOut_DcmDspRoutineAccCalib_DcmDspStartRoutineOutSignal_RoutineInfoType: implementation-data-type=ImplementationDataTypes/Dcm_StartDataOut_DcmDspRoutineAccCalib_DcmDspStartRoutineOutSignal_RoutineInfoPrimitivType
    StartDataOutType_DcmDspRoutineAccCalib_DcmDspStartRoutineOutSignal_RoutineInfo: implementation-data-type=uint8
    Dcm_StartDataOut_DcmDspRoutineLockSolenoid_DcmDspStartRoutineOutSignal_0PrimitivType: implementation-data-type=uint8
    Dcm_StartDataOut_DcmDspRoutineLockSolenoid_DcmDspStartRoutineOutSignal_0Type: implementation-data-type=ImplementationDataTypes/Dcm_StartDataOut_DcmDspRoutineLockSolenoid_DcmDspStartRoutineOutSignal_0PrimitivType
    StartDataOutType_DcmDspRoutineLockSolenoid_DcmDspStartRoutineOutSignal_0: implementation-data-type=uint8
    Dcm_StopDataOut_DcmDspRoutineLockSolenoid_DcmDspStopRoutineOutSignal_RoutineInfoPrimitivType: implementation-data-type=uint8
    Dcm_StopDataOut_DcmDspRoutineLockSolenoid_DcmDspStopRoutineOutSignal_RoutineInfoType: implementation-data-type=ImplementationDataTypes/Dcm_StopDataOut_DcmDspRoutineLockSolenoid_DcmDspStopRoutineOutSignal_RoutineInfoPrimitivType
    StopDataOutType_DcmDspRoutineLockSolenoid_DcmDspStopRoutineOutSignal_RoutineInfo: implementation-data-type=uint8
    Dcm_StartDataIn_DcmDspRoutineEcuTempCalibration_DcmDspStartRoutineInSignal_0PrimitivType: implementation-data-type=sint8
    Dcm_StartDataIn_DcmDspRoutineEcuTempCalibration_DcmDspStartRoutineInSignal_0Type: implementation-data-type=ImplementationDataTypes/Dcm_StartDataIn_DcmDspRoutineEcuTempCalibration_DcmDspStartRoutineInSignal_0PrimitivType
    StartDataInType_DcmDspRoutineEcuTempCalibration_DcmDspStartRoutineInSignal_0: implementation-data-type=sint8
    Dcm_StartDataOut_DcmDspRoutineEcuTempCalibration_DcmDspStartRoutineOutSignal_0PrimitivType: implementation-data-type=uint8
    Dcm_StartDataOut_DcmDspRoutineEcuTempCalibration_DcmDspStartRoutineOutSignal_0Type: implementation-data-type=ImplementationDataTypes/Dcm_StartDataOut_DcmDspRoutineEcuTempCalibration_DcmDspStartRoutineOutSignal_0PrimitivType
    StartDataOutType_DcmDspRoutineEcuTempCalibration_DcmDspStartRoutineOutSignal_0: implementation-data-type=uint8
    Dcm_StartDataIn_DcmDspRoutineAccAngleOffsetCalibration_DcmDspStartRoutineInSignal_0PrimitivType: implementation-data-type=uint16
    Dcm_StartDataIn_DcmDspRoutineAccAngleOffsetCalibration_DcmDspStartRoutineInSignal_0Type: implementation-data-type=ImplementationDataTypes/Dcm_StartDataIn_DcmDspRoutineAccAngleOffsetCalibration_DcmDspStartRoutineInSignal_0PrimitivType
    StartDataInType_DcmDspRoutineAccAngleOffsetCalibration_DcmDspStartRoutineInSignal_0: implementation-data-type=uint16
    Dcm_StartDataIn_DcmDspRoutineAccAngleOffsetCalibration_DcmDspStartRoutineInSignal_1PrimitivType: implementation-data-type=uint16
    Dcm_StartDataIn_DcmDspRoutineAccAngleOffsetCalibration_DcmDspStartRoutineInSignal_1Type: implementation-data-type=ImplementationDataTypes/Dcm_StartDataIn_DcmDspRoutineAccAngleOffsetCalibration_DcmDspStartRoutineInSignal_1PrimitivType
    StartDataInType_DcmDspRoutineAccAngleOffsetCalibration_DcmDspStartRoutineInSignal_1: implementation-data-type=uint16
    Dcm_StartDataIn_DcmDspRoutineAccAngleOffsetCalibration_DcmDspStartRoutineInSignal_2PrimitivType: implementation-data-type=uint16
    Dcm_StartDataIn_DcmDspRoutineAccAngleOffsetCalibration_DcmDspStartRoutineInSignal_2Type: implementation-data-type=ImplementationDataTypes/Dcm_StartDataIn_DcmDspRoutineAccAngleOffsetCalibration_DcmDspStartRoutineInSignal_2PrimitivType
    StartDataInType_DcmDspRoutineAccAngleOffsetCalibration_DcmDspStartRoutineInSignal_2: implementation-data-type=uint16
    Dcm_StartDataOut_DcmDspRoutineAccAngleOffsetCalibration_DcmDspStartRoutineOutSignal_0PrimitivType: implementation-data-type=uint8
    Dcm_StartDataOut_DcmDspRoutineAccAngleOffsetCalibration_DcmDspStartRoutineOutSignal_0Type: implementation-data-type=ImplementationDataTypes/Dcm_StartDataOut_DcmDspRoutineAccAngleOffsetCalibration_DcmDspStartRoutineOutSignal_0PrimitivType
    StartDataOutType_DcmDspRoutineAccAngleOffsetCalibration_DcmDspStartRoutineOutSignal_0: implementation-data-type=uint8
    Dcm_StartFlexibleOutArrayData_DcmDspRoutineRoutineCheckProgrammingPreconditions_DcmDspStartRoutineOutSignal_0Type: category=ARRAY
      element AuxU8_Dcm_StartFlexibleOutArrayData_DcmDspRoutineRoutineCheckProgrammingPreconditions_DcmDspStartRoutineOutSignal_0Type: array-size=5, array-size-semantics=FIXED-SIZE, implementation-data-type=uint8
    DcmDspRoutineInfoCheckProgrammingPreconditions_DcmDspStartRoutineOutSignal_ArrayType: category=ARRAY
      element AuxU8_DcmDspRoutineInfoCheckProgrammingPreconditions_DcmDspStartRoutineOutSignal_ArrayType: array-size=5, array-size-semantics=FIXED-SIZE, implementation-data-type=uint8
    StartFlexibleOutArrayDataType_DcmDspRoutineRoutineCheckProgrammingPreconditions_DcmDspStartRoutineOutSignal_0: category=ARRAY
      element AuxU8_StartFlexibleOutArrayDataType_DcmDspRoutineRoutineCheckProgrammingPreconditions_DcmDspStartRoutineOutSignal_0: array-size=5, array-size-semantics=FIXED-SIZE, implementation-data-type=uint8
    Dcm_ASR42_RequestData_ArrayType: category=ARRAY
      element AuxU8_Dcm_RequestData_ArrayType: array-size=512, array-size-semantics=FIXED-SIZE, implementation-data-type=uint8
    Dcm_ASR42_Uint8PtrDataType: category=DATA_REFERENCE, sw-pointer-target-props={target-category=TYPE_REFERENCE, implementation-data-type=uint8}
package /AUTOSAR_Dcm/ASR42/PortInterfaces
  54 x client server interface, all with is-service=true:
    Dcm_ASR42_DCMServices
      5 x operation, all with possible-error=Dcm_ASR42_DCMServices/E_NOT_OK:
        GetSecurityLevel
          arg SecLevel: type=Dcm_ASR42_SecLevelType, direction=OUT
        GetSesCtrlType
          arg SesCtrlType: type=Dcm_ASR42_SesCtrlType, direction=OUT
        GetActiveProtocol
          arg ActiveProtocol: type=Dcm_ASR42_ProtocolType, direction=OUT
        ResetToDefaultSession
        SetActiveDiagnostic
          arg active: type=boolean, direction=IN
      error E_NOT_OK: error-code=1
    DCM_ASR42_Roe
      operation TriggerOnEvent: possible-error=DCM_ASR42_Roe/E_NOT_OK
      error E_NOT_OK: error-code=1
    SecurityAccess_ASR42_DcmDspSecurityAlv
      operation GetSeed: possible-error=[SecurityAccess_ASR42_DcmDspSecurityAlv/E_NOT_OK, SecurityAccess_ASR42_DcmDspSecurityAlv/DCM_E_PENDING]
        arg OpStatus: type=Dcm_ASR42_OpStatusType, direction=IN
        arg Seed: type=Dcm_ASR42_SecSeedDcmDspSecurityAlv_ArrayType, direction=OUT
        arg ErrorCode: type=Dcm_ASR42_NegativeResponseCodeType, direction=OUT
      operation CompareKey: possible-error=[SecurityAccess_ASR42_DcmDspSecurityAlv/E_NOT_OK, SecurityAccess_ASR42_DcmDspSecurityAlv/DCM_E_PENDING, SecurityAccess_ASR42_DcmDspSecurityAlv/DCM_E_COMPARE_KEY_FAILED]
        arg Key: type=Dcm_ASR42_SecKeyDcmDspSecurityAlv_ArrayType, direction=IN
        arg OpStatus: type=Dcm_ASR42_OpStatusType, direction=IN
        arg ErrorCode: type=Dcm_ASR42_NegativeResponseCodeType, direction=OUT
      error E_NOT_OK: error-code=1
      error DCM_E_PENDING: error-code=10
      error DCM_E_COMPARE_KEY_FAILED: error-code=11
    DataServices_ASR42_DID_4024_SWSystemTimeData
      operation ReadData: possible-error=DataServices_ASR42_DID_4024_SWSystemTimeData/E_NOT_OK
        arg Data: type=Dcm_ASR42_DataDID_4024_SWSystemTimeData_ArrayType, direction=OUT
      error E_NOT_OK: error-code=1
    DataServices_ASR42_DID_FD00_HWVersionData
      operation ReadData: possible-error=[DataServices_ASR42_DID_FD00_HWVersionData/E_NOT_OK, DataServices_ASR42_DID_FD00_HWVersionData/DCM_E_PENDING]
        arg OpStatus: type=Dcm_ASR42_OpStatusType, direction=IN
        arg Data: type=Dcm_ASR42_DataDID_FD00_HWVersionData_ArrayType, direction=OUT
      operation WriteData: possible-error=[DataServices_ASR42_DID_FD00_HWVersionData/E_NOT_OK, DataServices_ASR42_DID_FD00_HWVersionData/DCM_E_PENDING]
        arg Data: type=Dcm_ASR42_DataDID_FD00_HWVersionData_ArrayType, direction=IN
        arg OpStatus: type=Dcm_ASR42_OpStatusType, direction=IN
        arg ErrorCode: type=Dcm_ASR42_NegativeResponseCodeType, direction=OUT
      error E_NOT_OK: error-code=1
      error DCM_E_PENDING: error-code=10
    DataServices_ASR42_DID_FD01_SWVersionData
      operation ReadData: possible-error=DataServices_ASR42_DID_FD01_SWVersionData/E_NOT_OK
        arg Data: type=Dcm_ASR42_DataDID_FD01_SWVersionData_ArrayType, direction=OUT
      error E_NOT_OK: error-code=1
    DataServices_ASR42_DID_FD03_AEETraceabilityNumberData
      operation ReadData: possible-error=[DataServices_ASR42_DID_FD03_AEETraceabilityNumberData/E_NOT_OK, DataServices_ASR42_DID_FD03_AEETraceabilityNumberData/DCM_E_PENDING]
        arg OpStatus: type=Dcm_ASR42_OpStatusType, direction=IN
        arg Data: type=Dcm_ASR42_DataDID_FD03_AEETraceabilityNumberData_ArrayType, direction=OUT
      operation WriteData: possible-error=[DataServices_ASR42_DID_FD03_AEETraceabilityNumberData/E_NOT_OK, DataServices_ASR42_DID_FD03_AEETraceabilityNumberData/DCM_E_PENDING]
        arg Data: type=Dcm_ASR42_DataDID_FD03_AEETraceabilityNumberData_ArrayType, direction=IN
        arg OpStatus: type=Dcm_ASR42_OpStatusType, direction=IN
        arg ErrorCode: type=Dcm_ASR42_NegativeResponseCodeType, direction=OUT
      error E_NOT_OK: error-code=1
      error DCM_E_PENDING: error-code=10
    DataServices_ASR42_DID_FD08_ResetCauseData
      operation ReadData: possible-error=DataServices_ASR42_DID_FD08_ResetCauseData/E_NOT_OK
        arg Data: type=Dcm_ASR42_DataDID_FD08_ResetCauseData_ArrayType, direction=OUT
      error E_NOT_OK: error-code=1
    DataServices_ASR42_DID_FD09_LastWarmResetParamData
      operation ReadData: possible-error=DataServices_ASR42_DID_FD09_LastWarmResetParamData/E_NOT_OK
        arg Data: type=Dcm_ASR42_DataDID_FD09_LastWarmResetParamData_ArrayType, direction=OUT
      error E_NOT_OK: error-code=1
    DataServices_ASR42_DID_FD62_EccOccurenceNbData
      operation ReadData: possible-error=DataServices_ASR42_DID_FD62_EccOccurenceNbData/E_NOT_OK
        arg Data: type=Dcm_ASR42_DataDID_FD62_EccOccurenceNbData_ArrayType, direction=OUT
      error E_NOT_OK: error-code=1
    DataServices_ASR42_DID_FEFF_MeasurementFramesConfData
      operation ReadData: possible-error=[DataServices_ASR42_DID_FEFF_MeasurementFramesConfData/E_NOT_OK, DataServices_ASR42_DID_FEFF_MeasurementFramesConfData/DCM_E_PENDING]
        arg OpStatus: type=Dcm_ASR42_OpStatusType, direction=IN
        arg Data: type=Dcm_ASR42_DataDID_FEFF_MeasurementFramesConfData_ArrayType, direction=OUT
      operation WriteData: possible-error=[DataServices_ASR42_DID_FEFF_MeasurementFramesConfData/E_NOT_OK, DataServices_ASR42_DID_FEFF_MeasurementFramesConfData/DCM_E_PENDING]
        arg Data: type=Dcm_ASR42_DataDID_FEFF_MeasurementFramesConfData_ArrayType, direction=IN
        arg OpStatus: type=Dcm_ASR42_OpStatusType, direction=IN
        arg ErrorCode: type=Dcm_ASR42_NegativeResponseCodeType, direction=OUT
      error E_NOT_OK: error-code=1
      error DCM_E_PENDING: error-code=10
    DataServices_ASR42_DID_FE00_AllEventStatusesRead
      operation ReadData: possible-error=DataServices_ASR42_DID_FE00_AllEventStatusesRead/E_NOT_OK
        arg Data: type=Dcm_ASR42_DataDID_FE00_AllEventStatusesRead_ArrayType, direction=OUT
      error E_NOT_OK: error-code=1
    DataServices_ASR42_DID_FD8B_ECUManufacturingDateData
      operation ReadData: possible-error=[DataServices_ASR42_DID_FD8B_ECUManufacturingDateData/E_NOT_OK, DataServices_ASR42_DID_FD8B_ECUManufacturingDateData/DCM_E_PENDING]
        arg OpStatus: type=Dcm_ASR42_OpStatusType, direction=IN
        arg Data: type=Dcm_ASR42_DataDID_FD8B_ECUManufacturingDateData_ArrayType, direction=OUT
      operation WriteData: possible-error=[DataServices_ASR42_DID_FD8B_ECUManufacturingDateData/E_NOT_OK, DataServices_ASR42_DID_FD8B_ECUManufacturingDateData/DCM_E_PENDING]
        arg Data: type=Dcm_ASR42_DataDID_FD8B_ECUManufacturingDateData_ArrayType, direction=IN
        arg OpStatus: type=Dcm_ASR42_OpStatusType, direction=IN
        arg ErrorCode: type=Dcm_ASR42_NegativeResponseCodeType, direction=OUT
      error E_NOT_OK: error-code=1
      error DCM_E_PENDING: error-code=10
    DataServices_ASR42_DID_FD8C_AssemblySerialNumber
      operation ReadData: possible-error=[DataServices_ASR42_DID_FD8C_AssemblySerialNumber/E_NOT_OK, DataServices_ASR42_DID_FD8C_AssemblySerialNumber/DCM_E_PENDING]
        arg OpStatus: type=Dcm_ASR42_OpStatusType, direction=IN
        arg Data: type=Dcm_ASR42_DataDID_FD8C_AssemblySerialNumber_ArrayType, direction=OUT
      operation WriteData: possible-error=[DataServices_ASR42_DID_FD8C_AssemblySerialNumber/E_NOT_OK, DataServices_ASR42_DID_FD8C_AssemblySerialNumber/DCM_E_PENDING]
        arg Data: type=Dcm_ASR42_DataDID_FD8C_AssemblySerialNumber_ArrayType, direction=IN
        arg OpStatus: type=Dcm_ASR42_OpStatusType, direction=IN
        arg ErrorCode: type=Dcm_ASR42_NegativeResponseCodeType, direction=OUT
      error E_NOT_OK: error-code=1
      error DCM_E_PENDING: error-code=10
    DataServices_ASR42_DID_FD0F_BatteryMeasureData
      operation ReadData: possible-error=[DataServices_ASR42_DID_FD0F_BatteryMeasureData/E_NOT_OK, DataServices_ASR42_DID_FD0F_BatteryMeasureData/DCM_E_PENDING]
        arg OpStatus: type=Dcm_ASR42_OpStatusType, direction=IN
        arg Data: type=Dcm_ASR42_DataDID_FD0F_BatteryMeasureData_ArrayType, direction=OUT
      error E_NOT_OK: error-code=1
      error DCM_E_PENDING: error-code=10
    DataServices_ASR42_DID_FD10_ECUTemperatureData
      operation ReadData: possible-error=[DataServices_ASR42_DID_FD10_ECUTemperatureData/E_NOT_OK, DataServices_ASR42_DID_FD10_ECUTemperatureData/DCM_E_PENDING]
        arg OpStatus: type=Dcm_ASR42_OpStatusType, direction=IN
        arg Data: type=Dcm_ASR42_DataDID_FD10_ECUTemperatureData_ArrayType, direction=OUT
      error E_NOT_OK: error-code=1
      error DCM_E_PENDING: error-code=10
    DataServices_ASR42_DID_FDE0_EcsVariantData
      operation ReadData: possible-error=[DataServices_ASR42_DID_FDE0_EcsVariantData/E_NOT_OK, DataServices_ASR42_DID_FDE0_EcsVariantData/DCM_E_PENDING]
        arg OpStatus: type=Dcm_ASR42_OpStatusType, direction=IN
        arg Data: type=Dcm_ASR42_DataDID_FDE0_EcsVariantData_ArrayType, direction=OUT
      operation WriteData: possible-error=[DataServices_ASR42_DID_FDE0_EcsVariantData/E_NOT_OK, DataServices_ASR42_DID_FDE0_EcsVariantData/DCM_E_PENDING]
        arg Data: type=Dcm_ASR42_DataDID_FDE0_EcsVariantData_ArrayType, direction=IN
        arg OpStatus: type=Dcm_ASR42_OpStatusType, direction=IN
        arg ErrorCode: type=Dcm_ASR42_NegativeResponseCodeType, direction=OUT
      error E_NOT_OK: error-code=1
      error DCM_E_PENDING: error-code=10
    DataServices_ASR42_DID_FDE1_EcsParametersData
      operation ReadData: possible-error=[DataServices_ASR42_DID_FDE1_EcsParametersData/E_NOT_OK, DataServices_ASR42_DID_FDE1_EcsParametersData/DCM_E_PENDING]
        arg OpStatus: type=Dcm_ASR42_OpStatusType, direction=IN
        arg Data: type=Dcm_ASR42_DataDID_FDE1_EcsParametersData_ArrayType, direction=OUT
      operation WriteData: possible-error=[DataServices_ASR42_DID_FDE1_EcsParametersData/E_NOT_OK, DataServices_ASR42_DID_FDE1_EcsParametersData/DCM_E_PENDING]
        arg Data: type=Dcm_ASR42_DataDID_FDE1_EcsParametersData_ArrayType, direction=IN
        arg OpStatus: type=Dcm_ASR42_OpStatusType, direction=IN
        arg ErrorCode: type=Dcm_ASR42_NegativeResponseCodeType, direction=OUT
      error E_NOT_OK: error-code=1
      error DCM_E_PENDING: error-code=10
    DataServices_ASR42_DID_FDE2_AccOffsetData
      operation ReadData: possible-error=[DataServices_ASR42_DID_FDE2_AccOffsetData/E_NOT_OK, DataServices_ASR42_DID_FDE2_AccOffsetData/DCM_E_PENDING]
        arg OpStatus: type=Dcm_ASR42_OpStatusType, direction=IN
        arg Data: type=Dcm_ASR42_DataDID_FDE2_AccOffsetData_ArrayType, direction=OUT
      operation WriteData: possible-error=[DataServices_ASR42_DID_FDE2_AccOffsetData/E_NOT_OK, DataServices_ASR42_DID_FDE2_AccOffsetData/DCM_E_PENDING]
        arg Data: type=Dcm_ASR42_DataDID_FDE2_AccOffsetData_ArrayType, direction=IN
        arg OpStatus: type=Dcm_ASR42_OpStatusType, direction=IN
        arg ErrorCode: type=Dcm_ASR42_NegativeResponseCodeType, direction=OUT
      error E_NOT_OK: error-code=1
      error DCM_E_PENDING: error-code=10
    DataServices_ASR42_DID_FDE3_EcsProfilesData
      operation ReadData: possible-error=[DataServices_ASR42_DID_FDE3_EcsProfilesData/E_NOT_OK, DataServices_ASR42_DID_FDE3_EcsProfilesData/DCM_E_PENDING]
        arg OpStatus: type=Dcm_ASR42_OpStatusType, direction=IN
        arg Data: type=Dcm_ASR42_DataDID_FDE3_EcsProfilesData_ArrayType, direction=OUT
      operation WriteData: possible-error=[DataServices_ASR42_DID_FDE3_EcsProfilesData/E_NOT_OK, DataServices_ASR42_DID_FDE3_EcsProfilesData/DCM_E_PENDING]
        arg Data: type=Dcm_ASR42_DataDID_FDE3_EcsProfilesData_ArrayType, direction=IN
        arg OpStatus: type=Dcm_ASR42_OpStatusType, direction=IN
        arg ErrorCode: type=Dcm_ASR42_NegativeResponseCodeType, direction=OUT
      error E_NOT_OK: error-code=1
      error DCM_E_PENDING: error-code=10
    DataServices_ASR42_DID_FDE4_EcsStepsData
      operation ReadData: possible-error=[DataServices_ASR42_DID_FDE4_EcsStepsData/E_NOT_OK, DataServices_ASR42_DID_FDE4_EcsStepsData/DCM_E_PENDING]
        arg OpStatus: type=Dcm_ASR42_OpStatusType, direction=IN
        arg Data: type=Dcm_ASR42_DataDID_FDE4_EcsStepsData_ArrayType, direction=OUT
      operation WriteData: possible-error=[DataServices_ASR42_DID_FDE4_EcsStepsData/E_NOT_OK, DataServices_ASR42_DID_FDE4_EcsStepsData/DCM_E_PENDING]
        arg Data: type=Dcm_ASR42_DataDID_FDE4_EcsStepsData_ArrayType, direction=IN
        arg OpStatus: type=Dcm_ASR42_OpStatusType, direction=IN
        arg ErrorCode: type=Dcm_ASR42_NegativeResponseCodeType, direction=OUT
      error E_NOT_OK: error-code=1
      error DCM_E_PENDING: error-code=10
    DataServices_ASR42_DID_FDE5_EcsAccLowPassData
      operation ReadData: possible-error=[DataServices_ASR42_DID_FDE5_EcsAccLowPassData/E_NOT_OK, DataServices_ASR42_DID_FDE5_EcsAccLowPassData/DCM_E_PENDING]
        arg OpStatus: type=Dcm_ASR42_OpStatusType, direction=IN
        arg Data: type=Dcm_ASR42_DataDID_FDE5_EcsAccLowPassData_ArrayType, direction=OUT
      operation WriteData: possible-error=[DataServices_ASR42_DID_FDE5_EcsAccLowPassData/E_NOT_OK, DataServices_ASR42_DID_FDE5_EcsAccLowPassData/DCM_E_PENDING]
        arg Data: type=Dcm_ASR42_DataDID_FDE5_EcsAccLowPassData_ArrayType, direction=IN
        arg OpStatus: type=Dcm_ASR42_OpStatusType, direction=IN
        arg ErrorCode: type=Dcm_ASR42_NegativeResponseCodeType, direction=OUT
      error E_NOT_OK: error-code=1
      error DCM_E_PENDING: error-code=10
    DataServices_ASR42_DID_FDE7_AlgoOutputDelayData
      operation ReadData: possible-error=[DataServices_ASR42_DID_FDE7_AlgoOutputDelayData/E_NOT_OK, DataServices_ASR42_DID_FDE7_AlgoOutputDelayData/DCM_E_PENDING]
        arg OpStatus: type=Dcm_ASR42_OpStatusType, direction=IN
        arg Data: type=Dcm_ASR42_DataDID_FDE7_AlgoOutputDelayData_ArrayType, direction=OUT
      operation WriteData: possible-error=[DataServices_ASR42_DID_FDE7_AlgoOutputDelayData/E_NOT_OK, DataServices_ASR42_DID_FDE7_AlgoOutputDelayData/DCM_E_PENDING]
        arg Data: type=Dcm_ASR42_DataDID_FDE7_AlgoOutputDelayData_ArrayType, direction=IN
        arg OpStatus: type=Dcm_ASR42_OpStatusType, direction=IN
        arg ErrorCode: type=Dcm_ASR42_NegativeResponseCodeType, direction=OUT
      error E_NOT_OK: error-code=1
      error DCM_E_PENDING: error-code=10
    DataServices_ASR42_DID_FDE9_SensitivityLutData
      operation ReadData: possible-error=[DataServices_ASR42_DID_FDE9_SensitivityLutData/E_NOT_OK, DataServices_ASR42_DID_FDE9_SensitivityLutData/DCM_E_PENDING]
        arg OpStatus: type=Dcm_ASR42_OpStatusType, direction=IN
        arg Data: type=Dcm_ASR42_DataDID_FDE9_SensitivityLutData_ArrayType, direction=OUT
      operation WriteData: possible-error=[DataServices_ASR42_DID_FDE9_SensitivityLutData/E_NOT_OK, DataServices_ASR42_DID_FDE9_SensitivityLutData/DCM_E_PENDING]
        arg Data: type=Dcm_ASR42_DataDID_FDE9_SensitivityLutData_ArrayType, direction=IN
        arg OpStatus: type=Dcm_ASR42_OpStatusType, direction=IN
        arg ErrorCode: type=Dcm_ASR42_NegativeResponseCodeType, direction=OUT
      error E_NOT_OK: error-code=1
      error DCM_E_PENDING: error-code=10
    DataServices_ASR42_DID_FDEA_SensitivityOptData
      operation ReadData: possible-error=[DataServices_ASR42_DID_FDEA_SensitivityOptData/E_NOT_OK, DataServices_ASR42_DID_FDEA_SensitivityOptData/DCM_E_PENDING]
        arg OpStatus: type=Dcm_ASR42_OpStatusType, direction=IN
        arg Data: type=Dcm_ASR42_DataDID_FDEA_SensitivityOptData_ArrayType, direction=OUT
      operation WriteData: possible-error=[DataServices_ASR42_DID_FDEA_SensitivityOptData/E_NOT_OK, DataServices_ASR42_DID_FDEA_SensitivityOptData/DCM_E_PENDING]
        arg Data: type=Dcm_ASR42_DataDID_FDEA_SensitivityOptData_ArrayType, direction=IN
        arg OpStatus: type=Dcm_ASR42_OpStatusType, direction=IN
        arg ErrorCode: type=Dcm_ASR42_NegativeResponseCodeType, direction=OUT
      error E_NOT_OK: error-code=1
      error DCM_E_PENDING: error-code=10
    DataServices_ASR42_DID_FDFF_MeasurementFrameConfDataRam
      operation ReadData: possible-error=[DataServices_ASR42_DID_FDFF_MeasurementFrameConfDataRam/E_NOT_OK, DataServices_ASR42_DID_FDFF_MeasurementFrameConfDataRam/DCM_E_PENDING]
        arg OpStatus: type=Dcm_ASR42_OpStatusType, direction=IN
        arg Data: type=Dcm_ASR42_DataDID_FDFF_MeasurementFrameConfDataRam_ArrayType, direction=OUT
      operation WriteData: possible-error=[DataServices_ASR42_DID_FDFF_MeasurementFrameConfDataRam/E_NOT_OK, DataServices_ASR42_DID_FDFF_MeasurementFrameConfDataRam/DCM_E_PENDING]
        arg Data: type=Dcm_ASR42_DataDID_FDFF_MeasurementFrameConfDataRam_ArrayType, direction=IN
        arg OpStatus: type=Dcm_ASR42_OpStatusType, direction=IN
        arg ErrorCode: type=Dcm_ASR42_NegativeResponseCodeType, direction=OUT
      error E_NOT_OK: error-code=1
      error DCM_E_PENDING: error-code=10
    DataServices_ASR42_DID_F187_VWSparePartNumberData
      operation ReadData: possible-error=[DataServices_ASR42_DID_F187_VWSparePartNumberData/E_NOT_OK, DataServices_ASR42_DID_F187_VWSparePartNumberData/DCM_E_PENDING]
        arg OpStatus: type=Dcm_ASR42_OpStatusType, direction=IN
        arg Data: type=Dcm_ASR42_DataDID_F187_VWSparePartNumberData_ArrayType, direction=OUT
      operation WriteData: possible-error=[DataServices_ASR42_DID_F187_VWSparePartNumberData/E_NOT_OK, DataServices_ASR42_DID_F187_VWSparePartNumberData/DCM_E_PENDING]
        arg Data: type=Dcm_ASR42_DataDID_F187_VWSparePartNumberData_ArrayType, direction=IN
        arg OpStatus: type=Dcm_ASR42_OpStatusType, direction=IN
        arg ErrorCode: type=Dcm_ASR42_NegativeResponseCodeType, direction=OUT
      error E_NOT_OK: error-code=1
      error DCM_E_PENDING: error-code=10
    DataServices_ASR42_DID_F189_VWApplicationSoftwareVersionNumberData
      operation ReadData: possible-error=[DataServices_ASR42_DID_F189_VWApplicationSoftwareVersionNumberData/E_NOT_OK, DataServices_ASR42_DID_F189_VWApplicationSoftwareVersionNumberData/DCM_E_PENDING]
        arg OpStatus: type=Dcm_ASR42_OpStatusType, direction=IN
        arg Data: type=Dcm_ASR42_DataDID_F189_VWApplicationSoftwareVersionNumberData_ArrayType, direction=OUT
      operation WriteData: possible-error=[DataServices_ASR42_DID_F189_VWApplicationSoftwareVersionNumberData/E_NOT_OK, DataServices_ASR42_DID_F189_VWApplicationSoftwareVersionNumberData/DCM_E_PENDING]
        arg Data: type=Dcm_ASR42_DataDID_F189_VWApplicationSoftwareVersionNumberData_ArrayType, direction=IN
        arg OpStatus: type=Dcm_ASR42_OpStatusType, direction=IN
        arg ErrorCode: type=Dcm_ASR42_NegativeResponseCodeType, direction=OUT
      error E_NOT_OK: error-code=1
      error DCM_E_PENDING: error-code=10
    DataServices_ASR42_DID_F191_VWECUHardwareNumberData
      operation ReadData: possible-error=[DataServices_ASR42_DID_F191_VWECUHardwareNumberData/E_NOT_OK, DataServices_ASR42_DID_F191_VWECUHardwareNumberData/DCM_E_PENDING]
        arg OpStatus: type=Dcm_ASR42_OpStatusType, direction=IN
        arg Data: type=Dcm_ASR42_DataDID_F191_VWECUHardwareNumberData_ArrayType, direction=OUT
      operation WriteData: possible-error=[DataServices_ASR42_DID_F191_VWECUHardwareNumberData/E_NOT_OK, DataServices_ASR42_DID_F191_VWECUHardwareNumberData/DCM_E_PENDING]
        arg Data: type=Dcm_ASR42_DataDID_F191_VWECUHardwareNumberData_ArrayType, direction=IN
        arg OpStatus: type=Dcm_ASR42_OpStatusType, direction=IN
        arg ErrorCode: type=Dcm_ASR42_NegativeResponseCodeType, direction=OUT
      error E_NOT_OK: error-code=1
      error DCM_E_PENDING: error-code=10
    DataServices_ASR42_DID_F197_VWSystemNameOrEngineTypeData
      operation ReadData: possible-error=[DataServices_ASR42_DID_F197_VWSystemNameOrEngineTypeData/E_NOT_OK, DataServices_ASR42_DID_F197_VWSystemNameOrEngineTypeData/DCM_E_PENDING]
        arg OpStatus: type=Dcm_ASR42_OpStatusType, direction=IN
        arg Data: type=Dcm_ASR42_DataDID_F197_VWSystemNameOrEngineTypeData_ArrayType, direction=OUT
      operation WriteData: possible-error=[DataServices_ASR42_DID_F197_VWSystemNameOrEngineTypeData/E_NOT_OK, DataServices_ASR42_DID_F197_VWSystemNameOrEngineTypeData/DCM_E_PENDING]
        arg Data: type=Dcm_ASR42_DataDID_F197_VWSystemNameOrEngineTypeData_ArrayType, direction=IN
        arg OpStatus: type=Dcm_ASR42_OpStatusType, direction=IN
        arg ErrorCode: type=Dcm_ASR42_NegativeResponseCodeType, direction=OUT
      error E_NOT_OK: error-code=1
      error DCM_E_PENDING: error-code=10
    DataServices_ASR42_DID_F1B4_TechnicalSpecificationsVersionData
      operation ReadData: possible-error=[DataServices_ASR42_DID_F1B4_TechnicalSpecificationsVersionData/E_NOT_OK, DataServices_ASR42_DID_F1B4_TechnicalSpecificationsVersionData/DCM_E_PENDING]
        arg OpStatus: type=Dcm_ASR42_OpStatusType, direction=IN
        arg Data: type=Dcm_ASR42_DataDID_F1B4_TechnicalSpecificationsVersionData_ArrayType, direction=OUT
      error E_NOT_OK: error-code=1
      error DCM_E_PENDING: error-code=10
    DataServices_ASR42_DID_0407_VWLogicalSoftwareBlockCounterOfProgrammingAttemptsData
      operation ReadData: possible-error=[DataServices_ASR42_DID_0407_VWLogicalSoftwareBlockCounterOfProgrammingAttemptsData/E_NOT_OK, DataServices_ASR42_DID_0407_VWLogicalSoftwareBlockCounterOfProgrammingAttemptsData/DCM_E_PENDING]
        arg OpStatus: type=Dcm_ASR42_OpStatusType, direction=IN
        arg Data: type=Dcm_ASR42_DataDID_0407_VWLogicalSoftwareBlockCounterOfProgrammingAttemptsData_ArrayType, direction=OUT
      error E_NOT_OK: error-code=1
      error DCM_E_PENDING: error-code=10
    DataServices_ASR42_DID_040F_VWLogicalSoftwareBlockLockValueData
      operation ReadData: possible-error=[DataServices_ASR42_DID_040F_VWLogicalSoftwareBlockLockValueData/E_NOT_OK, DataServices_ASR42_DID_040F_VWLogicalSoftwareBlockLockValueData/DCM_E_PENDING]
        arg OpStatus: type=Dcm_ASR42_OpStatusType, direction=IN
        arg Data: type=Dcm_ASR42_DataDID_040F_VWLogicalSoftwareBlockLockValueData_ArrayType, direction=OUT
      error E_NOT_OK: error-code=1
      error DCM_E_PENDING: error-code=10
    DataServices_ASR42_DID_0410_BootloaderTPBlocksizeData
      operation ReadData: possible-error=[DataServices_ASR42_DID_0410_BootloaderTPBlocksizeData/E_NOT_OK, DataServices_ASR42_DID_0410_BootloaderTPBlocksizeData/DCM_E_PENDING]
        arg OpStatus: type=Dcm_ASR42_OpStatusType, direction=IN
        arg Data: type=Dcm_ASR42_DataDID_0410_BootloaderTPBlocksizeData_ArrayType, direction=OUT
      operation WriteData: possible-error=[DataServices_ASR42_DID_0410_BootloaderTPBlocksizeData/E_NOT_OK, DataServices_ASR42_DID_0410_BootloaderTPBlocksizeData/DCM_E_PENDING]
        arg Data: type=Dcm_ASR42_DataDID_0410_BootloaderTPBlocksizeData_ArrayType, direction=IN
        arg OpStatus: type=Dcm_ASR42_OpStatusType, direction=IN
        arg ErrorCode: type=Dcm_ASR42_NegativeResponseCodeType, direction=OUT
      error E_NOT_OK: error-code=1
      error DCM_E_PENDING: error-code=10
    DataServices_ASR42_DID_0448_ProgrammingPreconditionsData
      operation ReadData: possible-error=[DataServices_ASR42_DID_0448_ProgrammingPreconditionsData/E_NOT_OK, DataServices_ASR42_DID_0448_ProgrammingPreconditionsData/DCM_E_PENDING]
        arg OpStatus: type=Dcm_ASR42_OpStatusType, direction=IN
        arg Data: type=Dcm_ASR42_DataDID_0448_ProgrammingPreconditionsData_ArrayType, direction=OUT
      error E_NOT_OK: error-code=1
      error DCM_E_PENDING: error-code=10
    DataServices_ASR42_DID_F1DF_ECUProgrammingInformationData
      operation ReadData: possible-error=[DataServices_ASR42_DID_F1DF_ECUProgrammingInformationData/E_NOT_OK, DataServices_ASR42_DID_F1DF_ECUProgrammingInformationData/DCM_E_PENDING]
        arg OpStatus: type=Dcm_ASR42_OpStatusType, direction=IN
        arg Data: type=Dcm_ASR42_DataDID_F1DF_ECUProgrammingInformationData_ArrayType, direction=OUT
      error E_NOT_OK: error-code=1
      error DCM_E_PENDING: error-code=10
    DataServices_ASR42_DID_F19E_ASAMODXFileIdentifierData
      operation ReadData: possible-error=[DataServices_ASR42_DID_F19E_ASAMODXFileIdentifierData/E_NOT_OK, DataServices_ASR42_DID_F19E_ASAMODXFileIdentifierData/DCM_E_PENDING]
        arg OpStatus: type=Dcm_ASR42_OpStatusType, direction=IN
        arg Data: type=Dcm_ASR42_DataDID_F19E_ASAMODXFileIdentifierData_ArrayType, direction=OUT
      operation WriteData: possible-error=[DataServices_ASR42_DID_F19E_ASAMODXFileIdentifierData/E_NOT_OK, DataServices_ASR42_DID_F19E_ASAMODXFileIdentifierData/DCM_E_PENDING]
        arg Data: type=Dcm_ASR42_DataDID_F19E_ASAMODXFileIdentifierData_ArrayType, direction=IN
        arg OpStatus: type=Dcm_ASR42_OpStatusType, direction=IN
        arg ErrorCode: type=Dcm_ASR42_NegativeResponseCodeType, direction=OUT
      error E_NOT_OK: error-code=1
      error DCM_E_PENDING: error-code=10
    DataServices_ASR42_DID_F1A2_ASAMODXFileVersionData
      operation ReadData: possible-error=[DataServices_ASR42_DID_F1A2_ASAMODXFileVersionData/E_NOT_OK, DataServices_ASR42_DID_F1A2_ASAMODXFileVersionData/DCM_E_PENDING]
        arg OpStatus: type=Dcm_ASR42_OpStatusType, direction=IN
        arg Data: type=Dcm_ASR42_DataDID_F1A2_ASAMODXFileVersionData_ArrayType, direction=OUT
      operation WriteData: possible-error=[DataServices_ASR42_DID_F1A2_ASAMODXFileVersionData/E_NOT_OK, DataServices_ASR42_DID_F1A2_ASAMODXFileVersionData/DCM_E_PENDING]
        arg Data: type=Dcm_ASR42_DataDID_F1A2_ASAMODXFileVersionData_ArrayType, direction=IN
        arg OpStatus: type=Dcm_ASR42_OpStatusType, direction=IN
        arg ErrorCode: type=Dcm_ASR42_NegativeResponseCodeType, direction=OUT
      error E_NOT_OK: error-code=1
      error DCM_E_PENDING: error-code=10
    DataServices_ASR42_DID_F1D5_FDSProjectData
      operation ReadData: possible-error=[DataServices_ASR42_DID_F1D5_FDSProjectData/E_NOT_OK, DataServices_ASR42_DID_F1D5_FDSProjectData/DCM_E_PENDING]
        arg OpStatus: type=Dcm_ASR42_OpStatusType, direction=IN
        arg Data: type=Dcm_ASR42_DataDID_F1D5_FDSProjectData_ArrayType, direction=OUT
      error E_NOT_OK: error-code=1
      error DCM_E_PENDING: error-code=10
    DataServices_ASR42_DID_F1A3_VWECUHardwareVersionNumberData
      operation ReadData: possible-error=[DataServices_ASR42_DID_F1A3_VWECUHardwareVersionNumberData/E_NOT_OK, DataServices_ASR42_DID_F1A3_VWECUHardwareVersionNumberData/DCM_E_PENDING]
        arg OpStatus: type=Dcm_ASR42_OpStatusType, direction=IN
        arg Data: type=Dcm_ASR42_DataDID_F1A3_VWECUHardwareVersionNumberData_ArrayType, direction=OUT
      operation WriteData: possible-error=[DataServices_ASR42_DID_F1A3_VWECUHardwareVersionNumberData/E_NOT_OK, DataServices_ASR42_DID_F1A3_VWECUHardwareVersionNumberData/DCM_E_PENDING]
        arg Data: type=Dcm_ASR42_DataDID_F1A3_VWECUHardwareVersionNumberData_ArrayType, direction=IN
        arg OpStatus: type=Dcm_ASR42_OpStatusType, direction=IN
        arg ErrorCode: type=Dcm_ASR42_NegativeResponseCodeType, direction=OUT
      error E_NOT_OK: error-code=1
      error DCM_E_PENDING: error-code=10
    DataServices_ASR42_DID_F18C_ECUSerialNumberData
      operation ReadData: possible-error=[DataServices_ASR42_DID_F18C_ECUSerialNumberData/E_NOT_OK, DataServices_ASR42_DID_F18C_ECUSerialNumberData/DCM_E_PENDING]
        arg OpStatus: type=Dcm_ASR42_OpStatusType, direction=IN
        arg Data: type=Dcm_ASR42_DataDID_F18C_ECUSerialNumberData_ArrayType, direction=OUT
      operation WriteData: possible-error=[DataServices_ASR42_DID_F18C_ECUSerialNumberData/E_NOT_OK, DataServices_ASR42_DID_F18C_ECUSerialNumberData/DCM_E_PENDING]
        arg Data: type=Dcm_ASR42_DataDID_F18C_ECUSerialNumberData_ArrayType, direction=IN
        arg OpStatus: type=Dcm_ASR42_OpStatusType, direction=IN
        arg ErrorCode: type=Dcm_ASR42_NegativeResponseCodeType, direction=OUT
      error E_NOT_OK: error-code=1
      error DCM_E_PENDING: error-code=10
    DataServices_ASR42_DID_F1AB_VWLogicalSoftwareBlockVersionData
      operation ReadData: possible-error=[DataServices_ASR42_DID_F1AB_VWLogicalSoftwareBlockVersionData/E_NOT_OK, DataServices_ASR42_DID_F1AB_VWLogicalSoftwareBlockVersionData/DCM_E_PENDING]
        arg OpStatus: type=Dcm_ASR42_OpStatusType, direction=IN
        arg Data: type=Dcm_ASR42_DataDID_F1AB_VWLogicalSoftwareBlockVersionData_ArrayType, direction=OUT
      error E_NOT_OK: error-code=1
      error DCM_E_PENDING: error-code=10
    DataServices_ASR42_DID_F15B_FingerprintAndProgrammingDateOfLogicalSoftwareBlocksData
      operation ReadData: possible-error=[DataServices_ASR42_DID_F15B_FingerprintAndProgrammingDateOfLogicalSoftwareBlocksData/E_NOT_OK, DataServices_ASR42_DID_F15B_FingerprintAndProgrammingDateOfLogicalSoftwareBlocksData/DCM_E_PENDING]
        arg OpStatus: type=Dcm_ASR42_OpStatusType, direction=IN
        arg Data: type=Dcm_ASR42_DataDID_F15B_FingerprintAndProgrammingDateOfLogicalSoftwareBlocksData_ArrayType, direction=OUT
      error E_NOT_OK: error-code=1
      error DCM_E_PENDING: error-code=10
    DataServices_ASR42_DID_0236_ProgrammingDataElockEcuData
      operation ReadData: possible-error=[DataServices_ASR42_DID_0236_ProgrammingDataElockEcuData/E_NOT_OK, DataServices_ASR42_DID_0236_ProgrammingDataElockEcuData/DCM_E_PENDING]
        arg OpStatus: type=Dcm_ASR42_OpStatusType, direction=IN
        arg Data: type=Dcm_ASR42_DataDID_0236_ProgrammingDataElockEcuData_ArrayType, direction=OUT
      operation WriteData: possible-error=[DataServices_ASR42_DID_0236_ProgrammingDataElockEcuData/E_NOT_OK, DataServices_ASR42_DID_0236_ProgrammingDataElockEcuData/DCM_E_PENDING]
        arg Data: type=Dcm_ASR42_DataDID_0236_ProgrammingDataElockEcuData_ArrayType, direction=IN
        arg OpStatus: type=Dcm_ASR42_OpStatusType, direction=IN
        arg ErrorCode: type=Dcm_ASR42_NegativeResponseCodeType, direction=OUT
      error E_NOT_OK: error-code=1
      error DCM_E_PENDING: error-code=10
    DataServices_ASR42_DID_023E_WSCForProgrammingElockEcuData
      operation ReadData: possible-error=[DataServices_ASR42_DID_023E_WSCForProgrammingElockEcuData/E_NOT_OK, DataServices_ASR42_DID_023E_WSCForProgrammingElockEcuData/DCM_E_PENDING]
        arg OpStatus: type=Dcm_ASR42_OpStatusType, direction=IN
        arg Data: type=Dcm_ASR42_DataDID_023E_WSCForProgrammingElockEcuData_ArrayType, direction=OUT
      operation WriteData: possible-error=[DataServices_ASR42_DID_023E_WSCForProgrammingElockEcuData/E_NOT_OK, DataServices_ASR42_DID_023E_WSCForProgrammingElockEcuData/DCM_E_PENDING]
        arg Data: type=Dcm_ASR42_DataDID_023E_WSCForProgrammingElockEcuData_ArrayType, direction=IN
        arg OpStatus: type=Dcm_ASR42_OpStatusType, direction=IN
        arg ErrorCode: type=Dcm_ASR42_NegativeResponseCodeType, direction=OUT
      error E_NOT_OK: error-code=1
      error DCM_E_PENDING: error-code=10
    Dcm_ASR42_ServiceRequestNotification
      operation Indication: possible-error=[Dcm_ASR42_ServiceRequestNotification/E_NOT_OK, Dcm_ASR42_ServiceRequestNotification/E_REQUEST_NOT_ACCEPTED]
        6 x arg:
          SID: type=uint8, direction=IN
          RequestData: type=Dcm_ASR42_RequestData_ArrayType, direction=IN
          DataSize: type=uint16, direction=IN
          ReqType: type=uint8, direction=IN
          SourceAddress: type=uint16, direction=IN
          ErrorCode: type=Dcm_ASR42_NegativeResponseCodeType, direction=OUT
      operation Confirmation: possible-error=Dcm_ASR42_ServiceRequestNotification/E_NOT_OK
        4 x arg, all with direction=IN:
          SID: type=uint8
          ReqType: type=uint8
          SourceAddress: type=uint16
          ConfirmationStatus: type=Dcm_ASR42_ConfirmationStatusType
      error E_NOT_OK: error-code=1
      error E_REQUEST_NOT_ACCEPTED: error-code=8
    Dcm_ASR42_CallbackDCMRequestServices
      operation StartProtocol: possible-error=[Dcm_ASR42_CallbackDCMRequestServices/E_NOT_OK, Dcm_ASR42_CallbackDCMRequestServices/E_PROTOCOL_NOT_ALLOWED]
        arg ProtocolID: type=Dcm_ASR42_ProtocolType, direction=IN
      operation StopProtocol: possible-error=Dcm_ASR42_CallbackDCMRequestServices/E_NOT_OK
        arg ProtocolID: type=Dcm_ASR42_ProtocolType, direction=IN
      error E_NOT_OK: error-code=1
      error E_PROTOCOL_NOT_ALLOWED: error-code=5
    RoutineServices_ASR42_DcmDspRoutineCtrl_Lock_UnlockECU
      operation Start: possible-error=[RoutineServices_ASR42_DcmDspRoutineCtrl_Lock_UnlockECU/E_NOT_OK, RoutineServices_ASR42_DcmDspRoutineCtrl_Lock_UnlockECU/DCM_E_PENDING, RoutineServices_ASR42_DcmDspRoutineCtrl_Lock_UnlockECU/DCM_E_FORCE_RCRRP]
        arg OpStatus: type=Dcm_ASR42_OpStatusType, direction=IN
        arg dataOut0: type=ImplementationDataTypes/Dcm_StartDataOut_DcmDspRoutineCtrl_Lock_UnlockECU_DcmDspStartRoutineOutSignal_0Type, direction=OUT
        arg ErrorCode: type=Dcm_ASR42_NegativeResponseCodeType, direction=OUT
      operation Stop: possible-error=[RoutineServices_ASR42_DcmDspRoutineCtrl_Lock_UnlockECU/E_NOT_OK, RoutineServices_ASR42_DcmDspRoutineCtrl_Lock_UnlockECU/DCM_E_PENDING, RoutineServices_ASR42_DcmDspRoutineCtrl_Lock_UnlockECU/DCM_E_FORCE_RCRRP]
        arg OpStatus: type=Dcm_ASR42_OpStatusType, direction=IN
        arg dataOut0: type=ImplementationDataTypes/Dcm_StopDataOut_DcmDspRoutineCtrl_Lock_UnlockECU_DcmDspRoutineStopOutSignal_0Type, direction=OUT
        arg ErrorCode: type=Dcm_ASR42_NegativeResponseCodeType, direction=OUT
      operation RequestResults: possible-error=[RoutineServices_ASR42_DcmDspRoutineCtrl_Lock_UnlockECU/E_NOT_OK, RoutineServices_ASR42_DcmDspRoutineCtrl_Lock_UnlockECU/DCM_E_PENDING, RoutineServices_ASR42_DcmDspRoutineCtrl_Lock_UnlockECU/DCM_E_FORCE_RCRRP]
        4 x arg:
          OpStatus: type=Dcm_ASR42_OpStatusType, direction=IN
          dataOut0: type=ImplementationDataTypes/Dcm_RequestDataOut_DcmDspRoutineCtrl_Lock_UnlockECU_DcmDspRoutineRequestResOutSignalType, direction=OUT
          dataOut1: type=ImplementationDataTypes/Dcm_RequestDataOut_DcmDspRoutineCtrl_Lock_UnlockECU_DcmDspRoutineRequestResOutSignalInformationLockType, direction=OUT
          ErrorCode: type=Dcm_ASR42_NegativeResponseCodeType, direction=OUT
      error E_NOT_OK: error-code=1
      error DCM_E_PENDING: error-code=10
      error DCM_E_FORCE_RCRRP: error-code=12
    RoutineServices_ASR42_DcmDspRoutineProcessMode
      operation Start: possible-error=[RoutineServices_ASR42_DcmDspRoutineProcessMode/E_NOT_OK, RoutineServices_ASR42_DcmDspRoutineProcessMode/DCM_E_PENDING, RoutineServices_ASR42_DcmDspRoutineProcessMode/DCM_E_FORCE_RCRRP]
        arg OpStatus: type=Dcm_ASR42_OpStatusType, direction=IN
        arg dataOut0: type=ImplementationDataTypes/Dcm_StartDataOut_DcmDspRoutineProcessMode_DcmDspStartRoutineOutSignal_RoutineInfoType, direction=OUT
        arg ErrorCode: type=Dcm_ASR42_NegativeResponseCodeType, direction=OUT
      operation Stop: possible-error=[RoutineServices_ASR42_DcmDspRoutineProcessMode/E_NOT_OK, RoutineServices_ASR42_DcmDspRoutineProcessMode/DCM_E_PENDING, RoutineServices_ASR42_DcmDspRoutineProcessMode/DCM_E_FORCE_RCRRP]
        arg OpStatus: type=Dcm_ASR42_OpStatusType, direction=IN
        arg dataOut0: type=ImplementationDataTypes/Dcm_StopDataOut_DcmDspRoutineProcessMode_DcmDspRoutineStopOutSignal_RoutineInfoType, direction=OUT
        arg ErrorCode: type=Dcm_ASR42_NegativeResponseCodeType, direction=OUT
      operation RequestResults: possible-error=[RoutineServices_ASR42_DcmDspRoutineProcessMode/E_NOT_OK, RoutineServices_ASR42_DcmDspRoutineProcessMode/DCM_E_PENDING, RoutineServices_ASR42_DcmDspRoutineProcessMode/DCM_E_FORCE_RCRRP]
        4 x arg:
          OpStatus: type=Dcm_ASR42_OpStatusType, direction=IN
          dataOut0: type=ImplementationDataTypes/Dcm_RequestDataOut_DcmDspRoutineProcessMode_DcmDspRoutineRequestResOutSignal_RoutineInfoType, direction=OUT
          dataOut1: type=ImplementationDataTypes/Dcm_RequestDataOut_DcmDspRoutineProcessMode_DcmDspRoutineRequestResOutSignal_PROCESSType, direction=OUT
          ErrorCode: type=Dcm_ASR42_NegativeResponseCodeType, direction=OUT
      error E_NOT_OK: error-code=1
      error DCM_E_PENDING: error-code=10
      error DCM_E_FORCE_RCRRP: error-code=12
    RoutineServices_ASR42_DcmDspRoutineAccCalib
      operation Start: possible-error=[RoutineServices_ASR42_DcmDspRoutineAccCalib/E_NOT_OK, RoutineServices_ASR42_DcmDspRoutineAccCalib/DCM_E_PENDING, RoutineServices_ASR42_DcmDspRoutineAccCalib/DCM_E_FORCE_RCRRP]
        arg OpStatus: type=Dcm_ASR42_OpStatusType, direction=IN
        arg dataOut0: type=ImplementationDataTypes/Dcm_StartDataOut_DcmDspRoutineAccCalib_DcmDspStartRoutineOutSignal_RoutineInfoType, direction=OUT
        arg ErrorCode: type=Dcm_ASR42_NegativeResponseCodeType, direction=OUT
      error E_NOT_OK: error-code=1
      error DCM_E_PENDING: error-code=10
      error DCM_E_FORCE_RCRRP: error-code=12
    RoutineServices_ASR42_DcmDspRoutineLockSolenoid
      operation Start: possible-error=[RoutineServices_ASR42_DcmDspRoutineLockSolenoid/E_NOT_OK, RoutineServices_ASR42_DcmDspRoutineLockSolenoid/DCM_E_PENDING, RoutineServices_ASR42_DcmDspRoutineLockSolenoid/DCM_E_FORCE_RCRRP]
        arg OpStatus: type=Dcm_ASR42_OpStatusType, direction=IN
        arg dataOut0: type=ImplementationDataTypes/Dcm_StartDataOut_DcmDspRoutineLockSolenoid_DcmDspStartRoutineOutSignal_0Type, direction=OUT
        arg ErrorCode: type=Dcm_ASR42_NegativeResponseCodeType, direction=OUT
      operation Stop: possible-error=[RoutineServices_ASR42_DcmDspRoutineLockSolenoid/E_NOT_OK, RoutineServices_ASR42_DcmDspRoutineLockSolenoid/DCM_E_PENDING, RoutineServices_ASR42_DcmDspRoutineLockSolenoid/DCM_E_FORCE_RCRRP]
        arg OpStatus: type=Dcm_ASR42_OpStatusType, direction=IN
        arg dataOut0: type=ImplementationDataTypes/Dcm_StopDataOut_DcmDspRoutineLockSolenoid_DcmDspStopRoutineOutSignal_RoutineInfoType, direction=OUT
        arg ErrorCode: type=Dcm_ASR42_NegativeResponseCodeType, direction=OUT
      error E_NOT_OK: error-code=1
      error DCM_E_PENDING: error-code=10
      error DCM_E_FORCE_RCRRP: error-code=12
    RoutineServices_ASR42_DcmDspRoutineEcuTempCalibration
      operation Start: possible-error=[RoutineServices_ASR42_DcmDspRoutineEcuTempCalibration/E_NOT_OK, RoutineServices_ASR42_DcmDspRoutineEcuTempCalibration/DCM_E_PENDING, RoutineServices_ASR42_DcmDspRoutineEcuTempCalibration/DCM_E_FORCE_RCRRP]
        4 x arg:
          dataIn0: type=ImplementationDataTypes/Dcm_StartDataIn_DcmDspRoutineEcuTempCalibration_DcmDspStartRoutineInSignal_0Type, direction=IN
          OpStatus: type=Dcm_ASR42_OpStatusType, direction=IN
          dataOut0: type=ImplementationDataTypes/Dcm_StartDataOut_DcmDspRoutineEcuTempCalibration_DcmDspStartRoutineOutSignal_0Type, direction=OUT
          ErrorCode: type=Dcm_ASR42_NegativeResponseCodeType, direction=OUT
      error E_NOT_OK: error-code=1
      error DCM_E_PENDING: error-code=10
      error DCM_E_FORCE_RCRRP: error-code=12
    RoutineServices_ASR42_DcmDspRoutineAccAngleOffsetCalibration
      operation Start: possible-error=[RoutineServices_ASR42_DcmDspRoutineAccAngleOffsetCalibration/E_NOT_OK, RoutineServices_ASR42_DcmDspRoutineAccAngleOffsetCalibration/DCM_E_PENDING, RoutineServices_ASR42_DcmDspRoutineAccAngleOffsetCalibration/DCM_E_FORCE_RCRRP]
        6 x arg:
          dataIn{0..2}: type=ImplementationDataTypes/Dcm_StartDataIn_DcmDspRoutineAccAngleOffsetCalibration_DcmDspStartRoutineInSignal_{0..2}Type, direction=IN
          OpStatus: type=Dcm_ASR42_OpStatusType, direction=IN
          dataOut0: type=ImplementationDataTypes/Dcm_StartDataOut_DcmDspRoutineAccAngleOffsetCalibration_DcmDspStartRoutineOutSignal_0Type, direction=OUT
          ErrorCode: type=Dcm_ASR42_NegativeResponseCodeType, direction=OUT
      error E_NOT_OK: error-code=1
      error DCM_E_PENDING: error-code=10
      error DCM_E_FORCE_RCRRP: error-code=12
    RoutineServices_ASR42_DcmDspRoutineRoutineCheckProgrammingPreconditions
      operation Start: possible-error=[RoutineServices_ASR42_DcmDspRoutineRoutineCheckProgrammingPreconditions/E_NOT_OK, RoutineServices_ASR42_DcmDspRoutineRoutineCheckProgrammingPreconditions/DCM_E_PENDING, RoutineServices_ASR42_DcmDspRoutineRoutineCheckProgrammingPreconditions/DCM_E_FORCE_RCRRP]
        4 x arg:
          OpStatus: type=Dcm_ASR42_OpStatusType, direction=IN
          dataOut0: type=ImplementationDataTypes/Dcm_StartFlexibleOutArrayData_DcmDspRoutineRoutineCheckProgrammingPreconditions_DcmDspStartRoutineOutSignal_0Type, direction=OUT
          currentDataLength: type=uint16, direction=OUT
          ErrorCode: type=Dcm_ASR42_NegativeResponseCodeType, direction=OUT
      error E_NOT_OK: error-code=1
      error DCM_E_PENDING: error-code=10
      error DCM_E_FORCE_RCRRP: error-code=12
package /AUTOSAR_Dcm/ImplementationDataTypes
  151 x impl type:
    Dcm_SecLevelType: compu {49=DcmConf_DcmDspSecurity_DcmDspSecurityAlv}, implementation-data-type=uint8
    Dcm_SesCtrlType: compu {1=DcmConf_DcmDspSession_DCM_DEFAULT_SESSION, 2=DcmConf_DcmDspSession_DCM_PROGRAMMING_SESSION, 3=DcmConf_DcmDspSession_DCM_EXTENDED_SESSION, 126=DcmConf_DcmDspSession_DCM_SUPPLIER_SESSION, 96=DcmConf_DcmDspSession_DCM_ELE_MANUFACTURING_SESSION, 97=DcmConf_DcmDspSession_DCM_SYSTEM_MANUFACTURING_SESSION}, implementation-data-type=uint8
    Dcm_ProtocolType: compu {0=DCM_OBD_ON_CAN, 1=DCM_OBD_ON_FLEXRAY, 2=DCM_OBD_ON_IP, 3=DCM_UDS_ON_CAN, 4=DCM_UDS_ON_FLEXRAY, 5=DCM_UDS_ON_IP, 6=DCM_ROE_ON_CAN, 7=DCM_ROE_ON_FLEXRAY, 8=DCM_ROE_ON_IP, 9=DCM_PERIODICTRANS_ON_CAN, 10=DCM_PERIODICTRANS_ON_FLEXRAY, 11=DCM_PERIODICTRANS_ON_IP, 12=DCM_NO_ACTIVE_PROTOCOL, 240..254=DCM_SUPPLIER_1..DCM_SUPPLIER_15}, implementation-data-type=uint8
    Dcm_OpStatusType: compu {0=DCM_INITIAL, 1=DCM_PENDING, 2=DCM_CANCEL, 3=DCM_FORCE_RCRRP_OK}, implementation-data-type=uint8
    Dcm_ConfirmationStatusType: compu {0=DCM_RES_POS_OK, 1=DCM_RES_POS_NOT_OK, 2=DCM_RES_NEG_OK, 3=DCM_RES_NEG_NOT_OK}, implementation-data-type=uint8
    Dcm_NegativeResponseCodeType: compu {0=DCM_E_POSITIVERESPONSE, 16=DCM_E_GENERALREJECT, 17=DCM_E_SERVICENOTSUPPORTED, 18=DCM_E_SUBFUNCTIONNOTSUPPORTED, 19=DCM_E_INCORRECTMESSAGELENGTHORINVALIDFORMAT, 20=DCM_E_RESPONSETOOLONG, 33=DCM_E_BUSYREPEATREQUEST, 34=DCM_E_CONDITIONSNOTCORRECT, 36=DCM_E_REQUESTSEQUENCEERROR, 37=DCM_E_NORESPONSEFROMSUBNETCOMPONENT, 38=DCM_E_FAILUREPREVENTSEXECUTIONOFREQUESTEDACTION, 49=DCM_E_REQUESTOUTOFRANGE, 51=DCM_E_SECURITYACCESSDENIED, 52=DCM_E_AUTHENTICATIONREQUIRED, 53=DCM_E_INVALIDKEY, 54=DCM_E_EXCEEDNUMBEROFATTEMPTS, 55=DCM_E_REQUIREDTIMEDELAYNOTEXPIRED, 80=DCM_E_CERTIFICATEVERIFICATIONFAILEDINVALIDTIMEPERIOD, 81=DCM_E_CERTIFICATEVERIFICATIONFAILEDINVALIDSIGNATURE, 82=DCM_E_CERTIFICATEVERIFICATIONFAILEDINVALIDCHAINOFTRUST, 83=DCM_E_CERTIFICATEVERIFICATIONFAILEDINVALIDTYPE, 84=DCM_E_CERTIFICATEVERIFICATIONFAILEDINVALIDFORMAT, 85=DCM_E_CERTIFICATEVERIFICATIONFAILEDINVALIDCONTENT, 86=DCM_E_CERTIFICATEVERIFICATIONFAILEDINVALIDSCOPE, 87=DCM_E_CERTIFICATEVERIFICATIONFAILEDREVOKED, 88=DCM_E_OWNERSHIPVERIFICATIONFAILED, 112=DCM_E_UPLOADDOWNLOADNOTACCEPTED, 113=DCM_E_TRANSFERDATASUSPENDED, 114=DCM_E_GENERALPROGRAMMINGFAILURE, 115=DCM_E_WRONGBLOCKSEQUENCECOUNTER, 120=DCM_E_REQUESTCORRECTLYRECEIVEDRESPONSEPENDING, 126=DCM_E_SUBFUNCTIONNOTSUPPORTEDINACTIVESESSION, 127=DCM_E_SERVICENOTSUPPORTEDINACTIVESESSION, 129=DCM_E_RPMTOOHIGH, 130=DCM_E_RPMTOOLOW, 131=DCM_E_ENGINEISRUNNING, 132=DCM_E_ENGINEISNOTRUNNING, 133=DCM_E_ENGINERUNTIMETOOLOW, 134=DCM_E_TEMPERATURETOOHIGH, 135=DCM_E_TEMPERATURETOOLOW, 136=DCM_E_VEHICLESPEEDTOOHIGH, 137=DCM_E_VEHICLESPEEDTOOLOW, 138=DCM_E_THROTTLE_PEDALTOOHIGH, 139=DCM_E_THROTTLE_PEDALTOOLOW, 140=DCM_E_TRANSMISSIONRANGENOTINNEUTRAL, 141=DCM_E_TRANSMISSIONRANGENOTINGEAR, 143=DCM_E_BRAKESWITCH_NOTCLOSED, 144=DCM_E_SHIFTERLEVERNOTINPARK, 145=DCM_E_TORQUECONVERTERCLUTCHLOCKED, 146=DCM_E_VOLTAGETOOHIGH, 147=DCM_E_VOLTAGETOOLOW}, implementation-data-type=uint8
    Dcm_SecSeedDcmDspSecurityAlv_ArrayType: category=ARRAY
      element AuxU8_Dcm_SecSeedDcmDspSecurityAlv_ArrayType: array-size=8, array-size-semantics=FIXED-SIZE, implementation-data-type=uint8
    Dcm_SecKeyDcmDspSecurityAlv_ArrayType: category=ARRAY
      element AuxU8_Dcm_SecKeyDcmDspSecurityAlv_ArrayType: array-size=8, array-size-semantics=FIXED-SIZE, implementation-data-type=uint8
    DataArrayTypeUint8_DID_4024_SWSystemTimeData: category=ARRAY
      element AuxU8_Dcm_DataDID_4024_SWSystemTimeData_ArrayType: array-size=5, array-size-semantics=FIXED-SIZE, implementation-data-type=uint8
    Dcm_DataDID_4024_SWSystemTimeData_ArrayType: category=ARRAY
      element AuxU8_Dcm_DataDID_4024_SWSystemTimeData_ArrayType: array-size=5, array-size-semantics=FIXED-SIZE, implementation-data-type=uint8
    DataArrayTypeUint8_DID_FD00_HWVersionData: category=ARRAY
      element AuxU8_Dcm_DataDID_FD00_HWVersionData_ArrayType: array-size=10, array-size-semantics=FIXED-SIZE, implementation-data-type=uint8
    Dcm_DataDID_FD00_HWVersionData_ArrayType: category=ARRAY
      element AuxU8_Dcm_DataDID_FD00_HWVersionData_ArrayType: array-size=10, array-size-semantics=FIXED-SIZE, implementation-data-type=uint8
    DataArrayTypeUint8_DID_FD01_SWVersionData: category=ARRAY
      element AuxU8_Dcm_DataDID_FD01_SWVersionData_ArrayType: array-size=12, array-size-semantics=FIXED-SIZE, implementation-data-type=uint8
    Dcm_DataDID_FD01_SWVersionData_ArrayType: category=ARRAY
      element AuxU8_Dcm_DataDID_FD01_SWVersionData_ArrayType: array-size=12, array-size-semantics=FIXED-SIZE, implementation-data-type=uint8
    DataArrayTypeUint8_DID_FD03_AEETraceabilityNumberData: category=ARRAY
      element AuxU8_Dcm_DataDID_FD03_AEETraceabilityNumberData_ArrayType: array-size=12, array-size-semantics=FIXED-SIZE, implementation-data-type=uint8
    Dcm_DataDID_FD03_AEETraceabilityNumberData_ArrayType: category=ARRAY
      element AuxU8_Dcm_DataDID_FD03_AEETraceabilityNumberData_ArrayType: array-size=12, array-size-semantics=FIXED-SIZE, implementation-data-type=uint8
    DataArrayTypeUint8_DID_FD08_ResetCauseData: category=ARRAY
      element AuxU8_Dcm_DataDID_FD08_ResetCauseData_ArrayType: array-size=4, array-size-semantics=FIXED-SIZE, implementation-data-type=uint8
    Dcm_DataDID_FD08_ResetCauseData_ArrayType: category=ARRAY
      element AuxU8_Dcm_DataDID_FD08_ResetCauseData_ArrayType: array-size=4, array-size-semantics=FIXED-SIZE, implementation-data-type=uint8
    DataArrayTypeUint8_DID_FD09_LastWarmResetParamData: category=ARRAY
      element AuxU8_Dcm_DataDID_FD09_LastWarmResetParamData_ArrayType: array-size=8, array-size-semantics=FIXED-SIZE, implementation-data-type=uint8
    Dcm_DataDID_FD09_LastWarmResetParamData_ArrayType: category=ARRAY
      element AuxU8_Dcm_DataDID_FD09_LastWarmResetParamData_ArrayType: array-size=8, array-size-semantics=FIXED-SIZE, implementation-data-type=uint8
    DataArrayTypeUint8_DID_FD62_EccOccurenceNbData: category=ARRAY
      element AuxU8_Dcm_DataDID_FD62_EccOccurenceNbData_ArrayType: array-size=16, array-size-semantics=FIXED-SIZE, implementation-data-type=uint8
    Dcm_DataDID_FD62_EccOccurenceNbData_ArrayType: category=ARRAY
      element AuxU8_Dcm_DataDID_FD62_EccOccurenceNbData_ArrayType: array-size=16, array-size-semantics=FIXED-SIZE, implementation-data-type=uint8
    DataArrayTypeUint8_DID_FEFF_MeasurementFramesConfData: category=ARRAY
      element AuxU8_Dcm_DataDID_FEFF_MeasurementFramesConfData_ArrayType: array-size=5, array-size-semantics=FIXED-SIZE, implementation-data-type=uint8
    Dcm_DataDID_FEFF_MeasurementFramesConfData_ArrayType: category=ARRAY
      element AuxU8_Dcm_DataDID_FEFF_MeasurementFramesConfData_ArrayType: array-size=5, array-size-semantics=FIXED-SIZE, implementation-data-type=uint8
    DataArrayTypeUint8_DID_FE00_AllEventStatusesRead: category=ARRAY
      element AuxU8_Dcm_DataDID_FE00_AllEventStatusesRead_ArrayType: array-size=69, array-size-semantics=FIXED-SIZE, implementation-data-type=uint8
    Dcm_DataDID_FE00_AllEventStatusesRead_ArrayType: category=ARRAY
      element AuxU8_Dcm_DataDID_FE00_AllEventStatusesRead_ArrayType: array-size=69, array-size-semantics=FIXED-SIZE, implementation-data-type=uint8
    DataArrayTypeUint8_DID_F186_ActiveDiagnosticSessionData: category=ARRAY
      element AuxU8_Dcm_DataDID_F186_ActiveDiagnosticSessionData_ArrayType: array-size=1, array-size-semantics=FIXED-SIZE, implementation-data-type=uint8
    Dcm_DataDID_F186_ActiveDiagnosticSessionData_ArrayType: category=ARRAY
      element AuxU8_Dcm_DataDID_F186_ActiveDiagnosticSessionData_ArrayType: array-size=1, array-size-semantics=FIXED-SIZE, implementation-data-type=uint8
    DataArrayTypeUint8_DID_FD8B_ECUManufacturingDateData: category=ARRAY
      element AuxU8_Dcm_DataDID_FD8B_ECUManufacturingDateData_ArrayType: array-size=3, array-size-semantics=FIXED-SIZE, implementation-data-type=uint8
    Dcm_DataDID_FD8B_ECUManufacturingDateData_ArrayType: category=ARRAY
      element AuxU8_Dcm_DataDID_FD8B_ECUManufacturingDateData_ArrayType: array-size=3, array-size-semantics=FIXED-SIZE, implementation-data-type=uint8
    DataArrayTypeUint8_DID_FD8C_AssemblySerialNumber: category=ARRAY
      element AuxU8_Dcm_DataDID_FD8C_AssemblySerialNumber_ArrayType: array-size=20, array-size-semantics=FIXED-SIZE, implementation-data-type=uint8
    Dcm_DataDID_FD8C_AssemblySerialNumber_ArrayType: category=ARRAY
      element AuxU8_Dcm_DataDID_FD8C_AssemblySerialNumber_ArrayType: array-size=20, array-size-semantics=FIXED-SIZE, implementation-data-type=uint8
    DataArrayTypeUint8_DID_FD0F_BatteryMeasureData: category=ARRAY
      element AuxU8_Dcm_DataDID_FD0F_BatteryMeasureData_ArrayType: array-size=2, array-size-semantics=FIXED-SIZE, implementation-data-type=uint8
    Dcm_DataDID_FD0F_BatteryMeasureData_ArrayType: category=ARRAY
      element AuxU8_Dcm_DataDID_FD0F_BatteryMeasureData_ArrayType: array-size=2, array-size-semantics=FIXED-SIZE, implementation-data-type=uint8
    DataArrayTypeUint8_DID_FD10_ECUTemperatureData: category=ARRAY
      element AuxU8_Dcm_DataDID_FD10_ECUTemperatureData_ArrayType: array-size=2, array-size-semantics=FIXED-SIZE, implementation-data-type=uint8
    Dcm_DataDID_FD10_ECUTemperatureData_ArrayType: category=ARRAY
      element AuxU8_Dcm_DataDID_FD10_ECUTemperatureData_ArrayType: array-size=2, array-size-semantics=FIXED-SIZE, implementation-data-type=uint8
    DataArrayTypeUint8_DID_FDE0_EcsVariantData: category=ARRAY
      element AuxU8_Dcm_DataDID_FDE0_EcsVariantData_ArrayType: array-size=4, array-size-semantics=FIXED-SIZE, implementation-data-type=uint8
    Dcm_DataDID_FDE0_EcsVariantData_ArrayType: category=ARRAY
      element AuxU8_Dcm_DataDID_FDE0_EcsVariantData_ArrayType: array-size=4, array-size-semantics=FIXED-SIZE, implementation-data-type=uint8
    DataArrayTypeUint8_DID_FDE1_EcsParametersData: category=ARRAY
      element AuxU8_Dcm_DataDID_FDE1_EcsParametersData_ArrayType: array-size=49, array-size-semantics=FIXED-SIZE, implementation-data-type=uint8
    Dcm_DataDID_FDE1_EcsParametersData_ArrayType: category=ARRAY
      element AuxU8_Dcm_DataDID_FDE1_EcsParametersData_ArrayType: array-size=49, array-size-semantics=FIXED-SIZE, implementation-data-type=uint8
    DataArrayTypeUint8_DID_FDE2_AccOffsetData: category=ARRAY
      element AuxU8_Dcm_DataDID_FDE2_AccOffsetData_ArrayType: array-size=6, array-size-semantics=FIXED-SIZE, implementation-data-type=uint8
    Dcm_DataDID_FDE2_AccOffsetData_ArrayType: category=ARRAY
      element AuxU8_Dcm_DataDID_FDE2_AccOffsetData_ArrayType: array-size=6, array-size-semantics=FIXED-SIZE, implementation-data-type=uint8
    DataArrayTypeUint8_DID_FDE3_EcsProfilesData: category=ARRAY
      element AuxU8_Dcm_DataDID_FDE3_EcsProfilesData_ArrayType: array-size=48, array-size-semantics=FIXED-SIZE, implementation-data-type=uint8
    Dcm_DataDID_FDE3_EcsProfilesData_ArrayType: category=ARRAY
      element AuxU8_Dcm_DataDID_FDE3_EcsProfilesData_ArrayType: array-size=48, array-size-semantics=FIXED-SIZE, implementation-data-type=uint8
    DataArrayTypeUint8_DID_FDE4_EcsStepsData: category=ARRAY
      element AuxU8_Dcm_DataDID_FDE4_EcsStepsData_ArrayType: array-size=56, array-size-semantics=FIXED-SIZE, implementation-data-type=uint8
    Dcm_DataDID_FDE4_EcsStepsData_ArrayType: category=ARRAY
      element AuxU8_Dcm_DataDID_FDE4_EcsStepsData_ArrayType: array-size=56, array-size-semantics=FIXED-SIZE, implementation-data-type=uint8
    DataArrayTypeUint8_DID_FDE5_EcsAccLowPassData: category=ARRAY
      element AuxU8_Dcm_DataDID_FDE5_EcsAccLowPassData_ArrayType: array-size=3, array-size-semantics=FIXED-SIZE, implementation-data-type=uint8
    Dcm_DataDID_FDE5_EcsAccLowPassData_ArrayType: category=ARRAY
      element AuxU8_Dcm_DataDID_FDE5_EcsAccLowPassData_ArrayType: array-size=3, array-size-semantics=FIXED-SIZE, implementation-data-type=uint8
    DataArrayTypeUint8_DID_FDE7_AlgoOutputDelayData: category=ARRAY
      element AuxU8_Dcm_DataDID_FDE7_AlgoOutputDelayData_ArrayType: array-size=2, array-size-semantics=FIXED-SIZE, implementation-data-type=uint8
    Dcm_DataDID_FDE7_AlgoOutputDelayData_ArrayType: category=ARRAY
      element AuxU8_Dcm_DataDID_FDE7_AlgoOutputDelayData_ArrayType: array-size=2, array-size-semantics=FIXED-SIZE, implementation-data-type=uint8
    DataArrayTypeUint8_DID_FDE9_SensitivityLutData: category=ARRAY
      element AuxU8_Dcm_DataDID_FDE9_SensitivityLutData_ArrayType: array-size=20, array-size-semantics=FIXED-SIZE, implementation-data-type=uint8
    Dcm_DataDID_FDE9_SensitivityLutData_ArrayType: category=ARRAY
      element AuxU8_Dcm_DataDID_FDE9_SensitivityLutData_ArrayType: array-size=20, array-size-semantics=FIXED-SIZE, implementation-data-type=uint8
    DataArrayTypeUint8_DID_FDEA_SensitivityOptData: category=ARRAY
      element AuxU8_Dcm_DataDID_FDEA_SensitivityOptData_ArrayType: array-size=1, array-size-semantics=FIXED-SIZE, implementation-data-type=uint8
    Dcm_DataDID_FDEA_SensitivityOptData_ArrayType: category=ARRAY
      element AuxU8_Dcm_DataDID_FDEA_SensitivityOptData_ArrayType: array-size=1, array-size-semantics=FIXED-SIZE, implementation-data-type=uint8
    DataArrayTypeUint8_DID_FDFF_MeasurementFrameConfDataRam: category=ARRAY
      element AuxU8_Dcm_DataDID_FDFF_MeasurementFrameConfDataRam_ArrayType: array-size=75, array-size-semantics=FIXED-SIZE, implementation-data-type=uint8
    Dcm_DataDID_FDFF_MeasurementFrameConfDataRam_ArrayType: category=ARRAY
      element AuxU8_Dcm_DataDID_FDFF_MeasurementFrameConfDataRam_ArrayType: array-size=75, array-size-semantics=FIXED-SIZE, implementation-data-type=uint8
    DataArrayTypeUint8_DID_F187_VWSparePartNumberData: category=ARRAY
      element AuxU8_Dcm_DataDID_F187_VWSparePartNumberData_ArrayType: array-size=11, array-size-semantics=FIXED-SIZE, implementation-data-type=uint8
    Dcm_DataDID_F187_VWSparePartNumberData_ArrayType: category=ARRAY
      element AuxU8_Dcm_DataDID_F187_VWSparePartNumberData_ArrayType: array-size=11, array-size-semantics=FIXED-SIZE, implementation-data-type=uint8
    DataArrayTypeUint8_DID_F189_VWApplicationSoftwareVersionNumberData: category=ARRAY
      element AuxU8_Dcm_DataDID_F189_VWApplicationSoftwareVersionNumberData_ArrayType: array-size=4, array-size-semantics=FIXED-SIZE, implementation-data-type=uint8
    Dcm_DataDID_F189_VWApplicationSoftwareVersionNumberData_ArrayType: category=ARRAY
      element AuxU8_Dcm_DataDID_F189_VWApplicationSoftwareVersionNumberData_ArrayType: array-size=4, array-size-semantics=FIXED-SIZE, implementation-data-type=uint8
    DataArrayTypeUint8_DID_F191_VWECUHardwareNumberData: category=ARRAY
      element AuxU8_Dcm_DataDID_F191_VWECUHardwareNumberData_ArrayType: array-size=11, array-size-semantics=FIXED-SIZE, implementation-data-type=uint8
    Dcm_DataDID_F191_VWECUHardwareNumberData_ArrayType: category=ARRAY
      element AuxU8_Dcm_DataDID_F191_VWECUHardwareNumberData_ArrayType: array-size=11, array-size-semantics=FIXED-SIZE, implementation-data-type=uint8
    DataArrayTypeUint8_DID_F197_VWSystemNameOrEngineTypeData: category=ARRAY
      element AuxU8_Dcm_DataDID_F197_VWSystemNameOrEngineTypeData_ArrayType: array-size=13, array-size-semantics=FIXED-SIZE, implementation-data-type=uint8
    Dcm_DataDID_F197_VWSystemNameOrEngineTypeData_ArrayType: category=ARRAY
      element AuxU8_Dcm_DataDID_F197_VWSystemNameOrEngineTypeData_ArrayType: array-size=13, array-size-semantics=FIXED-SIZE, implementation-data-type=uint8
    DataArrayTypeUint8_DID_F1B4_TechnicalSpecificationsVersionData: category=ARRAY
      element AuxU8_Dcm_DataDID_F1B4_TechnicalSpecificationsVersionData_ArrayType: array-size=26, array-size-semantics=FIXED-SIZE, implementation-data-type=uint8
    Dcm_DataDID_F1B4_TechnicalSpecificationsVersionData_ArrayType: category=ARRAY
      element AuxU8_Dcm_DataDID_F1B4_TechnicalSpecificationsVersionData_ArrayType: array-size=26, array-size-semantics=FIXED-SIZE, implementation-data-type=uint8
    DataArrayTypeUint8_DID_0407_VWLogicalSoftwareBlockCounterOfProgrammingAttemptsData: category=ARRAY
      element AuxU8_Dcm_DataDID_0407_VWLogicalSoftwareBlockCounterOfProgrammingAttemptsData_ArrayType: array-size=6, array-size-semantics=FIXED-SIZE, implementation-data-type=uint8
    Dcm_DataDID_0407_VWLogicalSoftwareBlockCounterOfProgrammingAttemptsData_ArrayType: category=ARRAY
      element AuxU8_Dcm_DataDID_0407_VWLogicalSoftwareBlockCounterOfProgrammingAttemptsData_ArrayType: array-size=6, array-size-semantics=FIXED-SIZE, implementation-data-type=uint8
    DataArrayTypeUint8_DID_040F_VWLogicalSoftwareBlockLockValueData: category=ARRAY
      element AuxU8_Dcm_DataDID_040F_VWLogicalSoftwareBlockLockValueData_ArrayType: array-size=6, array-size-semantics=FIXED-SIZE, implementation-data-type=uint8
    Dcm_DataDID_040F_VWLogicalSoftwareBlockLockValueData_ArrayType: category=ARRAY
      element AuxU8_Dcm_DataDID_040F_VWLogicalSoftwareBlockLockValueData_ArrayType: array-size=6, array-size-semantics=FIXED-SIZE, implementation-data-type=uint8
    DataArrayTypeUint8_DID_0410_BootloaderTPBlocksizeData: category=ARRAY
      element AuxU8_Dcm_DataDID_0410_BootloaderTPBlocksizeData_ArrayType: array-size=1, array-size-semantics=FIXED-SIZE, implementation-data-type=uint8
    Dcm_DataDID_0410_BootloaderTPBlocksizeData_ArrayType: category=ARRAY
      element AuxU8_Dcm_DataDID_0410_BootloaderTPBlocksizeData_ArrayType: array-size=1, array-size-semantics=FIXED-SIZE, implementation-data-type=uint8
    DataArrayTypeUint8_DID_0448_ProgrammingPreconditionsData: category=ARRAY
      element AuxU8_Dcm_DataDID_0448_ProgrammingPreconditionsData_ArrayType: array-size=5, array-size-semantics=FIXED-SIZE, implementation-data-type=uint8
    Dcm_DataDID_0448_ProgrammingPreconditionsData_ArrayType: category=ARRAY
      element AuxU8_Dcm_DataDID_0448_ProgrammingPreconditionsData_ArrayType: array-size=5, array-size-semantics=FIXED-SIZE, implementation-data-type=uint8
    DataArrayTypeUint8_DID_F1DF_ECUProgrammingInformationData: category=ARRAY
      element AuxU8_Dcm_DataDID_F1DF_ECUProgrammingInformationData_ArrayType: array-size=1, array-size-semantics=FIXED-SIZE, implementation-data-type=uint8
    Dcm_DataDID_F1DF_ECUProgrammingInformationData_ArrayType: category=ARRAY
      element AuxU8_Dcm_DataDID_F1DF_ECUProgrammingInformationData_ArrayType: array-size=1, array-size-semantics=FIXED-SIZE, implementation-data-type=uint8
    DataArrayTypeUint8_DID_F19E_ASAMODXFileIdentifierData: category=ARRAY
      element AuxU8_Dcm_DataDID_F19E_ASAMODXFileIdentifierData_ArrayType: array-size=24, array-size-semantics=FIXED-SIZE, implementation-data-type=uint8
    Dcm_DataDID_F19E_ASAMODXFileIdentifierData_ArrayType: category=ARRAY
      element AuxU8_Dcm_DataDID_F19E_ASAMODXFileIdentifierData_ArrayType: array-size=24, array-size-semantics=FIXED-SIZE, implementation-data-type=uint8
    DataArrayTypeUint8_DID_F1A2_ASAMODXFileVersionData: category=ARRAY
      element AuxU8_Dcm_DataDID_F1A2_ASAMODXFileVersionData_ArrayType: array-size=6, array-size-semantics=FIXED-SIZE, implementation-data-type=uint8
    Dcm_DataDID_F1A2_ASAMODXFileVersionData_ArrayType: category=ARRAY
      element AuxU8_Dcm_DataDID_F1A2_ASAMODXFileVersionData_ArrayType: array-size=6, array-size-semantics=FIXED-SIZE, implementation-data-type=uint8
    DataArrayTypeUint8_DID_F1D5_FDSProjectData: category=ARRAY
      element AuxU8_Dcm_DataDID_F1D5_FDSProjectData_ArrayType: array-size=7, array-size-semantics=FIXED-SIZE, implementation-data-type=uint8
    Dcm_DataDID_F1D5_FDSProjectData_ArrayType: category=ARRAY
      element AuxU8_Dcm_DataDID_F1D5_FDSProjectData_ArrayType: array-size=7, array-size-semantics=FIXED-SIZE, implementation-data-type=uint8
    DataArrayTypeUint8_DID_F1A3_VWECUHardwareVersionNumberData: category=ARRAY
      element AuxU8_Dcm_DataDID_F1A3_VWECUHardwareVersionNumberData_ArrayType: array-size=3, array-size-semantics=FIXED-SIZE, implementation-data-type=uint8
    Dcm_DataDID_F1A3_VWECUHardwareVersionNumberData_ArrayType: category=ARRAY
      element AuxU8_Dcm_DataDID_F1A3_VWECUHardwareVersionNumberData_ArrayType: array-size=3, array-size-semantics=FIXED-SIZE, implementation-data-type=uint8
    DataArrayTypeUint8_DID_F18C_ECUSerialNumberData: category=ARRAY
      element AuxU8_Dcm_DataDID_F18C_ECUSerialNumberData_ArrayType: array-size=20, array-size-semantics=FIXED-SIZE, implementation-data-type=uint8
    Dcm_DataDID_F18C_ECUSerialNumberData_ArrayType: category=ARRAY
      element AuxU8_Dcm_DataDID_F18C_ECUSerialNumberData_ArrayType: array-size=20, array-size-semantics=FIXED-SIZE, implementation-data-type=uint8
    DataArrayTypeUint8_DID_F1AB_VWLogicalSoftwareBlockVersionData: category=ARRAY
      element AuxU8_Dcm_DataDID_F1AB_VWLogicalSoftwareBlockVersionData_ArrayType: array-size=12, array-size-semantics=FIXED-SIZE, implementation-data-type=uint8
    Dcm_DataDID_F1AB_VWLogicalSoftwareBlockVersionData_ArrayType: category=ARRAY
      element AuxU8_Dcm_DataDID_F1AB_VWLogicalSoftwareBlockVersionData_ArrayType: array-size=12, array-size-semantics=FIXED-SIZE, implementation-data-type=uint8
    DataArrayTypeUint8_DID_F15B_FingerprintAndProgrammingDateOfLogicalSoftwareBlocksData: category=ARRAY
      element AuxU8_Dcm_DataDID_F15B_FingerprintAndProgrammingDateOfLogicalSoftwareBlocksData_ArrayType: array-size=30, array-size-semantics=FIXED-SIZE, implementation-data-type=uint8
    Dcm_DataDID_F15B_FingerprintAndProgrammingDateOfLogicalSoftwareBlocksData_ArrayType: category=ARRAY
      element AuxU8_Dcm_DataDID_F15B_FingerprintAndProgrammingDateOfLogicalSoftwareBlocksData_ArrayType: array-size=30, array-size-semantics=FIXED-SIZE, implementation-data-type=uint8
    DataArrayTypeUint8_DID_0236_ProgrammingDataElockEcuData: category=ARRAY
      element AuxU8_Dcm_DataDID_0236_ProgrammingDataElockEcuData_ArrayType: array-size=59, array-size-semantics=FIXED-SIZE, implementation-data-type=uint8
    Dcm_DataDID_0236_ProgrammingDataElockEcuData_ArrayType: category=ARRAY
      element AuxU8_Dcm_DataDID_0236_ProgrammingDataElockEcuData_ArrayType: array-size=59, array-size-semantics=FIXED-SIZE, implementation-data-type=uint8
    DataArrayTypeUint8_DID_023E_WSCForProgrammingElockEcuData: category=ARRAY
      element AuxU8_Dcm_DataDID_023E_WSCForProgrammingElockEcuData_ArrayType: array-size=6, array-size-semantics=FIXED-SIZE, implementation-data-type=uint8
    Dcm_DataDID_023E_WSCForProgrammingElockEcuData_ArrayType: category=ARRAY
      element AuxU8_Dcm_DataDID_023E_WSCForProgrammingElockEcuData_ArrayType: array-size=6, array-size-semantics=FIXED-SIZE, implementation-data-type=uint8
    Dcm_DidSupportedType: compu {0=DCM_DID_SUPPORTED, 1=DCM_DID_NOT_SUPPORTED}, implementation-data-type=uint8
    Dcm_StartDataOut_DcmDspRoutineCtrl_Lock_UnlockECU_DcmDspStartRoutineOutSignal_0PrimitivType: implementation-data-type=uint8
    Dcm_StartDataOut_DcmDspRoutineCtrl_Lock_UnlockECU_DcmDspStartRoutineOutSignal_0Type: implementation-data-type=ImplementationDataTypes/Dcm_StartDataOut_DcmDspRoutineCtrl_Lock_UnlockECU_DcmDspStartRoutineOutSignal_0PrimitivType
    StartDataOutType_DcmDspRoutineCtrl_Lock_UnlockECU_DcmDspStartRoutineOutSignal_0: implementation-data-type=uint8
    Dcm_StopDataOut_DcmDspRoutineCtrl_Lock_UnlockECU_DcmDspRoutineStopOutSignal_0PrimitivType: implementation-data-type=uint8
    Dcm_StopDataOut_DcmDspRoutineCtrl_Lock_UnlockECU_DcmDspRoutineStopOutSignal_0Type: implementation-data-type=ImplementationDataTypes/Dcm_StopDataOut_DcmDspRoutineCtrl_Lock_UnlockECU_DcmDspRoutineStopOutSignal_0PrimitivType
    StopDataOutType_DcmDspRoutineCtrl_Lock_UnlockECU_DcmDspRoutineStopOutSignal_0: implementation-data-type=uint8
    Dcm_RequestDataOut_DcmDspRoutineCtrl_Lock_UnlockECU_DcmDspRoutineRequestResOutSignalPrimitivType: implementation-data-type=uint8
    Dcm_RequestDataOut_DcmDspRoutineCtrl_Lock_UnlockECU_DcmDspRoutineRequestResOutSignalType: implementation-data-type=ImplementationDataTypes/Dcm_RequestDataOut_DcmDspRoutineCtrl_Lock_UnlockECU_DcmDspRoutineRequestResOutSignalPrimitivType
    RequestDataOutType_DcmDspRoutineCtrl_Lock_UnlockECU_DcmDspRoutineRequestResOutSignal: implementation-data-type=uint8
    Dcm_RequestDataOut_DcmDspRoutineCtrl_Lock_UnlockECU_DcmDspRoutineRequestResOutSignalInformationLockPrimitivType: implementation-data-type=uint16
    Dcm_RequestDataOut_DcmDspRoutineCtrl_Lock_UnlockECU_DcmDspRoutineRequestResOutSignalInformationLockType: implementation-data-type=ImplementationDataTypes/Dcm_RequestDataOut_DcmDspRoutineCtrl_Lock_UnlockECU_DcmDspRoutineRequestResOutSignalInformationLockPrimitivType
    RequestDataOutType_DcmDspRoutineCtrl_Lock_UnlockECU_DcmDspRoutineRequestResOutSignalInformationLock: implementation-data-type=uint16
    Dcm_StartDataOut_DcmDspRoutineProcessMode_DcmDspStartRoutineOutSignal_RoutineInfoPrimitivType: implementation-data-type=uint8
    Dcm_StartDataOut_DcmDspRoutineProcessMode_DcmDspStartRoutineOutSignal_RoutineInfoType: implementation-data-type=ImplementationDataTypes/Dcm_StartDataOut_DcmDspRoutineProcessMode_DcmDspStartRoutineOutSignal_RoutineInfoPrimitivType
    StartDataOutType_DcmDspRoutineProcessMode_DcmDspStartRoutineOutSignal_RoutineInfo: implementation-data-type=uint8
    Dcm_StopDataOut_DcmDspRoutineProcessMode_DcmDspRoutineStopOutSignal_RoutineInfoPrimitivType: implementation-data-type=uint8
    Dcm_StopDataOut_DcmDspRoutineProcessMode_DcmDspRoutineStopOutSignal_RoutineInfoType: implementation-data-type=ImplementationDataTypes/Dcm_StopDataOut_DcmDspRoutineProcessMode_DcmDspRoutineStopOutSignal_RoutineInfoPrimitivType
    StopDataOutType_DcmDspRoutineProcessMode_DcmDspRoutineStopOutSignal_RoutineInfo: implementation-data-type=uint8
    Dcm_RequestDataOut_DcmDspRoutineProcessMode_DcmDspRoutineRequestResOutSignal_RoutineInfoPrimitivType: implementation-data-type=uint8
    Dcm_RequestDataOut_DcmDspRoutineProcessMode_DcmDspRoutineRequestResOutSignal_RoutineInfoType: implementation-data-type=ImplementationDataTypes/Dcm_RequestDataOut_DcmDspRoutineProcessMode_DcmDspRoutineRequestResOutSignal_RoutineInfoPrimitivType
    RequestDataOutType_DcmDspRoutineProcessMode_DcmDspRoutineRequestResOutSignal_RoutineInfo: implementation-data-type=uint8
    Dcm_RequestDataOut_DcmDspRoutineProcessMode_DcmDspRoutineRequestResOutSignal_PROCESSPrimitivType: implementation-data-type=uint8
    Dcm_RequestDataOut_DcmDspRoutineProcessMode_DcmDspRoutineRequestResOutSignal_PROCESSType: implementation-data-type=ImplementationDataTypes/Dcm_RequestDataOut_DcmDspRoutineProcessMode_DcmDspRoutineRequestResOutSignal_PROCESSPrimitivType
    RequestDataOutType_DcmDspRoutineProcessMode_DcmDspRoutineRequestResOutSignal_PROCESS: implementation-data-type=uint8
    Dcm_StartDataOut_DcmDspRoutineAccCalib_DcmDspStartRoutineOutSignal_RoutineInfoPrimitivType: implementation-data-type=uint8
    Dcm_StartDataOut_DcmDspRoutineAccCalib_DcmDspStartRoutineOutSignal_RoutineInfoType: implementation-data-type=ImplementationDataTypes/Dcm_StartDataOut_DcmDspRoutineAccCalib_DcmDspStartRoutineOutSignal_RoutineInfoPrimitivType
    StartDataOutType_DcmDspRoutineAccCalib_DcmDspStartRoutineOutSignal_RoutineInfo: implementation-data-type=uint8
    Dcm_StartDataOut_DcmDspRoutineLockSolenoid_DcmDspStartRoutineOutSignal_0PrimitivType: implementation-data-type=uint8
    Dcm_StartDataOut_DcmDspRoutineLockSolenoid_DcmDspStartRoutineOutSignal_0Type: implementation-data-type=ImplementationDataTypes/Dcm_StartDataOut_DcmDspRoutineLockSolenoid_DcmDspStartRoutineOutSignal_0PrimitivType
    StartDataOutType_DcmDspRoutineLockSolenoid_DcmDspStartRoutineOutSignal_0: implementation-data-type=uint8
    Dcm_StopDataOut_DcmDspRoutineLockSolenoid_DcmDspStopRoutineOutSignal_RoutineInfoPrimitivType: implementation-data-type=uint8
    Dcm_StopDataOut_DcmDspRoutineLockSolenoid_DcmDspStopRoutineOutSignal_RoutineInfoType: implementation-data-type=ImplementationDataTypes/Dcm_StopDataOut_DcmDspRoutineLockSolenoid_DcmDspStopRoutineOutSignal_RoutineInfoPrimitivType
    StopDataOutType_DcmDspRoutineLockSolenoid_DcmDspStopRoutineOutSignal_RoutineInfo: implementation-data-type=uint8
    Dcm_StartDataIn_DcmDspRoutineEcuTempCalibration_DcmDspStartRoutineInSignal_0PrimitivType: implementation-data-type=sint8
    Dcm_StartDataIn_DcmDspRoutineEcuTempCalibration_DcmDspStartRoutineInSignal_0Type: implementation-data-type=ImplementationDataTypes/Dcm_StartDataIn_DcmDspRoutineEcuTempCalibration_DcmDspStartRoutineInSignal_0PrimitivType
    StartDataInType_DcmDspRoutineEcuTempCalibration_DcmDspStartRoutineInSignal_0: implementation-data-type=sint8
    Dcm_StartDataOut_DcmDspRoutineEcuTempCalibration_DcmDspStartRoutineOutSignal_0PrimitivType: implementation-data-type=uint8
    Dcm_StartDataOut_DcmDspRoutineEcuTempCalibration_DcmDspStartRoutineOutSignal_0Type: implementation-data-type=ImplementationDataTypes/Dcm_StartDataOut_DcmDspRoutineEcuTempCalibration_DcmDspStartRoutineOutSignal_0PrimitivType
    StartDataOutType_DcmDspRoutineEcuTempCalibration_DcmDspStartRoutineOutSignal_0: implementation-data-type=uint8
    Dcm_StartDataIn_DcmDspRoutineAccAngleOffsetCalibration_DcmDspStartRoutineInSignal_0PrimitivType: implementation-data-type=uint16
    Dcm_StartDataIn_DcmDspRoutineAccAngleOffsetCalibration_DcmDspStartRoutineInSignal_0Type: implementation-data-type=ImplementationDataTypes/Dcm_StartDataIn_DcmDspRoutineAccAngleOffsetCalibration_DcmDspStartRoutineInSignal_0PrimitivType
    StartDataInType_DcmDspRoutineAccAngleOffsetCalibration_DcmDspStartRoutineInSignal_0: implementation-data-type=uint16
    Dcm_StartDataIn_DcmDspRoutineAccAngleOffsetCalibration_DcmDspStartRoutineInSignal_1PrimitivType: implementation-data-type=uint16
    Dcm_StartDataIn_DcmDspRoutineAccAngleOffsetCalibration_DcmDspStartRoutineInSignal_1Type: implementation-data-type=ImplementationDataTypes/Dcm_StartDataIn_DcmDspRoutineAccAngleOffsetCalibration_DcmDspStartRoutineInSignal_1PrimitivType
    StartDataInType_DcmDspRoutineAccAngleOffsetCalibration_DcmDspStartRoutineInSignal_1: implementation-data-type=uint16
    Dcm_StartDataIn_DcmDspRoutineAccAngleOffsetCalibration_DcmDspStartRoutineInSignal_2PrimitivType: implementation-data-type=uint16
    Dcm_StartDataIn_DcmDspRoutineAccAngleOffsetCalibration_DcmDspStartRoutineInSignal_2Type: implementation-data-type=ImplementationDataTypes/Dcm_StartDataIn_DcmDspRoutineAccAngleOffsetCalibration_DcmDspStartRoutineInSignal_2PrimitivType
    StartDataInType_DcmDspRoutineAccAngleOffsetCalibration_DcmDspStartRoutineInSignal_2: implementation-data-type=uint16
    Dcm_StartDataOut_DcmDspRoutineAccAngleOffsetCalibration_DcmDspStartRoutineOutSignal_0PrimitivType: implementation-data-type=uint8
    Dcm_StartDataOut_DcmDspRoutineAccAngleOffsetCalibration_DcmDspStartRoutineOutSignal_0Type: implementation-data-type=ImplementationDataTypes/Dcm_StartDataOut_DcmDspRoutineAccAngleOffsetCalibration_DcmDspStartRoutineOutSignal_0PrimitivType
    StartDataOutType_DcmDspRoutineAccAngleOffsetCalibration_DcmDspStartRoutineOutSignal_0: implementation-data-type=uint8
    Dcm_StartFlexibleOutArrayData_DcmDspRoutineRoutineCheckProgrammingPreconditions_DcmDspStartRoutineOutSignal_0Type: category=ARRAY
      element AuxU8_Dcm_StartFlexibleOutArrayData_DcmDspRoutineRoutineCheckProgrammingPreconditions_DcmDspStartRoutineOutSignal_0Type: array-size=5, array-size-semantics=FIXED-SIZE, implementation-data-type=uint8
    DcmDspRoutineInfoCheckProgrammingPreconditions_DcmDspStartRoutineOutSignal_ArrayType: category=ARRAY
      element AuxU8_DcmDspRoutineInfoCheckProgrammingPreconditions_DcmDspStartRoutineOutSignal_ArrayType: array-size=5, array-size-semantics=FIXED-SIZE, implementation-data-type=uint8
    StartFlexibleOutArrayDataType_DcmDspRoutineRoutineCheckProgrammingPreconditions_DcmDspStartRoutineOutSignal_0: category=ARRAY
      element AuxU8_StartFlexibleOutArrayDataType_DcmDspRoutineRoutineCheckProgrammingPreconditions_DcmDspStartRoutineOutSignal_0: array-size=5, array-size-semantics=FIXED-SIZE, implementation-data-type=uint8
    Dcm_RequestData_ArrayType: category=ARRAY
      element AuxU8_Dcm_RequestData_ArrayType: array-size=512, array-size-semantics=FIXED-SIZE, implementation-data-type=uint8
    Dcm_Uint8PtrDataType: category=DATA_REFERENCE, sw-pointer-target-props={target-category=TYPE_REFERENCE, implementation-data-type=uint8}
package /AUTOSAR_Dcm/PortInterfaces
  54 x client server interface, all with is-service=true:
    DCMServices
      5 x operation, all with possible-error=DCMServices/E_NOT_OK:
        GetSecurityLevel
          arg SecLevel: type=Dcm_SecLevelType, direction=OUT
        GetSesCtrlType
          arg SesCtrlType: type=Dcm_SesCtrlType, direction=OUT
        GetActiveProtocol
          arg ActiveProtocol: type=Dcm_ProtocolType, direction=OUT
        ResetToDefaultSession
        SetActiveDiagnostic
          arg active: type=boolean, direction=IN
      error E_NOT_OK: error-code=1
    DCM_Roe
      operation TriggerOnEvent: possible-error=DCM_Roe/E_NOT_OK
      error E_NOT_OK: error-code=1
    SecurityAccess_DcmDspSecurityAlv
      operation GetSeed: possible-error=[SecurityAccess_DcmDspSecurityAlv/E_NOT_OK, SecurityAccess_DcmDspSecurityAlv/DCM_E_PENDING]
        arg OpStatus: type=Dcm_OpStatusType, direction=IN
        arg Seed: type=Dcm_SecSeedDcmDspSecurityAlv_ArrayType, direction=OUT
        arg ErrorCode: type=Dcm_NegativeResponseCodeType, direction=OUT
      operation CompareKey: possible-error=[SecurityAccess_DcmDspSecurityAlv/E_NOT_OK, SecurityAccess_DcmDspSecurityAlv/DCM_E_PENDING, SecurityAccess_DcmDspSecurityAlv/DCM_E_COMPARE_KEY_FAILED]
        arg Key: type=Dcm_SecKeyDcmDspSecurityAlv_ArrayType, direction=IN
        arg OpStatus: type=Dcm_OpStatusType, direction=IN
        arg ErrorCode: type=Dcm_NegativeResponseCodeType, direction=OUT
      error E_NOT_OK: error-code=1
      error DCM_E_PENDING: error-code=10
      error DCM_E_COMPARE_KEY_FAILED: error-code=11
    DataServices_DID_4024_SWSystemTimeData
      operation ReadData: possible-error=DataServices_DID_4024_SWSystemTimeData/E_NOT_OK
        arg Data: type=Dcm_DataDID_4024_SWSystemTimeData_ArrayType, direction=OUT
      error E_NOT_OK: error-code=1
    DataServices_DID_FD00_HWVersionData
      operation ReadData: possible-error=[DataServices_DID_FD00_HWVersionData/E_NOT_OK, DataServices_DID_FD00_HWVersionData/DCM_E_PENDING]
        arg OpStatus: type=Dcm_OpStatusType, direction=IN
        arg Data: type=Dcm_DataDID_FD00_HWVersionData_ArrayType, direction=OUT
      operation WriteData: possible-error=[DataServices_DID_FD00_HWVersionData/E_NOT_OK, DataServices_DID_FD00_HWVersionData/DCM_E_PENDING]
        arg Data: type=Dcm_DataDID_FD00_HWVersionData_ArrayType, direction=IN
        arg OpStatus: type=Dcm_OpStatusType, direction=IN
        arg ErrorCode: type=Dcm_NegativeResponseCodeType, direction=OUT
      error E_NOT_OK: error-code=1
      error DCM_E_PENDING: error-code=10
    DataServices_DID_FD01_SWVersionData
      operation ReadData: possible-error=DataServices_DID_FD01_SWVersionData/E_NOT_OK
        arg Data: type=Dcm_DataDID_FD01_SWVersionData_ArrayType, direction=OUT
      error E_NOT_OK: error-code=1
    DataServices_DID_FD03_AEETraceabilityNumberData
      operation ReadData: possible-error=[DataServices_DID_FD03_AEETraceabilityNumberData/E_NOT_OK, DataServices_DID_FD03_AEETraceabilityNumberData/DCM_E_PENDING]
        arg OpStatus: type=Dcm_OpStatusType, direction=IN
        arg Data: type=Dcm_DataDID_FD03_AEETraceabilityNumberData_ArrayType, direction=OUT
      operation WriteData: possible-error=[DataServices_DID_FD03_AEETraceabilityNumberData/E_NOT_OK, DataServices_DID_FD03_AEETraceabilityNumberData/DCM_E_PENDING]
        arg Data: type=Dcm_DataDID_FD03_AEETraceabilityNumberData_ArrayType, direction=IN
        arg OpStatus: type=Dcm_OpStatusType, direction=IN
        arg ErrorCode: type=Dcm_NegativeResponseCodeType, direction=OUT
      error E_NOT_OK: error-code=1
      error DCM_E_PENDING: error-code=10
    DataServices_DID_FD08_ResetCauseData
      operation ReadData: possible-error=DataServices_DID_FD08_ResetCauseData/E_NOT_OK
        arg Data: type=Dcm_DataDID_FD08_ResetCauseData_ArrayType, direction=OUT
      error E_NOT_OK: error-code=1
    DataServices_DID_FD09_LastWarmResetParamData
      operation ReadData: possible-error=DataServices_DID_FD09_LastWarmResetParamData/E_NOT_OK
        arg Data: type=Dcm_DataDID_FD09_LastWarmResetParamData_ArrayType, direction=OUT
      error E_NOT_OK: error-code=1
    DataServices_DID_FD62_EccOccurenceNbData
      operation ReadData: possible-error=DataServices_DID_FD62_EccOccurenceNbData/E_NOT_OK
        arg Data: type=Dcm_DataDID_FD62_EccOccurenceNbData_ArrayType, direction=OUT
      error E_NOT_OK: error-code=1
    DataServices_DID_FEFF_MeasurementFramesConfData
      operation ReadData: possible-error=[DataServices_DID_FEFF_MeasurementFramesConfData/E_NOT_OK, DataServices_DID_FEFF_MeasurementFramesConfData/DCM_E_PENDING]
        arg OpStatus: type=Dcm_OpStatusType, direction=IN
        arg Data: type=Dcm_DataDID_FEFF_MeasurementFramesConfData_ArrayType, direction=OUT
      operation WriteData: possible-error=[DataServices_DID_FEFF_MeasurementFramesConfData/E_NOT_OK, DataServices_DID_FEFF_MeasurementFramesConfData/DCM_E_PENDING]
        arg Data: type=Dcm_DataDID_FEFF_MeasurementFramesConfData_ArrayType, direction=IN
        arg OpStatus: type=Dcm_OpStatusType, direction=IN
        arg ErrorCode: type=Dcm_NegativeResponseCodeType, direction=OUT
      error E_NOT_OK: error-code=1
      error DCM_E_PENDING: error-code=10
    DataServices_DID_FE00_AllEventStatusesRead
      operation ReadData: possible-error=DataServices_DID_FE00_AllEventStatusesRead/E_NOT_OK
        arg Data: type=Dcm_DataDID_FE00_AllEventStatusesRead_ArrayType, direction=OUT
      error E_NOT_OK: error-code=1
    DataServices_DID_FD8B_ECUManufacturingDateData
      operation ReadData: possible-error=[DataServices_DID_FD8B_ECUManufacturingDateData/E_NOT_OK, DataServices_DID_FD8B_ECUManufacturingDateData/DCM_E_PENDING]
        arg OpStatus: type=Dcm_OpStatusType, direction=IN
        arg Data: type=Dcm_DataDID_FD8B_ECUManufacturingDateData_ArrayType, direction=OUT
      operation WriteData: possible-error=[DataServices_DID_FD8B_ECUManufacturingDateData/E_NOT_OK, DataServices_DID_FD8B_ECUManufacturingDateData/DCM_E_PENDING]
        arg Data: type=Dcm_DataDID_FD8B_ECUManufacturingDateData_ArrayType, direction=IN
        arg OpStatus: type=Dcm_OpStatusType, direction=IN
        arg ErrorCode: type=Dcm_NegativeResponseCodeType, direction=OUT
      error E_NOT_OK: error-code=1
      error DCM_E_PENDING: error-code=10
    DataServices_DID_FD8C_AssemblySerialNumber
      operation ReadData: possible-error=[DataServices_DID_FD8C_AssemblySerialNumber/E_NOT_OK, DataServices_DID_FD8C_AssemblySerialNumber/DCM_E_PENDING]
        arg OpStatus: type=Dcm_OpStatusType, direction=IN
        arg Data: type=Dcm_DataDID_FD8C_AssemblySerialNumber_ArrayType, direction=OUT
      operation WriteData: possible-error=[DataServices_DID_FD8C_AssemblySerialNumber/E_NOT_OK, DataServices_DID_FD8C_AssemblySerialNumber/DCM_E_PENDING]
        arg Data: type=Dcm_DataDID_FD8C_AssemblySerialNumber_ArrayType, direction=IN
        arg OpStatus: type=Dcm_OpStatusType, direction=IN
        arg ErrorCode: type=Dcm_NegativeResponseCodeType, direction=OUT
      error E_NOT_OK: error-code=1
      error DCM_E_PENDING: error-code=10
    DataServices_DID_FD0F_BatteryMeasureData
      operation ReadData: possible-error=[DataServices_DID_FD0F_BatteryMeasureData/E_NOT_OK, DataServices_DID_FD0F_BatteryMeasureData/DCM_E_PENDING]
        arg OpStatus: type=Dcm_OpStatusType, direction=IN
        arg Data: type=Dcm_DataDID_FD0F_BatteryMeasureData_ArrayType, direction=OUT
      error E_NOT_OK: error-code=1
      error DCM_E_PENDING: error-code=10
    DataServices_DID_FD10_ECUTemperatureData
      operation ReadData: possible-error=[DataServices_DID_FD10_ECUTemperatureData/E_NOT_OK, DataServices_DID_FD10_ECUTemperatureData/DCM_E_PENDING]
        arg OpStatus: type=Dcm_OpStatusType, direction=IN
        arg Data: type=Dcm_DataDID_FD10_ECUTemperatureData_ArrayType, direction=OUT
      error E_NOT_OK: error-code=1
      error DCM_E_PENDING: error-code=10
    DataServices_DID_FDE0_EcsVariantData
      operation ReadData: possible-error=[DataServices_DID_FDE0_EcsVariantData/E_NOT_OK, DataServices_DID_FDE0_EcsVariantData/DCM_E_PENDING]
        arg OpStatus: type=Dcm_OpStatusType, direction=IN
        arg Data: type=Dcm_DataDID_FDE0_EcsVariantData_ArrayType, direction=OUT
      operation WriteData: possible-error=[DataServices_DID_FDE0_EcsVariantData/E_NOT_OK, DataServices_DID_FDE0_EcsVariantData/DCM_E_PENDING]
        arg Data: type=Dcm_DataDID_FDE0_EcsVariantData_ArrayType, direction=IN
        arg OpStatus: type=Dcm_OpStatusType, direction=IN
        arg ErrorCode: type=Dcm_NegativeResponseCodeType, direction=OUT
      error E_NOT_OK: error-code=1
      error DCM_E_PENDING: error-code=10
    DataServices_DID_FDE1_EcsParametersData
      operation ReadData: possible-error=[DataServices_DID_FDE1_EcsParametersData/E_NOT_OK, DataServices_DID_FDE1_EcsParametersData/DCM_E_PENDING]
        arg OpStatus: type=Dcm_OpStatusType, direction=IN
        arg Data: type=Dcm_DataDID_FDE1_EcsParametersData_ArrayType, direction=OUT
      operation WriteData: possible-error=[DataServices_DID_FDE1_EcsParametersData/E_NOT_OK, DataServices_DID_FDE1_EcsParametersData/DCM_E_PENDING]
        arg Data: type=Dcm_DataDID_FDE1_EcsParametersData_ArrayType, direction=IN
        arg OpStatus: type=Dcm_OpStatusType, direction=IN
        arg ErrorCode: type=Dcm_NegativeResponseCodeType, direction=OUT
      error E_NOT_OK: error-code=1
      error DCM_E_PENDING: error-code=10
    DataServices_DID_FDE2_AccOffsetData
      operation ReadData: possible-error=[DataServices_DID_FDE2_AccOffsetData/E_NOT_OK, DataServices_DID_FDE2_AccOffsetData/DCM_E_PENDING]
        arg OpStatus: type=Dcm_OpStatusType, direction=IN
        arg Data: type=Dcm_DataDID_FDE2_AccOffsetData_ArrayType, direction=OUT
      operation WriteData: possible-error=[DataServices_DID_FDE2_AccOffsetData/E_NOT_OK, DataServices_DID_FDE2_AccOffsetData/DCM_E_PENDING]
        arg Data: type=Dcm_DataDID_FDE2_AccOffsetData_ArrayType, direction=IN
        arg OpStatus: type=Dcm_OpStatusType, direction=IN
        arg ErrorCode: type=Dcm_NegativeResponseCodeType, direction=OUT
      error E_NOT_OK: error-code=1
      error DCM_E_PENDING: error-code=10
    DataServices_DID_FDE3_EcsProfilesData
      operation ReadData: possible-error=[DataServices_DID_FDE3_EcsProfilesData/E_NOT_OK, DataServices_DID_FDE3_EcsProfilesData/DCM_E_PENDING]
        arg OpStatus: type=Dcm_OpStatusType, direction=IN
        arg Data: type=Dcm_DataDID_FDE3_EcsProfilesData_ArrayType, direction=OUT
      operation WriteData: possible-error=[DataServices_DID_FDE3_EcsProfilesData/E_NOT_OK, DataServices_DID_FDE3_EcsProfilesData/DCM_E_PENDING]
        arg Data: type=Dcm_DataDID_FDE3_EcsProfilesData_ArrayType, direction=IN
        arg OpStatus: type=Dcm_OpStatusType, direction=IN
        arg ErrorCode: type=Dcm_NegativeResponseCodeType, direction=OUT
      error E_NOT_OK: error-code=1
      error DCM_E_PENDING: error-code=10
    DataServices_DID_FDE4_EcsStepsData
      operation ReadData: possible-error=[DataServices_DID_FDE4_EcsStepsData/E_NOT_OK, DataServices_DID_FDE4_EcsStepsData/DCM_E_PENDING]
        arg OpStatus: type=Dcm_OpStatusType, direction=IN
        arg Data: type=Dcm_DataDID_FDE4_EcsStepsData_ArrayType, direction=OUT
      operation WriteData: possible-error=[DataServices_DID_FDE4_EcsStepsData/E_NOT_OK, DataServices_DID_FDE4_EcsStepsData/DCM_E_PENDING]
        arg Data: type=Dcm_DataDID_FDE4_EcsStepsData_ArrayType, direction=IN
        arg OpStatus: type=Dcm_OpStatusType, direction=IN
        arg ErrorCode: type=Dcm_NegativeResponseCodeType, direction=OUT
      error E_NOT_OK: error-code=1
      error DCM_E_PENDING: error-code=10
    DataServices_DID_FDE5_EcsAccLowPassData
      operation ReadData: possible-error=[DataServices_DID_FDE5_EcsAccLowPassData/E_NOT_OK, DataServices_DID_FDE5_EcsAccLowPassData/DCM_E_PENDING]
        arg OpStatus: type=Dcm_OpStatusType, direction=IN
        arg Data: type=Dcm_DataDID_FDE5_EcsAccLowPassData_ArrayType, direction=OUT
      operation WriteData: possible-error=[DataServices_DID_FDE5_EcsAccLowPassData/E_NOT_OK, DataServices_DID_FDE5_EcsAccLowPassData/DCM_E_PENDING]
        arg Data: type=Dcm_DataDID_FDE5_EcsAccLowPassData_ArrayType, direction=IN
        arg OpStatus: type=Dcm_OpStatusType, direction=IN
        arg ErrorCode: type=Dcm_NegativeResponseCodeType, direction=OUT
      error E_NOT_OK: error-code=1
      error DCM_E_PENDING: error-code=10
    DataServices_DID_FDE7_AlgoOutputDelayData
      operation ReadData: possible-error=[DataServices_DID_FDE7_AlgoOutputDelayData/E_NOT_OK, DataServices_DID_FDE7_AlgoOutputDelayData/DCM_E_PENDING]
        arg OpStatus: type=Dcm_OpStatusType, direction=IN
        arg Data: type=Dcm_DataDID_FDE7_AlgoOutputDelayData_ArrayType, direction=OUT
      operation WriteData: possible-error=[DataServices_DID_FDE7_AlgoOutputDelayData/E_NOT_OK, DataServices_DID_FDE7_AlgoOutputDelayData/DCM_E_PENDING]
        arg Data: type=Dcm_DataDID_FDE7_AlgoOutputDelayData_ArrayType, direction=IN
        arg OpStatus: type=Dcm_OpStatusType, direction=IN
        arg ErrorCode: type=Dcm_NegativeResponseCodeType, direction=OUT
      error E_NOT_OK: error-code=1
      error DCM_E_PENDING: error-code=10
    DataServices_DID_FDE9_SensitivityLutData
      operation ReadData: possible-error=[DataServices_DID_FDE9_SensitivityLutData/E_NOT_OK, DataServices_DID_FDE9_SensitivityLutData/DCM_E_PENDING]
        arg OpStatus: type=Dcm_OpStatusType, direction=IN
        arg Data: type=Dcm_DataDID_FDE9_SensitivityLutData_ArrayType, direction=OUT
      operation WriteData: possible-error=[DataServices_DID_FDE9_SensitivityLutData/E_NOT_OK, DataServices_DID_FDE9_SensitivityLutData/DCM_E_PENDING]
        arg Data: type=Dcm_DataDID_FDE9_SensitivityLutData_ArrayType, direction=IN
        arg OpStatus: type=Dcm_OpStatusType, direction=IN
        arg ErrorCode: type=Dcm_NegativeResponseCodeType, direction=OUT
      error E_NOT_OK: error-code=1
      error DCM_E_PENDING: error-code=10
    DataServices_DID_FDEA_SensitivityOptData
      operation ReadData: possible-error=[DataServices_DID_FDEA_SensitivityOptData/E_NOT_OK, DataServices_DID_FDEA_SensitivityOptData/DCM_E_PENDING]
        arg OpStatus: type=Dcm_OpStatusType, direction=IN
        arg Data: type=Dcm_DataDID_FDEA_SensitivityOptData_ArrayType, direction=OUT
      operation WriteData: possible-error=[DataServices_DID_FDEA_SensitivityOptData/E_NOT_OK, DataServices_DID_FDEA_SensitivityOptData/DCM_E_PENDING]
        arg Data: type=Dcm_DataDID_FDEA_SensitivityOptData_ArrayType, direction=IN
        arg OpStatus: type=Dcm_OpStatusType, direction=IN
        arg ErrorCode: type=Dcm_NegativeResponseCodeType, direction=OUT
      error E_NOT_OK: error-code=1
      error DCM_E_PENDING: error-code=10
    DataServices_DID_FDFF_MeasurementFrameConfDataRam
      operation ReadData: possible-error=[DataServices_DID_FDFF_MeasurementFrameConfDataRam/E_NOT_OK, DataServices_DID_FDFF_MeasurementFrameConfDataRam/DCM_E_PENDING]
        arg OpStatus: type=Dcm_OpStatusType, direction=IN
        arg Data: type=Dcm_DataDID_FDFF_MeasurementFrameConfDataRam_ArrayType, direction=OUT
      operation WriteData: possible-error=[DataServices_DID_FDFF_MeasurementFrameConfDataRam/E_NOT_OK, DataServices_DID_FDFF_MeasurementFrameConfDataRam/DCM_E_PENDING]
        arg Data: type=Dcm_DataDID_FDFF_MeasurementFrameConfDataRam_ArrayType, direction=IN
        arg OpStatus: type=Dcm_OpStatusType, direction=IN
        arg ErrorCode: type=Dcm_NegativeResponseCodeType, direction=OUT
      error E_NOT_OK: error-code=1
      error DCM_E_PENDING: error-code=10
    DataServices_DID_F187_VWSparePartNumberData
      operation ReadData: possible-error=[DataServices_DID_F187_VWSparePartNumberData/E_NOT_OK, DataServices_DID_F187_VWSparePartNumberData/DCM_E_PENDING]
        arg OpStatus: type=Dcm_OpStatusType, direction=IN
        arg Data: type=Dcm_DataDID_F187_VWSparePartNumberData_ArrayType, direction=OUT
      operation WriteData: possible-error=[DataServices_DID_F187_VWSparePartNumberData/E_NOT_OK, DataServices_DID_F187_VWSparePartNumberData/DCM_E_PENDING]
        arg Data: type=Dcm_DataDID_F187_VWSparePartNumberData_ArrayType, direction=IN
        arg OpStatus: type=Dcm_OpStatusType, direction=IN
        arg ErrorCode: type=Dcm_NegativeResponseCodeType, direction=OUT
      error E_NOT_OK: error-code=1
      error DCM_E_PENDING: error-code=10
    DataServices_DID_F189_VWApplicationSoftwareVersionNumberData
      operation ReadData: possible-error=[DataServices_DID_F189_VWApplicationSoftwareVersionNumberData/E_NOT_OK, DataServices_DID_F189_VWApplicationSoftwareVersionNumberData/DCM_E_PENDING]
        arg OpStatus: type=Dcm_OpStatusType, direction=IN
        arg Data: type=Dcm_DataDID_F189_VWApplicationSoftwareVersionNumberData_ArrayType, direction=OUT
      operation WriteData: possible-error=[DataServices_DID_F189_VWApplicationSoftwareVersionNumberData/E_NOT_OK, DataServices_DID_F189_VWApplicationSoftwareVersionNumberData/DCM_E_PENDING]
        arg Data: type=Dcm_DataDID_F189_VWApplicationSoftwareVersionNumberData_ArrayType, direction=IN
        arg OpStatus: type=Dcm_OpStatusType, direction=IN
        arg ErrorCode: type=Dcm_NegativeResponseCodeType, direction=OUT
      error E_NOT_OK: error-code=1
      error DCM_E_PENDING: error-code=10
    DataServices_DID_F191_VWECUHardwareNumberData
      operation ReadData: possible-error=[DataServices_DID_F191_VWECUHardwareNumberData/E_NOT_OK, DataServices_DID_F191_VWECUHardwareNumberData/DCM_E_PENDING]
        arg OpStatus: type=Dcm_OpStatusType, direction=IN
        arg Data: type=Dcm_DataDID_F191_VWECUHardwareNumberData_ArrayType, direction=OUT
      operation WriteData: possible-error=[DataServices_DID_F191_VWECUHardwareNumberData/E_NOT_OK, DataServices_DID_F191_VWECUHardwareNumberData/DCM_E_PENDING]
        arg Data: type=Dcm_DataDID_F191_VWECUHardwareNumberData_ArrayType, direction=IN
        arg OpStatus: type=Dcm_OpStatusType, direction=IN
        arg ErrorCode: type=Dcm_NegativeResponseCodeType, direction=OUT
      error E_NOT_OK: error-code=1
      error DCM_E_PENDING: error-code=10
    DataServices_DID_F197_VWSystemNameOrEngineTypeData
      operation ReadData: possible-error=[DataServices_DID_F197_VWSystemNameOrEngineTypeData/E_NOT_OK, DataServices_DID_F197_VWSystemNameOrEngineTypeData/DCM_E_PENDING]
        arg OpStatus: type=Dcm_OpStatusType, direction=IN
        arg Data: type=Dcm_DataDID_F197_VWSystemNameOrEngineTypeData_ArrayType, direction=OUT
      operation WriteData: possible-error=[DataServices_DID_F197_VWSystemNameOrEngineTypeData/E_NOT_OK, DataServices_DID_F197_VWSystemNameOrEngineTypeData/DCM_E_PENDING]
        arg Data: type=Dcm_DataDID_F197_VWSystemNameOrEngineTypeData_ArrayType, direction=IN
        arg OpStatus: type=Dcm_OpStatusType, direction=IN
        arg ErrorCode: type=Dcm_NegativeResponseCodeType, direction=OUT
      error E_NOT_OK: error-code=1
      error DCM_E_PENDING: error-code=10
    DataServices_DID_F1B4_TechnicalSpecificationsVersionData
      operation ReadData: possible-error=[DataServices_DID_F1B4_TechnicalSpecificationsVersionData/E_NOT_OK, DataServices_DID_F1B4_TechnicalSpecificationsVersionData/DCM_E_PENDING]
        arg OpStatus: type=Dcm_OpStatusType, direction=IN
        arg Data: type=Dcm_DataDID_F1B4_TechnicalSpecificationsVersionData_ArrayType, direction=OUT
      error E_NOT_OK: error-code=1
      error DCM_E_PENDING: error-code=10
    DataServices_DID_0407_VWLogicalSoftwareBlockCounterOfProgrammingAttemptsData
      operation ReadData: possible-error=[DataServices_DID_0407_VWLogicalSoftwareBlockCounterOfProgrammingAttemptsData/E_NOT_OK, DataServices_DID_0407_VWLogicalSoftwareBlockCounterOfProgrammingAttemptsData/DCM_E_PENDING]
        arg OpStatus: type=Dcm_OpStatusType, direction=IN
        arg Data: type=Dcm_DataDID_0407_VWLogicalSoftwareBlockCounterOfProgrammingAttemptsData_ArrayType, direction=OUT
      error E_NOT_OK: error-code=1
      error DCM_E_PENDING: error-code=10
    DataServices_DID_040F_VWLogicalSoftwareBlockLockValueData
      operation ReadData: possible-error=[DataServices_DID_040F_VWLogicalSoftwareBlockLockValueData/E_NOT_OK, DataServices_DID_040F_VWLogicalSoftwareBlockLockValueData/DCM_E_PENDING]
        arg OpStatus: type=Dcm_OpStatusType, direction=IN
        arg Data: type=Dcm_DataDID_040F_VWLogicalSoftwareBlockLockValueData_ArrayType, direction=OUT
      error E_NOT_OK: error-code=1
      error DCM_E_PENDING: error-code=10
    DataServices_DID_0410_BootloaderTPBlocksizeData
      operation ReadData: possible-error=[DataServices_DID_0410_BootloaderTPBlocksizeData/E_NOT_OK, DataServices_DID_0410_BootloaderTPBlocksizeData/DCM_E_PENDING]
        arg OpStatus: type=Dcm_OpStatusType, direction=IN
        arg Data: type=Dcm_DataDID_0410_BootloaderTPBlocksizeData_ArrayType, direction=OUT
      operation WriteData: possible-error=[DataServices_DID_0410_BootloaderTPBlocksizeData/E_NOT_OK, DataServices_DID_0410_BootloaderTPBlocksizeData/DCM_E_PENDING]
        arg Data: type=Dcm_DataDID_0410_BootloaderTPBlocksizeData_ArrayType, direction=IN
        arg OpStatus: type=Dcm_OpStatusType, direction=IN
        arg ErrorCode: type=Dcm_NegativeResponseCodeType, direction=OUT
      error E_NOT_OK: error-code=1
      error DCM_E_PENDING: error-code=10
    DataServices_DID_0448_ProgrammingPreconditionsData
      operation ReadData: possible-error=[DataServices_DID_0448_ProgrammingPreconditionsData/E_NOT_OK, DataServices_DID_0448_ProgrammingPreconditionsData/DCM_E_PENDING]
        arg OpStatus: type=Dcm_OpStatusType, direction=IN
        arg Data: type=Dcm_DataDID_0448_ProgrammingPreconditionsData_ArrayType, direction=OUT
      error E_NOT_OK: error-code=1
      error DCM_E_PENDING: error-code=10
    DataServices_DID_F1DF_ECUProgrammingInformationData
      operation ReadData: possible-error=[DataServices_DID_F1DF_ECUProgrammingInformationData/E_NOT_OK, DataServices_DID_F1DF_ECUProgrammingInformationData/DCM_E_PENDING]
        arg OpStatus: type=Dcm_OpStatusType, direction=IN
        arg Data: type=Dcm_DataDID_F1DF_ECUProgrammingInformationData_ArrayType, direction=OUT
      error E_NOT_OK: error-code=1
      error DCM_E_PENDING: error-code=10
    DataServices_DID_F19E_ASAMODXFileIdentifierData
      operation ReadData: possible-error=[DataServices_DID_F19E_ASAMODXFileIdentifierData/E_NOT_OK, DataServices_DID_F19E_ASAMODXFileIdentifierData/DCM_E_PENDING]
        arg OpStatus: type=Dcm_OpStatusType, direction=IN
        arg Data: type=Dcm_DataDID_F19E_ASAMODXFileIdentifierData_ArrayType, direction=OUT
      operation WriteData: possible-error=[DataServices_DID_F19E_ASAMODXFileIdentifierData/E_NOT_OK, DataServices_DID_F19E_ASAMODXFileIdentifierData/DCM_E_PENDING]
        arg Data: type=Dcm_DataDID_F19E_ASAMODXFileIdentifierData_ArrayType, direction=IN
        arg OpStatus: type=Dcm_OpStatusType, direction=IN
        arg ErrorCode: type=Dcm_NegativeResponseCodeType, direction=OUT
      error E_NOT_OK: error-code=1
      error DCM_E_PENDING: error-code=10
    DataServices_DID_F1A2_ASAMODXFileVersionData
      operation ReadData: possible-error=[DataServices_DID_F1A2_ASAMODXFileVersionData/E_NOT_OK, DataServices_DID_F1A2_ASAMODXFileVersionData/DCM_E_PENDING]
        arg OpStatus: type=Dcm_OpStatusType, direction=IN
        arg Data: type=Dcm_DataDID_F1A2_ASAMODXFileVersionData_ArrayType, direction=OUT
      operation WriteData: possible-error=[DataServices_DID_F1A2_ASAMODXFileVersionData/E_NOT_OK, DataServices_DID_F1A2_ASAMODXFileVersionData/DCM_E_PENDING]
        arg Data: type=Dcm_DataDID_F1A2_ASAMODXFileVersionData_ArrayType, direction=IN
        arg OpStatus: type=Dcm_OpStatusType, direction=IN
        arg ErrorCode: type=Dcm_NegativeResponseCodeType, direction=OUT
      error E_NOT_OK: error-code=1
      error DCM_E_PENDING: error-code=10
    DataServices_DID_F1D5_FDSProjectData
      operation ReadData: possible-error=[DataServices_DID_F1D5_FDSProjectData/E_NOT_OK, DataServices_DID_F1D5_FDSProjectData/DCM_E_PENDING]
        arg OpStatus: type=Dcm_OpStatusType, direction=IN
        arg Data: type=Dcm_DataDID_F1D5_FDSProjectData_ArrayType, direction=OUT
      error E_NOT_OK: error-code=1
      error DCM_E_PENDING: error-code=10
    DataServices_DID_F1A3_VWECUHardwareVersionNumberData
      operation ReadData: possible-error=[DataServices_DID_F1A3_VWECUHardwareVersionNumberData/E_NOT_OK, DataServices_DID_F1A3_VWECUHardwareVersionNumberData/DCM_E_PENDING]
        arg OpStatus: type=Dcm_OpStatusType, direction=IN
        arg Data: type=Dcm_DataDID_F1A3_VWECUHardwareVersionNumberData_ArrayType, direction=OUT
      operation WriteData: possible-error=[DataServices_DID_F1A3_VWECUHardwareVersionNumberData/E_NOT_OK, DataServices_DID_F1A3_VWECUHardwareVersionNumberData/DCM_E_PENDING]
        arg Data: type=Dcm_DataDID_F1A3_VWECUHardwareVersionNumberData_ArrayType, direction=IN
        arg OpStatus: type=Dcm_OpStatusType, direction=IN
        arg ErrorCode: type=Dcm_NegativeResponseCodeType, direction=OUT
      error E_NOT_OK: error-code=1
      error DCM_E_PENDING: error-code=10
    DataServices_DID_F18C_ECUSerialNumberData
      operation ReadData: possible-error=[DataServices_DID_F18C_ECUSerialNumberData/E_NOT_OK, DataServices_DID_F18C_ECUSerialNumberData/DCM_E_PENDING]
        arg OpStatus: type=Dcm_OpStatusType, direction=IN
        arg Data: type=Dcm_DataDID_F18C_ECUSerialNumberData_ArrayType, direction=OUT
      operation WriteData: possible-error=[DataServices_DID_F18C_ECUSerialNumberData/E_NOT_OK, DataServices_DID_F18C_ECUSerialNumberData/DCM_E_PENDING]
        arg Data: type=Dcm_DataDID_F18C_ECUSerialNumberData_ArrayType, direction=IN
        arg OpStatus: type=Dcm_OpStatusType, direction=IN
        arg ErrorCode: type=Dcm_NegativeResponseCodeType, direction=OUT
      error E_NOT_OK: error-code=1
      error DCM_E_PENDING: error-code=10
    DataServices_DID_F1AB_VWLogicalSoftwareBlockVersionData
      operation ReadData: possible-error=[DataServices_DID_F1AB_VWLogicalSoftwareBlockVersionData/E_NOT_OK, DataServices_DID_F1AB_VWLogicalSoftwareBlockVersionData/DCM_E_PENDING]
        arg OpStatus: type=Dcm_OpStatusType, direction=IN
        arg Data: type=Dcm_DataDID_F1AB_VWLogicalSoftwareBlockVersionData_ArrayType, direction=OUT
      error E_NOT_OK: error-code=1
      error DCM_E_PENDING: error-code=10
    DataServices_DID_F15B_FingerprintAndProgrammingDateOfLogicalSoftwareBlocksData
      operation ReadData: possible-error=[DataServices_DID_F15B_FingerprintAndProgrammingDateOfLogicalSoftwareBlocksData/E_NOT_OK, DataServices_DID_F15B_FingerprintAndProgrammingDateOfLogicalSoftwareBlocksData/DCM_E_PENDING]
        arg OpStatus: type=Dcm_OpStatusType, direction=IN
        arg Data: type=Dcm_DataDID_F15B_FingerprintAndProgrammingDateOfLogicalSoftwareBlocksData_ArrayType, direction=OUT
      error E_NOT_OK: error-code=1
      error DCM_E_PENDING: error-code=10
    DataServices_DID_0236_ProgrammingDataElockEcuData
      operation ReadData: possible-error=[DataServices_DID_0236_ProgrammingDataElockEcuData/E_NOT_OK, DataServices_DID_0236_ProgrammingDataElockEcuData/DCM_E_PENDING]
        arg OpStatus: type=Dcm_OpStatusType, direction=IN
        arg Data: type=Dcm_DataDID_0236_ProgrammingDataElockEcuData_ArrayType, direction=OUT
      operation WriteData: possible-error=[DataServices_DID_0236_ProgrammingDataElockEcuData/E_NOT_OK, DataServices_DID_0236_ProgrammingDataElockEcuData/DCM_E_PENDING]
        arg Data: type=Dcm_DataDID_0236_ProgrammingDataElockEcuData_ArrayType, direction=IN
        arg OpStatus: type=Dcm_OpStatusType, direction=IN
        arg ErrorCode: type=Dcm_NegativeResponseCodeType, direction=OUT
      error E_NOT_OK: error-code=1
      error DCM_E_PENDING: error-code=10
    DataServices_DID_023E_WSCForProgrammingElockEcuData
      operation ReadData: possible-error=[DataServices_DID_023E_WSCForProgrammingElockEcuData/E_NOT_OK, DataServices_DID_023E_WSCForProgrammingElockEcuData/DCM_E_PENDING]
        arg OpStatus: type=Dcm_OpStatusType, direction=IN
        arg Data: type=Dcm_DataDID_023E_WSCForProgrammingElockEcuData_ArrayType, direction=OUT
      operation WriteData: possible-error=[DataServices_DID_023E_WSCForProgrammingElockEcuData/E_NOT_OK, DataServices_DID_023E_WSCForProgrammingElockEcuData/DCM_E_PENDING]
        arg Data: type=Dcm_DataDID_023E_WSCForProgrammingElockEcuData_ArrayType, direction=IN
        arg OpStatus: type=Dcm_OpStatusType, direction=IN
        arg ErrorCode: type=Dcm_NegativeResponseCodeType, direction=OUT
      error E_NOT_OK: error-code=1
      error DCM_E_PENDING: error-code=10
    ServiceRequestNotification
      operation Indication: possible-error=[ServiceRequestNotification/E_NOT_OK, ServiceRequestNotification/E_REQUEST_NOT_ACCEPTED]
        6 x arg:
          SID: type=uint8, direction=IN
          RequestData: type=Dcm_RequestData_ArrayType, direction=IN
          DataSize: type=uint16, direction=IN
          ReqType: type=uint8, direction=IN
          SourceAddress: type=uint16, direction=IN
          ErrorCode: type=Dcm_NegativeResponseCodeType, direction=OUT
      operation Confirmation: possible-error=ServiceRequestNotification/E_NOT_OK
        4 x arg, all with direction=IN:
          SID: type=uint8
          ReqType: type=uint8
          SourceAddress: type=uint16
          ConfirmationStatus: type=Dcm_ConfirmationStatusType
      error E_NOT_OK: error-code=1
      error E_REQUEST_NOT_ACCEPTED: error-code=8
    CallbackDCMRequestServices
      operation StartProtocol: possible-error=[CallbackDCMRequestServices/E_NOT_OK, CallbackDCMRequestServices/E_PROTOCOL_NOT_ALLOWED]
        arg ProtocolID: type=Dcm_ProtocolType, direction=IN
      operation StopProtocol: possible-error=CallbackDCMRequestServices/E_NOT_OK
        arg ProtocolID: type=Dcm_ProtocolType, direction=IN
      error E_NOT_OK: error-code=1
      error E_PROTOCOL_NOT_ALLOWED: error-code=5
    RoutineServices_DcmDspRoutineCtrl_Lock_UnlockECU
      operation Start: possible-error=[RoutineServices_DcmDspRoutineCtrl_Lock_UnlockECU/E_NOT_OK, RoutineServices_DcmDspRoutineCtrl_Lock_UnlockECU/DCM_E_PENDING, RoutineServices_DcmDspRoutineCtrl_Lock_UnlockECU/DCM_E_FORCE_RCRRP]
        arg OpStatus: type=Dcm_OpStatusType, direction=IN
        arg dataOut0: type=ImplementationDataTypes/Dcm_StartDataOut_DcmDspRoutineCtrl_Lock_UnlockECU_DcmDspStartRoutineOutSignal_0Type, direction=OUT
        arg ErrorCode: type=Dcm_NegativeResponseCodeType, direction=OUT
      operation Stop: possible-error=[RoutineServices_DcmDspRoutineCtrl_Lock_UnlockECU/E_NOT_OK, RoutineServices_DcmDspRoutineCtrl_Lock_UnlockECU/DCM_E_PENDING, RoutineServices_DcmDspRoutineCtrl_Lock_UnlockECU/DCM_E_FORCE_RCRRP]
        arg OpStatus: type=Dcm_OpStatusType, direction=IN
        arg dataOut0: type=ImplementationDataTypes/Dcm_StopDataOut_DcmDspRoutineCtrl_Lock_UnlockECU_DcmDspRoutineStopOutSignal_0Type, direction=OUT
        arg ErrorCode: type=Dcm_NegativeResponseCodeType, direction=OUT
      operation RequestResults: possible-error=[RoutineServices_DcmDspRoutineCtrl_Lock_UnlockECU/E_NOT_OK, RoutineServices_DcmDspRoutineCtrl_Lock_UnlockECU/DCM_E_PENDING, RoutineServices_DcmDspRoutineCtrl_Lock_UnlockECU/DCM_E_FORCE_RCRRP]
        4 x arg:
          OpStatus: type=Dcm_OpStatusType, direction=IN
          dataOut0: type=ImplementationDataTypes/Dcm_RequestDataOut_DcmDspRoutineCtrl_Lock_UnlockECU_DcmDspRoutineRequestResOutSignalType, direction=OUT
          dataOut1: type=ImplementationDataTypes/Dcm_RequestDataOut_DcmDspRoutineCtrl_Lock_UnlockECU_DcmDspRoutineRequestResOutSignalInformationLockType, direction=OUT
          ErrorCode: type=Dcm_NegativeResponseCodeType, direction=OUT
      error E_NOT_OK: error-code=1
      error DCM_E_PENDING: error-code=10
      error DCM_E_FORCE_RCRRP: error-code=12
    RoutineServices_DcmDspRoutineProcessMode
      operation Start: possible-error=[RoutineServices_DcmDspRoutineProcessMode/E_NOT_OK, RoutineServices_DcmDspRoutineProcessMode/DCM_E_PENDING, RoutineServices_DcmDspRoutineProcessMode/DCM_E_FORCE_RCRRP]
        arg OpStatus: type=Dcm_OpStatusType, direction=IN
        arg dataOut0: type=ImplementationDataTypes/Dcm_StartDataOut_DcmDspRoutineProcessMode_DcmDspStartRoutineOutSignal_RoutineInfoType, direction=OUT
        arg ErrorCode: type=Dcm_NegativeResponseCodeType, direction=OUT
      operation Stop: possible-error=[RoutineServices_DcmDspRoutineProcessMode/E_NOT_OK, RoutineServices_DcmDspRoutineProcessMode/DCM_E_PENDING, RoutineServices_DcmDspRoutineProcessMode/DCM_E_FORCE_RCRRP]
        arg OpStatus: type=Dcm_OpStatusType, direction=IN
        arg dataOut0: type=ImplementationDataTypes/Dcm_StopDataOut_DcmDspRoutineProcessMode_DcmDspRoutineStopOutSignal_RoutineInfoType, direction=OUT
        arg ErrorCode: type=Dcm_NegativeResponseCodeType, direction=OUT
      operation RequestResults: possible-error=[RoutineServices_DcmDspRoutineProcessMode/E_NOT_OK, RoutineServices_DcmDspRoutineProcessMode/DCM_E_PENDING, RoutineServices_DcmDspRoutineProcessMode/DCM_E_FORCE_RCRRP]
        4 x arg:
          OpStatus: type=Dcm_OpStatusType, direction=IN
          dataOut0: type=ImplementationDataTypes/Dcm_RequestDataOut_DcmDspRoutineProcessMode_DcmDspRoutineRequestResOutSignal_RoutineInfoType, direction=OUT
          dataOut1: type=ImplementationDataTypes/Dcm_RequestDataOut_DcmDspRoutineProcessMode_DcmDspRoutineRequestResOutSignal_PROCESSType, direction=OUT
          ErrorCode: type=Dcm_NegativeResponseCodeType, direction=OUT
      error E_NOT_OK: error-code=1
      error DCM_E_PENDING: error-code=10
      error DCM_E_FORCE_RCRRP: error-code=12
    RoutineServices_DcmDspRoutineAccCalib
      operation Start: possible-error=[RoutineServices_DcmDspRoutineAccCalib/E_NOT_OK, RoutineServices_DcmDspRoutineAccCalib/DCM_E_PENDING, RoutineServices_DcmDspRoutineAccCalib/DCM_E_FORCE_RCRRP]
        arg OpStatus: type=Dcm_OpStatusType, direction=IN
        arg dataOut0: type=ImplementationDataTypes/Dcm_StartDataOut_DcmDspRoutineAccCalib_DcmDspStartRoutineOutSignal_RoutineInfoType, direction=OUT
        arg ErrorCode: type=Dcm_NegativeResponseCodeType, direction=OUT
      error E_NOT_OK: error-code=1
      error DCM_E_PENDING: error-code=10
      error DCM_E_FORCE_RCRRP: error-code=12
    RoutineServices_DcmDspRoutineLockSolenoid
      operation Start: possible-error=[RoutineServices_DcmDspRoutineLockSolenoid/E_NOT_OK, RoutineServices_DcmDspRoutineLockSolenoid/DCM_E_PENDING, RoutineServices_DcmDspRoutineLockSolenoid/DCM_E_FORCE_RCRRP]
        arg OpStatus: type=Dcm_OpStatusType, direction=IN
        arg dataOut0: type=ImplementationDataTypes/Dcm_StartDataOut_DcmDspRoutineLockSolenoid_DcmDspStartRoutineOutSignal_0Type, direction=OUT
        arg ErrorCode: type=Dcm_NegativeResponseCodeType, direction=OUT
      operation Stop: possible-error=[RoutineServices_DcmDspRoutineLockSolenoid/E_NOT_OK, RoutineServices_DcmDspRoutineLockSolenoid/DCM_E_PENDING, RoutineServices_DcmDspRoutineLockSolenoid/DCM_E_FORCE_RCRRP]
        arg OpStatus: type=Dcm_OpStatusType, direction=IN
        arg dataOut0: type=ImplementationDataTypes/Dcm_StopDataOut_DcmDspRoutineLockSolenoid_DcmDspStopRoutineOutSignal_RoutineInfoType, direction=OUT
        arg ErrorCode: type=Dcm_NegativeResponseCodeType, direction=OUT
      error E_NOT_OK: error-code=1
      error DCM_E_PENDING: error-code=10
      error DCM_E_FORCE_RCRRP: error-code=12
    RoutineServices_DcmDspRoutineEcuTempCalibration
      operation Start: possible-error=[RoutineServices_DcmDspRoutineEcuTempCalibration/E_NOT_OK, RoutineServices_DcmDspRoutineEcuTempCalibration/DCM_E_PENDING, RoutineServices_DcmDspRoutineEcuTempCalibration/DCM_E_FORCE_RCRRP]
        4 x arg:
          dataIn0: type=ImplementationDataTypes/Dcm_StartDataIn_DcmDspRoutineEcuTempCalibration_DcmDspStartRoutineInSignal_0Type, direction=IN
          OpStatus: type=Dcm_OpStatusType, direction=IN
          dataOut0: type=ImplementationDataTypes/Dcm_StartDataOut_DcmDspRoutineEcuTempCalibration_DcmDspStartRoutineOutSignal_0Type, direction=OUT
          ErrorCode: type=Dcm_NegativeResponseCodeType, direction=OUT
      error E_NOT_OK: error-code=1
      error DCM_E_PENDING: error-code=10
      error DCM_E_FORCE_RCRRP: error-code=12
    RoutineServices_DcmDspRoutineAccAngleOffsetCalibration
      operation Start: possible-error=[RoutineServices_DcmDspRoutineAccAngleOffsetCalibration/E_NOT_OK, RoutineServices_DcmDspRoutineAccAngleOffsetCalibration/DCM_E_PENDING, RoutineServices_DcmDspRoutineAccAngleOffsetCalibration/DCM_E_FORCE_RCRRP]
        6 x arg:
          dataIn{0..2}: type=ImplementationDataTypes/Dcm_StartDataIn_DcmDspRoutineAccAngleOffsetCalibration_DcmDspStartRoutineInSignal_{0..2}Type, direction=IN
          OpStatus: type=Dcm_OpStatusType, direction=IN
          dataOut0: type=ImplementationDataTypes/Dcm_StartDataOut_DcmDspRoutineAccAngleOffsetCalibration_DcmDspStartRoutineOutSignal_0Type, direction=OUT
          ErrorCode: type=Dcm_NegativeResponseCodeType, direction=OUT
      error E_NOT_OK: error-code=1
      error DCM_E_PENDING: error-code=10
      error DCM_E_FORCE_RCRRP: error-code=12
    RoutineServices_DcmDspRoutineRoutineCheckProgrammingPreconditions
      operation Start: possible-error=[RoutineServices_DcmDspRoutineRoutineCheckProgrammingPreconditions/E_NOT_OK, RoutineServices_DcmDspRoutineRoutineCheckProgrammingPreconditions/DCM_E_PENDING, RoutineServices_DcmDspRoutineRoutineCheckProgrammingPreconditions/DCM_E_FORCE_RCRRP]
        4 x arg:
          OpStatus: type=Dcm_OpStatusType, direction=IN
          dataOut0: type=ImplementationDataTypes/Dcm_StartFlexibleOutArrayData_DcmDspRoutineRoutineCheckProgrammingPreconditions_DcmDspStartRoutineOutSignal_0Type, direction=OUT
          currentDataLength: type=uint16, direction=OUT
          ErrorCode: type=Dcm_NegativeResponseCodeType, direction=OUT
      error E_NOT_OK: error-code=1
      error DCM_E_PENDING: error-code=10
      error DCM_E_FORCE_RCRRP: error-code=12
