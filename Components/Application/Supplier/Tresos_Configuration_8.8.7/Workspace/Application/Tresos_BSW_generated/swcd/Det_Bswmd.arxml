AUTOSAR XML (schema 4-0-3)
package /AUTOSAR_Det/BswModuleDescriptions
  bsw module description Det: module-id=15, provided-entrys=Det_Init
    bsw internal behavior InternalBehavior_0
      exclusive area SCHM_DET_EXCLUSIVE_AREA_0
      bsw called entity Det_Init: can-enter-exclusive-area=SCHM_DET_EXCLUSIVE_AREA_0, implemented-entry=Det_Init
package /AUTOSAR_Det/BswModuleEntrys
  bsw module entry Det_Init: service-id=0, is-reentrant=false, is-synchronous=true, call-type=REGULAR, execution-context=UNSPECIFIED, sw-service-impl-policy=STANDARD
package /EB_Det/Implementations
  bsw implementation BswImplementation_0: programming-language=C, sw-version=6.5.10, vendor-id=1, ar-release-version=4.6.0, behavior=InternalBehavior_0, vendor-specific-module-def=Det
    code-descriptors:
      code Files
        artifact-descriptors:
          short-label=Autosar::include::Det.h, category=SWHDR
          short-label=Autosar::include::Det_BSW.h, category=SWHDR
          short-label=Autosar::include::Det_Compiler.h, category=SWHDR
          short-label=Autosar::include::Det_Int.h, category=SWHDR
          short-label=Autosar::include::Det_Version.h, category=SWHDR
          short-label=Autosar::src::Det.c, category=SWSRC
          short-label=Autosar::src::Det_ASR32_Rte.c, category=SWSRC
          short-label=Autosar::src::Det_ASR40_Rte.c, category=SWSRC
          short-label=Autosar::src::Det_ASR43_Rte.c, category=SWSRC
          short-label=Autosar::src::Det_Rte.c, category=SWSRC
          short-label=make::Det_defs.mak, category=SWMAKE
          short-label=make::Det_rules.mak, category=SWMAKE
    resource consumption ResourceConsumption
      5 x memory section:
        VAR_CLEARED_UNSPECIFIED: alignment=UNSPECIFIED, sw-addrmethod=VAR_CLEARED
        CODE: sw-addrmethod=CODE
        VAR_INIT_8: alignment=8, sw-addrmethod=VAR_INIT
        VAR_CLEARED_8: alignment=8, sw-addrmethod=VAR_CLEARED
        VAR_CLEARED_16: alignment=16, sw-addrmethod=VAR_CLEARED
