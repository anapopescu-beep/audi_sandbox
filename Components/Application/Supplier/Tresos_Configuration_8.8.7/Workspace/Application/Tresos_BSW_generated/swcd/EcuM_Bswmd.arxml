AUTOSAR XML (schema 4-2-1)
package /AUTOSAR_EcuM/ImplementationDataTypes
  impl type EcuM_StateType: compu {16=ECUM_STATE_STARTUP, 17=ECUM_STATE_STARTUP_ONE, 18=ECUM_STATE_STARTUP_TWO, 32=ECUM_STATE_WAKEUP, 33=ECUM_STATE_WAKEUP_ONE, 34=ECUM_STATE_WAKEUP_VALIDATION, 35=ECUM_STATE_WAKEUP_REACTION, 36=ECUM_STATE_WAKEUP_TWO, 37=ECUM_STATE_WAKEUP_WAKESLEEP, 38=ECUM_STATE_WAKEUP_TTII, 48=ECUM_STATE_RUN, 50=ECUM_STATE_APP_RUN, 51=ECUM_STATE_APP_POST_RUN, 64=ECUM_STATE_SHUTDOWN, 68=ECUM_STATE_PREP_SHUTDOWN, 73=ECUM_STATE_GO_SLEEP, 77=ECUM_STATE_GO_OFF_ONE, 78=ECUM_STATE_GO_OFF_TWO, 80=ECUM_STATE_SLEEP, 128=ECUM_STATE_OFF, 144=ECUM_STATE_RESET}, implementation-data-type=uint8
package /AUTOSAR_EcuM/BswModuleDescriptions
  bsw module description EcuM: module-id=10, provided-entrys=EcuM_MainFunction
    bsw internal behavior InternalBehavior_0
      exclusive area SCHM_ECUM_EXCLUSIVE_AREA_0
      bsw schedulable entity EcuM_MainFunction: can-enter-exclusive-area=SCHM_ECUM_EXCLUSIVE_AREA_0, implemented-entry=EcuM_MainFunction
      bsw timing event TimingEvent_MainFunction: starts-on-event=EcuM_MainFunction, period=0.01
package /AUTOSAR_EcuM/BswModuleEntrys
  bsw module entry EcuM_MainFunction: service-id=24, is-reentrant=false, is-synchronous=true, call-type=SCHEDULED, execution-context=TASK, sw-service-impl-policy=STANDARD
package /EB_EcuM/Implementations
  bsw implementation BswImplementation_0: programming-language=C, sw-version=5.15.11, vendor-id=1, ar-release-version=4.6.0, behavior=InternalBehavior_0, vendor-specific-module-def=EcuM
    code-descriptors:
      code Files
        artifact-descriptors:
          short-label=Autosar::include::EcuM.h, category=SWHDR
          short-label=Autosar::include::EcuM_BSW.h, category=SWHDR
          short-label=Autosar::include::EcuM_BSW_Types.h, category=SWHDR
          short-label=Autosar::include::EcuM_BootTarget.h, category=SWHDR
          short-label=Autosar::include::EcuM_Cbk.h, category=SWHDR
          short-label=Autosar::include::EcuM_Externals.h, category=SWHDR
          short-label=Autosar::include::EcuM_Int.h, category=SWHDR
          short-label=Autosar::include::EcuM_Trace.h, category=SWHDR
          short-label=Autosar::include::EcuM_Trace_Internal.h, category=SWHDR
          short-label=Autosar::include::EcuM_Types.h, category=SWHDR
          short-label=Autosar::include::EcuM_Version.h, category=SWHDR
          short-label=Autosar::src::EcuM.c, category=SWSRC
          short-label=Autosar::src::EcuM_ASR32_Rte.c, category=SWSRC
          short-label=Autosar::src::EcuM_ASR40_Rte.c, category=SWSRC
          short-label=Autosar::src::EcuM_BootTarget.c, category=SWSRC
          short-label=Autosar::src::EcuM_Rte.c, category=SWSRC
          short-label=make::EcuM_defs.mak, category=SWMAKE
          short-label=make::EcuM_rules.mak, category=SWMAKE
    resource consumption ResourceConsumption
      14 x memory section:
        VAR_POWER_ON_INIT_UNSPECIFIED: alignment=UNSPECIFIED, sw-addrmethod=VAR_POWER_ON_INIT
        VAR_POWER_ON_INIT_8: alignment=8, sw-addrmethod=VAR_POWER_ON_INIT
        VAR_CLEARED_8: alignment=8, sw-addrmethod=VAR_CLEARED
        VAR_CLEARED_16: alignment=16, sw-addrmethod=VAR_CLEARED
        VAR_CLEARED_32: alignment=32, sw-addrmethod=VAR_CLEARED
        CONST_8: alignment=8, sw-addrmethod=CONST
        VAR_INIT_8: alignment=8, sw-addrmethod=VAR_INIT
        CONST_16: alignment=16, sw-addrmethod=CONST
        VAR_CLEARED_UNSPECIFIED: alignment=UNSPECIFIED, sw-addrmethod=VAR_CLEARED
        VAR_INIT_UNSPECIFIED: alignment=UNSPECIFIED, sw-addrmethod=VAR_INIT
        CONST_32: alignment=32, sw-addrmethod=CONST
        CONST_UNSPECIFIED: alignment=UNSPECIFIED, sw-addrmethod=CONST
        CONFIG_DATA_UNSPECIFIED: alignment=UNSPECIFIED, sw-addrmethod=CONFIG_DATA
        CODE: sw-addrmethod=CODE
