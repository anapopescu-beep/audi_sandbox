AUTOSAR XML (schema 4-0-3)
package /AUTOSAR_Fee/BswModuleDescriptions
  bsw module description Fee: module-id=21, provided-entrys=[Fee_Init, Fee_MainFunction]
    bsw internal behavior InternalBehavior_0
      4 x exclusive area:
        FEE_EXCLUSIVE_AREA_{00..03}
      bsw called entity Fee_Init: can-enter-exclusive-area=[FEE_EXCLUSIVE_AREA_00, FEE_EXCLUSIVE_AREA_01, FEE_EXCLUSIVE_AREA_02, FEE_EXCLUSIVE_AREA_03], implemented-entry=Fee_Init, scheduler-name-prefix=Prefix_Fee
      bsw schedulable entity Fee_MainFunction: implemented-entry=Fee_MainFunction, scheduler-name-prefix=Prefix_Fee
      bsw timing event TimingEvent_MainFunction: starts-on-event=Fee_MainFunction, period=0.01
      bsw scheduler name prefix Prefix_Fee: symbol=Fee
package /AUTOSAR_Fee/BswModuleEntrys
  bsw module entry Fee_Init: service-id=0, is-reentrant=false, is-synchronous=true, call-type=REGULAR, execution-context=UNSPECIFIED, sw-service-impl-policy=STANDARD
  bsw module entry Fee_MainFunction: service-id=18, is-reentrant=false, is-synchronous=true, call-type=SCHEDULED, execution-context=TASK, sw-service-impl-policy=STANDARD
package /Fee_TS_T40D2M10I1R0/Implementations
  bsw implementation BswImplementation_0: programming-language=C, sw-version=1.0.1, vendor-id=43, ar-release-version=4.4.0, behavior=InternalBehavior_0, vendor-specific-module-def=Fee
    code-descriptors:
      code Files: artifact-descriptors=[{short-label=make::Fee_defs.mak, category=SWMAKE}, {short-label=make::Fee_rules.mak, category=SWMAKE}]
    resource consumption ResourceConsumption
      9 x memory section:
        FEE_CODE: alignment=UNSPECIFIED, sw-addrmethod=CODE, symbol=CODE
        FEE_CONFIG_DATA_UNSPECIFIED: alignment=UNSPECIFIED, sw-addrmethod=CONFIG_DATA, symbol=CONFIG_DATA_UNSPECIFIED
        FEE_CONST_32: alignment=32, sw-addrmethod=CONST, symbol=CONST_32
        FEE_VAR_CLEARED_16: alignment=16, sw-addrmethod=VAR_CLEARED, symbol=VAR_CLEARED_16
        FEE_VAR_CLEARED_32: alignment=32, sw-addrmethod=VAR_CLEARED, symbol=VAR_CLEARED_32
        FEE_VAR_CLEARED_8: alignment=8, sw-addrmethod=VAR_CLEARED, symbol=VAR_CLEARED_8
        FEE_VAR_CLEARED_BOOLEAN: alignment=BOOLEAN, sw-addrmethod=VAR_CLEARED, symbol=VAR_CLEARED_BOOLEAN
        FEE_VAR_CLEARED_UNSPECIFIED: alignment=UNSPECIFIED, sw-addrmethod=VAR_CLEARED, symbol=VAR_CLEARED_UNSPECIFIED
        FEE_VAR_INIT_UNSPECIFIED: alignment=UNSPECIFIED, sw-addrmethod=VAR_INIT, symbol=VAR_INIT_UNSPECIFIED
