AUTOSAR XML (schema 4-0-3)
package /AUTOSAR_McalExt/SwAddrMethods_McalExt
  6 x sw addr method, all with memory-allocation-keyword-policy=ADDR-METHOD-SHORT-NAME-AND-ALIGNMENT:
    RAMCODE: options=RAMCODE, section-type=CODE
    VAR_CLEARED_32_NO: options=VAR_CLEARED_32_NO, section-type=VAR
    VAR_CLEARED_8_NO: options=VAR_CLEARED_8_NO, section-type=VAR
    VAR_CLEARED_16_NO: options=VAR_CLEARED_16_NO, section-type=VAR
    VAR_CLEARED_BOOLEAN_NO: options=VAR_CLEARED_BOOLEAN_NO, section-type=VAR
    VAR_CLEARED_UNSPECIFIED_NO: options=VAR_CLEARED_UNSPECIFIED_NO, section-type=VAR
