AUTOSAR XML (schema 4-0-3)
package /AUTOSAR_NvM/ASR42/ImplementationDataTypes
  4 x impl type:
    NvM_ASR42_DstPtrType: category=DATA_REFERENCE, sw-pointer-target-props={target-category=VALUE, base-type=void}
    NvM_ASR42_SrcPtrType: category=DATA_REFERENCE, sw-pointer-target-props={target-category=VALUE, base-type=void, sw-impl-policy=CONST}
    NvM_ASR42_BlockIdType: implementation-data-type=uint16
    NvM_ASR42_RequestResultType: compu {0=NVM_REQ_OK, 1=NVM_REQ_NOT_OK, 2=NVM_REQ_PENDING, 3=NVM_REQ_INTEGRITY_FAILED, 4=NVM_REQ_BLOCK_SKIPPED, 5=NVM_REQ_NV_INVALIDATED, 6=NVM_REQ_CANCELED, 7=NVM_REQ_REDUNDANCY_FAILED, 8=NVM_REQ_RESTORED_DEFAULTS, 8=NVM_REQ_RESTORED_FROM_ROM, 9=NVM_REQ_OK_BLK_INCREASED, 10=NVM_REQ_OK_BLK_DECREASED}, implementation-data-type=uint8
package /AUTOSAR_NvM/ASR42/PortInterfaces
  client server interface NvM_ASR42_Service: is-service=true
    12 x operation, all with possible-error=NvM_ASR42_Service/E_NOT_OK:
      GetErrorStatus
        arg RequestResultPtr: type=NvM_ASR42_RequestResultType, direction=OUT
      SetDataIndex
        arg DataIndex: type=uint8, direction=IN
      GetDataIndex
        arg DataIndexPtr: type=uint8, direction=OUT
      SetRamBlockStatus
        arg BlockChanged: type=boolean, direction=IN
      ReadBlock
        arg DstPtr: type=NvM_ASR42_DstPtrType, direction=IN
      ReadPRAMBlock
      WriteBlock
        arg SrcPtr: type=NvM_ASR42_SrcPtrType, direction=IN
      WritePRAMBlock
      RestoreBlockDefaults
        arg DstPtr: type=NvM_ASR42_DstPtrType, direction=IN
      RestorePRAMBlockDefaults
      EraseBlock
      InvalidateNvBlock
    error E_NOT_OK: error-code=1
package /AUTOSAR_NvM/ImplementationDataTypes
  4 x impl type:
    NvM_DstPtrType: category=DATA_REFERENCE, sw-pointer-target-props={target-category=VALUE, base-type=void}
    NvM_SrcPtrType: category=DATA_REFERENCE, sw-pointer-target-props={target-category=VALUE, base-type=void, sw-impl-policy=CONST}
    NvM_BlockIdType: implementation-data-type=uint16
    NvM_RequestResultType: compu {0=NVM_REQ_OK, 1=NVM_REQ_NOT_OK, 2=NVM_REQ_PENDING, 3=NVM_REQ_INTEGRITY_FAILED, 4=NVM_REQ_BLOCK_SKIPPED, 5=NVM_REQ_NV_INVALIDATED, 6=NVM_REQ_CANCELED, 7=NVM_REQ_REDUNDANCY_FAILED, 8=NVM_REQ_RESTORED_DEFAULTS, 8=NVM_REQ_RESTORED_FROM_ROM, 9=NVM_REQ_OK_BLK_INCREASED, 10=NVM_REQ_OK_BLK_DECREASED}, implementation-data-type=uint8
package /AUTOSAR_NvM/PortInterfaces
  client server interface NvMService: is-service=true
    12 x operation, all with possible-error=NvMService/E_NOT_OK:
      GetErrorStatus
        arg RequestResultPtr: type=NvM_RequestResultType, direction=OUT
      SetDataIndex
        arg DataIndex: type=uint8, direction=IN
      GetDataIndex
        arg DataIndexPtr: type=uint8, direction=OUT
      SetRamBlockStatus
        arg BlockChanged: type=boolean, direction=IN
      ReadBlock
        arg DstPtr: type=NvM_DstPtrType, direction=IN
      ReadPRAMBlock
      WriteBlock
        arg SrcPtr: type=NvM_SrcPtrType, direction=IN
      WritePRAMBlock
      RestoreBlockDefaults
        arg DstPtr: type=NvM_DstPtrType, direction=IN
      RestorePRAMBlockDefaults
      EraseBlock
      InvalidateNvBlock
    error E_NOT_OK: error-code=1
