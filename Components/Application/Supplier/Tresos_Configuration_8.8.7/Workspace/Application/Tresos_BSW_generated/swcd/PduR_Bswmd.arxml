AUTOSAR XML (schema 4-2-1)
package /AUTOSAR_PduR/BswModuleDescriptions
  bsw module description PduR: module-id=51, provided-entrys=PduR_Init
    bsw internal behavior InternalBehavior_0
      exclusive area SCHM_PDUR_EXCLUSIVE_AREA_0
      bsw called entity PduR_Init: can-enter-exclusive-area=SCHM_PDUR_EXCLUSIVE_AREA_0, implemented-entry=PduR_Init
package /AUTOSAR_PduR/BswModuleEntrys
  bsw module entry PduR_Init: service-id=01, is-reentrant=false, is-synchronous=true, call-type=REGULAR, execution-context=UNSPECIFIED, sw-service-impl-policy=STANDARD
package /EB_PduR/Implementations
  bsw implementation BswImplementation_0: programming-language=C, sw-version=5.3.50, vendor-id=1, ar-release-version=4.0.3, behavior=InternalBehavior_0, vendor-specific-module-def=PduR
    code-descriptors:
      code Files
        artifact-descriptors:
          short-label=Autosar::include::PduR.h, category=SWHDR
          short-label=Autosar::include::PduR_Api.h, category=SWHDR
          short-label=Autosar::include::PduR_Api_Depend.h, category=SWHDR
          short-label=Autosar::include::PduR_Api_Static.h, category=SWHDR
          short-label=Autosar::include::PduR_Internal_Static.h, category=SWHDR
          short-label=Autosar::include::PduR_Lcfg_Static.h, category=SWHDR
          short-label=Autosar::include::PduR_Trace.h, category=SWHDR
          short-label=Autosar::include::PduR_Version.h, category=SWHDR
          short-label=Autosar::include::PduR_WrapASR32.h, category=SWHDR
          short-label=Autosar::src::PduR.c, category=SWSRC
          short-label=Autosar::src::PduR_DisableRouting.c, category=SWSRC
          short-label=Autosar::src::PduR_EnableRouting.c, category=SWSRC
          short-label=Autosar::src::PduR_GateIfDfMCoreRxIndication.c, category=SWSRC
          short-label=Autosar::src::PduR_GateIfDfMCoreTxConfirmation.c, category=SWSRC
          short-label=Autosar::src::PduR_GateIfRxIndicationDf.c, category=SWSRC
          short-label=Autosar::src::PduR_GateIfRxIndicationDfDynPyld.c, category=SWSRC
          short-label=Autosar::src::PduR_GateIfRxIndicationNb.c, category=SWSRC
          short-label=Autosar::src::PduR_GateIfRxIndicationSb.c, category=SWSRC
          short-label=Autosar::src::PduR_GateIfRxIndicationSbDynPyld.c, category=SWSRC
          short-label=Autosar::src::PduR_GateIfRxIndicationTf.c, category=SWSRC
          short-label=Autosar::src::PduR_GateIfRxIndicationTfDynPyld.c, category=SWSRC
          short-label=Autosar::src::PduR_GateIfSbNoInitMCoreRxIndication.c, category=SWSRC
          short-label=Autosar::src::PduR_GateIfSbNoInitMCoreUpRxIndication.c, category=SWSRC
          short-label=Autosar::src::PduR_GateIfTriggerTransmitSb.c, category=SWSRC
          short-label=Autosar::src::PduR_GateIfTriggerTransmitSbDynPyld.c, category=SWSRC
          short-label=Autosar::src::PduR_GateIfTriggerTransmitTf.c, category=SWSRC
          short-label=Autosar::src::PduR_GateIfTriggerTransmitTfDynPyld.c, category=SWSRC
          short-label=Autosar::src::PduR_GateIfTxConfirmationDf.c, category=SWSRC
          short-label=Autosar::src::PduR_GateIfTxConfirmationDfDynPyld.c, category=SWSRC
          short-label=Autosar::src::PduR_GateIfTxConfirmationTf.c, category=SWSRC
          short-label=Autosar::src::PduR_GateIfTxConfirmationTfDynPyld.c, category=SWSRC
          short-label=Autosar::src::PduR_GateTp.c, category=SWSRC
          short-label=Autosar::src::PduR_GateTpCopyRxData.c, category=SWSRC
          short-label=Autosar::src::PduR_GateTpCopyTxData.c, category=SWSRC
          short-label=Autosar::src::PduR_GateTpRxIndication.c, category=SWSRC
          short-label=Autosar::src::PduR_GateTpStartOfReception.c, category=SWSRC
          short-label=Autosar::src::PduR_GateTpTxConfirmation.c, category=SWSRC
          short-label=Autosar::src::PduR_GateTpUpReception.c, category=SWSRC
          short-label=Autosar::src::PduR_GenericIfRxIndication.c, category=SWSRC
          short-label=Autosar::src::PduR_GenericIfTransmit.c, category=SWSRC
          short-label=Autosar::src::PduR_GenericIfTriggerTransmit.c, category=SWSRC
          short-label=Autosar::src::PduR_GenericIfTxConfirmation.c, category=SWSRC
          short-label=Autosar::src::PduR_GenericTpCancelReceive.c, category=SWSRC
          short-label=Autosar::src::PduR_GenericTpCancelTransmit.c, category=SWSRC
          short-label=Autosar::src::PduR_GenericTpChangeParameter.c, category=SWSRC
          short-label=Autosar::src::PduR_GenericTpCopyRxData.c, category=SWSRC
          short-label=Autosar::src::PduR_GenericTpCopyTxData.c, category=SWSRC
          short-label=Autosar::src::PduR_GenericTpRxIndication.c, category=SWSRC
          short-label=Autosar::src::PduR_GenericTpStartOfReception.c, category=SWSRC
          short-label=Autosar::src::PduR_GenericTpTransmit.c, category=SWSRC
          short-label=Autosar::src::PduR_GenericTpTxConfirmation.c, category=SWSRC
          short-label=Autosar::src::PduR_GetConfigurationId.c, category=SWSRC
          short-label=Autosar::src::PduR_GetVersionInfo.c, category=SWSRC
          short-label=Autosar::src::PduR_Init.c, category=SWSRC
          short-label=Autosar::src::PduR_IsValidConfig.c, category=SWSRC
          short-label=Autosar::src::PduR_MCastIfMCoreUpTransmit.c, category=SWSRC
          short-label=Autosar::src::PduR_Merged.c, category=SWSRC
          short-label=Autosar::src::PduR_MultiIf.c, category=SWSRC
          short-label=Autosar::src::PduR_MultiIfRxIndication.c, category=SWSRC
          short-label=Autosar::src::PduR_MultiIfTriggerTransmit.c, category=SWSRC
          short-label=Autosar::src::PduR_MultiIfTxConfirmation.c, category=SWSRC
          short-label=Autosar::src::PduR_MultiTp.c, category=SWSRC
          short-label=Autosar::src::PduR_MultiTpCopyTxData.c, category=SWSRC
          short-label=Autosar::src::PduR_MultiTpTransmit.c, category=SWSRC
          short-label=Autosar::src::PduR_MultiTpTxConfirmation.c, category=SWSRC
          short-label=Autosar::src::PduR_MultiUpIfTransmit.c, category=SWSRC
          short-label=Autosar::src::PduR_Nto1GateTpCopyRxData.c, category=SWSRC
          short-label=Autosar::src::PduR_Nto1GateTpCopyTxData.c, category=SWSRC
          short-label=Autosar::src::PduR_Nto1GateTpRxIndication.c, category=SWSRC
          short-label=Autosar::src::PduR_Nto1GateTpStartOfReception.c, category=SWSRC
          short-label=Autosar::src::PduR_Nto1GateTpTxConfirmation.c, category=SWSRC
          short-label=Autosar::src::PduR_RPathGroups.c, category=SWSRC
          short-label=Autosar::src::PduR_WrapASR32.c, category=SWSRC
          short-label=make::PduR_defs.mak, category=SWMAKE
          short-label=make::PduR_rules.mak, category=SWMAKE
    resource consumption ResourceConsumption
      9 x memory section:
        VAR_CLEARED_UNSPECIFIED: alignment=UNSPECIFIED, sw-addrmethod=VAR_CLEARED
        VAR_INIT_UNSPECIFIED: alignment=UNSPECIFIED, sw-addrmethod=VAR
        CODE: sw-addrmethod=CODE
        CONFIG_DATA_UNSPECIFIED: alignment=UNSPECIFIED, sw-addrmethod=CONFIG_DATA
        CONST_8: alignment=8, sw-addrmethod=CONST
        CONST_16: alignment=16, sw-addrmethod=CONST
        CONST_32: alignment=32, sw-addrmethod=CONST
        CONST_UNSPECIFIED: alignment=UNSPECIFIED, sw-addrmethod=CONST
        CODE_CC_BLOCK: alignment=UNSPECIFIED, sw-addrmethod=CODE
