AUTOSAR XML (schema 4-2-1)
package /AUTOSAR_Dcm/BswModuleDescriptions
  bsw module description Dcm: module-id=53, provided-entrys=Dcm_MainFunction
    bsw internal behavior InternalBehavior_0
      bsw schedulable entity Dcm_MainFunction: implemented-entry=Dcm_MainFunction
      bsw timing event TimingEvent_MainFunction: starts-on-event=Dcm_MainFunction, period=0.005
package /AUTOSAR_Dcm/BswModuleEntrys
  bsw module entry Dcm_MainFunction: service-id=37, is-reentrant=false, is-synchronous=true, call-type=SCHEDULED, execution-context=TASK, sw-service-impl-policy=STANDARD
package /EB_Dcm/Implementations
  bsw implementation BswImplementation_0: programming-language=C, sw-version=5.0.15, vendor-id=1, ar-release-version=4.0.3, behavior=InternalBehavior_0
    code-descriptors:
      code Files
        artifact-descriptors:
          short-label=Autosar::include::Dcm.h, category=SWHDR
          short-label=Autosar::include::Dcm_Authentication.h, category=SWHDR
          short-label=Autosar::include::Dcm_Authentication_AuthenticationHandler.h, category=SWHDR
          short-label=Autosar::include::Dcm_Authentication_CryptoStackFacade.h, category=SWHDR
          short-label=Autosar::include::Dcm_Authentication_DiagnosticPolicyHandler.h, category=SWHDR
          short-label=Autosar::include::Dcm_Cbk.h, category=SWHDR
          short-label=Autosar::include::Dcm_Dsl_ComMChannelStateManager.h, category=SWHDR
          short-label=Autosar::include::Dcm_Dsl_ComMChannelStateManager_External_Interface.h, category=SWHDR
          short-label=Autosar::include::Dcm_Dsl_CommunicationServices.h, category=SWHDR
          short-label=Autosar::include::Dcm_Dsl_CommunicationServices_BufferManager.h, category=SWHDR
          short-label=Autosar::include::Dcm_Dsl_CommunicationServices_MetaData.h, category=SWHDR
          short-label=Autosar::include::Dcm_Dsl_CommunicationServices_RxConnections.h, category=SWHDR
          short-label=Autosar::include::Dcm_Dsl_CommunicationServices_TxConnections.h, category=SWHDR
          short-label=Autosar::include::Dcm_Dsl_DiagnosticSessionHandler.h, category=SWHDR
          short-label=Autosar::include::Dcm_Dsl_PostBootOperationsHandler.h, category=SWHDR
          short-label=Autosar::include::Dcm_Dsl_RoeServices.h, category=SWHDR
          short-label=Autosar::include::Dcm_Dsl_SecurityLevelHandler.h, category=SWHDR
          short-label=Autosar::include::Dcm_Dsl_Supervisor.h, category=SWHDR
          short-label=Autosar::include::Dcm_Dsl_Supervisor_CommunicationSessionHandling.h, category=SWHDR
          short-label=Autosar::include::Dcm_Dsl_Supervisor_MainConnectionHandling.h, category=SWHDR
          short-label=Autosar::include::Dcm_Dsl_Supervisor_ProtocolHandling.h, category=SWHDR
          short-label=Autosar::include::Dcm_DspExternal.h, category=SWHDR
          short-label=Autosar::include::Dcm_Dsp_ApplicationDiagnosticRequests.h, category=SWHDR
          short-label=Autosar::include::Dcm_Dsp_Contexts.h, category=SWHDR
          short-label=Autosar::include::Dcm_Dsp_DataTransferServices.h, category=SWHDR
          short-label=Autosar::include::Dcm_Dsp_DemFacade.h, category=SWHDR
          short-label=Autosar::include::Dcm_Dsp_DidServices.h, category=SWHDR
          short-label=Autosar::include::Dcm_Dsp_DidSignals.h, category=SWHDR
          short-label=Autosar::include::Dcm_Dsp_EndiannessInterpretation.h, category=SWHDR
          short-label=Autosar::include::Dcm_Dsp_MemoryServices.h, category=SWHDR
          short-label=Autosar::include::Dcm_Dsp_MidServices.h, category=SWHDR
          short-label=Autosar::include::Dcm_Dsp_PidServices.h, category=SWHDR
          short-label=Autosar::include::Dcm_Dsp_SvcH_Authentication.h, category=SWHDR
          short-label=Autosar::include::Dcm_Dsp_SvcH_CommunicationControl.h, category=SWHDR
          short-label=Autosar::include::Dcm_Dsp_SvcH_ControlDTCSetting.h, category=SWHDR
          short-label=Autosar::include::Dcm_Dsp_SvcH_DynamicallyDefineDataIdentifier.h, category=SWHDR
          short-label=Autosar::include::Dcm_Dsp_SvcH_InputOutputControlByIdentifier.h, category=SWHDR
          short-label=Autosar::include::Dcm_Dsp_SvcH_LinkControl.h, category=SWHDR
          short-label=Autosar::include::Dcm_Dsp_SvcH_ReadDTCInformation.h, category=SWHDR
          short-label=Autosar::include::Dcm_Dsp_SvcH_ReadDataByIdentifier.h, category=SWHDR
          short-label=Autosar::include::Dcm_Dsp_SvcH_ReadDataByPeriodicIdentifier.h, category=SWHDR
          short-label=Autosar::include::Dcm_Dsp_SvcH_ReadMemoryByAddress.h, category=SWHDR
          short-label=Autosar::include::Dcm_Dsp_SvcH_ReadScalingDataByIdentifier.h, category=SWHDR
          short-label=Autosar::include::Dcm_Dsp_SvcH_RequestControlOfOnBoardSysTstComp.h, category=SWHDR
          short-label=Autosar::include::Dcm_Dsp_SvcH_RequestDownload.h, category=SWHDR
          short-label=Autosar::include::Dcm_Dsp_SvcH_RequestOnboardMonitoringTestResults.h, category=SWHDR
          short-label=Autosar::include::Dcm_Dsp_SvcH_RequestTransferExit.h, category=SWHDR
          short-label=Autosar::include::Dcm_Dsp_SvcH_RequestUpload.h, category=SWHDR
          short-label=Autosar::include::Dcm_Dsp_SvcH_RequestVehicleInformation.h, category=SWHDR
          short-label=Autosar::include::Dcm_Dsp_SvcH_ResponseOnEvent.h, category=SWHDR
          short-label=Autosar::include::Dcm_Dsp_SvcH_RoutineControl.h, category=SWHDR
          short-label=Autosar::include::Dcm_Dsp_SvcH_SecurityAccess.h, category=SWHDR
          short-label=Autosar::include::Dcm_Dsp_SvcH_TesterPresent.h, category=SWHDR
          short-label=Autosar::include::Dcm_Dsp_SvcH_TransferData.h, category=SWHDR
          short-label=Autosar::include::Dcm_Dsp_SvcH_WriteDataByIdentifier.h, category=SWHDR
          short-label=Autosar::include::Dcm_Dsp_SvcH_WriteMemoryByAddress.h, category=SWHDR
          short-label=Autosar::include::Dcm_Dsp_VinServices.h, category=SWHDR
          short-label=Autosar::include::Dcm_GenericServiceHandlers.h, category=SWHDR
          short-label=Autosar::include::Dcm_Hsm.h, category=SWHDR
          short-label=Autosar::include::Dcm_HsmCfg.h, category=SWHDR
          short-label=Autosar::include::Dcm_HsmDcm.h, category=SWHDR
          short-label=Autosar::include::Dcm_HsmDcmInt.h, category=SWHDR
          short-label=Autosar::include::Dcm_Int.h, category=SWHDR
          short-label=Autosar::include::Dcm_Trace.h, category=SWHDR
          short-label=Autosar::include::Dcm_Trace_Internal.h, category=SWHDR
          short-label=Autosar::include::Dcm_Types.h, category=SWHDR
          short-label=Autosar::include::Dcm_Version.h, category=SWHDR
          short-label=Autosar::src::Dcm.c, category=SWSRC
          short-label=Autosar::src::Dcm_Authentication.c, category=SWSRC
          short-label=Autosar::src::Dcm_Authentication_AuthenticationHandler.c, category=SWSRC
          short-label=Autosar::src::Dcm_Authentication_CryptoStackFacade.c, category=SWSRC
          short-label=Autosar::src::Dcm_Authentication_DiagnosticPolicyHandler.c, category=SWSRC
          short-label=Autosar::src::Dcm_Dsd.c, category=SWSRC
          short-label=Autosar::src::Dcm_Dsl_ComMChannelStateManager.c, category=SWSRC
          short-label=Autosar::src::Dcm_Dsl_CommunicationServices.c, category=SWSRC
          short-label=Autosar::src::Dcm_Dsl_CommunicationServices_BufferManager.c, category=SWSRC
          short-label=Autosar::src::Dcm_Dsl_CommunicationServices_MetaData.c, category=SWSRC
          short-label=Autosar::src::Dcm_Dsl_CommunicationServices_RxConnections.c, category=SWSRC
          short-label=Autosar::src::Dcm_Dsl_CommunicationServices_TxConnections.c, category=SWSRC
          short-label=Autosar::src::Dcm_Dsl_DiagnosticSessionHandler.c, category=SWSRC
          short-label=Autosar::src::Dcm_Dsl_PostBootOperationsHandler.c, category=SWSRC
          short-label=Autosar::src::Dcm_Dsl_RoeServices.c, category=SWSRC
          short-label=Autosar::src::Dcm_Dsl_SecurityLevelHandler.c, category=SWSRC
          short-label=Autosar::src::Dcm_Dsl_Supervisor.c, category=SWSRC
          short-label=Autosar::src::Dcm_Dsl_Supervisor_CommunicationSessionHandling.c, category=SWSRC
          short-label=Autosar::src::Dcm_Dsl_Supervisor_MainConnectionHandling.c, category=SWSRC
          short-label=Autosar::src::Dcm_Dsl_Supervisor_ProtocolHandling.c, category=SWSRC
          short-label=Autosar::src::Dcm_Dsp.c, category=SWSRC
          short-label=Autosar::src::Dcm_Dsp_ApplicationDiagnosticRequests.c, category=SWSRC
          short-label=Autosar::src::Dcm_Dsp_Contexts.c, category=SWSRC
          short-label=Autosar::src::Dcm_Dsp_DataTransferServices.c, category=SWSRC
          short-label=Autosar::src::Dcm_Dsp_DemFacade.c, category=SWSRC
          short-label=Autosar::src::Dcm_Dsp_DidServices.c, category=SWSRC
          short-label=Autosar::src::Dcm_Dsp_DidSignals.c, category=SWSRC
          short-label=Autosar::src::Dcm_Dsp_EndiannessInterpretation.c, category=SWSRC
          short-label=Autosar::src::Dcm_Dsp_MemoryServices.c, category=SWSRC
          short-label=Autosar::src::Dcm_Dsp_MidServices.c, category=SWSRC
          short-label=Autosar::src::Dcm_Dsp_PidServices.c, category=SWSRC
          short-label=Autosar::src::Dcm_Dsp_SvcH_Authentication.c, category=SWSRC
          short-label=Autosar::src::Dcm_Dsp_SvcH_CommunicationControl.c, category=SWSRC
          short-label=Autosar::src::Dcm_Dsp_SvcH_ControlDTCSetting.c, category=SWSRC
          short-label=Autosar::src::Dcm_Dsp_SvcH_DynamicallyDefineDataIdentifier.c, category=SWSRC
          short-label=Autosar::src::Dcm_Dsp_SvcH_InputOutputControlByIdentifier.c, category=SWSRC
          short-label=Autosar::src::Dcm_Dsp_SvcH_LinkControl.c, category=SWSRC
          short-label=Autosar::src::Dcm_Dsp_SvcH_ReadDTCInformation.c, category=SWSRC
          short-label=Autosar::src::Dcm_Dsp_SvcH_ReadDataByIdentifier.c, category=SWSRC
          short-label=Autosar::src::Dcm_Dsp_SvcH_ReadDataByPeriodicIdentifier.c, category=SWSRC
          short-label=Autosar::src::Dcm_Dsp_SvcH_ReadMemoryByAddress.c, category=SWSRC
          short-label=Autosar::src::Dcm_Dsp_SvcH_ReadScalingDataByIdentifier.c, category=SWSRC
          short-label=Autosar::src::Dcm_Dsp_SvcH_RequestControlOfOnBoardSysTstComp.c, category=SWSRC
          short-label=Autosar::src::Dcm_Dsp_SvcH_RequestDownload.c, category=SWSRC
          short-label=Autosar::src::Dcm_Dsp_SvcH_RequestOnboardMonitoringTestResults.c, category=SWSRC
          short-label=Autosar::src::Dcm_Dsp_SvcH_RequestTransferExit.c, category=SWSRC
          short-label=Autosar::src::Dcm_Dsp_SvcH_RequestUpload.c, category=SWSRC
          short-label=Autosar::src::Dcm_Dsp_SvcH_RequestVehicleInformation.c, category=SWSRC
          short-label=Autosar::src::Dcm_Dsp_SvcH_ResponseOnEvent.c, category=SWSRC
          short-label=Autosar::src::Dcm_Dsp_SvcH_RoutineControl.c, category=SWSRC
          short-label=Autosar::src::Dcm_Dsp_SvcH_SecurityAccess.c, category=SWSRC
          short-label=Autosar::src::Dcm_Dsp_SvcH_TesterPresent.c, category=SWSRC
          short-label=Autosar::src::Dcm_Dsp_SvcH_TransferData.c, category=SWSRC
          short-label=Autosar::src::Dcm_Dsp_SvcH_WriteDataByIdentifier.c, category=SWSRC
          short-label=Autosar::src::Dcm_Dsp_SvcH_WriteMemoryByAddress.c, category=SWSRC
          short-label=Autosar::src::Dcm_Dsp_VinServices.c, category=SWSRC
          short-label=Autosar::src::Dcm_Hsm.c, category=SWSRC
          short-label=Autosar::src::Dcm_HsmDcmData.c, category=SWSRC
          short-label=Autosar::src::Dcm_HsmDcmFnct.c, category=SWSRC
          short-label=make::Dcm_defs.mak, category=SWMAKE
          short-label=make::Dcm_rules.mak, category=SWMAKE
    mc-parameter-instances:
      mc data instance Dcm_DspDidUsed: category=ARRAY, array-size=6
        43 x mc data instance, all with category=VALUE:
          DID_0236_ProgrammingDataElockEcuDid: resulting-properties={base-type=uint8, sw-bit-representation={bit-position=0, number-of-bits=1}, sw-calibration-access=READ-WRITE, data-constr=uint8}, symbol=[0]  # DcmDspDidUsed parameter for Did 0x0236 ('1' means Did is available) - If the value is '0' the Did is not available in all services.
          DID_023E_WSCForProgrammingElockEcuDid: resulting-properties={base-type=uint8, sw-bit-representation={bit-position=1, number-of-bits=1}, sw-calibration-access=READ-WRITE, data-constr=uint8}, symbol=[0]  # DcmDspDidUsed parameter for Did 0x023e ('1' means Did is available) - If the value is '0' the Did is not available in all services.
          DID_0407_VWLogicalSoftwareBlockCounterOfProgrammingAttemptsDid: resulting-properties={base-type=uint8, sw-bit-representation={bit-position=2, number-of-bits=1}, sw-calibration-access=READ-WRITE, data-constr=uint8}, symbol=[0]  # DcmDspDidUsed parameter for Did 0x0407 ('1' means Did is available) - If the value is '0' the Did is not available in all services.
          DID_040F_VWLogicalSoftwareBlockLockValueDid: resulting-properties={base-type=uint8, sw-bit-representation={bit-position=3, number-of-bits=1}, sw-calibration-access=READ-WRITE, data-constr=uint8}, symbol=[0]  # DcmDspDidUsed parameter for Did 0x040f ('1' means Did is available) - If the value is '0' the Did is not available in all services.
          DID_0410_BootloaderTPBlocksizeDid: resulting-properties={base-type=uint8, sw-bit-representation={bit-position=4, number-of-bits=1}, sw-calibration-access=READ-WRITE, data-constr=uint8}, symbol=[0]  # DcmDspDidUsed parameter for Did 0x0410 ('1' means Did is available) - If the value is '0' the Did is not available in all services.
          DID_0448_ProgrammingPreconditionsDid: resulting-properties={base-type=uint8, sw-bit-representation={bit-position=5, number-of-bits=1}, sw-calibration-access=READ-WRITE, data-constr=uint8}, symbol=[0]  # DcmDspDidUsed parameter for Did 0x0448 ('1' means Did is available) - If the value is '0' the Did is not available in all services.
          DID_4024_SWSystemTimeDid: resulting-properties={base-type=uint8, sw-bit-representation={bit-position=6, number-of-bits=1}, sw-calibration-access=READ-WRITE, data-constr=uint8}, symbol=[0]  # DcmDspDidUsed parameter for Did 0x4024 ('1' means Did is available) - If the value is '0' the Did is not available in all services.
          DID_F15B_FingerprintAndProgrammingDateOfLogicalSoftwareBlocksDid: resulting-properties={base-type=uint8, sw-bit-representation={bit-position=7, number-of-bits=1}, sw-calibration-access=READ-WRITE, data-constr=uint8}, symbol=[0]  # DcmDspDidUsed parameter for Did 0xf15b ('1' means Did is available) - If the value is '0' the Did is not available in all services.
          DID_F186_ActiveDiagnosticSessionDid: resulting-properties={base-type=uint8, sw-bit-representation={bit-position=0, number-of-bits=1}, sw-calibration-access=READ-WRITE, data-constr=uint8}, symbol=[1]  # DcmDspDidUsed parameter for Did 0xf186 ('1' means Did is available) - If the value is '0' the Did is not available in all services.
          DID_F187_VWSparePartNumberDid: resulting-properties={base-type=uint8, sw-bit-representation={bit-position=1, number-of-bits=1}, sw-calibration-access=READ-WRITE, data-constr=uint8}, symbol=[1]  # DcmDspDidUsed parameter for Did 0xf187 ('1' means Did is available) - If the value is '0' the Did is not available in all services.
          DID_F189_VWApplicationSoftwareVersionNumberDid: resulting-properties={base-type=uint8, sw-bit-representation={bit-position=2, number-of-bits=1}, sw-calibration-access=READ-WRITE, data-constr=uint8}, symbol=[1]  # DcmDspDidUsed parameter for Did 0xf189 ('1' means Did is available) - If the value is '0' the Did is not available in all services.
          DID_F18C_ECUSerialNumberDid: resulting-properties={base-type=uint8, sw-bit-representation={bit-position=3, number-of-bits=1}, sw-calibration-access=READ-WRITE, data-constr=uint8}, symbol=[1]  # DcmDspDidUsed parameter for Did 0xf18c ('1' means Did is available) - If the value is '0' the Did is not available in all services.
          DID_F191_VWECUHardwareNumberDid: resulting-properties={base-type=uint8, sw-bit-representation={bit-position=4, number-of-bits=1}, sw-calibration-access=READ-WRITE, data-constr=uint8}, symbol=[1]  # DcmDspDidUsed parameter for Did 0xf191 ('1' means Did is available) - If the value is '0' the Did is not available in all services.
          DID_F197_VWSystemNameOrEngineTypeDid: resulting-properties={base-type=uint8, sw-bit-representation={bit-position=5, number-of-bits=1}, sw-calibration-access=READ-WRITE, data-constr=uint8}, symbol=[1]  # DcmDspDidUsed parameter for Did 0xf197 ('1' means Did is available) - If the value is '0' the Did is not available in all services.
          DID_F19E_ASAMODXFileIdentifierDid: resulting-properties={base-type=uint8, sw-bit-representation={bit-position=6, number-of-bits=1}, sw-calibration-access=READ-WRITE, data-constr=uint8}, symbol=[1]  # DcmDspDidUsed parameter for Did 0xf19e ('1' means Did is available) - If the value is '0' the Did is not available in all services.
          DID_F1A2_ASAMODXFileVersionDid: resulting-properties={base-type=uint8, sw-bit-representation={bit-position=7, number-of-bits=1}, sw-calibration-access=READ-WRITE, data-constr=uint8}, symbol=[1]  # DcmDspDidUsed parameter for Did 0xf1a2 ('1' means Did is available) - If the value is '0' the Did is not available in all services.
          DID_F1A3_VWECUHardwareVersionNumberDid: resulting-properties={base-type=uint8, sw-bit-representation={bit-position=0, number-of-bits=1}, sw-calibration-access=READ-WRITE, data-constr=uint8}, symbol=[2]  # DcmDspDidUsed parameter for Did 0xf1a3 ('1' means Did is available) - If the value is '0' the Did is not available in all services.
          DID_F1AB_VWLogicalSoftwareBlockVersionDid: resulting-properties={base-type=uint8, sw-bit-representation={bit-position=1, number-of-bits=1}, sw-calibration-access=READ-WRITE, data-constr=uint8}, symbol=[2]  # DcmDspDidUsed parameter for Did 0xf1ab ('1' means Did is available) - If the value is '0' the Did is not available in all services.
          DID_F1B4_TechnicalSpecificationsVersionDid: resulting-properties={base-type=uint8, sw-bit-representation={bit-position=2, number-of-bits=1}, sw-calibration-access=READ-WRITE, data-constr=uint8}, symbol=[2]  # DcmDspDidUsed parameter for Did 0xf1b4 ('1' means Did is available) - If the value is '0' the Did is not available in all services.
          DID_F1D5_FDSProjectDataDid: resulting-properties={base-type=uint8, sw-bit-representation={bit-position=3, number-of-bits=1}, sw-calibration-access=READ-WRITE, data-constr=uint8}, symbol=[2]  # DcmDspDidUsed parameter for Did 0xf1d5 ('1' means Did is available) - If the value is '0' the Did is not available in all services.
          DID_F1DF_ECUProgrammingInformationDid: resulting-properties={base-type=uint8, sw-bit-representation={bit-position=4, number-of-bits=1}, sw-calibration-access=READ-WRITE, data-constr=uint8}, symbol=[2]  # DcmDspDidUsed parameter for Did 0xf1df ('1' means Did is available) - If the value is '0' the Did is not available in all services.
          DID_FD00_HWVersionDid: resulting-properties={base-type=uint8, sw-bit-representation={bit-position=5, number-of-bits=1}, sw-calibration-access=READ-WRITE, data-constr=uint8}, symbol=[2]  # DcmDspDidUsed parameter for Did 0xfd00 ('1' means Did is available) - If the value is '0' the Did is not available in all services.
          DID_FD01_SWVersionDid: resulting-properties={base-type=uint8, sw-bit-representation={bit-position=6, number-of-bits=1}, sw-calibration-access=READ-WRITE, data-constr=uint8}, symbol=[2]  # DcmDspDidUsed parameter for Did 0xfd01 ('1' means Did is available) - If the value is '0' the Did is not available in all services.
          DID_FD03_AEETraceabilityNumberDid: resulting-properties={base-type=uint8, sw-bit-representation={bit-position=7, number-of-bits=1}, sw-calibration-access=READ-WRITE, data-constr=uint8}, symbol=[2]  # DcmDspDidUsed parameter for Did 0xfd03 ('1' means Did is available) - If the value is '0' the Did is not available in all services.
          DID_FD08_ResetCauseDid: resulting-properties={base-type=uint8, sw-bit-representation={bit-position=0, number-of-bits=1}, sw-calibration-access=READ-WRITE, data-constr=uint8}, symbol=[3]  # DcmDspDidUsed parameter for Did 0xfd08 ('1' means Did is available) - If the value is '0' the Did is not available in all services.
          DID_FD09_LastWarmResetParamDid: resulting-properties={base-type=uint8, sw-bit-representation={bit-position=1, number-of-bits=1}, sw-calibration-access=READ-WRITE, data-constr=uint8}, symbol=[3]  # DcmDspDidUsed parameter for Did 0xfd09 ('1' means Did is available) - If the value is '0' the Did is not available in all services.
          DID_FD0F_BatteryMeasureDid: resulting-properties={base-type=uint8, sw-bit-representation={bit-position=2, number-of-bits=1}, sw-calibration-access=READ-WRITE, data-constr=uint8}, symbol=[3]  # DcmDspDidUsed parameter for Did 0xfd0f ('1' means Did is available) - If the value is '0' the Did is not available in all services.
          DID_FD10_ECUTemperature: resulting-properties={base-type=uint8, sw-bit-representation={bit-position=3, number-of-bits=1}, sw-calibration-access=READ-WRITE, data-constr=uint8}, symbol=[3]  # DcmDspDidUsed parameter for Did 0xfd10 ('1' means Did is available) - If the value is '0' the Did is not available in all services.
          DID_FD62_EccOccurenceNbDid: resulting-properties={base-type=uint8, sw-bit-representation={bit-position=4, number-of-bits=1}, sw-calibration-access=READ-WRITE, data-constr=uint8}, symbol=[3]  # DcmDspDidUsed parameter for Did 0xfd62 ('1' means Did is available) - If the value is '0' the Did is not available in all services.
          DID_FD8B_ECUManufacturingDateDid: resulting-properties={base-type=uint8, sw-bit-representation={bit-position=5, number-of-bits=1}, sw-calibration-access=READ-WRITE, data-constr=uint8}, symbol=[3]  # DcmDspDidUsed parameter for Did 0xfd8b ('1' means Did is available) - If the value is '0' the Did is not available in all services.
          DID_FD8C_AssemblySerialNumberDid: resulting-properties={base-type=uint8, sw-bit-representation={bit-position=6, number-of-bits=1}, sw-calibration-access=READ-WRITE, data-constr=uint8}, symbol=[3]  # DcmDspDidUsed parameter for Did 0xfd8c ('1' means Did is available) - If the value is '0' the Did is not available in all services.
          DID_FDE0_EcsVariantDid: resulting-properties={base-type=uint8, sw-bit-representation={bit-position=7, number-of-bits=1}, sw-calibration-access=READ-WRITE, data-constr=uint8}, symbol=[3]  # DcmDspDidUsed parameter for Did 0xfde0 ('1' means Did is available) - If the value is '0' the Did is not available in all services.
          DID_FDE1_EcsParametersDid: resulting-properties={base-type=uint8, sw-bit-representation={bit-position=0, number-of-bits=1}, sw-calibration-access=READ-WRITE, data-constr=uint8}, symbol=[4]  # DcmDspDidUsed parameter for Did 0xfde1 ('1' means Did is available) - If the value is '0' the Did is not available in all services.
          DID_FDE2_AccOffsetDid: resulting-properties={base-type=uint8, sw-bit-representation={bit-position=1, number-of-bits=1}, sw-calibration-access=READ-WRITE, data-constr=uint8}, symbol=[4]  # DcmDspDidUsed parameter for Did 0xfde2 ('1' means Did is available) - If the value is '0' the Did is not available in all services.
          DID_FDE3_EcsProfilesDid: resulting-properties={base-type=uint8, sw-bit-representation={bit-position=2, number-of-bits=1}, sw-calibration-access=READ-WRITE, data-constr=uint8}, symbol=[4]  # DcmDspDidUsed parameter for Did 0xfde3 ('1' means Did is available) - If the value is '0' the Did is not available in all services.
          DID_FDE4_EcsStepsDid: resulting-properties={base-type=uint8, sw-bit-representation={bit-position=3, number-of-bits=1}, sw-calibration-access=READ-WRITE, data-constr=uint8}, symbol=[4]  # DcmDspDidUsed parameter for Did 0xfde4 ('1' means Did is available) - If the value is '0' the Did is not available in all services.
          DID_FDE5_EcsAccLowPassDid: resulting-properties={base-type=uint8, sw-bit-representation={bit-position=4, number-of-bits=1}, sw-calibration-access=READ-WRITE, data-constr=uint8}, symbol=[4]  # DcmDspDidUsed parameter for Did 0xfde5 ('1' means Did is available) - If the value is '0' the Did is not available in all services.
          DID_FDE7_AlgoOutputDelayDid: resulting-properties={base-type=uint8, sw-bit-representation={bit-position=5, number-of-bits=1}, sw-calibration-access=READ-WRITE, data-constr=uint8}, symbol=[4]  # DcmDspDidUsed parameter for Did 0xfde7 ('1' means Did is available) - If the value is '0' the Did is not available in all services.
          DID_FDE9_SensitivityLutDid: resulting-properties={base-type=uint8, sw-bit-representation={bit-position=6, number-of-bits=1}, sw-calibration-access=READ-WRITE, data-constr=uint8}, symbol=[4]  # DcmDspDidUsed parameter for Did 0xfde9 ('1' means Did is available) - If the value is '0' the Did is not available in all services.
          DID_FDEA_SensitivityOptDid: resulting-properties={base-type=uint8, sw-bit-representation={bit-position=7, number-of-bits=1}, sw-calibration-access=READ-WRITE, data-constr=uint8}, symbol=[4]  # DcmDspDidUsed parameter for Did 0xfdea ('1' means Did is available) - If the value is '0' the Did is not available in all services.
          DID_FDFF_MeasurementFrameConfDataRamDid: resulting-properties={base-type=uint8, sw-bit-representation={bit-position=0, number-of-bits=1}, sw-calibration-access=READ-WRITE, data-constr=uint8}, symbol=[5]  # DcmDspDidUsed parameter for Did 0xfdff ('1' means Did is available) - If the value is '0' the Did is not available in all services.
          DID_FE00_AllEventStatusesReadDid: resulting-properties={base-type=uint8, sw-bit-representation={bit-position=1, number-of-bits=1}, sw-calibration-access=READ-WRITE, data-constr=uint8}, symbol=[5]  # DcmDspDidUsed parameter for Did 0xfe00 ('1' means Did is available) - If the value is '0' the Did is not available in all services.
          DID_FEFF_MeasurementFramesConfDid: resulting-properties={base-type=uint8, sw-bit-representation={bit-position=2, number-of-bits=1}, sw-calibration-access=READ-WRITE, data-constr=uint8}, symbol=[5]  # DcmDspDidUsed parameter for Did 0xfeff ('1' means Did is available) - If the value is '0' the Did is not available in all services.
      mc data instance Dcm_DsdSubServiceUsed: category=ARRAY, array-size=12
        15 x mc data instance, all with category=VALUE:
          ServiceTable_0_ServiceId_0_Subf_01_DefaultSession_SubServiceId_1: resulting-properties={base-type=uint8, sw-bit-representation={bit-position=0, number-of-bits=1}, sw-calibration-access=READ-WRITE, data-constr=uint8}, symbol=[0][0][0]  # DcmDsdSubServiceUsed parameter for subservice Subf_01_DefaultSession in Service SID10_DiagnosticSessionControl belonging to Servicetable DcmDsdServiceTable_0
          ServiceTable_0_ServiceId_0_Subf_02_ProgrammingSession_SubServiceId_2: resulting-properties={base-type=uint8, sw-bit-representation={bit-position=1, number-of-bits=1}, sw-calibration-access=READ-WRITE, data-constr=uint8}, symbol=[0][0][0]  # DcmDsdSubServiceUsed parameter for subservice Subf_02_ProgrammingSession in Service SID10_DiagnosticSessionControl belonging to Servicetable DcmDsdServiceTable_0
          ServiceTable_0_ServiceId_0_Subf_03_ExtendedSession_SubServiceId_3: resulting-properties={base-type=uint8, sw-bit-representation={bit-position=2, number-of-bits=1}, sw-calibration-access=READ-WRITE, data-constr=uint8}, symbol=[0][0][0]  # DcmDsdSubServiceUsed parameter for subservice Subf_03_ExtendedSession in Service SID10_DiagnosticSessionControl belonging to Servicetable DcmDsdServiceTable_0
          ServiceTable_0_ServiceId_0_Subf_60_ELEManufacturing_SubServiceId_96: resulting-properties={base-type=uint8, sw-bit-representation={bit-position=3, number-of-bits=1}, sw-calibration-access=READ-WRITE, data-constr=uint8}, symbol=[0][0][0]  # DcmDsdSubServiceUsed parameter for subservice Subf_60_ELEManufacturing in Service SID10_DiagnosticSessionControl belonging to Servicetable DcmDsdServiceTable_0
          ServiceTable_0_ServiceId_0_Subf_61_SystemManufacturing_SubServiceId_97: resulting-properties={base-type=uint8, sw-bit-representation={bit-position=4, number-of-bits=1}, sw-calibration-access=READ-WRITE, data-constr=uint8}, symbol=[0][0][0]  # DcmDsdSubServiceUsed parameter for subservice Subf_61_SystemManufacturing in Service SID10_DiagnosticSessionControl belonging to Servicetable DcmDsdServiceTable_0
          ServiceTable_0_ServiceId_0_Subf_7E_SupplierSession_SubServiceId_126: resulting-properties={base-type=uint8, sw-bit-representation={bit-position=5, number-of-bits=1}, sw-calibration-access=READ-WRITE, data-constr=uint8}, symbol=[0][0][0]  # DcmDsdSubServiceUsed parameter for subservice Subf_7E_SupplierSession in Service SID10_DiagnosticSessionControl belonging to Servicetable DcmDsdServiceTable_0
          ServiceTable_0_ServiceId_1_Subf01_HardReset_SubServiceId_1: resulting-properties={base-type=uint8, sw-bit-representation={bit-position=0, number-of-bits=1}, sw-calibration-access=READ-WRITE, data-constr=uint8}, symbol=[0][1][0]  # DcmDsdSubServiceUsed parameter for subservice Subf01_HardReset in Service SID11_ECUReset belonging to Servicetable DcmDsdServiceTable_0
          ServiceTable_0_ServiceId_1_Subf03_SoftReset_SubServiceId_3: resulting-properties={base-type=uint8, sw-bit-representation={bit-position=1, number-of-bits=1}, sw-calibration-access=READ-WRITE, data-constr=uint8}, symbol=[0][1][0]  # DcmDsdSubServiceUsed parameter for subservice Subf03_SoftReset in Service SID11_ECUReset belonging to Servicetable DcmDsdServiceTable_0
          ServiceTable_0_ServiceId_5_Subf61_SecurityAccess_GetSeed_SubServiceId_97: resulting-properties={base-type=uint8, sw-bit-representation={bit-position=0, number-of-bits=1}, sw-calibration-access=READ-WRITE, data-constr=uint8}, symbol=[0][5][0]  # DcmDsdSubServiceUsed parameter for subservice Subf61_SecurityAccess_GetSeed in Service SID27_SecurityAccess belonging to Servicetable DcmDsdServiceTable_0
          ServiceTable_0_ServiceId_5_Subf62_SecurityAccess_CompareKey_SubServiceId_98: resulting-properties={base-type=uint8, sw-bit-representation={bit-position=1, number-of-bits=1}, sw-calibration-access=READ-WRITE, data-constr=uint8}, symbol=[0][5][0]  # DcmDsdSubServiceUsed parameter for subservice Subf62_SecurityAccess_CompareKey in Service SID27_SecurityAccess belonging to Servicetable DcmDsdServiceTable_0
          ServiceTable_0_ServiceId_6_Subf00_EnableTxEnableRx_SubServiceId_0: resulting-properties={base-type=uint8, sw-bit-representation={bit-position=0, number-of-bits=1}, sw-calibration-access=READ-WRITE, data-constr=uint8}, symbol=[0][6][0]  # DcmDsdSubServiceUsed parameter for subservice Subf00_EnableTxEnableRx in Service SID28_CommunicationControl belonging to Servicetable DcmDsdServiceTable_0
          ServiceTable_0_ServiceId_6_Subf01_DisableTxEnableRx_SubServiceId_1: resulting-properties={base-type=uint8, sw-bit-representation={bit-position=1, number-of-bits=1}, sw-calibration-access=READ-WRITE, data-constr=uint8}, symbol=[0][6][0]  # DcmDsdSubServiceUsed parameter for subservice Subf01_DisableTxEnableRx in Service SID28_CommunicationControl belonging to Servicetable DcmDsdServiceTable_0
          ServiceTable_0_ServiceId_10_Subf00_TesterPresent_SubServiceId_0: resulting-properties={base-type=uint8, sw-bit-representation={bit-position=1, number-of-bits=1}, sw-calibration-access=READ-WRITE, data-constr=uint8}, symbol=[0][10][0]  # DcmDsdSubServiceUsed parameter for subservice Subf00_TesterPresent in Service SID3E_TesterPresent belonging to Servicetable DcmDsdServiceTable_0
          ServiceTable_0_ServiceId_11_Subf00_EnableUpdateDTC_SubServiceId_1: resulting-properties={base-type=uint8, sw-bit-representation={bit-position=0, number-of-bits=1}, sw-calibration-access=READ-WRITE, data-constr=uint8}, symbol=[0][11][0]  # DcmDsdSubServiceUsed parameter for subservice Subf00_EnableUpdateDTC in Service SID85_ControlDTCSetting belonging to Servicetable DcmDsdServiceTable_0
          ServiceTable_0_ServiceId_11_Subf01_DisableUpdateDTC_SubServiceId_2: resulting-properties={base-type=uint8, sw-bit-representation={bit-position=1, number-of-bits=1}, sw-calibration-access=READ-WRITE, data-constr=uint8}, symbol=[0][11][0]  # DcmDsdSubServiceUsed parameter for subservice Subf01_DisableUpdateDTC in Service SID85_ControlDTCSetting belonging to Servicetable DcmDsdServiceTable_0
      mc data instance Dcm_DsdServiceUsed: category=ARRAY, array-size=2
        12 x mc data instance, all with category=VALUE:
          ServiceTable_0_SID10_DiagnosticSessionControl_ServiceId_16: resulting-properties={base-type=uint8, sw-bit-representation={bit-position=0, number-of-bits=1}, sw-calibration-access=READ-WRITE, data-constr=uint8}, symbol=[0][0]  # DcmDsdServiceUsed parameter for service SID10_DiagnosticSessionControl in Servicetable DcmDsdServiceTable_0
          ServiceTable_0_SID11_ECUReset_ServiceId_17: resulting-properties={base-type=uint8, sw-bit-representation={bit-position=1, number-of-bits=1}, sw-calibration-access=READ-WRITE, data-constr=uint8}, symbol=[0][0]  # DcmDsdServiceUsed parameter for service SID11_ECUReset in Servicetable DcmDsdServiceTable_0
          ServiceTable_0_SID14_ClearDiagnosticInformation_ServiceId_20: resulting-properties={base-type=uint8, sw-bit-representation={bit-position=2, number-of-bits=1}, sw-calibration-access=READ-WRITE, data-constr=uint8}, symbol=[0][0]  # DcmDsdServiceUsed parameter for service SID14_ClearDiagnosticInformation in Servicetable DcmDsdServiceTable_0
          ServiceTable_0_SID22_ReadDataByIdentifier_ServiceId_34: resulting-properties={base-type=uint8, sw-bit-representation={bit-position=3, number-of-bits=1}, sw-calibration-access=READ-WRITE, data-constr=uint8}, symbol=[0][0]  # DcmDsdServiceUsed parameter for service SID22_ReadDataByIdentifier in Servicetable DcmDsdServiceTable_0
          ServiceTable_0_SID23_ReadMemoryByAddress_ServiceId_35: resulting-properties={base-type=uint8, sw-bit-representation={bit-position=4, number-of-bits=1}, sw-calibration-access=READ-WRITE, data-constr=uint8}, symbol=[0][0]  # DcmDsdServiceUsed parameter for service SID23_ReadMemoryByAddress in Servicetable DcmDsdServiceTable_0
          ServiceTable_0_SID27_SecurityAccess_ServiceId_39: resulting-properties={base-type=uint8, sw-bit-representation={bit-position=5, number-of-bits=1}, sw-calibration-access=READ-WRITE, data-constr=uint8}, symbol=[0][0]  # DcmDsdServiceUsed parameter for service SID27_SecurityAccess in Servicetable DcmDsdServiceTable_0
          ServiceTable_0_SID28_CommunicationControl_ServiceId_40: resulting-properties={base-type=uint8, sw-bit-representation={bit-position=6, number-of-bits=1}, sw-calibration-access=READ-WRITE, data-constr=uint8}, symbol=[0][0]  # DcmDsdServiceUsed parameter for service SID28_CommunicationControl in Servicetable DcmDsdServiceTable_0
          ServiceTable_0_SID2E_WriteDataByIdentifier_ServiceId_46: resulting-properties={base-type=uint8, sw-bit-representation={bit-position=7, number-of-bits=1}, sw-calibration-access=READ-WRITE, data-constr=uint8}, symbol=[0][0]  # DcmDsdServiceUsed parameter for service SID2E_WriteDataByIdentifier in Servicetable DcmDsdServiceTable_0
          ServiceTable_0_SID31_RoutineControl_ServiceId_49: resulting-properties={base-type=uint8, sw-bit-representation={bit-position=0, number-of-bits=1}, sw-calibration-access=READ-WRITE, data-constr=uint8}, symbol=[0][1]  # DcmDsdServiceUsed parameter for service SID31_RoutineControl in Servicetable DcmDsdServiceTable_0
          ServiceTable_0_SID3D_WriteMemoryByAddress_ServiceId_61: resulting-properties={base-type=uint8, sw-bit-representation={bit-position=1, number-of-bits=1}, sw-calibration-access=READ-WRITE, data-constr=uint8}, symbol=[0][1]  # DcmDsdServiceUsed parameter for service SID3D_WriteMemoryByAddress in Servicetable DcmDsdServiceTable_0
          ServiceTable_0_SID3E_TesterPresent_ServiceId_62: resulting-properties={base-type=uint8, sw-bit-representation={bit-position=2, number-of-bits=1}, sw-calibration-access=READ-WRITE, data-constr=uint8}, symbol=[0][1]  # DcmDsdServiceUsed parameter for service SID3E_TesterPresent in Servicetable DcmDsdServiceTable_0
          ServiceTable_0_SID85_ControlDTCSetting_ServiceId_133: resulting-properties={base-type=uint8, sw-bit-representation={bit-position=3, number-of-bits=1}, sw-calibration-access=READ-WRITE, data-constr=uint8}, symbol=[0][1]  # DcmDsdServiceUsed parameter for service SID85_ControlDTCSetting in Servicetable DcmDsdServiceTable_0
    resource consumption ResourceConsumption
