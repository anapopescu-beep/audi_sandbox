AUTOSAR XML (schema 4-0-3)
package /AUTOSAR_Gpt/BswModuleDescriptions
  bsw module description Gpt: module-id=100, provided-entrys=Gpt_Init
    bsw internal behavior InternalBehavior_0
      31 x exclusive area:
        GPT_EXCLUSIVE_AREA_17
        GPT_EXCLUSIVE_AREA_{21..28}
        GPT_EXCLUSIVE_AREA_{40..46}
        GPT_EXCLUSIVE_AREA_{50..56}
        GPT_EXCLUSIVE_AREA_{60..67}
      bsw called entity Gpt_Init: can-enter-exclusive-area=[GPT_EXCLUSIVE_AREA_17, GPT_EXCLUSIVE_AREA_21, GPT_EXCLUSIVE_AREA_22, GPT_EXCLUSIVE_AREA_23, GPT_EXCLUSIVE_AREA_24, GPT_EXCLUSIVE_AREA_25, GPT_EXCLUSIVE_AREA_26, GPT_EXCLUSIVE_AREA_27, GPT_EXCLUSIVE_AREA_28, GPT_EXCLUSIVE_AREA_40, GPT_EXCLUSIVE_AREA_41, GPT_EXCLUSIVE_AREA_42, GPT_EXCLUSIVE_AREA_43, GPT_EXCLUSIVE_AREA_44, GPT_EXCLUSIVE_AREA_45, GPT_EXCLUSIVE_AREA_46, GPT_EXCLUSIVE_AREA_50, GPT_EXCLUSIVE_AREA_51, GPT_EXCLUSIVE_AREA_52, GPT_EXCLUSIVE_AREA_53, GPT_EXCLUSIVE_AREA_54, GPT_EXCLUSIVE_AREA_55, GPT_EXCLUSIVE_AREA_56, GPT_EXCLUSIVE_AREA_60, GPT_EXCLUSIVE_AREA_61, GPT_EXCLUSIVE_AREA_62, GPT_EXCLUSIVE_AREA_63, GPT_EXCLUSIVE_AREA_64, GPT_EXCLUSIVE_AREA_65, GPT_EXCLUSIVE_AREA_66, GPT_EXCLUSIVE_AREA_67], implemented-entry=Gpt_Init
package /AUTOSAR_Gpt/BswModuleEntrys
  bsw module entry Gpt_Init: service-id=1, is-reentrant=false, is-synchronous=true, call-type=REGULAR, execution-context=UNSPECIFIED, sw-service-impl-policy=STANDARD
package /Gpt_TS_T40D2M10I1R0/Implementations
  bsw implementation BswImplementation_0: programming-language=C, sw-version=1.0.1, vendor-id=43, ar-release-version=4.4.0, behavior=InternalBehavior_0, vendor-specific-module-def=Gpt
    code-descriptors:
      code Files: artifact-descriptors=[{short-label=make::Gpt_defs.mak, category=SWMAKE}, {short-label=make::Gpt_rules.mak, category=SWMAKE}]
    resource consumption ResourceConsumption
      10 x memory section:
        GPT_CODE: sw-addrmethod=CODE, symbol=CODE
        GPT_CONFIG_DATA_UNSPECIFIED: alignment=UNSPECIFIED, sw-addrmethod=CONFIG_DATA, symbol=CONFIG_DATA_UNSPECIFIED
        GPT_CONST_16: alignment=16, sw-addrmethod=CONST, symbol=CONST_16
        GPT_CONST_8: alignment=8, sw-addrmethod=CONST, symbol=CONST_8
        GPT_CONST_UNSPECIFIED: alignment=UNSPECIFIED, sw-addrmethod=CONST, symbol=CONST_UNSPECIFIED
        GPT_VAR_CLEARED_32: alignment=32, sw-addrmethod=VAR_CLEARED, symbol=VAR_CLEARED_32
        GPT_VAR_CLEARED_BOOLEAN: alignment=BOOLEAN, sw-addrmethod=VAR_CLEARED, symbol=VAR_CLEARED_BOOLEAN
        GPT_VAR_CLEARED_UNSPECIFIED: alignment=UNSPECIFIED, sw-addrmethod=VAR_CLEARED, symbol=VAR_CLEARED_UNSPECIFIED
        GPT_VAR_INIT_32: alignment=32, sw-addrmethod=VAR_INIT, symbol=VAR_INIT_32
        GPT_VAR_INIT_UNSPECIFIED: alignment=UNSPECIFIED, sw-addrmethod=VAR_INIT, symbol=VAR_INIT_UNSPECIFIED
