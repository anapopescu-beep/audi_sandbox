AUTOSAR XML (schema 4-0-3)
package /AUTOSAR_Port/BswModuleDescriptions
  bsw module description Port: module-id=124, provided-entrys=Port_Init
    bsw internal behavior InternalBehavior_0
      28 x exclusive area:
        PORT_EXCLUSIVE_AREA_{00..27}
      bsw called entity Port_Init: can-enter-exclusive-area=[PORT_EXCLUSIVE_AREA_00, PORT_EXCLUSIVE_AREA_01, PORT_EXCLUSIVE_AREA_02, PORT_EXCLUSIVE_AREA_03, PORT_EXCLUSIVE_AREA_04, PORT_EXCLUSIVE_AREA_05, PORT_EXCLUSIVE_AREA_06, PORT_EXCLUSIVE_AREA_07, PORT_EXCLUSIVE_AREA_08, PORT_EXCLUSIVE_AREA_09, PORT_EXCLUSIVE_AREA_10, PORT_EXCLUSIVE_AREA_11, PORT_EXCLUSIVE_AREA_12, PORT_EXCLUSIVE_AREA_13, PORT_EXCLUSIVE_AREA_14, PORT_EXCLUSIVE_AREA_15, PORT_EXCLUSIVE_AREA_16, PORT_EXCLUSIVE_AREA_17, PORT_EXCLUSIVE_AREA_18, PORT_EXCLUSIVE_AREA_19, PORT_EXCLUSIVE_AREA_20, PORT_EXCLUSIVE_AREA_21, PORT_EXCLUSIVE_AREA_22, PORT_EXCLUSIVE_AREA_23, PORT_EXCLUSIVE_AREA_24, PORT_EXCLUSIVE_AREA_25, PORT_EXCLUSIVE_AREA_26, PORT_EXCLUSIVE_AREA_27], implemented-entry=Port_Init
package /AUTOSAR_Port/BswModuleEntrys
  bsw module entry Port_Init: service-id=0, is-reentrant=false, is-synchronous=true, call-type=REGULAR, execution-context=UNSPECIFIED, sw-service-impl-policy=STANDARD
package /Port_TS_T40D2M10I1R0/Implementations
  bsw implementation BswImplementation_0: programming-language=C, sw-version=1.0.1, vendor-id=43, ar-release-version=4.4.0, behavior=InternalBehavior_0, vendor-specific-module-def=Port
    code-descriptors:
      code Files
        artifact-descriptors:
          short-label=make::Port_defs.mak, category=SWMAKE
          short-label=make::Port_rules.mak, category=SWMAKE
    resource consumption ResourceConsumption
      9 x memory section:
        PORT_CODE: alignment=UNSPECIFIED, sw-addrmethod=CODE, symbol=CODE
        PORT_CONFIG_DATA_16: alignment=16, sw-addrmethod=CONFIG_DATA, symbol=CONFIG_DATA_16
        PORT_CONFIG_DATA_32: alignment=32, sw-addrmethod=CONFIG_DATA, symbol=CONFIG_DATA_32
        PORT_CONFIG_DATA_8: alignment=8, sw-addrmethod=CONFIG_DATA, symbol=CONFIG_DATA_8
        PORT_CONFIG_DATA_UNSPECIFIED: alignment=UNSPECIFIED, sw-addrmethod=CONFIG_DATA, symbol=CONFIG_DATA_UNSPECIFIED
        PORT_CONST_16: alignment=16, sw-addrmethod=CONST, symbol=CONST_16
        PORT_CONST_32: alignment=32, sw-addrmethod=CONST, symbol=CONST_32
        PORT_VAR_CLEARED_16: alignment=16, sw-addrmethod=VAR_CLEARED, symbol=VAR_CLEARED_16
        PORT_VAR_CLEARED_UNSPECIFIED_NO_CACHEABLE: alignment=UNSPECIFIED, sw-addrmethod=VAR_CLEARED_UNSPECIFIED_NO, symbol=VAR_CLEARED_UNSPECIFIED_NO_CACHEABLE
