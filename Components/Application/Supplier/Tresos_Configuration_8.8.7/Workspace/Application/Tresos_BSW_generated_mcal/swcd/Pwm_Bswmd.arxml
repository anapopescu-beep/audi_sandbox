AUTOSAR XML (schema 4-0-3)
package /AUTOSAR_Pwm/BswModuleDescriptions
  bsw module description Pwm: module-id=121, provided-entrys=Pwm_Init
    bsw internal behavior InternalBehavior_0
      16 x exclusive area:
        PWM_EXCLUSIVE_AREA_00
        PWM_EXCLUSIVE_AREA_01
        PWM_EXCLUSIVE_AREA_{03..05}
        PWM_EXCLUSIVE_AREA_{07..13}
        PWM_EXCLUSIVE_AREA_{31..34}
      bsw called entity Pwm_Init: can-enter-exclusive-area=[PWM_EXCLUSIVE_AREA_00, PWM_EXCLUSIVE_AREA_01, PWM_EXCLUSIVE_AREA_03, PWM_EXCLUSIVE_AREA_04, PWM_EXCLUSIVE_AREA_05, PWM_EXCLUSIVE_AREA_07, PWM_EXCLUSIVE_AREA_08, PWM_EXCLUSIVE_AREA_09, PWM_EXCLUSIVE_AREA_10, PWM_EXCLUSIVE_AREA_11, PWM_EXCLUSIVE_AREA_12, PWM_EXCLUSIVE_AREA_13, PWM_EXCLUSIVE_AREA_31, PWM_EXCLUSIVE_AREA_32, PWM_EXCLUSIVE_AREA_33, PWM_EXCLUSIVE_AREA_34], implemented-entry=Pwm_Init
package /AUTOSAR_Pwm/BswModuleEntrys
  bsw module entry Pwm_Init: service-id=0, is-reentrant=false, is-synchronous=true, call-type=REGULAR, execution-context=UNSPECIFIED, sw-service-impl-policy=STANDARD
package /Pwm_TS_T40D2M10I1R0/Implementations
  bsw implementation BswImplementation_0: programming-language=C, sw-version=1.0.1, vendor-id=43, ar-release-version=4.4.0, behavior=InternalBehavior_0, vendor-specific-module-def=Pwm
    code-descriptors:
      code Files: artifact-descriptors=[{short-label=make::Pwm_defs.mak, category=SWMAKE}, {short-label=make::Pwm_rules.mak, category=SWMAKE}]
    resource consumption ResourceConsumption
      8 x memory section:
        PWM_CODE: sw-addrmethod=CODE, symbol=CODE
        PWM_CONFIG_DATA_UNSPECIFIED: alignment=UNSPECIFIED, sw-addrmethod=CONFIG_DATA, symbol=CONFIG_DATA_UNSPECIFIED
        PWM_CONST_UNSPECIFIED: alignment=UNSPECIFIED, sw-addrmethod=CONST, symbol=CONST_UNSPECIFIED
        PWM_VAR_CLEARED_16: alignment=16, sw-addrmethod=VAR_CLEARED, symbol=VAR_CLEARED_16
        PWM_VAR_CLEARED_32: alignment=32, sw-addrmethod=VAR_CLEARED, symbol=VAR_CLEARED_32
        PWM_VAR_CLEARED_8: alignment=8, sw-addrmethod=VAR_CLEARED, symbol=VAR_CLEARED_8
        PWM_VAR_CLEARED_UNSPECIFIED: alignment=UNSPECIFIED, sw-addrmethod=VAR_CLEARED, symbol=VAR_CLEARED_UNSPECIFIED
        PWM_VAR_INIT_UNSPECIFIED: alignment=UNSPECIFIED, sw-addrmethod=VAR_INIT, symbol=VAR_INIT_UNSPECIFIED
