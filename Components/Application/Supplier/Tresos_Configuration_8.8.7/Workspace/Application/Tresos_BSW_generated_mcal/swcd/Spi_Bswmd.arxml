AUTOSAR XML (schema 4-0-3)
package /AUTOSAR_Spi/BswModuleDescriptions
  bsw module description Spi: module-id=83, provided-entrys=[Spi_Init, Spi_MainFunction_Handling]
    bsw internal behavior InternalBehavior_0
      19 x exclusive area:
        SPI_EXCLUSIVE_AREA_{00..18}
      bsw called entity Spi_Init:
        can-enter-exclusive-area=[SPI_EXCLUSIVE_AREA_00, SPI_EXCLUSIVE_AREA_01, SPI_EXCLUSIVE_AREA_02, SPI_EXCLUSIVE_AREA_03, SPI_EXCLUSIVE_AREA_04, SPI_EXCLUSIVE_AREA_05, SPI_EXCLUSIVE_AREA_06, SPI_EXCLUSIVE_AREA_07, SPI_EXCLUSIVE_AREA_08, SPI_EXCLUSIVE_AREA_09, SPI_EXCLUSIVE_AREA_10, SPI_EXCLUSIVE_AREA_11, SPI_EXCLUSIVE_AREA_12, SPI_EXCLUSIVE_AREA_13, SPI_EXCLUSIVE_AREA_14, SPI_EXCLUSIVE_AREA_15, SPI_EXCLUSIVE_AREA_16, SPI_EXCLUSIVE_AREA_17, SPI_EXCLUSIVE_AREA_18]
        implemented-entry=Spi_Init
        scheduler-name-prefix=Prefix_Spi
      bsw schedulable entity Spi_MainFunction_Handling: implemented-entry=Spi_MainFunction_Handling, scheduler-name-prefix=Prefix_Spi
      bsw timing event TimingEvent_MainFunction: starts-on-event=Spi_MainFunction_Handling, period=0.005
      bsw scheduler name prefix Prefix_Spi: symbol=Spi
package /AUTOSAR_Spi/BswModuleEntrys
  bsw module entry Spi_Init: service-id=0, is-reentrant=false, is-synchronous=true, call-type=REGULAR, execution-context=UNSPECIFIED, sw-service-impl-policy=STANDARD
  bsw module entry Spi_MainFunction_Handling: service-id=16, is-reentrant=false, is-synchronous=true, call-type=SCHEDULED, execution-context=TASK, sw-service-impl-policy=STANDARD
package /Spi_TS_T40D2M10I1R0/Implementations
  bsw implementation BswImplementation_0: programming-language=C, sw-version=1.0.1, vendor-id=43, ar-release-version=4.4.0, behavior=InternalBehavior_0, vendor-specific-module-def=Spi
    code-descriptors:
      code Files: artifact-descriptors=[{short-label=make::Spi_defs.mak, category=SWMAKE}, {short-label=make::Spi_rules.mak, category=SWMAKE}]
    resource consumption ResourceConsumption
      11 x memory section:
        SPI_CODE: alignment=UNSPECIFIED, sw-addrmethod=CODE, symbol=CODE
        SPI_CONFIG_DATA_UNSPECIFIED: alignment=UNSPECIFIED, sw-addrmethod=CONFIG_DATA, symbol=CONFIG_DATA_UNSPECIFIED
        SPI_CONST_UNSPECIFIED: alignment=UNSPECIFIED, sw-addrmethod=CONST, symbol=CONST_UNSPECIFIED
        SPI_VAR_CLEARED_32: alignment=32, sw-addrmethod=VAR_CLEARED, symbol=VAR_CLEARED_32
        SPI_VAR_CLEARED_32_NO_CACHEABLE: alignment=UNSPECIFIED, sw-addrmethod=VAR_CLEARED_32_NO, symbol=VAR_CLEARED_32_NO_CACHEABLE
        SPI_VAR_CLEARED_8_NO_CACHEABLE: alignment=UNSPECIFIED, sw-addrmethod=VAR_CLEARED_8_NO, symbol=VAR_CLEARED_8_NO_CACHEABLE
        SPI_VAR_CLEARED_UNSPECIFIED: alignment=UNSPECIFIED, sw-addrmethod=VAR_CLEARED, symbol=VAR_CLEARED_UNSPECIFIED
        SPI_VAR_CLEARED_UNSPECIFIED_NO_CACHEABLE: alignment=UNSPECIFIED, sw-addrmethod=VAR_CLEARED_UNSPECIFIED_NO, symbol=VAR_CLEARED_UNSPECIFIED_NO_CACHEABLE
        SPI_VAR_INIT_8_NO_CACHEABLE: alignment=UNSPECIFIED, sw-addrmethod=VAR_INIT, symbol=VAR_INIT_8_NO_CACHEABLE
        SPI_VAR_INIT_UNSPECIFIED: alignment=UNSPECIFIED, sw-addrmethod=VAR_INIT, symbol=VAR_INIT_UNSPECIFIED
        SPI_VAR_INIT_UNSPECIFIED_NO_CACHEABLE: alignment=UNSPECIFIED, sw-addrmethod=VAR_INIT, symbol=VAR_INIT_UNSPECIFIED_NO_CACHEABLE
