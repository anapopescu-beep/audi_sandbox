AUTOSAR XML (schema 4-2-2)
package /AUTOLIV/SoftwareComponents/DcmIf
  application sw component type DcmIf: category=BSW_Communication_Services
    provide port ptrpAsrDcmServicesDcmIf: provided-interface=itrAsrDcmServices  # # Architecture Element ID ARCH_SW_DcmIf_ptrpAsrDcmServices_Rte_DcmConfirmation # Description - The runnable shall be called in order to know if the Dcm confirmation is made # Data Flow ## Inputs {Sid} - The Id of service {ReqType} - Request type {SourceAddress} - Address of request source {ConfirmationStatus} - Confirmation status ## Outputs # Linked Runnable - Rte_DcmConfirmation #Traceability --------------------------------------------------------------------------------------- # Architecture Element ID ARCH_SW_DcmIf_ptrpAsrDcmServices_Dcm_GetProgConditions # Description - The runnable shall be called in order to know if the Dcm initialization is the consequence of a jump from the bootloader # Data Flow ## Inputs ## Outputs # Linked Runnable - Dcm_GetProgConditions #Traceability --------------------------------------------------------------------------------------- # Architecture Element ID ARCH_SW_DcmIf_ptrpAsrDcmServices_Dcm_SetProgConditions # Description - The runnable shall be called in order to know if the Dcm can jump to the Bootloader # Data Flow ## Inputs ## Outputs # Linked Runnable - Dcm_SetProgConditions #Traceability --------------------------------------------------------------------------------------- # Architecture Element ID ARCH_SW_DcmIf_ptrpAsrDcmServices_WriteMemory # Description - The runnable shall be called by the Autosar Dcm module when a diagnostic request for write memory by address has been received - The runnable shall write the memory data located at the {Start address} input parameter value with a length of {Number of bytes to be written} with the data contained in the diagnostic buffer located at {Pointer to the buffer in Dcm} # Data Flow ## Inputs - {Operation status} - {Identifier of the memory device} - {Start address} (of the memory from which data is to be written) - {Number of bytes to be written} - {Pointer to the buffer in Dcm} ## Outputs - {Return Status} - Can be: DCM_WRITE_OK, DCM_WRITE_PENDING or DCM_WRITE_FAILED. # Linked Runnable - Dcm_WriteMemory #Traceability --------------------------------------------------------------------------------------- # Architecture Element ID ARCH_SW_DcmIf_ptrpAsrDcmServices_ReadMemory # Description - The runnable shall be called by the Autosar Dcm module when a diagnostic request for read memory by address has been received - The runnable shall return the memory data located at the {Start address} input parameter value with a length of {Number of bytes to be read} # Data Flow ## Inputs - {Operation status} - {Identifier of the memory device} - {Start address} (of the memory from which data is to be retrieved) - {Number of bytes to be read} ## Outputs - {Pointer to the buffer in Dcm} - {Return Status} - Can be: DCM_WRITE_OK, DCM_WRITE_PENDING or DCM_WRITE_FAILED. # Linked Runnable - Dcm_ReadMemory #Traceability
