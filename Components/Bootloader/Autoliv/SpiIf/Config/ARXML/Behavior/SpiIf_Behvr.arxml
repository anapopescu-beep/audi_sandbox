AUTOSAR XML (schema 4-2-2)
package /AUTOLIV/SoftwareComponents/SpiIf
  ecu abstraction sw component type SpiIf: category=MCAL_Communication_Drivers
    behavior SpiIf_IB: constant-value-mapping=ConstantsMappingSet_SpiIf, data-type-mapping=DataTypeMappingSet_SpiIf, handle-termination-and-restart=NO-SUPPORT
      4 x external trigger occurred event:
        trSpi_ReadIB: start-on-event=SpiIf_spiReadIBFromChannel, trigger=ptrrAsrSpiServicesSpiIf.Spi_ReadIB
        trSpi_SyncTransmit: start-on-event=SpiIf_writeSpiData, trigger=ptrrAsrSpiServicesSpiIf.Spi_SyncTransmit
        trSpi_SyncTransmit_Sequence: start-on-event=SpiIf_spiSyncTransmitSequence, trigger=ptrrAsrSpiServicesSpiIf.Spi_SyncTransmit
        trSpi_WriteIB: start-on-event=SpiIf_writeSpiData, trigger=ptrrAsrSpiServicesSpiIf.Spi_WriteIB
      runnable SpiIf_spiReadIBFromChannel: sw-addr-method=CODE_ASIL_A, external-triggering-points=[ptrpSpiIfServicesSBC.SpiIf_spiReadIBFromChannel, ptrpSpiIfServicesACC.SpiIf_spiReadIBFromChannel]  # # Architecture Element ID - ARCH_SW_SpiIf_ptrrAsrSpiServices_SpiIf_setSpiAsyncMode # Description - The Spi_SetAsyncMode interface shall be called in order to set the {Spi bus communication mode}, either to polling or interrupt mode # Data Flow ## Inputs - {Spi bus communication mode} ## Outputs - # Linked Runnable - SpiIf_setSpiAsyncMode #Traceability ------------------------------------------------------------------------------------ # Architecture Element ID - ARCH_SW_SpiIf_ptrrAsrSpiServices_SpiIf_spiAsyncTransmitSequence # Description - The Spi_AsyncTransmit interface shall be called in order to transmit the selected {Spi Sequence} on the input parameter on the Spi bus - The Spi_GetStatus_Sequence interface shall be called in order to poll the status of the previously transmitted sequence # Data Flow ## Inputs - {Spi Sequence} ## Outputs - # Linked Runnable - SpiIf_spiAsyncTransmitSequence #Traceability ------------------------------------------------------------------------------------ # Architecture Element ID - ARCH_SW_SpiIf_ptrrAsrSpiServices_SpiIf_waitSpiIdleStatus # Description - The Spi_GetStatus interface shall be called in order to get the current status of the Spi bus - The runnable will wait until the bus is in the SPI_IDLE mode # Data Flow ## Inputs ## Outputs # Linked Runnable - SpiIf_waitSpiIdleStatus #Traceability ------------------------------------------------------------------------------------ Architecture Element ID - ARCH_SW_SpiIf_ptrrAsrSpiServices_SpiIf_writeSpiData # Description - The Spi_WriteIB interface shall be called with the {Spi Channel Id} and {Spi Data} input parameters in order to send data on the Spi bus - The Spi_AsyncTransmit interface shall be called in order to transmit the selected {Spi Sequence} on the input parameter on the Spi bus - The Spi_GetStatus interface shall be called in order to get the current status of the Spi bus and wait until the bus is in the SPI_IDLE mode if the {Wait Idle Flag} is set # Data Flow ## Inputs - {Spi Channel Id} - {Spi Channel Sequence} - {Spi Data} - {Wait Idle Flag} ## Outputs - # Linked Runnable - SpiIf_writeSpiData #Traceability ------------------------------------------------------------------------------------ Architecture Element ID - ARCH_SW_SpiIf_ptrrAsrSpiServices_SpiIf_writeSpiDataAndReadAnswer # Description - The Spi_WriteIB interface shall be called with the {Spi Channel Id} and {Spi Data} input parameters in order to send data on the Spi bus - The Spi_AsyncTransmit interface shall be called in order to transmit the selected {Spi Sequence} on the input parameter on the Spi bus - The Spi_GetStatus interface shall be called in order to get the current status of the Spi bus and wait until the bus is in the SPI_IDLE mode - The Spi_ReadIB interface will be called in order to read the Spi data response from the slave on the {Spi Response Data} output parameter # Data Flow ## Inputs - {Spi Channel Id} - {Spi Channel Sequence} - {Spi Data} ## Outputs - {Spi Response Data} # Linked Runnable - SpiIf_writeSpiDataAndReadAnswer #Traceability
      runnable SpiIf_spiSyncTransmitSequence: sw-addr-method=CODE_ASIL_A, external-triggering-points=[ptrpSpiIfServicesSBC.SpiIf_spiSyncTransmitSequence, ptrpSpiIfServicesACC.SpiIf_spiSyncTransmitSequence]
      runnable SpiIf_writeSpiData: sw-addr-method=CODE_ASIL_A, external-triggering-points=[ptrpSpiIfServicesSBC.SpiIf_writeSpiData, ptrpSpiIfServicesACC.SpiIf_writeSpiData]
  swc implementation SpiIf_imp: category=MCAL_Communication_Drivers, programming-language=C, sw-version=1.0.0, vendor-id=0, behavior=SpiIf_IB
    code-descriptors:
      code SpiIf_Impl_Code: artifact-descriptors=autosar-engineering-object={short-label=SpiIf_Impl_Code_CodeDesc, category=SWSRC}
    resource consumption SpiIf_ImplResCons
      33 x memory section:
        CODE: size=0, sw-addrmethod=CODE
        CODE_ASIL_A: size=0, sw-addrmethod=CODE_ASIL_A
        CONST_16: alignment=16, size=16, sw-addrmethod=CONST
        CONST_16_ASIL_A: alignment=16, size=16, sw-addrmethod=CONST_ASIL_A
        CONST_32: alignment=32, size=32, sw-addrmethod=CONST
        CONST_32_ASIL_A: alignment=32, size=32, sw-addrmethod=CONST_ASIL_A
        CONST_8: alignment=8, size=8, sw-addrmethod=CONST
        CONST_8_ASIL_A: alignment=8, size=8, sw-addrmethod=CONST_ASIL_A
        CONST_BOOL: alignment=8, size=1, sw-addrmethod=CONST
        CONST_BOOL_ASIL_A: alignment=8, size=1, sw-addrmethod=CONST_ASIL_A
        CONST_UNSPECIFIED: alignment=UNSPECIFIED, size=0, sw-addrmethod=CONST
        CONST_UNSPECIFIED_ASIL_A: alignment=UNSPECIFIED, size=0, sw-addrmethod=CONST_ASIL_A
        VAR_INIT_16: alignment=16, size=16, sw-addrmethod=VAR_INIT
        VAR_INIT_16_ASIL_A: alignment=16, size=16, sw-addrmethod=VAR_INIT_ASIL_A
        VAR_INIT_32: alignment=32, size=32, sw-addrmethod=VAR_INIT
        VAR_INIT_32_ASIL_A: alignment=32, size=32, sw-addrmethod=VAR_INIT_ASIL_A
        VAR_INIT_8: alignment=8, size=8, sw-addrmethod=VAR_INIT
        VAR_INIT_8_ASIL_A: alignment=8, size=8, sw-addrmethod=VAR_INIT_ASIL_A
        VAR_INIT_BOOL: alignment=8, size=1, sw-addrmethod=VAR_INIT
        VAR_INIT_BOOL_ASIL_A: alignment=8, size=1, sw-addrmethod=VAR_INIT_ASIL_A
        VAR_INIT_UNSPECIFIED: alignment=UNSPECIFIED, size=0, sw-addrmethod=VAR_INIT
        VAR_INIT_UNSPECIFIED_ASIL_A: alignment=UNSPECIFIED, size=0, sw-addrmethod=VAR_INIT_ASIL_A
        VAR_NO_INIT_16: alignment=16, size=16, sw-addrmethod=VAR_NOINIT
        VAR_NO_INIT_16_ASIL_A: alignment=16, size=16, sw-addrmethod=VAR_NOINIT_ASIL_A
        VAR_NO_INIT_32: alignment=32, size=32, sw-addrmethod=VAR_NOINIT
        VAR_NO_INIT_32_ASIL_A: alignment=32, size=32, sw-addrmethod=VAR_NOINIT_ASIL_A
        VAR_NO_INIT_8: alignment=8, size=8, sw-addrmethod=VAR_NOINIT
        VAR_NO_INIT_8_ASIL_A: alignment=8, size=8, sw-addrmethod=VAR_NOINIT_ASIL_A
        VAR_NO_INIT_BOOL: alignment=8, size=1, sw-addrmethod=VAR_NOINIT
        VAR_NO_INIT_BOOL_ASIL_A: alignment=8, size=1, sw-addrmethod=VAR_NOINIT_ASIL_A
        VAR_NO_INIT_UNSPECIFIED: alignment=UNSPECIFIED, size=0, sw-addrmethod=VAR_NOINIT
        VAR_NO_INIT_UNSPECIFIED_ASIL_A: alignment=UNSPECIFIED, size=0, sw-addrmethod=VAR_NOINIT_ASIL_A
        VAR_POWER_ON_CLEARED: alignment=UNSPECIFIED, size=0, sw-addrmethod=VAR_POWER_ON_CLEARED
