AUTOSAR XML (schema 4-2-2)
package /AUTOLIV/SoftwareComponents/SBC
  complex device driver sw component type SBC: category=MCAL_Communication_Abstraction
    behavior SBC_IB: constant-value-mapping=ConstantsMappingSet_SBC, data-type-mapping=[DataTypeMappingSet_RCM, DataTypeMappingSet_SBC, DataTypeMappingSet_SpiIf], handle-termination-and-restart=NO-SUPPORT
      timing event SBC_evMainFunction: start-on-event=SBC_runMainFunction, period=0.01
      8 x operation invoked event:
        oie_pseCheckSbcStatusInfo_AutotestCallback: start-on-event=SBC_Autotest_CheckStatusInformation, operation=pseCheckSbcStatusInfo.AutotestCallback
        oie_pseSbcServices_SBC_SetToLowPower: start-on-event=SBC_SetToLowPower, operation=pseSbcServices.SBC_SetToLowPower
        oie_pseSbcServices_SBC_SetToNormal: start-on-event=SBC_SetToNormal, operation=pseSbcServices.SBC_SetToNormal
        oie_pseSbcServices_SBC_sleepTriggerWatchdog: start-on-event=SBC_sleepTriggerWatchdog, operation=pseSbcServices.SBC_sleepTriggerWatchdog
        oie_pseSbcStatus_GetSbcStatus: start-on-event=SBC_GetSBCStatusInformation, operation=pseSbcStatus.GetSbcStatus
        oie_pseSbcStatus_SBC_Reset: start-on-event=SBC_Reset, operation=pseSbcStatus.SBC_Reset
        oie_pseSbcStatus_SBC_Shutdown: start-on-event=SBC_Shutdown, operation=pseSbcStatus.SBC_Shutdown
        oie_pseSbcWdgAutotest_AutotestCallback: start-on-event=SBC_Autotest_WdgTest, operation=pseSbcWdgAutotest.AutotestCallback
      6 x external trigger occurred event:
        trSpiIf_spiReadIBFromChannel_Init: start-on-event=SBC_Init, trigger=ptrrSpiIfServices.SpiIf_spiReadIBFromChannel
        trSpiIf_spiReadIBFromChannel_runMainFunction: start-on-event=SBC_runMainFunction, trigger=ptrrSpiIfServices.SpiIf_spiReadIBFromChannel
        trSpiIf_spiSyncTransmitSequence_Init: start-on-event=SBC_Init, trigger=ptrrSpiIfServices.SpiIf_spiSyncTransmitSequence
        trSpiIf_spiSyncTransmitSequence_runMainFunction: start-on-event=SBC_runMainFunction, trigger=ptrrSpiIfServices.SpiIf_spiSyncTransmitSequence
        trSpiIf_writeSpiData_Init: start-on-event=SBC_Init, trigger=ptrrSpiIfServices.SpiIf_writeSpiData
        trSpiIf_writeSpiData_runMainFunction: start-on-event=SBC_runMainFunction, trigger=ptrrSpiIfServices.SpiIf_writeSpiData
      10 x runnable:
        SBC_Autotest_CheckStatusInformation: sw-addr-method=CODE_ASIL_A
          data-send-points:
            access dsp_u32SbcReg1Status: accessed-variable=psrSbcStatusFailiureSource.u32SbcReg1Status
        SBC_Autotest_WdgTest: sw-addr-method=CODE_ASIL_A
        SBC_GetSBCStatusInformation: sw-addr-method=CODE_ASIL_A
        SBC_Init: sw-addr-method=CODE_ASIL_A, external-triggering-point=ptrpSbcServicesEcuM.EcuM_AL_DriverInitOne
        SBC_Reset: sw-addr-method=CODE_ASIL_A
        SBC_SetToLowPower
        SBC_SetToNormal
        SBC_Shutdown
        SBC_runMainFunction: sw-addr-method=CODE_ASIL_A, external-triggering-point=ptrpAsrOsServicesSBC.SBC_runMainFunction
          sync call scp_GetResetCause: operation=pclResetCause.GetResetCause, timeout=0.0
          sync call scp_NotifyResetCause: operation=pclResetCauseNotification.NotifyResetCause, timeout=0.0
        SBC_sleepTriggerWatchdog
