/*@!Encoding:1252*/
/*------------------------------------------------------------------------------
                                IMPORT LIBRARY
 ------------------------------------------------------------------------------*/
/* To include all the libraries used by the .capl script. */
/* WARNING: Some things such as diagnostic functions are different from project
to project, change those according to your project requirements */
includes
{
  #include "S:\\Tools\\CANoe\\Config\\ECS_AUDI_INT\\Includes\\Debugger_Defines.cin"
  #include "S:\\Tools\\CANoe\\Config\\ECS_AUDI_INT\\Includes\\Debugger_Functions.cin"
  #include "S:\\Tools\\CANoe\\Config\\ECS_AUDI_INT\\Includes\\Project_Functions.cin"
  #include "S:\\Tools\\CANoe\\Config\\ECS_AUDI_INT\\Includes\\Diagnostic_Functions.cin"
}

/*------------------------------------------------------------------------------
                                    GLOBALS
 ------------------------------------------------------------------------------*/
/* To declare the constants used throurough the entire module, and global variables */
variables
{

/*----------------------------Global Variables---------------------------------*/
  float sEcs_HW_defekt;
 
}


/*------------------------------------------------------------------------------
                                TEST FUNCTIONS
------------------------------------------------------------------------------*/
/*------------------------- Test Preconditions ------------------------------*/
/* For operations to ensure the correct execution of the test case, such as IGN_ON,
checking that CAN communication is present, etc.
/* Varies from module to module, use from Helper_Functions.cin only the ones you need */
testfunction RunPreTs()
{
  DisplayRequirementsInfo();
  AddTestSetupInformation();
  
  PreTS_StartLogging();
  
  testCaseComment("Preconditions");
  testStep("STEP", "Bench Initialization");
  
  testStep("", "Delete all breakpoint from debugger.");
  debugger_deleteAllBreakpoints();
  
  testStep("", "Reset the debugger.");
  debugger_reset();
  
  testStep("", "Run the debugger.");
  debugger_run();
}

/*------------------------- Test Postconditions ------------------------------*/
/* For operations to ensure that after the test case was executed, the enviroment
would go back to a blank state, to be ready for the next test step in queue. Call it a Cleanup phase. */
testfunction RunPostTs()
{
  stopLogging("TestCaseLogASC");
  stopLogging("TestCaseLogBLF");
}

testcase InitTestModule()
{
  ConfigureTestModuleInformation();
  strncpy(cLogPathAndName, "S:\\Tools\\CANoe\\Config\\ECS_AUDI_INT\\Logs\\",  elcount(cLogPathAndName));
}


/*------------------------------------------------------------------------------
                                TEST EXECUTION
------------------------------------------------------------------------------*/

testcase Sw_Int_BswMIf_ptrrAsrNvMServicesBswMIf_01()
{
   /*-------------------------Test specific report info------------------------------*/
  
  testReportAddMiscInfoBlock("AUTOLIV ELECTRONICS document");
  TestReportAddMiscInfo("Nightly test", "No");
  TestReportAddMiscInfo("Test type", "Requirement-Based");
  TestReportAddMiscInfo("Regression Test", "No");
  TestReportAddMiscInfo("Fault injection method used", "No");
  TestReportAddMiscInfo("Resource usage evaluation", "No");
  TestReportAddMiscInfo("Priority", "No");
  TestReportAddMiscInfo("Safety relevant", "No");
  
  AddRequirementInfo("Requirement under test", "ARCH_SW_BswMIf_ptrrNvMServicesBswMIf_NvM_Init_BswM_OnStartupTwoA, ARCH_SW_BswMIf_ptrrNvMServicesBswMIf_NvM_ReadAll_BswM_OnStartupTwoA, ARCH_SW_BswMIf_ptrrNvMServicesBswMIf_NvM_WriteAll_BswM_OnPostRunFromRun, ARCH_SW_BswMIf_ptrrNvMServicesBswMIf_NvM_MainFunction_OsTask_Bsw_ReadWrite_AllProcess,ARCH_SW_BswMIf_ptrrNvMServicesBswMIf_NvM_WriteAll_BswM_On_Prep_Shutdown");
  AddRequirementInfo("ARCH_SW_BswMIf_ptrrNvMServicesBswMIf_NvM_Init_BswM_OnStartupTwoA", "The NvM_Init runnable shall be called in the BswM_OnStartupTwoA runnable in order to initialize NvM stack.");
  AddRequirementInfo("ARCH_SW_BswMIf_ptrrNvMServicesBswMIf_NvM_ReadAll_BswM_OnStartupTwoA", "The NvM_ReadAll runnable shall be called in the BswM_OnStartupTwoA runnable in order to start Read All process.");
  AddRequirementInfo("ARCH_SW_BswMIf_ptrrNvMServicesBswMIf_NvM_WriteAll_BswM_OnPostRunFromRun", "The NvM_WriteAll runnable shall be called in the BswM_OnPostRunFromRun runnable in order to start Write All process.");
  AddRequirementInfo("ARCH_SW_BswMIf_ptrrNvMServicesBswMIf_NvM_MainFunction_OsTask_Bsw_ReadWrite_AllProcess", "The NvM_MainFunction runnable shall be called in the OsTask_Bsw_ReadWrite_AllProcess runnable in order to manage NvM jobs.");
  AddRequirementInfo("ARCH_SW_BswMIf_ptrrNvMServicesBswMIf_NvM_WriteAll_BswM_On_Prep_Shutdown", "The NvM_WriteAll runnable shall be called in the BswM_On_Prep_Shutdown runnable in order to start Write All process.");
  //***************************************************************************************
  
  testCaseComment("Preconditions");
  testStep("STEP", "Bench Initialization"); // If the first parameter of testStep() is "Step", the arguments will be written in the specification file and "Step" argument will be numbered by 1 for each iteration.
  RunPreTs();
//   /*------------------------- Test scenario start ------------------------------*/
   
  testCaseComment("Action: ARCH_SW_BswMIf_ptrrNvMServicesBswMIf_NvM_Init_BswM_OnStartupTwoA");
  debugger_setRelativeFunctionBpAtLine("BswM_OnStartupTwoA", "14");
   testStep("", "Reset the debugger.");
  debugger_reset(); 
   testStep("", "Run the debugger.");
  debugger_run();
   testStep("STEP", "Set a BP in function BswM_OnStartupTwoA in order to Initialize NvM stack  --> BP was set");
  debugger_waitUntilBPisReached("2000");
  ExpectedTestResult(debugger_result, W8_UNTIL_BP_SUCCESSFUL, "Breakpoint is reached");

  debugger_setRelativeFunctionBpAtLine("NvM_Init", "0");
   testStep("", "Run the debugger.");
  debugger_run();
   testStep("STEP", "Set a BP in function NvM_Init for check the interface --> BP was set");
  debugger_waitUntilBPisReached("2000");
  ExpectedTestResult(debugger_result, W8_UNTIL_BP_SUCCESSFUL, "Breakpoint is reached");

    testCaseComment("Action: ARCH_SW_BswMIf_ptrrNvMServicesBswMIf_NvM_ReadAll_BswM_OnStartupTwoA");
  debugger_setRelativeFunctionBpAtLine("BswM_OnStartupTwoA", "17");
   testStep("", "Run the debugger.");
  debugger_run();
   testStep("STEP", "Set a BP in function BswM_OnStartupTwoA in order to Start Read All process --> BP was set");
  debugger_waitUntilBPisReached("2000");
  ExpectedTestResult(debugger_result, W8_UNTIL_BP_SUCCESSFUL, "Breakpoint is reached");

  debugger_setRelativeFunctionBpAtLine("NvM_ReadAll", "0");
   testStep("", "Run the debugger.");
  debugger_run();
   testStep("STEP", "Set a BP in function NvM_Init for check the interface --> BP was set");
  debugger_waitUntilBPisReached("2000");
  ExpectedTestResult(debugger_result, W8_UNTIL_BP_SUCCESSFUL, "Breakpoint is reached");

  testCaseComment("Action: ARCH_SW_BswMIf_ptrrNvMServicesBswMIf_NvM_WriteAll_BswM_On_Prep_Shutdown");
  debugger_deleteAllBreakpoints();
   debugger_setRelativeFunctionBpAtLine("BswM_ProceedReset", "6");
  testStep("", "Reset the debugger.");
   debugger_reset();
  testStep("", "Run the debugger.");
  debugger_run();
  
  testStep("STEP", "Send diagnostic request in order to do soft Reset");
   SendDiagnosticRequest(dSoftResetRequest, dSoftResetResponse);
  
   debugger_waitUntilBPisReached("2000");
   testStep("STEP", "Set a BP in function BswM_ProceedReset in order to call BswM_On_Prep_Shutdown and to start Write All process --> BP was set");
  ExpectedTestResult(debugger_result, W8_UNTIL_BP_SUCCESSFUL, "Breakpoint is reached");
  
   debugger_setRelativeFunctionBpAtLine("NvM_WriteAll", "1");
   testStep("", "Run the debugger.");
  debugger_run();
   testStep("STEP", "Set a BP in NvM_WriteAll for check if BP is reached in order to start Write All process --> BP was set");
  debugger_waitUntilBPisReached("2000");
  ExpectedTestResult(debugger_result, W8_UNTIL_BP_SUCCESSFUL, "Breakpoint is reached");
  
  debugger_setRelativeFunctionBpAtLine("BswM_CB_NfyNvMJobEnd", "2");
   testStep("", "Run the debugger.");
  debugger_run();
   testStep("STEP", "Set a BP in function BswM_CB_NfyNvMJobEnd for check the interface --> BP was set");
  debugger_waitUntilBPisReached("2000");
  ExpectedTestResult(debugger_result, W8_UNTIL_BP_SUCCESSFUL, "Breakpoint is reached");
    
   testCaseComment("Action: ARCH_SW_BswMIf_ptrrNvMServicesBswMIf_NvM_WriteAll_BswM_OnPostRunFromRun");
  debugger_deleteAllBreakpoints();
  testStep("STEP", "Enable comunication --> Comunication enable");
   TestSetMsgEvent(Airbag_01);
  TestSetMsgEvent(Airbag_02);
  TestSetMsgEvent(Airbag_eCS_01);
   TestWaitForTimeout(5000);
  
    debugger_setRelativeFunctionBpAtLine("BswM_OnPostRunFromRun", "13");
   testStep("", "Reset the debugger.");
  debugger_reset();
   testStep("", "Run the debugger.");
  debugger_run();
    
  testStep("STEP", "Disable comunication --> Comunication disable");
  TestDisableMsg(Airbag_01);
  TestDisableMsg(Airbag_02);
  TestDisableMsg(Airbag_eCS_01);
  TestWaitForTimeout(5000);
  testStep("STEP", "Set a BP in function BswM_OnStartupTwoA in order to Start Write All process --> BP was set");
  debugger_waitUntilBPisReached("2000");
  ExpectedTestResult(debugger_result, W8_UNTIL_BP_SUCCESSFUL, "Breakpoint is reached");
  
  debugger_setRelativeFunctionBpAtLine("NvM_WriteAll", "1");
   testStep("", "Run the debugger.");
  debugger_run();
   testStep("STEP", "Set a BP in function NvM_WriteAll for check the interface --> BP was set");
  debugger_waitUntilBPisReached("2000");
  ExpectedTestResult(debugger_result, W8_UNTIL_BP_SUCCESSFUL, "Breakpoint is reached");

  testCaseComment("Action: ARCH_SW_BswMIf_ptrrNvMServicesBswMIf_NvM_MainFunction_OsTask_Bsw_ReadWrite_AllProcess");
   debugger_deleteAllBreakpoints();
    testStep("STEP", "Enable comunication --> Comunication enable");
   TestSetMsgEvent(Airbag_01);
  TestSetMsgEvent(Airbag_02);
  TestSetMsgEvent(Airbag_eCS_01);
   TestWaitForTimeout(5000);
  debugger_setBpAtLine("c:\\Projects\\eCS_R1.2\\Components\\Application\\Autoliv\\BswMIf\\Implementation\\src\\BswM_Callouts.c", "1853");
//   debugger_setRelativeFunctionBpAtLine("OsTask_Bsw_ReadWrite_AllProcess", "7");
  testStep("", "Reset the debugger.");
   debugger_reset(); 
  testStep("", "Run the debugger.");
   debugger_run();
  testStep("STEP", "Set a BP in OsTask_Bsw_ReadWrite_AllProcess in order to call NvM_MainFunction function --> BP was set");
   debugger_waitUntilBPisReached("2000");
  ExpectedTestResult(debugger_result, W8_UNTIL_BP_SUCCESSFUL, "Breakpoint is reached");
  
  testStep("STEP", "Modify the local variable bswmif_u8IsReadWriteAllProcessFinished with value 55. --> bswmif_u8IsReadWriteAllProcessFinished value is set.");
   debugger_writeLocalVariable("bswmif_u8IsReadWriteAllProcessFinished", "55");
  ExpectedTestResult(debugger_result, "55", "Variable was modified with 55");
  
  debugger_setRelativeFunctionBpAtLine("NvM_MainFunction", "1");
   testStep("", "Run the debugger.");
  debugger_run();
   testStep("STEP", "Set a BP in function NvM_MainFunction in order to check the interface --> BP was set");
  debugger_waitUntilBPisReached("2000");
  ExpectedTestResult(debugger_result, W8_UNTIL_BP_SUCCESSFUL, "Breakpoint is reached");
  
  //====================================================
  testCaseComment("Postcondition");
  testStep("STEP", "Return ECU to default values");
  RunPostTs();
}
testcase Sw_Int_BswMIf_ptrrAsrNvMServicesBswMIf_02()
{
   /*-------------------------Test specific report info------------------------------*/
  
  testReportAddMiscInfoBlock("AUTOLIV ELECTRONICS document");
  TestReportAddMiscInfo("Nightly test", "No");
  TestReportAddMiscInfo("Test type", "Requirement-Based");
  TestReportAddMiscInfo("Regression Test", "No");
  TestReportAddMiscInfo("Fault injection method used", "No");
  TestReportAddMiscInfo("Resource usage evaluation", "No");
  TestReportAddMiscInfo("Priority", "No");
  TestReportAddMiscInfo("Safety relevant", "No");
  
  AddRequirementInfo("Requirement under test", "ARCH_SW_BswMIf_ptrrNvMServicesBswMIf_NvM_WriteAll_BswM_Cyclic_10msTimer");
  AddRequirementInfo("ARCH_SW_BswMIf_ptrrNvMServicesBswMIf_NvM_WriteAll_BswM_Cyclic_10msTimer", "The NvM_WriteAll runnable shall be called in the BswM_Cyclic_10msTimer runnable in order to start Write All process.");
//***************************************************************************************
  
  testCaseComment("Preconditions");
  testStep("STEP", "Bench Initialization"); // If the first parameter of testStep() is "Step", the arguments will be written in the specification file and "Step" argument will be numbered by 1 for each iteration.
  RunPreTs();
//   /*------------------------- Test scenario start ------------------------------*/
    testCaseComment("Action: ARCH_SW_BswMIf_ptrrNvMServicesBswMIf_NvM_WriteAll_BswM_Cyclic_10msTimer");   
  testStep("STEP", "Enable comunication --> Comunication enable");
   TestSetMsgEvent(Airbag_01);
  TestSetMsgEvent(Airbag_02);
  TestSetMsgEvent(Airbag_eCS_01);
   TestWaitForTimeout(10000);
  
  debugger_setRelativeFunctionBpAtLine("BswM_Cyclic_10msTimer", "5");
   testStep("", "Reset the debugger.");
  debugger_reset(); 
   testStep("", "Run the debugger.");
  debugger_run();
    
  testStep("STEP", "Disable comunication --> Comunication disable");
  TestDisableMsg(Airbag_01);
  TestDisableMsg(Airbag_02);
  TestDisableMsg(Airbag_eCS_01);
  TestWaitForTimeout(6100);
  testStep("STEP", "Set a BP in function BswM_Cyclic_10msTimer in order to change post run timer value --> BP was set");
  debugger_waitUntilBPisReached("2000");
  ExpectedTestResult(debugger_result, W8_UNTIL_BP_SUCCESSFUL, "Breakpoint is reached");
  
  testStep("STEP", "Change value for Post Run Timer in order to go in LPM_sleepMainLoop function --> Succesfully changed");
  debugger_writeVariable("uint8","bswmif_u16TPostRunTimer,,app.elf", "1", "17EC");
  TestWaitForTimeout(500);
  
  debugger_setRelativeFunctionBpAtLine("LPM_sleepMainLoop", "46");
  TestWaitForTimeout(500);
   testStep("", "Run the debugger.");
  debugger_run();
   testStep("STEP", "Set a BP in function LPM_sleepMainLoop in order to change Adc Wakeup value --> BP was set");
  debugger_waitUntilBPisReached("3000");
  ExpectedTestResult(debugger_result, W8_UNTIL_BP_SUCCESSFUL, "Breakpoint is reached");

  testStep("STEP", "Change value for Adc wakeup in True --> Succesfully changed");
   debugger_writeLocalVariable("bAdcWakeup", "AA");
  TestWaitForTimeout(2000);
  debugger_deleteAllBreakpoints();
  
    debugger_setRelativeFunctionBpAtLine("BswM_OnRunFromLowPwrPassengerDetected", "5");
   testStep("", "Run the debugger.");
  debugger_run();
   testStep("STEP", "Set a BP in function BswM_OnRunFromLowPwrPassengerDetected to check if Low Power Passenger Detected --> BP was set");
  debugger_waitUntilBPisReached("2000");
  ExpectedTestResult(debugger_result, W8_UNTIL_BP_SUCCESSFUL, "Breakpoint is reached");
  debugger_deleteAllBreakpoints();
  
  debugger_setRelativeFunctionBpAtLine("BswM_Cyclic_10msTimer", "143");
   testStep("", "Run the debugger.");
  debugger_run();
   testStep("STEP", "Set a BP in function BswM_Cyclic_10msTimer in order to wait until comuncation is enable--> BP was set");
  debugger_waitUntilBPisReached("2000");
  ExpectedTestResult(debugger_result, W8_UNTIL_BP_SUCCESSFUL, "Breakpoint is reached");
  
  testStep("STEP", "Enable comunication --> Comunication enable");
   TestSetMsgEvent(Airbag_01);
  TestSetMsgEvent(Airbag_02);
  TestSetMsgEvent(Airbag_eCS_01);
   TestWaitForTimeout(1000);
  
  testStep("STEP", "Change value for Current Tx Pdu State --> Succesfully changed");
   debugger_writeLocalVariable("bswmif_u8CurrentTxPduState", "0");
  TestWaitForTimeout(2000);
  
  
  debugger_setRelativeFunctionBpAtLine("BswM_Cyclic_10msTimer ", "158");
   testStep("", "Run the debugger.");
  debugger_run();
   testStep("STEP", "Set a BP in function BswM_Cyclic_10msTimer in order to call NvM_WriteAll --> BP was set");
  debugger_waitUntilBPisReached("2000");
  ExpectedTestResult(debugger_result, W8_UNTIL_BP_SUCCESSFUL, "Breakpoint is reached");
  
   debugger_setRelativeFunctionBpAtLine("NvM_WriteAll", "1");
   testStep("", "Run the debugger.");
  debugger_run();
   testStep("STEP", "Set a BP in function NvM_WriteAll in order to start Write All process --> BP was set");
  debugger_waitUntilBPisReached("2000");
  ExpectedTestResult(debugger_result, W8_UNTIL_BP_SUCCESSFUL, "Breakpoint is reached");
  
   debugger_setRelativeFunctionBpAtLine("BswM_Cyclic_10msTimer ", "165");
   testStep("", "Run the debugger.");
  debugger_run();
   testStep("STEP", "Set a BP in function BswM_Cyclic_10msTimer in order to check the interface --> BP was set");
  debugger_waitUntilBPisReached("2000");
  ExpectedTestResult(debugger_result, W8_UNTIL_BP_SUCCESSFUL, "Breakpoint is reached");
  
  //====================================================
  testCaseComment("Postcondition");
  testStep("STEP", "Return ECU to default values");
  RunPostTs();
}
testcase Sw_Int_BswMIf_ptrrAsrOsServicesBswMIf_01()
{
   /*-------------------------Test specific report info------------------------------*/
  
  testReportAddMiscInfoBlock("AUTOLIV ELECTRONICS document");
  TestReportAddMiscInfo("Nightly test", "No");
  TestReportAddMiscInfo("Test type", "Requirement-Based");
  TestReportAddMiscInfo("Regression Test", "No");
  TestReportAddMiscInfo("Fault injection method used", "No");
  TestReportAddMiscInfo("Resource usage evaluation", "No");
  TestReportAddMiscInfo("Priority", "No");
  TestReportAddMiscInfo("Safety relevant", "No");
  
  AddRequirementInfo("Requirement under test", "ARCH_SW_BswMIf_ptrrOsServicesBswMIf_ActivateTask_BswM_OnStartupTwoA, ARCH_SW_BswMIf_ptrrOsServicesBswMIf_SetEvent_BswM_OnStartupTwoA, ARCH_SW_BswMIf_ptrrOsServicesBswMIf_StopScheduleTable_BswM_OnStartComEffective, ARCH_SW_BswMIf_ptrrOsServicesBswMIf_ActivateTask_BswM_OnPostRunFromRun");
  AddRequirementInfo("ARCH_SW_BswMIf_ptrrOsServicesBswMIf_ActivateTask_BswM_OnStartupTwoA", "The ActivateTask runnable shall be called in the BswM_OnStartupTwoA runnable in order to activate the task dedicated to the ReadAll process fastening.");
  AddRequirementInfo("ARCH_SW_BswMIf_ptrrOsServicesBswMIf_SetEvent_BswM_OnStartupTwoA", "The SetEvent runnable shall be called in the BswM_OnStartupTwoA runnable in order to set the task dedicated to the ReadAll process fastening.");
  AddRequirementInfo("ARCH_SW_BswMIf_ptrrOsServicesBswMIf_StopScheduleTable_BswM_OnStartComEffective", "The StopScheduleTable runnable shall be called in the BswM_OnStartComEffective runnable in order to stop the default schedule table to be able to start the main schedule table.");
  AddRequirementInfo("ARCH_SW_BswMIf_ptrrOsServicesBswMIf_ActivateTask_BswM_OnPostRunFromRun", " The ActivateTask runnable shall be called in the BswM_OnPostRunFromRun runnable in order to activate the task dedicated to the WriteAll process fastening.");
//***************************************************************************************
  testCaseComment("Preconditions");
  testStep("STEP", "Bench Initialization"); // If the first parameter of testStep() is "Step", the arguments will be written in the specification file and "Step" argument will be numbered by 1 for each iteration.
  RunPreTs();
   /*------------------------- Test scenario start ------------------------------*/
   
  testCaseComment("Action: ARCH_SW_BswMIf_ptrrOsServicesBswMIf_ActivateTask_BswM_OnStartupTwoA");
   testStep("STEP", "Set a BP in function BswM_OnStartupTwoA in order to call ActivateTask function --> BP was set");
  debugger_setRelativeFunctionBpAtLine("BswM_OnStartupTwoA", "26");
   testStep("", "Reset the debugger.");
  debugger_reset(); 
   testStep("", "Run the debugger.");
  debugger_run();
  debugger_waitUntilBPisReached("2000");
  ExpectedTestResult(debugger_result, W8_UNTIL_BP_SUCCESSFUL, "Breakpoint is reached");

  testStep("STEP", "Set a BP in function stopscheduletable in order to Activate the task --> BP was set");
  debugger_setBpAtLine("C:\\Projects\\eCS_R1.2\\Tools\\Build_Env\\Workspace\\Outputs\\app\\Obj\\CORTEXM-user-setevent.s", "53");
   testStep("", "Run the debugger.");
  debugger_run();
   debugger_waitUntilBPisReached("2000");
  ExpectedTestResult(debugger_result, W8_UNTIL_BP_SUCCESSFUL, "Breakpoint is reached");
  
  debugger_setRelativeFunctionBpAtLine("BswM_OnStartupTwoA", "27");
   testStep("STEP", "Set a BP in function BswM_OnStartupTwoA for check the interface --> BP was set");
  testStep("", "Run the debugger.");
  debugger_run();
   debugger_waitUntilBPisReached("2000");
  ExpectedTestResult(debugger_result, W8_UNTIL_BP_SUCCESSFUL, "Breakpoint is reached");
  
  testCaseComment("Action: ARCH_SW_BswMIf_ptrrOsServicesBswMIf_SetEvent_BswM_OnStartupTwoA");
  debugger_deleteAllBreakpoints();
   testStep("STEP", "Set a BP in function BswM_OnStartupTwoA in order to Activate the event dedicated to the ReadAll process fastening  --> BP was set");
  debugger_setRelativeFunctionBpAtLine("BswM_OnStartupTwoA", "27");
   testStep("", "Reset the debugger.");
  debugger_reset(); 
   testStep("", "Run the debugger.");
  debugger_run();
  debugger_waitUntilBPisReached("2000");
  ExpectedTestResult(debugger_result, W8_UNTIL_BP_SUCCESSFUL, "Breakpoint is reached");

  testStep("STEP", "Set a BP in function stopscheduletable in order to check if BP is reached and Activate the event dedicated to the ReadAll process fastening --> BP was set");
  debugger_setBpAtLine("C:\\Projects\\eCS_R1.2\\Tools\\Build_Env\\Workspace\\Outputs\\app\\Obj\\CORTEXM-user-setevent.s", "53");
   testStep("", "Run the debugger.");
  debugger_run();
   debugger_waitUntilBPisReached("2000");
  ExpectedTestResult(debugger_result, W8_UNTIL_BP_SUCCESSFUL, "Breakpoint is reached");
  
   testStep("STEP", "Set a BP in function BswM_OnStartupTwoA for check the interface --> BP was set");
  debugger_setRelativeFunctionBpAtLine("BswM_OnStartupTwoA", "30");
   testStep("", "Run the debugger.");
  debugger_run();
   debugger_waitUntilBPisReached("2000");
  ExpectedTestResult(debugger_result, W8_UNTIL_BP_SUCCESSFUL, "Breakpoint is reached");
  
  testCaseComment("Action: ARCH_SW_BswMIf_ptrrOsServicesBswMIf_StopScheduleTable_BswM_OnStartComEffective");
  debugger_deleteAllBreakpoints();
   testStep("STEP", "Set a BP in function BswM_OnStartComEffective in order to stop the default schedule table --> BP was set");
  debugger_setRelativeFunctionBpAtLine("BswM_OnStartComEffective", "5");
   testStep("", "Reset the debugger.");
  debugger_reset();
   testStep("", "Run the debugger.");
  debugger_run();
   debugger_waitUntilBPisReached("2000");
  ExpectedTestResult(debugger_result, W8_UNTIL_BP_SUCCESSFUL, "Breakpoint is reached");

   testStep("STEP", "Set a BP in function stopscheduletable in order to check if BP is reached and stop the default schedule table --> BP was set");
  debugger_setBpAtLine("C:\\Projects\\eCS_R1.2\\Tools\\Build_Env\\Workspace\\Outputs\\app\\Obj\\CORTEXM-user-stopscheduletable.s", "53");
   testStep("", "Run the debugger.");
  debugger_run();
   debugger_waitUntilBPisReached("2000");
  ExpectedTestResult(debugger_result, W8_UNTIL_BP_SUCCESSFUL, "Breakpoint is reached");
  
   testStep("STEP", "Set a BP in function BswM_OnStartComEffective for check the interface --> BP was set");
  debugger_setRelativeFunctionBpAtLine("BswM_OnStartComEffective", "8");
   testStep("", "Run the debugger.");
  debugger_run();
   debugger_waitUntilBPisReached("2000");
  ExpectedTestResult(debugger_result, W8_UNTIL_BP_SUCCESSFUL, "Breakpoint is reached");
  
   testCaseComment("Action: ARCH_SW_BswMIf_ptrrOsServicesBswMIf_ActivateTask_BswM_OnPostRunFromRun");
  debugger_deleteAllBreakpoints();
  testStep("STEP", "Set a BP in function BswM_OnPostRunFromRun in order to Activate the task --> BP was set");
   debugger_setRelativeFunctionBpAtLine("BswM_OnPostRunFromRun", "19");
  testStep("", "Reset the debugger.");
   debugger_reset();
  testStep("", "Run the debugger.");
  debugger_run();
  testStep("STEP", "Disable comunication --> Comunication disable");
   TestDisableMsg(Airbag_01);
  TestDisableMsg(Airbag_02);
  TestDisableMsg(Airbag_eCS_01);
   TestWaitForTimeout(5000);
   debugger_waitUntilBPisReached("2000");
  ExpectedTestResult(debugger_result, W8_UNTIL_BP_SUCCESSFUL, "Breakpoint is reached");

  testStep("STEP", "Set a BP in OS_UserActivateTask to ckeck if BP is reached in order to activate user Task --> BP was set");
  debugger_setBpAtLine("C:\\Projects\\eCS_R1.2\\Tools\\Build_Env\\Workspace\\Outputs\\app\\Obj\\CORTEXM-user-activatetask.s", "53");
   testStep("", "Run the debugger.");
  debugger_run();
   debugger_waitUntilBPisReached("2000");
  ExpectedTestResult(debugger_result, W8_UNTIL_BP_SUCCESSFUL, "Breakpoint is reached");
  
  testStep("STEP", "Set a BP in function BswM_OnStartupTwoA for check the interface --> BP was set");
   debugger_setRelativeFunctionBpAtLine("BswM_OnPostRunFromRun", "20");
   testStep("", "Run the debugger.");
  debugger_run();
   debugger_waitUntilBPisReached("2000");
  ExpectedTestResult(debugger_result, W8_UNTIL_BP_SUCCESSFUL, "Breakpoint is reached");
  
  testStep("STEP", "Enable comunication --> Comunication enable");
   TestSetMsgEvent(Airbag_01);
  TestSetMsgEvent(Airbag_02);
  TestSetMsgEvent(Airbag_eCS_01);
   TestWaitForTimeout(5000);
  
  //====================================================
  testCaseComment("Postcondition");
  testStep("STEP", "Return ECU to default values");
  RunPostTs();
}
testcase Sw_Int_BswMIf_ptrrAsrOsServicesBswMIf_02()
{
   /*-------------------------Test specific report info------------------------------*/
  
  testReportAddMiscInfoBlock("AUTOLIV ELECTRONICS document");
  TestReportAddMiscInfo("Nightly test", "No");
  TestReportAddMiscInfo("Test type", "Requirement-Based");
  TestReportAddMiscInfo("Regression Test", "No");
  TestReportAddMiscInfo("Fault injection method used", "No");
  TestReportAddMiscInfo("Resource usage evaluation", "No");
  TestReportAddMiscInfo("Priority", "No");
  TestReportAddMiscInfo("Safety relevant", "No");
  
  AddRequirementInfo("Requirement under test", "ARCH_SW_BswMIf_ptrrOsServicesBswMIf_SetEvent_BswM_OnPostRunFromRun, ARCH_SW_BswMIf_ptrrOsServicesBswMIf_ActivateTask_BswM_On_Prep_Shutdown, ARCH_SW_BswMIf_ptrrOsServicesBswMIf_SetEvent_BswM_On_Prep_Shutdown, ARCH_SW_BswMIf_ptrrOsServicesBswMIf_StopScheduleTable_BswM_ProceedReset, ARCH_SW_BswMIf_ptrrOsServicesBswMIf_StartScheduleTable_BswM_ProceedReset, ARCH_SW_BswMIf_ptrrOsServicesBswMIf_WaitEvent_OsTask_Bsw_ReadWrite_AllProcess, ARCH_SW_BswMIf_ptrrOsServicesBswMIf_ClearEvent_OsTask_Bsw_ReadWrite_AllProcess, ARCH_SW_BswMIf_ptrrOsServicesBswMIf_SuspendAllInterrupts_OsTask_Bsw_ReadWrite_AllProcess, ARCH_SW_BswMIf_ptrrOsServicesBswMIf_ResumeAllInterrupts_OsTask_Bsw_ReadWrite_AllProcess, ARCH_SW_BswMIf_ptrrOsServicesBswMIf_TerminateTask_OsTask_Bsw_ReadWrite_AllProcess, ARCH_SW_BswMIf_ptrrOsServicesBswMIf_SetEvent_OsTask_Bsw_ReadWrite_AllProcess, ARCH_SW_BswMIf_ptrrOsServicesBswMIf_StartScheduleTableRel_BswM_On_Prep_Shutdown");
  AddRequirementInfo("ARCH_SW_BswMIf_ptrrOsServicesBswMIf_SetEvent_BswM_OnPostRunFromRun", "  The SetEvent runnable shall be called in the BswM_OnPostRunFromRun runnable in order to set the task dedicated to the WriteAll process fastening.");
  AddRequirementInfo("ARCH_SW_BswMIf_ptrrOsServicesBswMIf_ActivateTask_BswM_On_Prep_Shutdown", "The ActivateTask runnable shall be called in the BswM_On_Prep_Shutdown runnable in order to activate the task dedicated to the WriteAll process fastening.");
  AddRequirementInfo("ARCH_SW_BswMIf_ptrrOsServicesBswMIf_SetEvent_BswM_On_Prep_Shutdown", "The SetEvent runnable shall be called in the BswM_On_Prep_Shutdown runnable in order to set the task dedicated to the WriteAll process fastening.");
  AddRequirementInfo("ARCH_SW_BswMIf_ptrrOsServicesBswMIf_StopScheduleTable_BswM_ProceedReset", "The StopScheduleTable runnable shall be called in the BswM_ProceedReset runnable in order to stop the main schedule table.");
  AddRequirementInfo("ARCH_SW_BswMIf_ptrrOsServicesBswMIf_StartScheduleTable_BswM_ProceedReset", "The StartScheduleTable runnable shall be called in the BswM_ProceedReset runnable in order to start the default schedule table.");
  AddRequirementInfo("ARCH_SW_BswMIf_ptrrOsServicesBswMIf_WaitEvent_OsTask_Bsw_ReadWrite_AllProcess", "The WaitEvent runnable shall be called in the OsTask_Bsw_ReadWrite_AllProcess runnable in order to wait for ReadWrite Os task.");
  AddRequirementInfo("ARCH_SW_BswMIf_ptrrOsServicesBswMIf_ClearEvent_OsTask_Bsw_ReadWrite_AllProcess", "The ClearEvent runnable shall be called in the OsTask_Bsw_ReadWrite_AllProcess runnable in order to clear ReadWrite Os task assigned event.");
  AddRequirementInfo("ARCH_SW_BswMIf_ptrrOsServicesBswMIf_SuspendAllInterrupts_OsTask_Bsw_ReadWrite_AllProcess", "The SuspendAllInterrupts runnable shall be called in the OsTask_Bsw_ReadWrite_AllProcess runnable in order to suspend all interrupts.");
  AddRequirementInfo("ARCH_SW_BswMIf_ptrrOsServicesBswMIf_ResumeAllInterrupts_OsTask_Bsw_ReadWrite_AllProcess", "The ResumeAllInterrupts runnable shall be called in the OsTask_Bsw_ReadWrite_AllProcess runnable in order to resume all interrupts.");
  AddRequirementInfo("ARCH_SW_BswMIf_ptrrOsServicesBswMIf_TerminateTask_OsTask_Bsw_ReadWrite_AllProcess", "The TerminateTask runnable shall be called in the OsTask_Bsw_ReadWrite_AllProcess runnable in order to terminate task when all blocks have been correctly managed.");
  AddRequirementInfo("ARCH_SW_BswMIf_ptrrOsServicesBswMIf_SetEvent_OsTask_Bsw_ReadWrite_AllProcess", "The SetEvent runnable shall be called in the OsTask_Bsw_ReadWrite_AllProcess runnable in order to set the event in OS task.");
  AddRequirementInfo("ARCH_SW_BswMIf_ptrrOsServicesBswMIf_StartScheduleTableRel_BswM_On_Prep_Shutdown", "The StartScheduleTableRel runnable shall be called in the BswM_On_Prep_Shutdown runnable in order to start the default schedule table after main schedule table (RTE) was stopped.");
  //***************************************************************************************
  testCaseComment("Preconditions");
  testStep("STEP", "Bench Initialization"); // If the first parameter of testStep() is "Step", the arguments will be written in the specification file and "Step" argument will be numbered by 1 for each iteration.
  RunPreTs();
   /*------------------------- Test scenario start ------------------------------*/
  testCaseComment("Action: ARCH_SW_BswMIf_ptrrOsServicesBswMIf_ActivateTask_BswM_On_Prep_Shutdown, ARCH_SW_BswMIf_ptrrOsServicesBswMIf_SetEvent_BswM_On_Prep_Shutdown ");
   debugger_setRelativeFunctionBpAtLine("BswM_ProceedReset", "6");
  testStep("", "Reset the debugger.");
   debugger_reset();
  testStep("", "Run the debugger.");
  debugger_run();
  
  testStep("STEP", "Send diagnostic request in order to do soft Reset");
   SendDiagnosticRequest(dSoftResetRequest, dSoftResetResponse);
  
   debugger_waitUntilBPisReached("2000");
   testStep("STEP", "Set a BP in function BswM_ProceedReset in order to call BswM_On_Prep_Shutdown and to Activate the event dedicated to the OsTask_Bsw_ReadWrite_AllProcess --> BP was set");
  ExpectedTestResult(debugger_result, W8_UNTIL_BP_SUCCESSFUL, "Breakpoint is reached");
  
  debugger_setRelativeFunctionBpAtLine("BswM_CB_NfyNvMJobEnd", "58");
   testStep("", "Run the debugger.");
  debugger_run();
   testStep("STEP", "Set a BP in function BswM_CB_NfyNvMJobEnd for check the interface --> BP was set");
  debugger_waitUntilBPisReached("2000");
  ExpectedTestResult(debugger_result, W8_UNTIL_BP_SUCCESSFUL, "Breakpoint is reached");
  
  testCaseComment("Action: ARCH_SW_BswMIf_ptrrOsServicesBswMIf_StopScheduleTable_BswM_ProceedReset");
  debugger_deleteAllBreakpoints();
   debugger_setRelativeFunctionBpAtLine("BswM_ProceedReset", "12");
  testStep("", "Reset the debugger.");
   debugger_reset();
  testStep("", "Run the debugger.");
  debugger_run();
  
  testStep("STEP", "Send diagnostic request in order to do hard Reset");
   SendDiagnosticRequest(dHardResetRequest, dHardResetResponse);
  
   debugger_waitUntilBPisReached("2000");
   testStep("STEP", "Set a BP in function BswM_ProceedReset in order to stop the main schedule table --> BP was set");
  ExpectedTestResult(debugger_result, W8_UNTIL_BP_SUCCESSFUL, "Breakpoint is reached");
  
  debugger_setBpAtLine("C:\\Projects\\eCS_R1.2\\Tools\\Build_Env\\Workspace\\Outputs\\app\\Obj\\CORTEXM-user-stopscheduletable.s", "53");
   testStep("", "Run the debugger.");
  debugger_run();
   testStep("STEP", "Set a BP in OS_UserStopScheduleTable for check if BP is reached in order to stop the main schedule table --> BP was set");
  debugger_waitUntilBPisReached("2000");
  ExpectedTestResult(debugger_result, W8_UNTIL_BP_SUCCESSFUL, "Breakpoint is reached");
  
   debugger_setRelativeFunctionBpAtLine("BswM_ProceedReset", "14");
  testStep("", "Run the debugger.");
  debugger_run();
   debugger_waitUntilBPisReached("2000");
   testStep("STEP", "Set a BP in function BswM_ProceedReset to check the interface --> BP was set");
  ExpectedTestResult(debugger_result, W8_UNTIL_BP_SUCCESSFUL, "Breakpoint is reached");
  
  testCaseComment("Action: ARCH_SW_BswMIf_ptrrOsServicesBswMIf_StartScheduleTable_BswM_ProceedReset");
  debugger_deleteAllBreakpoints();
   debugger_setRelativeFunctionBpAtLine("BswM_ProceedReset", "14");
  testStep("", "Reset the debugger.");
   debugger_reset();
  testStep("", "Run the debugger.");
  debugger_run();
  
  testStep("STEP", "Send diagnostic request in order to do hard Reset");
   SendDiagnosticRequest(dHardResetRequest, dHardResetResponse);
  
   debugger_waitUntilBPisReached("2000");
   testStep("STEP", "Set a BP in function BswM_ProceedReset in order to start the default schedule table --> BP was set");
  ExpectedTestResult(debugger_result, W8_UNTIL_BP_SUCCESSFUL, "Breakpoint is reached");
  
  debugger_setBpAtLine("C:\\Projects\\eCS_R1.2\\Tools\\Build_Env\\Workspace\\Outputs\\app\\Obj\\CORTEXM-user-startscheduletable.s", "53");
   testStep("", "Run the debugger.");
  debugger_run();
   testStep("STEP", "Set a BP in OS_UserStartScheduleTable for check if BP is reached in order to start the default schedule table --> BP was set");
  debugger_waitUntilBPisReached("2000");
  ExpectedTestResult(debugger_result, W8_UNTIL_BP_SUCCESSFUL, "Breakpoint is reached");
  
   debugger_setRelativeFunctionBpAtLine("BswM_ProceedReset", "15");
  testStep("", "Run the debugger.");
  debugger_run();
   debugger_waitUntilBPisReached("2000");
   testStep("STEP", "Set a BP in function BswM_ProceedReset to check the interface --> BP was set");
  ExpectedTestResult(debugger_result, W8_UNTIL_BP_SUCCESSFUL, "Breakpoint is reached");
  
  testCaseComment("Action: ARCH_SW_BswMIf_ptrrOsServicesBswMIf_WaitEvent_OsTask_Bsw_ReadWrite_AllProcess ");
  debugger_deleteAllBreakpoints();
  debugger_setBpAtLine("C:\\Projects\\eCS_R1.2\\Components\\Application\\Autoliv\\BswMIf\\Implementation\\src\\BswM_Callouts.c", "1849");
////   debugger_setRelativeFunctionBpAtLine("OsTask_Bsw_ReadWrite_AllProcess", "3");
  testStep("", "Reset the debugger.");
   debugger_reset();
  testStep("", "Run the debugger.");
  debugger_run();
   debugger_waitUntilBPisReached("2000");
   testStep("STEP", "Set a BP in OsTask_Bsw_ReadWrite_AllProcess in order to wait for ReadWrite Os task --> BP was set");
  ExpectedTestResult(debugger_result, W8_UNTIL_BP_SUCCESSFUL, "Breakpoint is reached");
  
  debugger_setBpAtLine("C:\\Projects\\eCS_R1.2\\Tools\\Build_Env\\Workspace\\Outputs\\app\\Obj\\CORTEXM-user-waitevent.s", "53");
   testStep("", "Run the debugger.");
  debugger_run();
   testStep("STEP", "Set a BP in OS_UserWaitEvent for check if BP is reached in order to wait for ReadWrite Os task --> BP was set");
  debugger_waitUntilBPisReached("2000");
  ExpectedTestResult(debugger_result, W8_UNTIL_BP_SUCCESSFUL, "Breakpoint is reached");
  
  debugger_setBpAtLine("C:\\Projects\\eCS_R1.2\\Components\\Application\\Autoliv\\BswMIf\\Implementation\\src\\BswM_Callouts.c", "1850");
////   debugger_setRelativeFunctionBpAtLine("OsTask_Bsw_ReadWrite_AllProcess", "4");
  testStep("", "Run the debugger.");
  debugger_run();
   debugger_waitUntilBPisReached("2000");
   testStep("STEP", "Set a BP in function OsTask_Bsw_ReadWrite_AllProcess to check the interface --> BP was set");
  ExpectedTestResult(debugger_result, W8_UNTIL_BP_SUCCESSFUL, "Breakpoint is reached");
  
  testCaseComment("Action: ARCH_SW_BswMIf_ptrrOsServicesBswMIf_ClearEvent_OsTask_Bsw_ReadWrite_AllProcess");
  debugger_deleteAllBreakpoints();
  debugger_setBpAtLine("C:\\Projects\\eCS_R1.2\\Components\\Application\\Autoliv\\BswMIf\\Implementation\\src\\BswM_Callouts.c", "1850");
////   debugger_setRelativeFunctionBpAtLine("OsTask_Bsw_ReadWrite_AllProcess", "4");
  testStep("", "Reset the debugger.");
   debugger_reset();
  testStep("", "Run the debugger.");
  debugger_run();
   debugger_waitUntilBPisReached("2000");
   testStep("STEP", "Set a BP in OsTask_Bsw_ReadWrite_AllProcess in order to clear ReadWrite Os task assigned event --> BP was set");
  ExpectedTestResult(debugger_result, W8_UNTIL_BP_SUCCESSFUL, "Breakpoint is reached");
  
  debugger_setBpAtLine("C:\\Projects\\eCS_R1.2\\Tools\\Build_Env\\Workspace\\Outputs\\app\\Obj\\CORTEXM-user-clearevent.s", "53");
   testStep("", "Run the debugger.");
  debugger_run();
   testStep("STEP", "Set a BP in OS_UserClearEvent for check if BP is reached in order to clear ReadWrite Os task assigned event --> BP was set");
  debugger_waitUntilBPisReached("2000");
  ExpectedTestResult(debugger_result, W8_UNTIL_BP_SUCCESSFUL, "Breakpoint is reached");
  
  debugger_setBpAtLine("C:\\Projects\\eCS_R1.2\\Components\\Application\\Autoliv\\BswMIf\\Implementation\\src\\BswM_Callouts.c", "1852");
////   debugger_setRelativeFunctionBpAtLine("OsTask_Bsw_ReadWrite_AllProcess", "4");
  testStep("", "Run the debugger.");
  debugger_run();
   debugger_waitUntilBPisReached("2000");
   testStep("STEP", "Set a BP in function OsTask_Bsw_ReadWrite_AllProcess to check the interface --> BP was set");
  ExpectedTestResult(debugger_result, W8_UNTIL_BP_SUCCESSFUL, "Breakpoint is reached");
 
  testCaseComment("Action: ARCH_SW_BswMIf_ptrrOsServicesBswMIf_SuspendAllInterrupts_OsTask_Bsw_ReadWrite_AllProcess");
  debugger_deleteAllBreakpoints();
  debugger_setBpAtLine("C:\\Projects\\eCS_R1.2\\Components\\Application\\Autoliv\\BswMIf\\Implementation\\src\\BswM_Callouts.c", "1852");
////   debugger_setRelativeFunctionBpAtLine("OsTask_Bsw_ReadWrite_AllProcess", "4");
  testStep("", "Reset the debugger.");
   debugger_reset();
  testStep("", "Run the debugger.");
  debugger_run();
   debugger_waitUntilBPisReached("2000");
   testStep("STEP", "Set a BP in OsTask_Bsw_ReadWrite_AllProcess in order to suspend all interrupts --> BP was set");
  ExpectedTestResult(debugger_result, W8_UNTIL_BP_SUCCESSFUL, "Breakpoint is reached");
  
//  debugger_setBpAtLine("C:\\Projects\\eCS_R1.2\\Tools\\EB_BSW_8.5.1\\Workspace\\plugins\\Os_TS_T40D2M6I0R0\\lib_src\\user\\lib-fastsuspendallinterrupts.c", "45");
  debugger_setRelativeFunctionBpAtLine("OS_FastSuspendAllInterrupts", "2"); 
  testStep("", "Run the debugger.");
  debugger_run();
   testStep("STEP", "Set a BP in function OS_FastSuspendAllInterrupts for check if BP is reached in order to suspend all interrupts --> BP was set");
  debugger_waitUntilBPisReached("2000");
  ExpectedTestResult(debugger_result, W8_UNTIL_BP_SUCCESSFUL, "Breakpoint is reached");
  
  debugger_setBpAtLine("C:\\Projects\\eCS_R1.2\\Components\\Application\\Autoliv\\BswMIf\\Implementation\\src\\BswM_Callouts.c", "1853");
////   debugger_setRelativeFunctionBpAtLine("OsTask_Bsw_ReadWrite_AllProcess", "4");
  testStep("", "Run the debugger.");
  debugger_run();
   debugger_waitUntilBPisReached("2000");
   testStep("STEP", "Set a BP in function OsTask_Bsw_ReadWrite_AllProcess to check the interface --> BP was set");
  ExpectedTestResult(debugger_result, W8_UNTIL_BP_SUCCESSFUL, "Breakpoint is reached");
  
   testCaseComment("Action: ARCH_SW_BswMIf_ptrrOsServicesBswMIf_ResumeAllInterrupts_OsTask_Bsw_ReadWrite_AllProcess");
  debugger_deleteAllBreakpoints();
  debugger_setBpAtLine("C:\\Projects\\eCS_R1.2\\Components\\Application\\Autoliv\\BswMIf\\Implementation\\src\\BswM_Callouts.c", "1859");
////   debugger_setRelativeFunctionBpAtLine("OsTask_Bsw_ReadWrite_AllProcess", "4");
  testStep("", "Reset the debugger.");
   debugger_reset();
  testStep("", "Run the debugger.");
  debugger_run();
   debugger_waitUntilBPisReached("2000");
   testStep("STEP", "Set a BP in OsTask_Bsw_ReadWrite_AllProcess in order to resume all interrupts --> BP was set");
  ExpectedTestResult(debugger_result, W8_UNTIL_BP_SUCCESSFUL, "Breakpoint is reached");
  
//  debugger_setBpAtLine("C:\\Projects\\eCS_R1.2\\Tools\\EB_BSW_8.5.1\\Workspace\\plugins\\Os_TS_T40D2M6I0R0\\lib_src\\user\\lib-fastsuspendallinterrupts.c", "45");
  debugger_setRelativeFunctionBpAtLine("OS_FastResumeAllInterrupts", "0"); 
  testStep("", "Run the debugger.");
  debugger_run();
   testStep("STEP", "Set a BP in function OS_FastSuspendAllInterrupts for check if BP is reached in order to resume all interrupts --> BP was set");
  debugger_waitUntilBPisReached("2000");
  ExpectedTestResult(debugger_result, W8_UNTIL_BP_SUCCESSFUL, "Breakpoint is reached");
  
  debugger_setBpAtLine("C:\\Projects\\eCS_R1.2\\Components\\Application\\Autoliv\\BswMIf\\Implementation\\src\\BswM_Callouts.c", "1861");
////   debugger_setRelativeFunctionBpAtLine("OsTask_Bsw_ReadWrite_AllProcess", "4");
  testStep("", "Run the debugger.");
  debugger_run();
   debugger_waitUntilBPisReached("2000");
   testStep("STEP", "Set a BP in function OsTask_Bsw_ReadWrite_AllProcess to check the interface --> BP was set");
  ExpectedTestResult(debugger_result, W8_UNTIL_BP_SUCCESSFUL, "Breakpoint is reached");
  
     testCaseComment("Action: ARCH_SW_BswMIf_ptrrOsServicesBswMIf_TerminateTask_OsTask_Bsw_ReadWrite_AllProcess ");
  debugger_deleteAllBreakpoints();
  debugger_setBpAtLine("C:\\Projects\\eCS_R1.2\\Components\\Application\\Autoliv\\BswMIf\\Implementation\\src\\BswM_Callouts.c", "1876");
////   debugger_setRelativeFunctionBpAtLine("OsTask_Bsw_ReadWrite_AllProcess", "4");
  testStep("", "Reset the debugger.");
   debugger_reset();
  testStep("", "Run the debugger.");
  debugger_run();
   debugger_waitUntilBPisReached("2000");
   testStep("STEP", "Set a BP in OsTask_Bsw_ReadWrite_AllProcess in order to terminate task when all blocks have been correctly managed --> BP was set");
  ExpectedTestResult(debugger_result, W8_UNTIL_BP_SUCCESSFUL, "Breakpoint is reached");
  
  debugger_setBpAtLine("C:\\Projects\\eCS_R1.2\\Tools\\Build_Env\\Workspace\\Outputs\\app\\Obj\\CORTEXM-user-terminatetask.s", "53");
//  debugger_setRelativeFunctionBpAtLine("OS_FastResumeAllInterrupts", "0"); 
  testStep("", "Run the debugger.");
  debugger_run();
   testStep("STEP", "Set a BP in OS_UserTerminateTask for check if BP is reached in order to terminate task when all blocks have been correctly managed --> BP was set");
  debugger_waitUntilBPisReached("2000");
  ExpectedTestResult(debugger_result, W8_UNTIL_BP_SUCCESSFUL, "Breakpoint is reached");
  
  testCaseComment("Action: ARCH_SW_BswMIf_ptrrOsServicesBswMIf_SetEvent_OsTask_Bsw_ReadWrite_AllProcess");
  debugger_deleteAllBreakpoints();
  debugger_setBpAtLine("C:\\Projects\\eCS_R1.2\\Components\\Application\\Autoliv\\BswMIf\\Implementation\\src\\BswM_Callouts.c", "1861");
//   debugger_setRelativeFunctionBpAtLine("OsTask_Bsw_ReadWrite_AllProcess", "15");
  testStep("", "Reset the debugger.");
   debugger_reset();
  testStep("", "Run the debugger.");
  debugger_run();
   debugger_waitUntilBPisReached("2000");
   testStep("STEP", "Set a BP in OsTask_Bsw_ReadWrite_AllProcess in order to set the event in OS task --> BP was set");
  ExpectedTestResult(debugger_result, W8_UNTIL_BP_SUCCESSFUL, "Breakpoint is reached");
  
  debugger_setBpAtLine("C:\\Projects\\eCS_R1.2\\Tools\\Build_Env\\Workspace\\Outputs\\app\\Obj\\CORTEXM-user-setevent.s", "53");
//  debugger_setRelativeFunctionBpAtLine("OS_FastResumeAllInterrupts", "0"); 
  testStep("", "Run the debugger.");
  debugger_run();
   testStep("STEP", "Set a BP in OS_UserSetEvent for check if BP is reached in order to set the event in OS task --> BP was set");
  debugger_waitUntilBPisReached("2000");
  ExpectedTestResult(debugger_result, W8_UNTIL_BP_SUCCESSFUL, "Breakpoint is reached");
  
  debugger_setBpAtLine("C:\\Projects\\eCS_R1.2\\Components\\Application\\Autoliv\\BswMIf\\Implementation\\src\\BswM_Callouts.c", "1865");
//   debugger_setRelativeFunctionBpAtLine("OsTask_Bsw_ReadWrite_AllProcess", "19");
  testStep("", "Run the debugger.");
  debugger_run();
   debugger_waitUntilBPisReached("2000");
   testStep("STEP", "Set a BP in function OsTask_Bsw_ReadWrite_AllProcess to check the interface --> BP was set");
  ExpectedTestResult(debugger_result, W8_UNTIL_BP_SUCCESSFUL, "Breakpoint is reached");
  
    testCaseComment("Action: ARCH_SW_BswMIf_ptrrOsServicesBswMIf_StartScheduleTableRel_BswM_On_Prep_Shutdown");
  debugger_deleteAllBreakpoints();
   debugger_setRelativeFunctionBpAtLine("BswM_ProceedReset", "6");
  testStep("", "Reset the debugger.");
   debugger_reset();
  testStep("", "Run the debugger.");
  debugger_run();
  
  testStep("STEP", "Send diagnostic request in order to do soft Reset");
   SendDiagnosticRequest(dSoftResetRequest, dSoftResetResponse);
  
   debugger_waitUntilBPisReached("2000");
   testStep("STEP", "Set a BP in function BswM_ProceedReset in order to call BswM_On_Prep_Shutdown and to start the default schedule table after main schedule table (RTE) was stopped --> BP was set");
  ExpectedTestResult(debugger_result, W8_UNTIL_BP_SUCCESSFUL, "Breakpoint is reached");
  
  debugger_setBpAtLine("C:\\Projects\\eCS_R1.2\\Tools\\Build_Env\\Workspace\\Outputs\\app\\Obj\\CORTEXM-user-startscheduletable.s", "53");
//  debugger_setRelativeFunctionBpAtLine("OS_FastResumeAllInterrupts", "0"); 
  testStep("", "Run the debugger.");
  debugger_run();
   testStep("STEP", "Set a BP in OS_UserStartScheduleTable for check if BP is reached in order to start the default schedule table after main schedule table (RTE) was stopped --> BP was set");
  debugger_waitUntilBPisReached("2000");
  ExpectedTestResult(debugger_result, W8_UNTIL_BP_SUCCESSFUL, "Breakpoint is reached");
  
  debugger_setRelativeFunctionBpAtLine("BswM_CB_NfyNvMJobEnd", "58");
   testStep("", "Run the debugger.");
  debugger_run();
   testStep("STEP", "Set a BP in function BswM_CB_NfyNvMJobEnd for check the interface --> BP was set");
  debugger_waitUntilBPisReached("2000");
  ExpectedTestResult(debugger_result, W8_UNTIL_BP_SUCCESSFUL, "Breakpoint is reached");
  
   testCaseComment("Action: ARCH_SW_BswMIf_ptrrOsServicesBswMIf_SetEvent_BswM_OnPostRunFromRun");
  debugger_deleteAllBreakpoints();
   debugger_setRelativeFunctionBpAtLine("BswM_OnPostRunFromRun", "20");
  testStep("", "Reset the debugger.");
   debugger_reset();
  testStep("", "Run the debugger.");
  debugger_run();
  testStep("STEP", "Disable comunication --> Comunication disable");
   TestDisableMsg(Airbag_01);
  TestDisableMsg(Airbag_02);
  TestDisableMsg(Airbag_eCS_01);
   TestWaitForTimeout(5000);
   debugger_waitUntilBPisReached("2000");
   testStep("STEP", "Set a BP in function BswM_OnPostRunFromRun in order to Activate the event dedicated to the OsTask_Bsw_ReadWrite_AllProcess --> BP was set");
  ExpectedTestResult(debugger_result, W8_UNTIL_BP_SUCCESSFUL, "Breakpoint is reached");

  debugger_setBpAtLine("C:\\Projects\\eCS_R1.2\\Tools\\Build_Env\\Workspace\\Outputs\\app\\Obj\\CORTEXM-user-setevent.s", "53");
   testStep("", "Run the debugger.");
  debugger_run();
   testStep("STEP", "Set a BP in OS_UserSetEvent to ckeck if BP is reached in order to set the task dedicated to the WriteAll process fastening --> BP was set");
  debugger_waitUntilBPisReached("2000");
  ExpectedTestResult(debugger_result, W8_UNTIL_BP_SUCCESSFUL, "Breakpoint is reached");
  
  debugger_setRelativeFunctionBpAtLine("BswM_OnPostRunFromRun", "23");
   testStep("", "Run the debugger.");
  debugger_run();
   testStep("STEP", "Set a BP in function BswM_OnStartupTwoA for check the interface --> BP was set");
  debugger_waitUntilBPisReached("2000");
  ExpectedTestResult(debugger_result, W8_UNTIL_BP_SUCCESSFUL, "Breakpoint is reached");
   
  testStep("STEP", "Enable comunication --> Comunication enable");
   TestSetMsgEvent(Airbag_01);
  TestSetMsgEvent(Airbag_02);
  TestSetMsgEvent(Airbag_eCS_01);
   TestWaitForTimeout(5000);
  
  //====================================================
  testCaseComment("Postcondition");
  testStep("STEP", "Return ECU to default values");
  RunPostTs();
}
testcase Sw_Int_BswMIf_ptrrAsrPduRServicesBswMIf_01()
{
   /*-------------------------Test specific report info------------------------------*/
  
  testReportAddMiscInfoBlock("AUTOLIV ELECTRONICS document");
  TestReportAddMiscInfo("Nightly test", "No");
  TestReportAddMiscInfo("Test type", "Requirement-Based");
  TestReportAddMiscInfo("Regression Test", "No");
  TestReportAddMiscInfo("Fault injection method used", "No");
  TestReportAddMiscInfo("Resource usage evaluation", "No");
  TestReportAddMiscInfo("Priority", "No");
  TestReportAddMiscInfo("Safety relevant", "No");
  
  AddRequirementInfo("Requirement under test", "ARCH_SW_BswMIf_ptrrPduRServicesBswMIf_PduR_Init_BswM_OnStartupTwoA");
  AddRequirementInfo("ARCH_SW_BswMIf_ptrrPduRServicesBswMIf_PduR_Init_BswM_OnStartupTwoA", "The PduR_Init runnable shall be called in the BswM_OnStartupTwoA runnable in order to initialize the PduR module.");
  //***************************************************************************************
  testCaseComment("Preconditions");
  testStep("STEP", "Bench Initialization"); // If the first parameter of testStep() is "Step", the arguments will be written in the specification file and "Step" argument will be numbered by 1 for each iteration.
  RunPreTs();
//   /*------------------------- Test scenario start ------------------------------*/
   
  testCaseComment("Action: ARCH_SW_BswMIf_ptrrPduRServicesBswMIf_PduR_Init_BswM_OnStartupTwoA");
  debugger_setRelativeFunctionBpAtLine("BswM_OnStartupTwoA", "7");
   testStep("", "Reset the debugger.");
  debugger_reset(); 
   testStep("", "Run the debugger.");
  debugger_run();
   testStep("STEP", "Set a BP in function BswM_OnStartupTwoA in order to initialize the PduR module  --> BP was set");
  debugger_waitUntilBPisReached("2000");
  ExpectedTestResult(debugger_result, W8_UNTIL_BP_SUCCESSFUL, "Breakpoint is reached");

    debugger_setBpAtLine("C:\\Projects\\eCS_R1.2\\Tools\\EB_BSW_8.5.1\\Workspace\\plugins\\PduR_TS_TxDxM5I3R0\\src\\PduR_Init.c", "213");
//   debugger_setRelativeFunctionBpAtLine("PduR_Init", "0");
   testStep("", "Run the debugger.");
  debugger_run();
   testStep("STEP", "Set a BP in function PduR_Init for check if interface work --> BP was set");
  debugger_waitUntilBPisReached("2000");
  ExpectedTestResult(debugger_result, W8_UNTIL_BP_SUCCESSFUL, "Breakpoint is reached");
    
  debugger_setRelativeFunctionBpAtLine("BswM_OnStartupTwoA", "8");
   testStep("", "Run the debugger.");
  debugger_run();
   testStep("STEP", "Set a BP in function BswM_OnStartupTwoA for check the interface --> BP was set");
  debugger_waitUntilBPisReached("2000");
  ExpectedTestResult(debugger_result, W8_UNTIL_BP_SUCCESSFUL, "Breakpoint is reached");
  
  //====================================================
  testCaseComment("Postcondition");
  testStep("STEP", "Return ECU to default values");
  RunPostTs();
}
testcase Sw_Int_BswMIf_ptrrAsrRteServicesBswMIf_01()
{
   /*-------------------------Test specific report info------------------------------*/
  
  testReportAddMiscInfoBlock("AUTOLIV ELECTRONICS document");
  TestReportAddMiscInfo("Nightly test", "No");
  TestReportAddMiscInfo("Test type", "Requirement-Based");
  TestReportAddMiscInfo("Regression Test", "No");
  TestReportAddMiscInfo("Fault injection method used", "No");
  TestReportAddMiscInfo("Resource usage evaluation", "No");
  TestReportAddMiscInfo("Priority", "No");
  TestReportAddMiscInfo("Safety relevant", "No");
  
  AddRequirementInfo("Requirement under test", "ARCH_SW_BswMIf_ptrrRteServicesBswMIf_Rte_Start_BswM_OnStartComEffective, ARCH_SW_BswMIf_ptrrRteServicesBswMIf_Rte_Stop_BswM_On_Prep_Shutdown");
  AddRequirementInfo("ARCH_SW_BswMIf_ptrrRteServicesBswMIf_Rte_Start_BswM_OnStartComEffective", "The Rte_Start runnable shall be called in the BswM_OnStartComEffective runnable in order to start RTE services");
  AddRequirementInfo("ARCH_SW_BswMIf_ptrrRteServicesBswMIf_Rte_Stop_BswM_On_Prep_Shutdown", "The Rte_Stop runnable shall be called in the BswM_On_Prep_Shutdown runnable in order to stop RTE services");
  //***************************************************************************************
  testCaseComment("Preconditions");
  testStep("STEP", "Bench Initialization"); // If the first parameter of testStep() is "Step", the arguments will be written in the specification file and "Step" argument will be numbered by 1 for each iteration.
  RunPreTs();
//   /*------------------------- Test scenario start ------------------------------*/
   
  testCaseComment("Action: ARCH_SW_BswMIf_ptrrRteServicesBswMIf_Rte_Start_BswM_OnStartComEffective");
  debugger_setRelativeFunctionBpAtLine("BswM_OnStartComEffective", "8");
   testStep("", "Reset the debugger.");
  debugger_reset(); 
   testStep("", "Run the debugger.");
  debugger_run();
   testStep("STEP", "Set a BP in function BswM_OnStartComEffective in order to start RTE services--> BP was set");
  debugger_waitUntilBPisReached("2000");
  ExpectedTestResult(debugger_result, W8_UNTIL_BP_SUCCESSFUL, "Breakpoint is reached");

//   debugger_setBpAtLine("C:\\Projects\\eCS_R1.2\\Tools\\EB_BSW_8.5.1\\Workspace\\plugins\\PduR_TS_TxDxM5I3R0\\src\\PduR_Init.c", "213");
  debugger_setRelativeFunctionBpAtLine("Rte_Start", "1");
   testStep("", "Run the debugger.");
  debugger_run();
   testStep("STEP", "Set a BP in function Rte_Start for check if interface work --> BP was set");
  debugger_waitUntilBPisReached("2000");
  ExpectedTestResult(debugger_result, W8_UNTIL_BP_SUCCESSFUL, "Breakpoint is reached");
    
  debugger_setRelativeFunctionBpAtLine("BswM_OnStartComEffective", "11");
   testStep("", "Run the debugger.");
  debugger_run();
   testStep("STEP", "Set a BP in function BswM_OnStartComEffective for check the interface --> BP was set");
  debugger_waitUntilBPisReached("2000");
  ExpectedTestResult(debugger_result, W8_UNTIL_BP_SUCCESSFUL, "Breakpoint is reached");
  
  testCaseComment("Action: ARCH_SW_BswMIf_ptrrRteServicesBswMIf_Rte_Stop_BswM_On_Prep_Shutdown");
  debugger_deleteAllBreakpoints();
   debugger_setRelativeFunctionBpAtLine("BswM_ProceedReset", "6");
  testStep("", "Reset the debugger.");
   debugger_reset();
  testStep("", "Run the debugger.");
  debugger_run();
  
  testStep("STEP", "Send diagnostic request in order to do soft Reset");
   SendDiagnosticRequest(dSoftResetRequest, dSoftResetResponse);
  
   debugger_waitUntilBPisReached("2000");
   testStep("STEP", "Set a BP in function BswM_ProceedReset in order to call BswM_On_Prep_Shutdown and to stop RTE services  --> BP was set");
  ExpectedTestResult(debugger_result, W8_UNTIL_BP_SUCCESSFUL, "Breakpoint is reached");
  
   debugger_setRelativeFunctionBpAtLine("Rte_Stop", "1");
   testStep("", "Run the debugger.");
  debugger_run();
   testStep("STEP", "Set a BP in Rte_Stop for check if BP is reached in order to stop RTE services --> BP was set");
  debugger_waitUntilBPisReached("2000");
  ExpectedTestResult(debugger_result, W8_UNTIL_BP_SUCCESSFUL, "Breakpoint is reached");
  
  debugger_setRelativeFunctionBpAtLine("BswM_CB_NfyNvMJobEnd", "58");
   testStep("", "Run the debugger.");
  debugger_run();
   testStep("STEP", "Set a BP in function BswM_CB_NfyNvMJobEnd for check the interface --> BP was set");
  debugger_waitUntilBPisReached("2000");
  ExpectedTestResult(debugger_result, W8_UNTIL_BP_SUCCESSFUL, "Breakpoint is reached");
    
  //====================================================
  testCaseComment("Postcondition");
  testStep("STEP", "Return ECU to default values");
  RunPostTs();
}
testcase Sw_Int_BswMIf_ptrrAtmServicesBswMIf_01()
{
   /*-------------------------Test specific report info------------------------------*/
  
  testReportAddMiscInfoBlock("AUTOLIV ELECTRONICS document");
  TestReportAddMiscInfo("Nightly test", "No");
  TestReportAddMiscInfo("Test type", "Requirement-Based");
  TestReportAddMiscInfo("Regression Test", "No");
  TestReportAddMiscInfo("Fault injection method used", "No");
  TestReportAddMiscInfo("Resource usage evaluation", "No");
  TestReportAddMiscInfo("Priority", "No");
  TestReportAddMiscInfo("Safety relevant", "No");
  
  AddRequirementInfo("Requirement under test", "ARCH_SW_BswMIf_ptrrAtmServicesBswMIf_ATM_Init_BswM_OnStartComEffective");
  AddRequirementInfo("ARCH_SW_BswMIf_ptrrAtmServicesBswMIf_ATM_Init_BswM_OnStartComEffective", " The ATM_Init runnable shall be called in the BswM_OnStartComEffective runnable in order to initialize ATM module");
  //***************************************************************************************
  testCaseComment("Preconditions");
  testStep("STEP", "Bench Initialization"); // If the first parameter of testStep() is "Step", the arguments will be written in the specification file and "Step" argument will be numbered by 1 for each iteration.
  RunPreTs();
//   /*------------------------- Test scenario start ------------------------------*/
   
  testCaseComment("Action: ARCH_SW_BswMIf_ptrrAtmServicesBswMIf_ATM_Init_BswM_OnStartComEffective");
  debugger_setRelativeFunctionBpAtLine("BswM_OnStartComEffective", "14");
   testStep("", "Reset the debugger.");
  debugger_reset(); 
   testStep("", "Run the debugger.");
  debugger_run();
   testStep("STEP", "Set a BP in function BswM_OnStartComEffective in order to initialize ATM module--> BP was set");
  debugger_waitUntilBPisReached("2000");
  ExpectedTestResult(debugger_result, W8_UNTIL_BP_SUCCESSFUL, "Breakpoint is reached");

//   debugger_setBpAtLine("C:\\Projects\\eCS_R1.2\\Tools\\EB_BSW_8.5.1\\Workspace\\plugins\\PduR_TS_TxDxM5I3R0\\src\\PduR_Init.c", "213");
  debugger_setRelativeFunctionBpAtLine("ATM_Init", "12");
   testStep("", "Run the debugger.");
  debugger_run();
   testStep("STEP", "Set a BP in function ATM_Init for check if interface work --> BP was set");
  debugger_waitUntilBPisReached("2000");
  ExpectedTestResult(debugger_result, W8_UNTIL_BP_SUCCESSFUL, "Breakpoint is reached");
    
  debugger_setRelativeFunctionBpAtLine("BswM_OnStartComEffective", "15");
   testStep("", "Run the debugger.");
  debugger_run();
   testStep("STEP", "Set a BP in function BswM_OnStartComEffective for check the interface --> BP was set");
  debugger_waitUntilBPisReached("2000");
  ExpectedTestResult(debugger_result, W8_UNTIL_BP_SUCCESSFUL, "Breakpoint is reached");
  
  //====================================================
  testCaseComment("Postcondition");
  testStep("STEP", "Return ECU to default values");
  RunPostTs();
}
testcase Sw_Int_BswMIf_ptrrCilServicesBswMIf_01()
{
   /*-------------------------Test specific report info------------------------------*/
  
  testReportAddMiscInfoBlock("AUTOLIV ELECTRONICS document");
  TestReportAddMiscInfo("Nightly test", "No");
  TestReportAddMiscInfo("Test type", "Requirement-Based");
  TestReportAddMiscInfo("Regression Test", "No");
  TestReportAddMiscInfo("Fault injection method used", "No");
  TestReportAddMiscInfo("Resource usage evaluation", "No");
  TestReportAddMiscInfo("Priority", "No");
  TestReportAddMiscInfo("Safety relevant", "No");
  
  AddRequirementInfo("Requirement under test", "ARCH_SW_BswMIf_ptrrCilServicesBswMIf_CIL_runInit_BswM_OnStartComEffective");
  AddRequirementInfo("ARCH_SW_BswMIf_ptrrCilServicesBswMIf_CIL_runInit_BswM_OnStartComEffective", " The CIL_runInit runnable shall be called in the BswM_OnStartComEffective runnable in order to initialize CIL module");
  //***************************************************************************************
  testCaseComment("Preconditions");
  testStep("STEP", "Bench Initialization"); // If the first parameter of testStep() is "Step", the arguments will be written in the specification file and "Step" argument will be numbered by 1 for each iteration.
  RunPreTs();
//   /*------------------------- Test scenario start ------------------------------*/
   //NU ARE NIMIC IN FUNCTIA DE CIL
  testCaseComment("Action: ARCH_SW_BswMIf_ptrrCilServicesBswMIf_CIL_runInit_BswM_OnStartComEffective");
  debugger_setRelativeFunctionBpAtLine("BswM_OnStartComEffective", "16");
   testStep("", "Reset the debugger.");
  debugger_reset(); 
   testStep("", "Run the debugger.");
  debugger_run();
   testStep("STEP", "Set a BP in function BswM_OnStartComEffective in order to initialize CIL module--> BP was set");
  debugger_waitUntilBPisReached("2000");
  ExpectedTestResult(debugger_result, W8_UNTIL_BP_SUCCESSFUL, "Breakpoint is reached");

//   debugger_setBpAtLine("C:\\Projects\\eCS_R1.2\\Tools\\EB_BSW_8.5.1\\Workspace\\plugins\\PduR_TS_TxDxM5I3R0\\src\\PduR_Init.c", "213");
  debugger_setRelativeFunctionBpAtLine("CIL_runInit", "0");
   testStep("", "Run the debugger.");
  debugger_run();
   testStep("STEP", "Set a BP in function CIL_runInit for check if interface work --> BP was set");
  debugger_waitUntilBPisReached("2000");
  ExpectedTestResult(debugger_result, W8_UNTIL_BP_SUCCESSFUL, "Breakpoint is reached");
    
  debugger_setRelativeFunctionBpAtLine("BswM_OnStartComEffective", "17");
   testStep("", "Run the debugger.");
  debugger_run();
   testStep("STEP", "Set a BP in function BswM_OnStartComEffective for check the interface --> BP was set");
  debugger_waitUntilBPisReached("2000");
  ExpectedTestResult(debugger_result, W8_UNTIL_BP_SUCCESSFUL, "Breakpoint is reached");
  
  //====================================================
  testCaseComment("Postcondition");
  testStep("STEP", "Return ECU to default values");
  RunPostTs();
}
testcase Sw_Int_BswMIf_ptrrDiaServicesBswMIf_01()
{
   /*-------------------------Test specific report info------------------------------*/
  
  testReportAddMiscInfoBlock("AUTOLIV ELECTRONICS document");
  TestReportAddMiscInfo("Nightly test", "No");
  TestReportAddMiscInfo("Test type", "Requirement-Based");
  TestReportAddMiscInfo("Regression Test", "No");
  TestReportAddMiscInfo("Fault injection method used", "No");
  TestReportAddMiscInfo("Resource usage evaluation", "No");
  TestReportAddMiscInfo("Priority", "No");
  TestReportAddMiscInfo("Safety relevant", "No");
  
  AddRequirementInfo("Requirement under test", "ARCH_SW_BswMIf_ptrrDiaServicesBswMIf_DIA_Init_BswM_OnStartComEffective");
  AddRequirementInfo("ARCH_SW_BswMIf_ptrrDiaServicesBswMIf_DIA_Init_BswM_OnStartComEffective", "The DIA_Init runnable shall be called in the BswM_OnStartComEffective runnable in order to initialize DIA module to be able to manage diagnostic requests.");
  //***************************************************************************************
  testCaseComment("Preconditions");
  testStep("STEP", "Bench Initialization"); // If the first parameter of testStep() is "Step", the arguments will be written in the specification file and "Step" argument will be numbered by 1 for each iteration.
  RunPreTs();
//   /*------------------------- Test scenario start ------------------------------*/
  
   testCaseComment("Action: ARCH_SW_BswMIf_ptrrDiaServicesBswMIf_DIA_Init_BswM_OnStartComEffective");
  debugger_setRelativeFunctionBpAtLine("BswM_OnStartComEffective", "17");
   testStep("", "Reset the debugger.");
  debugger_reset(); 
   testStep("", "Run the debugger.");
  debugger_run();
   testStep("STEP", "Set a BP in function BswM_OnStartComEffective in order to  initialize DIA module to be able to manage diagnostic requests --> BP was set");
  debugger_waitUntilBPisReached("2000");
  ExpectedTestResult(debugger_result, W8_UNTIL_BP_SUCCESSFUL, "Breakpoint is reached");

//   debugger_setBpAtLine("C:\\Projects\\eCS_R1.2\\Tools\\EB_BSW_8.5.1\\Workspace\\plugins\\PduR_TS_TxDxM5I3R0\\src\\PduR_Init.c", "213");
  debugger_setRelativeFunctionBpAtLine("DIA_Init", "2");
   testStep("", "Run the debugger.");
  debugger_run();
   testStep("STEP", "Set a BP in function DIA_Init for check if interface work --> BP was set");
  debugger_waitUntilBPisReached("2000");
  ExpectedTestResult(debugger_result, W8_UNTIL_BP_SUCCESSFUL, "Breakpoint is reached");
    
  debugger_setRelativeFunctionBpAtLine("BswM_OnStartComEffective", "18");
   testStep("", "Run the debugger.");
  debugger_run();
   testStep("STEP", "Set a BP in function BswM_OnStartComEffective for check the interface --> BP was set");
  debugger_waitUntilBPisReached("2000");
  ExpectedTestResult(debugger_result, W8_UNTIL_BP_SUCCESSFUL, "Breakpoint is reached");
  
  //====================================================
  testCaseComment("Postcondition");
  testStep("STEP", "Return ECU to default values");
  RunPostTs();
}
testcase Sw_Int_BswMIf_ptrrFsmServicesBswMIf_01()
{
   /*-------------------------Test specific report info------------------------------*/
  
  testReportAddMiscInfoBlock("AUTOLIV ELECTRONICS document");
  TestReportAddMiscInfo("Nightly test", "No");
  TestReportAddMiscInfo("Test type", "Requirement-Based");
  TestReportAddMiscInfo("Regression Test", "No");
  TestReportAddMiscInfo("Fault injection method used", "No");
  TestReportAddMiscInfo("Resource usage evaluation", "No");
  TestReportAddMiscInfo("Priority", "No");
  TestReportAddMiscInfo("Safety relevant", "No");
  
  AddRequirementInfo("Requirement under test", "ARCH_SW_BswMIf_ptrrFsmServicesBswMIf_FSM_ModesInit_BswM_OnStartComEffective");
  AddRequirementInfo("ARCH_SW_BswMIf_ptrrFsmServicesBswMIf_FSM_ModesInit_BswM_OnStartComEffective", "The FSM_ModesInit runnable shall be called in the BswM_OnStartComEffective runnable in order to initialize FSM context modes module");
  //***************************************************************************************
  testCaseComment("Preconditions");
  testStep("STEP", "Bench Initialization"); // If the first parameter of testStep() is "Step", the arguments will be written in the specification file and "Step" argument will be numbered by 1 for each iteration.
  RunPreTs();
//   /*------------------------- Test scenario start ------------------------------*/
  
   testCaseComment("Action: ARCH_SW_BswMIf_ptrrFsmServicesBswMIf_FSM_ModesInit_BswM_OnStartComEffective");
  debugger_setRelativeFunctionBpAtLine("BswM_OnStartComEffective", "15");
   testStep("", "Reset the debugger.");
  debugger_reset(); 
   testStep("", "Run the debugger.");
  debugger_run();
   testStep("STEP", "Set a BP in function BswM_OnStartComEffective in order to initialize FSM context modes module --> BP was set");
  debugger_waitUntilBPisReached("2000");
  ExpectedTestResult(debugger_result, W8_UNTIL_BP_SUCCESSFUL, "Breakpoint is reached");

//   debugger_setBpAtLine("C:\\Projects\\eCS_R1.2\\Tools\\EB_BSW_8.5.1\\Workspace\\plugins\\PduR_TS_TxDxM5I3R0\\src\\PduR_Init.c", "213");
  debugger_setRelativeFunctionBpAtLine("FSM_ModesInit", "0");
   testStep("", "Run the debugger.");
  debugger_run();
   testStep("STEP", "Set a BP in function FSM_ModesInit for check if interface work --> BP was set");
  debugger_waitUntilBPisReached("2000");
  ExpectedTestResult(debugger_result, W8_UNTIL_BP_SUCCESSFUL, "Breakpoint is reached");
    
  debugger_setRelativeFunctionBpAtLine("BswM_OnStartComEffective", "16");
   testStep("", "Run the debugger.");
  debugger_run();
   testStep("STEP", "Set a BP in function BswM_OnStartComEffective for check the interface --> BP was set");
  debugger_waitUntilBPisReached("2000");
  ExpectedTestResult(debugger_result, W8_UNTIL_BP_SUCCESSFUL, "Breakpoint is reached");
  
  //====================================================
  testCaseComment("Postcondition");
  testStep("STEP", "Return ECU to default values");
  RunPostTs();
}
testcase Sw_Int_BswMIf_ptrrSadServicesBswMIf_01()
{
   /*-------------------------Test specific report info------------------------------*/
  
  testReportAddMiscInfoBlock("AUTOLIV ELECTRONICS document");
  TestReportAddMiscInfo("Nightly test", "No");
  TestReportAddMiscInfo("Test type", "Requirement-Based");
  TestReportAddMiscInfo("Regression Test", "No");
  TestReportAddMiscInfo("Fault injection method used", "No");
  TestReportAddMiscInfo("Resource usage evaluation", "No");
  TestReportAddMiscInfo("Priority", "No");
  TestReportAddMiscInfo("Safety relevant", "No");
  
  AddRequirementInfo("Requirement under test", "ARCH_SW_BswMIf_ptrrSadServicesBswMIf_SAD_Init_BswM_OnStartComEffective");
  AddRequirementInfo("ARCH_SW_BswMIf_ptrrSadServicesBswMIf_SAD_Init_BswM_OnStartComEffective", "The SAD_Init runnable shall be called in the BswM_OnStartComEffective runnable in order to initialize SAD module");
  //***************************************************************************************
  testCaseComment("Preconditions");
  testStep("STEP", "Bench Initialization"); // If the first parameter of testStep() is "Step", the arguments will be written in the specification file and "Step" argument will be numbered by 1 for each iteration.
  RunPreTs();
//   /*------------------------- Test scenario start ------------------------------*/
  
   testCaseComment("Action: ARCH_SW_BswMIf_ptrrSadServicesBswMIf_SAD_Init_BswM_OnStartComEffective");
  debugger_setRelativeFunctionBpAtLine("BswM_OnStartComEffective", "18");
   testStep("", "Reset the debugger.");
  debugger_reset(); 
   testStep("", "Run the debugger.");
  debugger_run();
   testStep("STEP", "Set a BP in function BswM_OnStartComEffective in order to to initialize SAD module --> BP was set");
  debugger_waitUntilBPisReached("2000");
  ExpectedTestResult(debugger_result, W8_UNTIL_BP_SUCCESSFUL, "Breakpoint is reached");

//   debugger_setBpAtLine("C:\\Projects\\eCS_R1.2\\Tools\\EB_BSW_8.5.1\\Workspace\\plugins\\PduR_TS_TxDxM5I3R0\\src\\PduR_Init.c", "213");
  debugger_setRelativeFunctionBpAtLine("SAD_Init", "4");
   testStep("", "Run the debugger.");
  debugger_run();
   testStep("STEP", "Set a BP in function SAD_Init for check if interface work --> BP was set");
  debugger_waitUntilBPisReached("2000");
  ExpectedTestResult(debugger_result, W8_UNTIL_BP_SUCCESSFUL, "Breakpoint is reached");
    
  debugger_setRelativeFunctionBpAtLine("BswM_OnStartComEffective", "21");
   testStep("", "Run the debugger.");
  debugger_run();
   testStep("STEP", "Set a BP in function BswM_OnStartComEffective for check the interface --> BP was set");
  debugger_waitUntilBPisReached("2000");
  ExpectedTestResult(debugger_result, W8_UNTIL_BP_SUCCESSFUL, "Breakpoint is reached");
  
  //====================================================
  testCaseComment("Postcondition");
  testStep("STEP", "Return ECU to default values");
  RunPostTs();
}
testcase Sw_Int_BswMIf_ptrrRcmServicesBswMIf_01()
{
   /*-------------------------Test specific report info------------------------------*/
  
  testReportAddMiscInfoBlock("AUTOLIV ELECTRONICS document");
  TestReportAddMiscInfo("Nightly test", "No");
  TestReportAddMiscInfo("Test type", "Requirement-Based");
  TestReportAddMiscInfo("Regression Test", "No");
  TestReportAddMiscInfo("Fault injection method used", "No");
  TestReportAddMiscInfo("Resource usage evaluation", "No");
  TestReportAddMiscInfo("Priority", "No");
  TestReportAddMiscInfo("Safety relevant", "No");
  
  AddRequirementInfo("Requirement under test", "ARCH_SW_BswMIf_ptrrRcmServicesBswMIf_RCM_runDetermineResetCause_BswM_OnStartComEffective, ARCH_SW_BswMIf_ptrrRcmServicesBswMIf_RCM_runConfirmResetCause_BswM_OnStartComEffective, ARCH_SW_BswMIf_ptrrRcmServicesBswMIf_RCM_runGetResetCause_BswM_OnStartupTwoB");
  AddRequirementInfo("ARCH_SW_BswMIf_ptrrRcmServicesBswMIf_RCM_runDetermineResetCause_BswM_OnStartComEffective", "The RCM_runDetermineResetCause runnable shall be called in the BswM_OnStartComEffective runnable in order to determine the current reset cause");
  AddRequirementInfo("ARCH_SW_BswMIf_ptrrRcmServicesBswMIf_RCM_runConfirmResetCause_BswM_OnStartComEffective", "The RCM_runConfirmResetCause runnable shall be called in the BswM_OnStartComEffective runnable in order to confirm the detected reset cause");
  AddRequirementInfo("ARCH_SW_BswMIf_ptrrRcmServicesBswMIf_RCM_runGetResetCause_BswM_OnStartupTwoB", "The RCM_runGetResetCause runnable shall be called in the BswM_OnStartupTwoB runnable in order to check if a valid wake up event was detected");
  //***************************************************************************************
  testCaseComment("Preconditions");
  testStep("STEP", "Bench Initialization"); // If the first parameter of testStep() is "Step", the arguments will be written in the specification file and "Step" argument will be numbered by 1 for each iteration.
  RunPreTs();
//   /*------------------------- Test scenario start ------------------------------*/
  
   testCaseComment("Action: ARCH_SW_BswMIf_ptrrRcmServicesBswMIf_RCM_runDetermineResetCause_BswM_OnStartComEffective");
  debugger_setRelativeFunctionBpAtLine("BswM_OnStartComEffective", "21");
   testStep("", "Reset the debugger.");
  debugger_reset(); 
   testStep("", "Run the debugger.");
  debugger_run();
   testStep("STEP", "Set a BP in function BswM_OnStartComEffective  in order to determine the current reset cause --> BP was set");
  debugger_waitUntilBPisReached("2000");
  ExpectedTestResult(debugger_result, W8_UNTIL_BP_SUCCESSFUL, "Breakpoint is reached");

//   debugger_setBpAtLine("C:\\Projects\\eCS_R1.2\\Tools\\EB_BSW_8.5.1\\Workspace\\plugins\\PduR_TS_TxDxM5I3R0\\src\\PduR_Init.c", "213");
  debugger_setRelativeFunctionBpAtLine("RCM_runDetermineResetCause", "6");
   testStep("", "Run the debugger.");
  debugger_run();
   testStep("STEP", "Set a BP in function RCM_runDetermineResetCause for check if interface work --> BP was set");
  debugger_waitUntilBPisReached("2000");
  ExpectedTestResult(debugger_result, W8_UNTIL_BP_SUCCESSFUL, "Breakpoint is reached");
    
  debugger_setRelativeFunctionBpAtLine("BswM_OnStartComEffective", "22");
   testStep("", "Run the debugger.");
  debugger_run();
   testStep("STEP", "Set a BP in function BswM_OnStartComEffective for check the interface --> BP was set");
  debugger_waitUntilBPisReached("2000");
  ExpectedTestResult(debugger_result, W8_UNTIL_BP_SUCCESSFUL, "Breakpoint is reached");
  
   testCaseComment("Action: ARCH_SW_BswMIf_ptrrRcmServicesBswMIf_RCM_runConfirmResetCause_BswM_OnStartComEffective");
  debugger_deleteAllBreakpoints();
  debugger_setRelativeFunctionBpAtLine("BswM_OnStartComEffective", "22");
   testStep("", "Reset the debugger.");
  debugger_reset(); 
   testStep("", "Run the debugger.");
  debugger_run();
   testStep("STEP", "Set a BP in function BswM_OnStartComEffective in order to confirm the detected reset cause --> BP was set");
  debugger_waitUntilBPisReached("2000");
  ExpectedTestResult(debugger_result, W8_UNTIL_BP_SUCCESSFUL, "Breakpoint is reached");

//   debugger_setBpAtLine("C:\\Projects\\eCS_R1.2\\Tools\\EB_BSW_8.5.1\\Workspace\\plugins\\PduR_TS_TxDxM5I3R0\\src\\PduR_Init.c", "213");
  debugger_setRelativeFunctionBpAtLine("RCM_runConfirmResetCause", "0");
   testStep("", "Run the debugger.");
  debugger_run();
   testStep("STEP", "Set a BP in function RCM_runConfirmResetCause for check if interface work --> BP was set");
  debugger_waitUntilBPisReached("2000");
  ExpectedTestResult(debugger_result, W8_UNTIL_BP_SUCCESSFUL, "Breakpoint is reached");
    
  debugger_setRelativeFunctionBpAtLine("BswM_OnStartComEffective", "25");
   testStep("", "Run the debugger.");
  debugger_run();
   testStep("STEP", "Set a BP in function BswM_OnStartComEffective for check the interface --> BP was set");
  debugger_waitUntilBPisReached("2000");
  ExpectedTestResult(debugger_result, W8_UNTIL_BP_SUCCESSFUL, "Breakpoint is reached");
  
   testCaseComment("Action: ARCH_SW_BswMIf_ptrrRcmServicesBswMIf_RCM_runGetResetCause_BswM_OnStartupTwoB");
  debugger_deleteAllBreakpoints();
  debugger_setRelativeFunctionBpAtLine("BswM_OnStartupTwoB", "16");
   testStep("", "Reset the debugger.");
  debugger_reset(); 
   testStep("", "Run the debugger.");
  debugger_run();
   testStep("STEP", "Set a BP in function BswM_OnStartupTwoB in order to check if a valid wake up event was detected --> BP was set");
  debugger_waitUntilBPisReached("2000");
  ExpectedTestResult(debugger_result, W8_UNTIL_BP_SUCCESSFUL, "Breakpoint is reached");

////    debugger_setBpAtLine("C:\\Projects\\eCS_R1.2\\Tools\\EB_BSW_8.5.1\\Workspace\\plugins\\PduR_TS_TxDxM5I3R0\\src\\PduR_Init.c", "213");
   debugger_setRelativeFunctionBpAtLine("RCM_runGetResetCause", "2");
   testStep("", "Run the debugger.");
  debugger_run();
   testStep("STEP", "Set a BP in function RCM_runGetResetCause for check if interface work --> BP was set");
  debugger_waitUntilBPisReached("2000");
  ExpectedTestResult(debugger_result, W8_UNTIL_BP_SUCCESSFUL, "Breakpoint is reached");
    
  debugger_setRelativeFunctionBpAtLine("BswM_OnStartupTwoB", "18");
   testStep("", "Run the debugger.");
  debugger_run();
   testStep("STEP", "Set a BP in function BswM_OnStartupTwoA for check the interface --> BP was set");
  debugger_waitUntilBPisReached("2000");
  ExpectedTestResult(debugger_result, W8_UNTIL_BP_SUCCESSFUL, "Breakpoint is reached");
  
  //====================================================
  testCaseComment("Postcondition");
  testStep("STEP", "Return ECU to default values");
  RunPostTs();
}
testcase Sw_Int_BswMIf_ptrrLpmServicesBswMIf_01()
{
   /*-------------------------Test specific report info------------------------------*/
  
  testReportAddMiscInfoBlock("AUTOLIV ELECTRONICS document");
  TestReportAddMiscInfo("Nightly test", "No");
  TestReportAddMiscInfo("Test type", "Requirement-Based");
  TestReportAddMiscInfo("Regression Test", "No");
  TestReportAddMiscInfo("Fault injection method used", "No");
  TestReportAddMiscInfo("Resource usage evaluation", "No");
  TestReportAddMiscInfo("Priority", "No");
  TestReportAddMiscInfo("Safety relevant", "No");
  
  AddRequirementInfo("Requirement under test", "ARCH_SW_BswMIf_ptrrLpmServicesBswMIf_LPM_sleepInit_BswM_OnLowPwrFromPostRun");
  AddRequirementInfo("ARCH_SW_BswMIf_ptrrLpmServicesBswMIf_LPM_sleepInit_BswM_OnLowPwrFromPostRun", "The LPM_sleepInit runnable shall be called in the BswM_OnLowPwrFromPostRun runnable in order to initialize LPM module");
  //***************************************************************************************
  testCaseComment("Preconditions");
  testStep("STEP", "Bench Initialization"); // If the first parameter of testStep() is "Step", the arguments will be written in the specification file and "Step" argument will be numbered by 1 for each iteration.
  RunPreTs();
//   /*------------------------- Test scenario start ------------------------------*/
  
   testCaseComment("Action: ARCH_SW_BswMIf_ptrrLpmServicesBswMIf_LPM_sleepInit_BswM_OnLowPwrFromPostRun");
  testStep("STEP", "Enable comunication --> Comunication enable");
   TestSetMsgEvent(Airbag_01);
  TestSetMsgEvent(Airbag_02);
  TestSetMsgEvent(Airbag_eCS_01);
   TestWaitForTimeout(10000);
  
  debugger_setRelativeFunctionBpAtLine("BswM_Cyclic_10msTimer", "5");
   testStep("", "Reset the debugger.");
  debugger_reset(); 
  testStep("", "Run the debugger.");
  debugger_run();
    
  testStep("STEP", "Disable comunication --> Comunication disable");
  TestDisableMsg(Airbag_01);
  TestDisableMsg(Airbag_02);
  TestDisableMsg(Airbag_eCS_01);
  TestWaitForTimeout(5000);
  testStep("STEP", "Set a BP in function BswM_Cyclic_10msTimer in order to go in  BswM_OnLowPwrFromPostRun function --> BP was set");
  debugger_waitUntilBPisReached("2000");
  ExpectedTestResult(debugger_result, W8_UNTIL_BP_SUCCESSFUL, "Breakpoint is reached");
  
  debugger_writeVariable("uint8","bswmif_u16TPostRunTimer,,app.elf", "1", "17EC");
  TestWaitForTimeout(2000);
  
  debugger_setRelativeFunctionBpAtLine("BswM_OnLowPwrFromPostRun", "8");
   testStep("", "Run the debugger.");
  debugger_run();
   testStep("STEP", "Set a BP in function BswM_OnLowPwrFromPostRun in order to initialize LPM module --> BP was set");
  debugger_waitUntilBPisReached("2000");
  ExpectedTestResult(debugger_result, W8_UNTIL_BP_SUCCESSFUL, "Breakpoint is reached");

  debugger_setRelativeFunctionBpAtLine("LPM_sleepInit", "1");
   testStep("", "Run the debugger.");
  debugger_run();
   testStep("STEP", "Set a BP in function LPM_sleepInit for check the interface and initialize LPM module --> BP was set");
  debugger_waitUntilBPisReached("2000");
  ExpectedTestResult(debugger_result, W8_UNTIL_BP_SUCCESSFUL, "Breakpoint is reached");

   debugger_setRelativeFunctionBpAtLine("BswM_OnLowPwrFromPostRun", "14");
   testStep("", "Run the debugger.");
  debugger_run();
   testStep("STEP", "Set a BP in function BswM_OnLowPwrFromPostRun for check the interface --> BP was set");
  debugger_waitUntilBPisReached("2000");
  ExpectedTestResult(debugger_result, W8_UNTIL_BP_SUCCESSFUL, "Breakpoint is reached");
 
  //====================================================
  testCaseComment("Postcondition");
  testStep("STEP", "Return ECU to default values");
  RunPostTs();
}
testcase Sw_Int_BswMIf_ptrrLpmServicesBswMIf_02()
{
   /*-------------------------Test specific report info------------------------------*/
  
  testReportAddMiscInfoBlock("AUTOLIV ELECTRONICS document");
  TestReportAddMiscInfo("Nightly test", "No");
  TestReportAddMiscInfo("Test type", "Requirement-Based");
  TestReportAddMiscInfo("Regression Test", "No");
  TestReportAddMiscInfo("Fault injection method used", "No");
  TestReportAddMiscInfo("Resource usage evaluation", "No");
  TestReportAddMiscInfo("Priority", "No");
  TestReportAddMiscInfo("Safety relevant", "No");
  
  AddRequirementInfo("Requirement under test", "ARCH_SW_BswMIf_ptrrLpmServicesBswMIf_LPM_sleepMainLoop_BswM_OnLowPwrFromPostRun, ARCH_SW_BswMIf_ptrrLpmServicesBswMIf_LPM_sleepRestore_BswM_OnLowPwrFromPostRun");
  AddRequirementInfo("ARCH_SW_BswMIf_ptrrLpmServicesBswMIf_LPM_sleepMainLoop_BswM_OnLowPwrFromPostRun", "The LPM_sleepMainLoop runnable shall be called in the BswM_OnLowPwrFromPostRun runnable in order to enter in main loop and stay there until: - Passenger occupancy detected - Bus activity detected - TLowPower timeout");
  AddRequirementInfo("ARCH_SW_BswMIf_ptrrLpmServicesBswMIf_LPM_sleepRestore_BswM_OnLowPwrFromPostRun", "The LPM_sleepRestore runnable shall be called in the BswM_OnLowPwrFromPostRun runnable in order to restore previous state and set rules to go back in RUN STATE");
   //***************************************************************************************
  testCaseComment("Preconditions");
  testStep("STEP", "Bench Initialization"); // If the first parameter of testStep() is "Step", the arguments will be written in the specification file and "Step" argument will be numbered by 1 for each iteration.
  RunPreTs();
//   /*------------------------- Test scenario start ------------------------------*/
  
   testCaseComment("Action: ARCH_SW_BswMIf_ptrrLpmServicesBswMIf_LPM_sleepMainLoop_BswM_OnLowPwrFromPostRun");
  testStep("STEP", "Enable comunication --> Comunication enable");
   TestSetMsgEvent(Airbag_01);
  TestSetMsgEvent(Airbag_02);
  TestSetMsgEvent(Airbag_eCS_01);
   TestWaitForTimeout(10000);
  
  debugger_setRelativeFunctionBpAtLine("BswM_Cyclic_10msTimer", "5");
  testStep("", "Reset the debugger.");
  debugger_reset(); 
  testStep("", "Run the debugger.");
  debugger_run();
    
  testStep("STEP", "Disable comunication --> Comunication disable");
  TestDisableMsg(Airbag_01);
  TestDisableMsg(Airbag_02);
  TestDisableMsg(Airbag_eCS_01);
  TestWaitForTimeout(5000);
  testStep("STEP", "Set a BP in function BswM_Cyclic_10msTimer in order to go in  BswM_OnLowPwrFromPostRun function --> BP was set");
  debugger_waitUntilBPisReached("2000");
  ExpectedTestResult(debugger_result, W8_UNTIL_BP_SUCCESSFUL, "Breakpoint is reached");
  
  testStep("STEP", "Change value for Post Run Timer in order to go in BswM_OnLowPwrFromPostRun function --> Succesfully changed");
  debugger_writeVariable("uint8","bswmif_u16TPostRunTimer,,app.elf", "1", "17EC");
  TestWaitForTimeout(2000);
  
  debugger_setRelativeFunctionBpAtLine("BswM_OnLowPwrFromPostRun", "14");
   testStep("", "Run the debugger.");
  debugger_run();
   testStep("STEP", "Set a BP in function BswM_OnLowPwrFromPostRun in order to call LPM_sleepMainLoop --> BP was set");
  debugger_waitUntilBPisReached("2000");
  ExpectedTestResult(debugger_result, W8_UNTIL_BP_SUCCESSFUL, "Breakpoint is reached");

  debugger_setRelativeFunctionBpAtLine("LPM_sleepMainLoop", "51");
   testStep("", "Run the debugger.");
  debugger_run();
   testStep("STEP", "Set a BP in function LPM_sleepMainLoop in order to enter in main loop and stay there until: - Passenger occupancy detected - Bus activity detected - TLowPower timeout --> BP was set");
  debugger_waitUntilBPisReached("2000");
  ExpectedTestResult(debugger_result, W8_UNTIL_BP_SUCCESSFUL, "Breakpoint is reached");

  testStep("STEP", "Change value for lpm wakeup in order go out from while --> Succesfully changed");
  debugger_writeVariable("uint8","lpm_u8Wakeup,,app.elf", "0", "14");
  TestWaitForTimeout(2000);

  testCaseComment("Action: ARCH_SW_BswMIf_ptrrLpmServicesBswMIf_LPM_sleepRestore_BswM_OnLowPwrFromPostRun");
  debugger_setRelativeFunctionBpAtLine("BswM_OnLowPwrFromPostRun", "17");
   testStep("", "Run the debugger.");
  debugger_run();
   testStep("STEP", "Set a BP in function BswM_OnLowPwrFromPostRun in order to call LPM_sleepRestore --> BP was set");
  debugger_waitUntilBPisReached("2000");
  ExpectedTestResult(debugger_result, W8_UNTIL_BP_SUCCESSFUL, "Breakpoint is reached");
  
    debugger_setRelativeFunctionBpAtLine("LPM_sleepRestore", "2");
   testStep("", "Run the debugger.");
  debugger_run();
   testStep("STEP", "Set a BP in function LPM_sleepRestore in order to restore previous state and set rules to go back in RUN STATE");
  debugger_waitUntilBPisReached("2000");
  ExpectedTestResult(debugger_result, W8_UNTIL_BP_SUCCESSFUL, "Breakpoint is reached");
  
  //====================================================
  testCaseComment("Postcondition");
  testStep("STEP", "Return ECU to default values");
  RunPostTs();
}
testcase Sw_Int_BswMIf_ptrrAsrFlsServicesBswMIf_01()
{
   /*-------------------------Test specific report info------------------------------*/
  
  testReportAddMiscInfoBlock("AUTOLIV ELECTRONICS document");
  TestReportAddMiscInfo("Nightly test", "No");
  TestReportAddMiscInfo("Test type", "Requirement-Based");
  TestReportAddMiscInfo("Regression Test", "No");
  TestReportAddMiscInfo("Fault injection method used", "No");
  TestReportAddMiscInfo("Resource usage evaluation", "No");
  TestReportAddMiscInfo("Priority", "No");
  TestReportAddMiscInfo("Safety relevant", "No");
  
  AddRequirementInfo("Requirement under test", "ARCH_SW_BswMIf_ptrrFlsServicesBswMIf_Fls_MainFunction_OsTask_Bsw_ReadWrite_AllProcess");
  AddRequirementInfo("ARCH_SW_BswMIf_ptrrFlsServicesBswMIf_Fls_MainFunction_OsTask_Bsw_ReadWrite_AllProcess", "The Fls_MainFunction runnable shall be called in the OsTask_Bsw_ReadWrite_AllProcess runnable in order to perform flash read/write/erase or compare fls jobs");
  //***************************************************************************************
  testCaseComment("Preconditions");
  testStep("STEP", "Bench Initialization"); // If the first parameter of testStep() is "Step", the arguments will be written in the specification file and "Step" argument will be numbered by 1 for each iteration.
  RunPreTs();
//   /*------------------------- Test scenario start ------------------------------*/
  
  testCaseComment("Action: ARCH_SW_BswMIf_ptrrFlsServicesBswMIf_Fls_MainFunction_OsTask_Bsw_ReadWrite_AllProcess");
  debugger_deleteAllBreakpoints();
  debugger_setBpAtLine("C:\\Projects\\eCS_R1.2\\Components\\Application\\Autoliv\\BswMIf\\Implementation\\src\\BswM_Callouts.c", "1855");
////   debugger_setRelativeFunctionBpAtLine("OsTask_Bsw_ReadWrite_AllProcess", "9");
  testStep("", "Reset the debugger.");
   debugger_reset();
  testStep("", "Run the debugger.");
  debugger_run();
   debugger_waitUntilBPisReached("2000");
   testStep("STEP", "Set a BP in OsTask_Bsw_ReadWrite_AllProcess in order to call Fls_MainFunction --> BP was set");
  ExpectedTestResult(debugger_result, W8_UNTIL_BP_SUCCESSFUL, "Breakpoint is reached");
  
//  debugger_setBpAtLine("C:\\Projects\\eCS_R1.2\\Tools\\EB_BSW_8.5.1\\Workspace\\plugins\\Os_TS_T40D2M6I0R0\\lib_src\\user\\lib-fastsuspendallinterrupts.c", "45");
  debugger_setRelativeFunctionBpAtLine("Fls_MainFunction", "9"); 
  testStep("", "Run the debugger.");
  debugger_run();
   testStep("STEP", "Set a BP in function Fls_MainFunction in order to perform flash read/write/erase or compare fls jobs --> BP was set");
  debugger_waitUntilBPisReached("2000");
  ExpectedTestResult(debugger_result, W8_UNTIL_BP_SUCCESSFUL, "Breakpoint is reached");
  
  debugger_setBpAtLine("C:\\Projects\\eCS_R1.2\\Components\\Application\\Autoliv\\BswMIf\\Implementation\\src\\BswM_Callouts.c", "1857");
////   debugger_setRelativeFunctionBpAtLine("OsTask_Bsw_ReadWrite_AllProcess", "4");
  testStep("", "Run the debugger.");
  debugger_run();
   debugger_waitUntilBPisReached("2000");
   testStep("STEP", "Set a BP in function OsTask_Bsw_ReadWrite_AllProcess to check the interface --> BP was set");
  ExpectedTestResult(debugger_result, W8_UNTIL_BP_SUCCESSFUL, "Breakpoint is reached");
 
  //====================================================
  testCaseComment("Postcondition");
  testStep("STEP", "Return ECU to default values");
  RunPostTs();
}
testcase Sw_Int_BswMIf_ptrrAsrFeeServicesBswMIf_01()
{
   /*-------------------------Test specific report info------------------------------*/
  
  testReportAddMiscInfoBlock("AUTOLIV ELECTRONICS document");
  TestReportAddMiscInfo("Nightly test", "No");
  TestReportAddMiscInfo("Test type", "Requirement-Based");
  TestReportAddMiscInfo("Regression Test", "No");
  TestReportAddMiscInfo("Fault injection method used", "No");
  TestReportAddMiscInfo("Resource usage evaluation", "No");
  TestReportAddMiscInfo("Priority", "No");
  TestReportAddMiscInfo("Safety relevant", "No");
  
  AddRequirementInfo("Requirement under test", "ARCH_SW_BswMIf_ptrrFeeServicesBswMIf_Fee_MainFunction_OsTask_Bsw_ReadWrite_AllProcess");
  AddRequirementInfo("ARCH_SW_BswMIf_ptrrFeeServicesBswMIf_Fee_MainFunction_OsTask_Bsw_ReadWrite_AllProcess", "The Fee_MainFunction runnable shall be called in the OsTask_Bsw_ReadWrite_AllProcess runnable in order to read/write or erase fee jobs");
  //***************************************************************************************
  testCaseComment("Preconditions");
  testStep("STEP", "Bench Initialization"); // If the first parameter of testStep() is "Step", the arguments will be written in the specification file and "Step" argument will be numbered by 1 for each iteration.
  RunPreTs();
//   /*------------------------- Test scenario start ------------------------------*/
  
  testCaseComment("Action: ARCH_SW_BswMIf_ptrrFeeServicesBswMIf_Fee_MainFunction_OsTask_Bsw_ReadWrite_AllProcess");
  debugger_deleteAllBreakpoints();
  debugger_setBpAtLine("C:\\Projects\\eCS_R1.2\\Components\\Application\\Autoliv\\BswMIf\\Implementation\\src\\BswM_Callouts.c", "1854");
  testStep("", "Reset the debugger.");
   debugger_reset();
  testStep("", "Run the debugger.");
  debugger_run();
   debugger_waitUntilBPisReached("2000");
   testStep("STEP", "Set a BP in OsTask_Bsw_ReadWrite_AllProcess in order to call Fee_MainFunction --> BP was set");
  ExpectedTestResult(debugger_result, W8_UNTIL_BP_SUCCESSFUL, "Breakpoint is reached");
  
  debugger_setRelativeFunctionBpAtLine("Fee_MainFunction", "0"); 
  testStep("", "Run the debugger.");
  debugger_run();
   testStep("STEP", "Set a BP in function Fee_MainFunction in order to read/write or erase fee jobs --> BP was set");
  debugger_waitUntilBPisReached("2000");
  ExpectedTestResult(debugger_result, W8_UNTIL_BP_SUCCESSFUL, "Breakpoint is reached");
  
  debugger_setBpAtLine("C:\\Projects\\eCS_R1.2\\Components\\Application\\Autoliv\\BswMIf\\Implementation\\src\\BswM_Callouts.c", "1855");
  testStep("", "Run the debugger.");
  debugger_run();
   debugger_waitUntilBPisReached("2000");
   testStep("STEP", "Set a BP in function OsTask_Bsw_ReadWrite_AllProcess to check the interface --> BP was set");
  ExpectedTestResult(debugger_result, W8_UNTIL_BP_SUCCESSFUL, "Breakpoint is reached");
 
  //====================================================
  testCaseComment("Postcondition");
  testStep("STEP", "Return ECU to default values");
  RunPostTs();
}
testcase Sw_Int_BswMIf_ptrrAsrEcuMServicesBswMIf_01()
{
   /*-------------------------Test specific report info------------------------------*/
  
  testReportAddMiscInfoBlock("AUTOLIV ELECTRONICS document");
  TestReportAddMiscInfo("Nightly test", "No");
  TestReportAddMiscInfo("Test type", "Requirement-Based");
  TestReportAddMiscInfo("Regression Test", "No");
  TestReportAddMiscInfo("Fault injection method used", "No");
  TestReportAddMiscInfo("Resource usage evaluation", "No");
  TestReportAddMiscInfo("Priority", "No");
  TestReportAddMiscInfo("Safety relevant", "No");
  
  AddRequirementInfo("Requirement under test", "ARCH_SW_BswMIf_ptrrEcuMServicesBswMIf_EcuM_ClearWakeupEvent_BswM_OnStartComEffective, ARCH_SW_BswMIf_ptrrEcuMServicesBswMIf_EcuM_ClearWakeupEvent_BswM_On_Prep_Shutdown, ARCH_SW_BswMIf_ptrrRcmServicesBswMIf_RCM_runGetResetCause_BswM_OnStartupTwoB, ARCH_SW_BswMIf_ptrrEcuMServicesBswMIf_EcuM_GoDown_BswM_ProceedReset");
  AddRequirementInfo("ARCH_SW_BswMIf_ptrrEcuMServicesBswMIf_EcuM_ClearWakeupEvent_BswM_OnStartComEffective", "The EcuM_ClearWakeupEvent runnable shall be called in the BswM_OnStartComEffective runnable in order to acknowledge wake validation information");
  AddRequirementInfo("ARCH_SW_BswMIf_ptrrEcuMServicesBswMIf_EcuM_ClearWakeupEvent_BswM_On_Prep_Shutdown", "The EcuM_ClearWakeupEvent runnable shall be called in the BswM_On_Prep_Shutdown runnable in order to acknowledge wake validation information");
  AddRequirementInfo("ARCH_SW_BswMIf_ptrrEcuMServicesBswMIf_EcuM_ValidateWakeupEvent_BswM_OnStartupTwoB", "The EcuM_ValidateWakeupEvent runnable shall be called in the BswM_OnStartupTwoB runnable in order to validate wakeup event");
  AddRequirementInfo("ARCH_SW_BswMIf_ptrrEcuMServicesBswMIf_EcuM_GoDown_BswM_ProceedReset", "The EcuM_GoDown runnable shall be called in the BswM_ProceedReset runnable in order to prepare for a power off/reset");
  //***************************************************************************************
  testCaseComment("Preconditions");
  testStep("STEP", "Bench Initialization"); // If the first parameter of testStep() is "Step", the arguments will be written in the specification file and "Step" argument will be numbered by 1 for each iteration.
  RunPreTs();
   /*------------------------- Test scenario start ------------------------------*/
  
   testCaseComment("Action: ARCH_SW_BswMIf_ptrrEcuMServicesBswMIf_EcuM_ClearWakeupEvent_BswM_OnStartComEffective");
  debugger_setRelativeFunctionBpAtLine("BswM_OnStartComEffective", "2");
   testStep("", "Reset the debugger.");
  debugger_reset(); 
   testStep("", "Run the debugger.");
  debugger_run();
   testStep("STEP", "Set a BP in function BswM_OnStartComEffective call EcuM_ClearWakeupEvent function --> BP was set");
  debugger_waitUntilBPisReached("2000");
  ExpectedTestResult(debugger_result, W8_UNTIL_BP_SUCCESSFUL, "Breakpoint is reached");

//   debugger_setBpAtLine("C:\\Projects\\eCS_R1.2\\Tools\\EB_BSW_8.5.1\\Workspace\\plugins\\PduR_TS_TxDxM5I3R0\\src\\PduR_Init.c", "213");
  debugger_setRelativeFunctionBpAtLine("EcuM_ClearWakeupEvent", "2");
   testStep("", "Run the debugger.");
  debugger_run();
   testStep("STEP", "Set a BP in function EcuM_ClearWakeupEvent in order to acknowledge wake validation information --> BP was set");
  debugger_waitUntilBPisReached("2000");
  ExpectedTestResult(debugger_result, W8_UNTIL_BP_SUCCESSFUL, "Breakpoint is reached");
    
  debugger_setRelativeFunctionBpAtLine("BswM_OnStartComEffective", "5");
   testStep("", "Run the debugger.");
  debugger_run();
   testStep("STEP", "Set a BP in function BswM_OnStartComEffective for check the interface --> BP was set");
  debugger_waitUntilBPisReached("2000");
  ExpectedTestResult(debugger_result, W8_UNTIL_BP_SUCCESSFUL, "Breakpoint is reached");
  
   testCaseComment("Action: ARCH_SW_BswMIf_ptrrEcuMServicesBswMIf_EcuM_ClearWakeupEvent_BswM_On_Prep_Shutdown");
  debugger_deleteAllBreakpoints();
   debugger_setRelativeFunctionBpAtLine("BswM_ProceedReset", "6");
  testStep("", "Reset the debugger.");
   debugger_reset();
  testStep("", "Run the debugger.");
  debugger_run();
  
  testStep("STEP", "Send diagnostic request in order to do soft Reset");
   SendDiagnosticRequest(dSoftResetRequest, dSoftResetResponse);
  
   debugger_waitUntilBPisReached("2000");
   testStep("STEP", "Set a BP in function BswM_ProceedReset in order to call BswM_On_Prep_Shutdown --> BP was set");
  ExpectedTestResult(debugger_result, W8_UNTIL_BP_SUCCESSFUL, "Breakpoint is reached");
  
  debugger_setRelativeFunctionBpAtLine("EcuM_ClearWakeupEvent", "2");
   testStep("", "Run the debugger.");
  debugger_run();
   testStep("STEP", "Set a BP in EcuM_ClearWakeupEvent in order to acknowledge wake validation information --> BP was set");
  debugger_waitUntilBPisReached("2000");
  ExpectedTestResult(debugger_result, W8_UNTIL_BP_SUCCESSFUL, "Breakpoint is reached");
  
  debugger_setRelativeFunctionBpAtLine("BswM_CB_NfyNvMJobEnd", "58");
   testStep("", "Run the debugger.");
  debugger_run();
   testStep("STEP", "Set a BP in function BswM_CB_NfyNvMJobEnd for check the interface --> BP was set");
  debugger_waitUntilBPisReached("2000");
  ExpectedTestResult(debugger_result, W8_UNTIL_BP_SUCCESSFUL, "Breakpoint is reached");
  
   testCaseComment("Action: ARCH_SW_BswMIf_ptrrEcuMServicesBswMIf_EcuM_ValidateWakeupEvent_BswM_OnStartupTwoB");
  debugger_deleteAllBreakpoints();
  debugger_setRelativeFunctionBpAtLine("BswM_OnStartupTwoB", "18");
   testStep("", "Reset the debugger.");
  debugger_reset(); 
   testStep("", "Run the debugger.");
  debugger_run();
   testStep("STEP", "Set a BP in function BswM_OnStartupTwoB in order change Detected Reset Reason value to be ~0 --> BP was set");
  debugger_waitUntilBPisReached("2000");
  ExpectedTestResult(debugger_result, W8_UNTIL_BP_SUCCESSFUL, "Breakpoint is reached");

  testStep("STEP", "Change value for Detected Reset Reason to be ~0 --> Succesfully changed");
  debugger_writeLocalVariable("u32DetectedResetReason", "1000");
  
  debugger_setRelativeFunctionBpAtLine("BswM_OnStartupTwoB", "21"); 
   testStep("", "Run the debugger.");
  debugger_run();
   testStep("STEP", "Set a BP in function BswM_OnStartupTwoB in order call EcuM_ValidateWakeupEvent --> BP was set");
  debugger_waitUntilBPisReached("2000");
  ExpectedTestResult(debugger_result, W8_UNTIL_BP_SUCCESSFUL, "Breakpoint is reached");
  
   debugger_setRelativeFunctionBpAtLine("EcuM_ValidateWakeupEvent", "2");
   testStep("", "Run the debugger.");
  debugger_run();
   testStep("STEP", "Set a BP in function EcuM_ValidateWakeupEvent in order to validate wakeup event --> BP was set");
  debugger_waitUntilBPisReached("2000");
  ExpectedTestResult(debugger_result, W8_UNTIL_BP_SUCCESSFUL, "Breakpoint is reached");
  
  debugger_setRelativeFunctionBpAtLine("BswM_OnStartupTwoB", "25");
   testStep("", "Run the debugger.");
  debugger_run();
   testStep("STEP", "Set a BP in function BswM_OnStartupTwoA for check the interface --> BP was set");
  debugger_waitUntilBPisReached("2000");
  ExpectedTestResult(debugger_result, W8_UNTIL_BP_SUCCESSFUL, "Breakpoint is reached");
  
   testCaseComment("Action: ARCH_SW_BswMIf_ptrrEcuMServicesBswMIf_EcuM_ClearWakeupEvent_BswM_On_Prep_Shutdown");
  debugger_deleteAllBreakpoints();
   debugger_setRelativeFunctionBpAtLine("BswM_ProceedReset", "15");
  testStep("", "Reset the debugger.");
   debugger_reset();
  testStep("", "Run the debugger.");
  debugger_run();
  
  testStep("STEP", "Send diagnostic request in order to do Hard Reset");
   SendDiagnosticRequest(dHardResetRequest, dHardResetResponse);
  
   debugger_waitUntilBPisReached("2000");
   testStep("STEP", "Set a BP in function EcuM_GoDown in order to call EcuM_GoDown and to prepare for a power off/reset --> BP was set");
  ExpectedTestResult(debugger_result, W8_UNTIL_BP_SUCCESSFUL, "Breakpoint is reached");
  
  debugger_setRelativeFunctionBpAtLine("EcuM_GoDown", "0");
   testStep("", "Run the debugger.");
  debugger_run();
   testStep("STEP", "Set a BP in EcuM_GoDown in order to prepare for a power off/reset --> BP was set");
  debugger_waitUntilBPisReached("2000");
  ExpectedTestResult(debugger_result, W8_UNTIL_BP_SUCCESSFUL, "Breakpoint is reached");
  
  debugger_setRelativeFunctionBpAtLine("Dem_Init", "0");
   testStep("", "Run the debugger.");
  debugger_run();
   testStep("STEP", "Set a BP in function Dem_Init for check if the reset was executed --> BP was set");
  debugger_waitUntilBPisReached("2000");
  ExpectedTestResult(debugger_result, W8_UNTIL_BP_SUCCESSFUL, "Breakpoint is reached");

  //====================================================
  testCaseComment("Postcondition");
  testStep("STEP", "Return ECU to default values");
  RunPostTs();
}
testcase Sw_Int_BswMIf_ptrrAsrDemServicesBswMIf_01()
{
   /*-------------------------Test specific report info------------------------------*/
  
  testReportAddMiscInfoBlock("AUTOLIV ELECTRONICS document");
  TestReportAddMiscInfo("Nightly test", "No");
  TestReportAddMiscInfo("Test type", "Requirement-Based");
  TestReportAddMiscInfo("Regression Test", "No");
  TestReportAddMiscInfo("Fault injection method used", "No");
  TestReportAddMiscInfo("Resource usage evaluation", "No");
  TestReportAddMiscInfo("Priority", "No");
  TestReportAddMiscInfo("Safety relevant", "No");
  
  AddRequirementInfo("Requirement under test", "ARCH_SW_BswMIf_ptrrDemServicesBswMIf_Dem_Init_BswM_OnStartupTwoB, ARCH_SW_BswMIf_ptrrDemServicesBswMIf_Dem_Shutdown_BswM_On_Prep_Shutdown");
  AddRequirementInfo("ARCH_SW_BswMIf_ptrrDemServicesBswMIf_Dem_Init_BswM_OnStartupTwoB", "The Dem_Init runnable shall be called in the BswM_OnStartupTwoB runnable in order to initialize DEM module");
  AddRequirementInfo("ARCH_SW_BswMIf_ptrrDemServicesBswMIf_Dem_Shutdown_BswM_On_Prep_Shutdown", "The Dem_Shutdown runnable shall be called in the BswM_On_Prep_Shutdown runnable in order to shutdown the DEM module");
  //***************************************************************************************
  testCaseComment("Preconditions");
  testStep("STEP", "Bench Initialization"); // If the first parameter of testStep() is "Step", the arguments will be written in the specification file and "Step" argument will be numbered by 1 for each iteration.
  RunPreTs();
   /*------------------------- Test scenario start ------------------------------*/
   testCaseComment("Action: ARCH_SW_BswMIf_ptrrDemServicesBswMIf_Dem_Init_BswM_OnStartupTwoB");
  debugger_setRelativeFunctionBpAtLine("BswM_OnStartupTwoB", "7");
   testStep("", "Reset the debugger.");
  debugger_reset(); 
   testStep("", "Run the debugger.");
  debugger_run();
   testStep("STEP", "Set a BP in function BswM_OnStartupTwoB in order call Dem_Init --> BP was set");
  debugger_waitUntilBPisReached("2000");
   ExpectedTestResult(debugger_result, W8_UNTIL_BP_SUCCESSFUL, "Breakpoint is reached");
   
   debugger_setRelativeFunctionBpAtLine("Dem_Init", "19");
   testStep("", "Run the debugger.");
  debugger_run();
   testStep("STEP", "Set a BP in function Dem_Init in order to initialize DEM module --> BP was set");
  debugger_waitUntilBPisReached("2000");
  ExpectedTestResult(debugger_result, W8_UNTIL_BP_SUCCESSFUL, "Breakpoint is reached");
  
  debugger_setRelativeFunctionBpAtLine("BswM_OnStartupTwoB", "10");
   testStep("", "Run the debugger.");
  debugger_run();
   testStep("STEP", "Set a BP in function BswM_OnStartupTwoB for check the interface --> BP was set");
  debugger_waitUntilBPisReached("2000");
  ExpectedTestResult(debugger_result, W8_UNTIL_BP_SUCCESSFUL, "Breakpoint is reached"); 
  
   testCaseComment("Action: ARCH_SW_BswMIf_ptrrDemServicesBswMIf_Dem_Shutdown_BswM_On_Prep_Shutdown");
  debugger_deleteAllBreakpoints();
   debugger_setRelativeFunctionBpAtLine("BswM_ProceedReset", "6");
  testStep("", "Reset the debugger.");
   debugger_reset();
  testStep("", "Run the debugger.");
  debugger_run();
  
  testStep("STEP", "Send diagnostic request in order to do soft Reset");
   SendDiagnosticRequest(dSoftResetRequest, dSoftResetResponse);
  
   debugger_waitUntilBPisReached("2000");
   testStep("STEP", "Set a BP in function BswM_ProceedReset in order to call BswM_On_Prep_Shutdown function --> BP was set");
  ExpectedTestResult(debugger_result, W8_UNTIL_BP_SUCCESSFUL, "Breakpoint is reached");
  
  debugger_setRelativeFunctionBpAtLine("Dem_Shutdown", "21");
   testStep("", "Run the debugger.");
  debugger_run();
   testStep("STEP", "Set a BP in Dem_Shutdown in order to shutdown the DEM module --> BP was set");
  debugger_waitUntilBPisReached("2000");
  ExpectedTestResult(debugger_result, W8_UNTIL_BP_SUCCESSFUL, "Breakpoint is reached");
  
  debugger_setRelativeFunctionBpAtLine("BswM_CB_NfyNvMJobEnd", "58");
   testStep("", "Run the debugger.");
  debugger_run();
   testStep("STEP", "Set a BP in function BswM_CB_NfyNvMJobEnd for check the interface --> BP was set");
  debugger_waitUntilBPisReached("2000");
  ExpectedTestResult(debugger_result, W8_UNTIL_BP_SUCCESSFUL, "Breakpoint is reached");

  //====================================================
  testCaseComment("Postcondition");
  testStep("STEP", "Return ECU to default values");
  RunPostTs();
}
testcase Sw_Int_BswMIf_ptrrAsrDcmServicesBswMIf_01()
{
   /*-------------------------Test specific report info------------------------------*/
  
  testReportAddMiscInfoBlock("AUTOLIV ELECTRONICS document");
  TestReportAddMiscInfo("Nightly test", "No");
  TestReportAddMiscInfo("Test type", "Requirement-Based");
  TestReportAddMiscInfo("Regression Test", "No");
  TestReportAddMiscInfo("Fault injection method used", "No");
  TestReportAddMiscInfo("Resource usage evaluation", "No");
  TestReportAddMiscInfo("Priority", "No");
  TestReportAddMiscInfo("Safety relevant", "No");
  
  AddRequirementInfo("Requirement under test", "ARCH_SW_BswMIf_ptrrDcmServicesBswMIf_Dcm_Init_BswM_OnStartComEffective");
  AddRequirementInfo("ARCH_SW_BswMIf_ptrrDcmServicesBswMIf_Dcm_Init_BswM_OnStartComEffective", "The Dcm_Init runnable shall be called in the BswM_OnStartComEffective runnable in order to initialize DCM module");
  //***************************************************************************************
  testCaseComment("Preconditions");
  testStep("STEP", "Bench Initialization"); // If the first parameter of testStep() is "Step", the arguments will be written in the specification file and "Step" argument will be numbered by 1 for each iteration.
  RunPreTs();
//   /*------------------------- Test scenario start ------------------------------*/
  
   testCaseComment("Action: ARCH_SW_BswMIf_ptrrDcmServicesBswMIf_Dcm_Init_BswM_OnStartComEffective");
  debugger_setRelativeFunctionBpAtLine("BswM_OnStartComEffective", "11");
   testStep("", "Reset the debugger.");
  debugger_reset(); 
   testStep("", "Run the debugger.");
  debugger_run();
   testStep("STEP", "Set a BP in function BswM_OnStartComEffective in order to call Dcm_Init function --> BP was set");
  debugger_waitUntilBPisReached("2000");
  ExpectedTestResult(debugger_result, W8_UNTIL_BP_SUCCESSFUL, "Breakpoint is reached");

//   debugger_setBpAtLine("C:\\Projects\\eCS_R1.2\\Tools\\EB_BSW_8.5.1\\Workspace\\plugins\\PduR_TS_TxDxM5I3R0\\src\\PduR_Init.c", "213");
  debugger_setRelativeFunctionBpAtLine("Dcm_Init", "3");
   testStep("", "Run the debugger.");
  debugger_run();
   testStep("STEP", "Set a BP in function Dcm_Init in order to initialize DCM module --> BP was set");
  debugger_waitUntilBPisReached("2000");
  ExpectedTestResult(debugger_result, W8_UNTIL_BP_SUCCESSFUL, "Breakpoint is reached");
    
  debugger_setRelativeFunctionBpAtLine("BswM_OnStartComEffective", "14");
   testStep("", "Run the debugger.");
  debugger_run();
   testStep("STEP", "Set a BP in function BswM_OnStartComEffective in order to check the interface --> BP was set");
  debugger_waitUntilBPisReached("2000");
  ExpectedTestResult(debugger_result, W8_UNTIL_BP_SUCCESSFUL, "Breakpoint is reached");
  
  //====================================================
  testCaseComment("Postcondition");
  testStep("STEP", "Return ECU to default values");
  RunPostTs();
}
testcase Sw_Int_BswMIf_ptrrAsrComServicesBswMIf_01()
{
   /*-------------------------Test specific report info------------------------------*/
  
  testReportAddMiscInfoBlock("AUTOLIV ELECTRONICS document");
  TestReportAddMiscInfo("Nightly test", "No");
  TestReportAddMiscInfo("Test type", "Requirement-Based");
  TestReportAddMiscInfo("Regression Test", "No");
  TestReportAddMiscInfo("Fault injection method used", "No");
  TestReportAddMiscInfo("Resource usage evaluation", "No");
  TestReportAddMiscInfo("Priority", "No");
  TestReportAddMiscInfo("Safety relevant", "No");
  
  AddRequirementInfo("Requirement under test", "ARCH_SW_BswMIf_ptrrComServicesBswMIf_Com_Init_BswM_OnStartupTwoA, ARCH_SW_BswMIf_ptrrComServicesBswMIf_Com_ClearIpduGroupVector_BswM_OnEnableTxPdu, ARCH_SW_BswMIf_ptrrComServicesBswMIf_Com_SetIpduGroup_BswM_OnEnableTxPdu, ARCH_SW_BswMIf_ptrrComServicesBswMIf_Com_IpduGroupControl_BswM_OnEnableTxPdu");
  AddRequirementInfo("ARCH_SW_BswMIf_ptrrComServicesBswMIf_Com_Init_BswM_OnStartupTwoA", "The Com_Init runnable shall be called in the BswM_OnStartupTwoA runnable in order to initialize the Com module.");
  AddRequirementInfo("ARCH_SW_BswMIf_ptrrComServicesBswMIf_Com_ClearIpduGroupVector_BswM_OnEnableTxPdu", "The Com_ClearIpduGroupVector runnable shall be called in the BswM_OnEnableTxPdu runnable in order to initialize the PDU group vector to 0");
  AddRequirementInfo("ARCH_SW_BswMIf_ptrrComServicesBswMIf_Com_SetIpduGroup_BswM_OnEnableTxPdu", "The Com_SetIpduGroup runnable shall be called in the BswM_OnEnableTxPdu runnable in order to set new states to RX and Tx Com IPDUs: - Enable frame reception - Enable frame transmission");
  AddRequirementInfo("ARCH_SW_BswMIf_ptrrComServicesBswMIf_Com_IpduGroupControl_BswM_OnEnableTxPdu", "The Com_IpduGroupControl runnable shall be called in the BswM_OnEnableTxPdu runnable in order to start both COM PDUs (after their states have been updated)");
  //***************************************************************************************
  
  testCaseComment("Preconditions");
  testStep("STEP", "Bench Initialization"); // If the first parameter of testStep() is "Step", the arguments will be written in the specification file and "Step" argument will be numbered by 1 for each iteration.
  RunPreTs();
//   /*------------------------- Test scenario start ------------------------------*/
   
  testCaseComment("Action: ARCH_SW_BswMIf_ptrrComServicesBswMIf_Com_Init_BswM_OnStartupTwoA");
  debugger_setRelativeFunctionBpAtLine("BswM_OnStartupTwoA", "8");
   testStep("", "Reset the debugger.");
  debugger_reset(); 
   testStep("", "Run the debugger.");
  debugger_run();
   testStep("STEP", "Set a BP in function BswM_OnStartupTwoA to call Com_Init function --> BP was set");
  debugger_waitUntilBPisReached("2000");
  ExpectedTestResult(debugger_result, W8_UNTIL_BP_SUCCESSFUL, "Breakpoint is reached");

  debugger_setRelativeFunctionBpAtLine("Com_Init", "0");
   testStep("", "Run the debugger.");
  debugger_run();
   testStep("STEP", "Set a BP in function Com_Init in order to initialize the Com module --> BP was set");
  debugger_waitUntilBPisReached("2000");
  ExpectedTestResult(debugger_result, W8_UNTIL_BP_SUCCESSFUL, "Breakpoint is reached");

  debugger_setRelativeFunctionBpAtLine("BswM_OnStartupTwoA", "11");
   testStep("", "Run the debugger.");
  debugger_run();
   testStep("STEP", "Set a BP in function Com_Init for check the interface --> BP was set");
  debugger_waitUntilBPisReached("2000");
  ExpectedTestResult(debugger_result, W8_UNTIL_BP_SUCCESSFUL, "Breakpoint is reached");

  testCaseComment("Action: ARCH_SW_BswMIf_ptrrComServicesBswMIf_Com_ClearIpduGroupVector_BswM_OnEnableTxPdu");
  debugger_deleteAllBreakpoints();
  debugger_setRelativeFunctionBpAtLine("BswM_OnEnableTxPdu", "7");
   testStep("", "Reset the debugger.");
  debugger_reset(); 
   testStep("", "Run the debugger.");
  debugger_run();
   testStep("STEP", "Set a BP in function BswM_OnEnableTxPdu to call Com_ClearIpduGroupVector function --> BP was set");
  debugger_waitUntilBPisReached("2000");
  ExpectedTestResult(debugger_result, W8_UNTIL_BP_SUCCESSFUL, "Breakpoint is reached");

  debugger_setRelativeFunctionBpAtLine("Com_ClearIpduGroupVector", "0");
   testStep("", "Run the debugger.");
  debugger_run();
   testStep("STEP", "Set a BP in function Com_ClearIpduGroupVector in order to initialize the PDU group vector to 0 --> BP was set");
  debugger_waitUntilBPisReached("2000");
  ExpectedTestResult(debugger_result, W8_UNTIL_BP_SUCCESSFUL, "Breakpoint is reached");
  
  debugger_setRelativeFunctionBpAtLine("BswM_OnEnableTxPdu", "10");
   testStep("", "Run the debugger.");
  debugger_run();
   testStep("STEP", "Set a BP in function BswM_OnEnableTxPdu for check the interface --> BP was set");
  debugger_waitUntilBPisReached("2000");
  ExpectedTestResult(debugger_result, W8_UNTIL_BP_SUCCESSFUL, "Breakpoint is reached");
  debugger_deleteAllBreakpoints();
  
  testCaseComment("Action: ARCH_SW_BswMIf_ptrrComServicesBswMIf_Com_SetIpduGroup_BswM_OnEnableTxPdu");
  debugger_setRelativeFunctionBpAtLine("BswM_OnEnableTxPdu", "10");
   testStep("", "Reset the debugger.");
  debugger_reset(); 
   testStep("", "Run the debugger.");
  debugger_run();
   testStep("STEP", "Set a BP in function BswM_OnEnableTxPdu to call Com_SetIpduGroup function --> BP was set");
  debugger_waitUntilBPisReached("2000");
  ExpectedTestResult(debugger_result, W8_UNTIL_BP_SUCCESSFUL, "Breakpoint is reached");
   
  debugger_setRelativeFunctionBpAtLine("Com_SetIpduGroup", "0");
   testStep("", "Run the debugger.");
  debugger_run();
   testStep("STEP", "Set a BP in function Com_SetIpduGroup in order to set new states to RX Com IPDUs: - Enable frame reception --> BP was set");
  debugger_waitUntilBPisReached("2000");
  ExpectedTestResult(debugger_result, W8_UNTIL_BP_SUCCESSFUL, "Breakpoint is reached");
   debugger_deleteAllBreakpoints();
  
  debugger_setRelativeFunctionBpAtLine("BswM_OnEnableTxPdu", "11");
   testStep("", "Run the debugger.");
  debugger_run();
   testStep("STEP", "Set a BP in function BswM_OnEnableTxPdu in order to enable frame transmission --> BP was set");
  debugger_waitUntilBPisReached("2000");
  ExpectedTestResult(debugger_result, W8_UNTIL_BP_SUCCESSFUL, "Breakpoint is reached");
  
  debugger_setRelativeFunctionBpAtLine("Com_SetIpduGroup", "27");
   testStep("", "Run the debugger.");
  debugger_run();
   testStep("STEP", "Set a BP in function Com_SetIpduGroup in order to set new states to Tx Com IPDUs: - Enable frame transmission --> BP was set");
  debugger_waitUntilBPisReached("2000");
  ExpectedTestResult(debugger_result, W8_UNTIL_BP_SUCCESSFUL, "Breakpoint is reached");
  
   debugger_setRelativeFunctionBpAtLine("BswM_OnEnableTxPdu", "14");
   testStep("", "Run the debugger.");
  debugger_run();
   testStep("STEP", "Set a BP in function BswM_OnEnableTxPdu for check the interface --> BP was set");
  debugger_waitUntilBPisReached("2000");
  ExpectedTestResult(debugger_result, W8_UNTIL_BP_SUCCESSFUL, "Breakpoint is reached");
  
   testCaseComment("Action: ARCH_SW_BswMIf_ptrrComServicesBswMIf_Com_IpduGroupControl_BswM_OnEnableTxPdu");
  debugger_deleteAllBreakpoints();
  debugger_setRelativeFunctionBpAtLine("BswM_OnEnableTxPdu", "14");
   testStep("", "Reset the debugger.");
  debugger_reset(); 
   testStep("", "Run the debugger.");
  debugger_run();
   testStep("STEP", "Set a BP in function BswM_OnEnableTxPdu to call Com_IpduGroupControl function --> BP was set");
  debugger_waitUntilBPisReached("2000");
  ExpectedTestResult(debugger_result, W8_UNTIL_BP_SUCCESSFUL, "Breakpoint is reached");
   
  debugger_setRelativeFunctionBpAtLine("Com_IpduGroupControl", "0");
   testStep("", "Run the debugger.");
  debugger_run();
   testStep("STEP", "Set a BP in function Com_IpduGroupControl in order to start both COM PDUs (after their states have been updated) --> BP was set");
  debugger_waitUntilBPisReached("2000");
  ExpectedTestResult(debugger_result, W8_UNTIL_BP_SUCCESSFUL, "Breakpoint is reached");
   debugger_deleteAllBreakpoints();
  
  debugger_setRelativeFunctionBpAtLine("BswM_OnEnableTxPdu", "17");
   testStep("", "Run the debugger.");
  debugger_run();
   testStep("STEP", "Set a BP in function BswM_OnEnableTxPdu for check the interface --> BP was set");
  debugger_waitUntilBPisReached("2000");
  ExpectedTestResult(debugger_result, W8_UNTIL_BP_SUCCESSFUL, "Breakpoint is reached");  
  
  //====================================================
  testCaseComment("Postcondition");
  testStep("STEP", "Return ECU to default values");
  RunPostTs();
}
testcase Sw_Int_BswMIf_ptrrAsrComMServicesBswMIf_01()
{
   /*-------------------------Test specific report info------------------------------*/
  
  testReportAddMiscInfoBlock("AUTOLIV ELECTRONICS document");
  TestReportAddMiscInfo("Nightly test", "No");
  TestReportAddMiscInfo("Test type", "Requirement-Based");
  TestReportAddMiscInfo("Regression Test", "No");
  TestReportAddMiscInfo("Fault injection method used", "No");
  TestReportAddMiscInfo("Resource usage evaluation", "No");
  TestReportAddMiscInfo("Priority", "No");
  TestReportAddMiscInfo("Safety relevant", "No");
  
  AddRequirementInfo("Requirement under test", "ARCH_SW_BswMIf_ptrrComMServicesBswMIf_ComM_Init_BswM_OnStartupTwoB, ARCH_SW_BswMIf_ptrrComMServicesBswMIf_ComM_CommunicationAllowed_BswM_OnWakeupValidation, ARCH_SW_BswMIf_ptrrComMServicesBswMIf_ComM_ASR40_RequestComMode_BswM_OnWakeupValidation, ARCH_SW_BswMIf_ptrrComMServicesBswMIf_ComM_DeInit_BswM_OnGoOffOneA, ARCH_SW_BswMIf_ptrrComMServicesBswMIf_ComM_ASR40_RequestComMode_BswM_OnPostRunFromRun");
  AddRequirementInfo("ARCH_SW_BswMIf_ptrrComMServicesBswMIf_ComM_Init_BswM_OnStartupTwoB", "The ComM_Init runnable shall be called in the BswM_OnStartupTwoB runnable in order to initialize the ComM module.");
  AddRequirementInfo("ARCH_SW_BswMIf_ptrrComMServicesBswMIf_ComM_CommunicationAllowed_BswM_OnWakeupValidation", "The ComM_CommunicationAllowed runnable shall be called in the BswM_OnWakeupValidation runnable in order to authorize the start of communication");
  AddRequirementInfo("ARCH_SW_BswMIf_ptrrComMServicesBswMIf_ComM_ASR40_RequestComMode_BswM_OnWakeupValidation", "The ComM_ASR40_RequestComMode runnable shall be called in the BswM_OnWakeupValidation runnable in order to enable message transmission and reception.");
  AddRequirementInfo("ARCH_SW_BswMIf_ptrrComMServicesBswMIf_ComM_DeInit_BswM_OnGoOffOneA", "The ComM_DeInit runnable shall be called in the BswM_OnGoOffOneA runnable in order to de-initialize the ComM module.");
  AddRequirementInfo("ARCH_SW_BswMIf_ptrrComMServicesBswMIf_ComM_ASR40_RequestComMode_BswM_OnPostRunFromRun", "The ComM_ASR40_RequestComMode runnable shall be called in the BswM_OnPostRunFromRun runnable in order to set ComM back to full communication to be able to detect a wake-up request after post run state was entered.");
  //***************************************************************************************
  testCaseComment("Preconditions");
  testStep("STEP", "Bench Initialization"); // If the first parameter of testStep() is "Step", the arguments will be written in the specification file and "Step" argument will be numbered by 1 for each iteration.
  RunPreTs();
   /*------------------------- Test scenario start ------------------------------*/
   testCaseComment("Action: ARCH_SW_BswMIf_ptrrComMServicesBswMIf_ComM_Init_BswM_OnStartupTwoB");
  debugger_setRelativeFunctionBpAtLine("BswM_OnStartupTwoB", "4");
   testStep("", "Reset the debugger.");
  debugger_reset(); 
   testStep("", "Run the debugger.");
  debugger_run();
   testStep("STEP", "Set a BP in function BswM_OnStartupTwoB in order call ComM_Init --> BP was set");
  debugger_waitUntilBPisReached("2000");
   ExpectedTestResult(debugger_result, W8_UNTIL_BP_SUCCESSFUL, "Breakpoint is reached");
   
   debugger_setRelativeFunctionBpAtLine("ComM_Init", "2");
   testStep("", "Run the debugger.");
  debugger_run();
   testStep("STEP", "Set a BP in function ComM_Init in order to initialize the ComM module --> BP was set");
  debugger_waitUntilBPisReached("2000");
  ExpectedTestResult(debugger_result, W8_UNTIL_BP_SUCCESSFUL, "Breakpoint is reached");
  
  debugger_setRelativeFunctionBpAtLine("BswM_OnStartupTwoB", "7");
   testStep("", "Run the debugger.");
  debugger_run();
   testStep("STEP", "Set a BP in function BswM_OnStartupTwoB for check the interface --> BP was set");
  debugger_waitUntilBPisReached("2000");
  ExpectedTestResult(debugger_result, W8_UNTIL_BP_SUCCESSFUL, "Breakpoint is reached"); 
  
  testCaseComment("Action: ARCH_SW_BswMIf_ptrrComMServicesBswMIf_ComM_CommunicationAllowed_BswM_OnWakeupValidation");
   debugger_deleteAllBreakpoints();
  debugger_setRelativeFunctionBpAtLine("BswM_OnWakeupValidation", "2");
   testStep("", "Reset the debugger.");
  debugger_reset(); 
   testStep("", "Run the debugger.");
  debugger_run();
   testStep("STEP", "Set a BP in function BswM_OnWakeupValidation in order call ComM_CommunicationAllowed --> BP was set");
  debugger_waitUntilBPisReached("2000");
   ExpectedTestResult(debugger_result, W8_UNTIL_BP_SUCCESSFUL, "Breakpoint is reached");
   
   debugger_setRelativeFunctionBpAtLine("ComM_CommunicationAllowed", "0");
   testStep("", "Run the debugger.");
  debugger_run();
   testStep("STEP", "Set a BP in function ComM_CommunicationAllowed in order to authorize the start of communication --> BP was set");
  debugger_waitUntilBPisReached("2000");
  ExpectedTestResult(debugger_result, W8_UNTIL_BP_SUCCESSFUL, "Breakpoint is reached");
  
  debugger_setRelativeFunctionBpAtLine("BswM_OnWakeupValidation", "5");
   testStep("", "Run the debugger.");
  debugger_run();
   testStep("STEP", "Set a BP in function BswM_OnWakeupValidation for check the interface --> BP was set");
  debugger_waitUntilBPisReached("2000");
  ExpectedTestResult(debugger_result, W8_UNTIL_BP_SUCCESSFUL, "Breakpoint is reached"); 
 
  testCaseComment("Action: ARCH_SW_BswMIf_ptrrComMServicesBswMIf_ComM_ASR40_RequestComMode_BswM_OnWakeupValidation");
   debugger_deleteAllBreakpoints();
  debugger_setRelativeFunctionBpAtLine("BswM_OnWakeupValidation", "5");
   testStep("", "Reset the debugger.");
  debugger_reset(); 
   testStep("", "Run the debugger.");
  debugger_run();
   testStep("STEP", "Set a BP in function BswM_OnWakeupValidation in order call ComM_ASR40_RequestComMode --> BP was set");
  debugger_waitUntilBPisReached("2000");
   ExpectedTestResult(debugger_result, W8_UNTIL_BP_SUCCESSFUL, "Breakpoint is reached");
   
   debugger_setRelativeFunctionBpAtLine("ComM_ASR40_RequestComMode", "1");
   testStep("", "Run the debugger.");
  debugger_run();
   testStep("STEP", "Set a BP in function ComM_ASR40_RequestComMode in order to authorize the start of communication --> BP was set");
  debugger_waitUntilBPisReached("2000");
  ExpectedTestResult(debugger_result, W8_UNTIL_BP_SUCCESSFUL, "Breakpoint is reached");
  
  testCaseComment("Action: ARCH_SW_BswMIf_ptrrComMServicesBswMIf_ComM_DeInit_BswM_OnGoOffOneA");
   debugger_deleteAllBreakpoints();
  debugger_setRelativeFunctionBpAtLine("BswM_OnGoOffOneA", "5");
   testStep("", "Reset the debugger.");
  debugger_reset(); 
   testStep("", "Run the debugger.");
  debugger_run();
  
  testStep("STEP", "Send diagnostic request in order to do soft Reset");
   SendDiagnosticRequest(dSoftResetRequest, dSoftResetResponse);
  
   testStep("STEP", "Set a BP in function BswM_OnGoOffOneA in order call ComM_DeInit function --> BP was set");
  debugger_waitUntilBPisReached("2000");
   ExpectedTestResult(debugger_result, W8_UNTIL_BP_SUCCESSFUL, "Breakpoint is reached");
   
   debugger_setRelativeFunctionBpAtLine("ComM_DeInit", "0");
   testStep("", "Run the debugger.");
  debugger_run();
   testStep("STEP", "Set a BP in function ComM_DeInit in order to de-initialize the ComM module --> BP was set");
  debugger_waitUntilBPisReached("2000");
  ExpectedTestResult(debugger_result, W8_UNTIL_BP_SUCCESSFUL, "Breakpoint is reached");
  
  debugger_setRelativeFunctionBpAtLine("BswM_OnGoOffOneA", "8");
   testStep("", "Run the debugger.");
  debugger_run();
   testStep("STEP", "Set a BP in function BswM_OnGoOffOneA for check the interface --> BP was set");
  debugger_waitUntilBPisReached("2000");
  ExpectedTestResult(debugger_result, W8_UNTIL_BP_SUCCESSFUL, "Breakpoint is reached"); 
  
  testCaseComment("Action: ARCH_SW_BswMIf_ptrrComMServicesBswMIf_ComM_ASR40_RequestComMode_BswM_OnPostRunFromRun");
  debugger_deleteAllBreakpoints();
   debugger_setRelativeFunctionBpAtLine("BswM_OnPostRunFromRun", "23");
  testStep("", "Reset the debugger.");
   debugger_reset();
  testStep("", "Run the debugger.");
  debugger_run();
  testStep("STEP", "Disable comunication --> Comunication disable");
   TestDisableMsg(Airbag_01);
  TestDisableMsg(Airbag_02);
  TestDisableMsg(Airbag_eCS_01);
   TestWaitForTimeout(5000);
   debugger_waitUntilBPisReached("2000");
   testStep("STEP", "Set a BP in function BswM_OnPostRunFromRun in order to call ComM_ASR40_RequestComMode function --> BP was set");
  ExpectedTestResult(debugger_result, W8_UNTIL_BP_SUCCESSFUL, "Breakpoint is reached");

   debugger_setRelativeFunctionBpAtLine("ComM_ASR40_RequestComMode", "1"); 
  testStep("", "Run the debugger.");
  debugger_run();
   testStep("STEP", "Set a BP in function BswM_OnPostRunFromRun in order to set ComM back to full communication to be able to detect a wake-up request after post run state was entered --> BP was set");
  debugger_waitUntilBPisReached("2000");
  ExpectedTestResult(debugger_result, W8_UNTIL_BP_SUCCESSFUL, "Breakpoint is reached");
  
  debugger_setRelativeFunctionBpAtLine("BswM_OnPostRunFromRun", "26");
   testStep("", "Run the debugger.");
  debugger_run();
   testStep("STEP", "Set a BP in function BswM_OnPostRunFromRun for check the interface --> BP was set");
  debugger_waitUntilBPisReached("2000");
  ExpectedTestResult(debugger_result, W8_UNTIL_BP_SUCCESSFUL, "Breakpoint is reached");
  
  //====================================================
  testCaseComment("Postcondition");
  testStep("STEP", "Return ECU to default values");
  RunPostTs();
}
testcase Sw_Int_BswMIf_ptrrAsrCanTpServicesBswMIf_01()
{
   /*-------------------------Test specific report info------------------------------*/
  
  testReportAddMiscInfoBlock("AUTOLIV ELECTRONICS document");
  TestReportAddMiscInfo("Nightly test", "No");
  TestReportAddMiscInfo("Test type", "Requirement-Based");
  TestReportAddMiscInfo("Regression Test", "No");
  TestReportAddMiscInfo("Fault injection method used", "No");
  TestReportAddMiscInfo("Resource usage evaluation", "No");
  TestReportAddMiscInfo("Priority", "No");
  TestReportAddMiscInfo("Safety relevant", "No");
  
  AddRequirementInfo("Requirement under test", "ARCH_SW_BswMIf_ptrrCanTpServicesBswMIf_CanTp_Init_BswM_OnStartupTwoA");
  AddRequirementInfo("ARCH_SW_BswMIf_ptrrCanTpServicesBswMIf_CanTp_Init_BswM_OnStartupTwoA", "The CanTp_Init runnable shall be called in the BswM_OnStartupTwoA runnable in order to initialize the CanTp module.");
  //***************************************************************************************
  
  testCaseComment("Preconditions");
  testStep("STEP", "Bench Initialization"); // If the first parameter of testStep() is "Step", the arguments will be written in the specification file and "Step" argument will be numbered by 1 for each iteration.
  RunPreTs();
//   /*------------------------- Test scenario start ------------------------------*/
   
  testCaseComment("Action: ARCH_SW_BswMIf_ptrrCanTpServicesBswMIf_CanTp_Init_BswM_OnStartupTwoA");
  debugger_setRelativeFunctionBpAtLine("BswM_OnStartupTwoA", "6");
   testStep("", "Reset the debugger.");
  debugger_reset(); 
   testStep("", "Run the debugger.");
  debugger_run();
   testStep("STEP", "Set a BP in function BswM_OnStartupTwoA to call CanTp_Init function --> BP was set");
  debugger_waitUntilBPisReached("2000");
  ExpectedTestResult(debugger_result, W8_UNTIL_BP_SUCCESSFUL, "Breakpoint is reached");

  debugger_setBpAtLine("C:\\Projects\\eCS_R1.2\\Tools\\EB_BSW_8.5.1\\Workspace\\plugins\\CanTp_TS_TxDxM6I8R0\\src\\CanTp_Init.c", "214");
//  debugger_setRelativeFunctionBpAtLine("CanTp_Init", "0");
   testStep("", "Run the debugger.");
  debugger_run();
   testStep("STEP", "Set a BP in function CanTp_Init in order to initialize the CanTp module --> BP was set");
  debugger_waitUntilBPisReached("2000");
  ExpectedTestResult(debugger_result, W8_UNTIL_BP_SUCCESSFUL, "Breakpoint is reached");

  debugger_setRelativeFunctionBpAtLine("BswM_OnStartupTwoA", "7");
   testStep("", "Run the debugger.");
  debugger_run();
   testStep("STEP", "Set a BP in function BswM_OnStartupTwoA for check the interface --> BP was set");
  debugger_waitUntilBPisReached("2000");
  ExpectedTestResult(debugger_result, W8_UNTIL_BP_SUCCESSFUL, "Breakpoint is reached");

  //====================================================
  testCaseComment("Postcondition");
  testStep("STEP", "Return ECU to default values");
  RunPostTs();
}
testcase Sw_Int_BswMIf_ptrrAsrCanServicesBswMIf_01()
{
   /*-------------------------Test specific report info------------------------------*/
  
  testReportAddMiscInfoBlock("AUTOLIV ELECTRONICS document");
  TestReportAddMiscInfo("Nightly test", "No");
  TestReportAddMiscInfo("Test type", "Requirement-Based");
  TestReportAddMiscInfo("Regression Test", "No");
  TestReportAddMiscInfo("Fault injection method used", "No");
  TestReportAddMiscInfo("Resource usage evaluation", "No");
  TestReportAddMiscInfo("Priority", "No");
  TestReportAddMiscInfo("Safety relevant", "No");
  
  AddRequirementInfo("Requirement under test", "ARCH_SW_BswMIf_ptrrCanServicesBswMIf_Can_SetControllerMode_BswM_OnStartupTwoA, ARCH_SW_BswMIf_ptrrCanServicesBswMIf_Can_EnableControllerInterrupts_BswM_OnStartupTwoA");
  AddRequirementInfo("ARCH_SW_BswMIf_ptrrCanServicesBswMIf_Can_SetControllerMode_BswM_OnStartupTwoA", "The Can_SetControllerMode runnable shall be called in the BswM_OnStartupTwoA runnable in order to put the CAN controller in START State.");
  AddRequirementInfo("ARCH_SW_BswMIf_ptrrCanServicesBswMIf_Can_EnableControllerInterrupts_BswM_OnStartupTwoA", "The Can_EnableControllerInterrupts runnable shall be called in the BswM_OnStartupTwoA runnable in order to enable CAN interrupts.");
  //***************************************************************************************
  
  testCaseComment("Preconditions");
  testStep("STEP", "Bench Initialization"); // If the first parameter of testStep() is "Step", the arguments will be written in the specification file and "Step" argument will be numbered by 1 for each iteration.
  RunPreTs();
//   /*------------------------- Test scenario start ------------------------------*/
   
  testCaseComment("Action: ARCH_SW_BswMIf_ptrrCanServicesBswMIf_Can_SetControllerMode_BswM_OnStartupTwoA");
  debugger_setRelativeFunctionBpAtLine("BswM_OnStartupTwoA", "2");
   testStep("", "Reset the debugger.");
  debugger_reset(); 
   testStep("", "Run the debugger.");
  debugger_run();
   testStep("STEP", "Set a BP in function BswM_OnStartupTwoA to call Can_SetControllerMode function --> BP was set");
  debugger_waitUntilBPisReached("2000");
  ExpectedTestResult(debugger_result, W8_UNTIL_BP_SUCCESSFUL, "Breakpoint is reached");

  debugger_setBpAtLine("C:\\Projects\\eCS_R1.2\\Tools\\EB_BSW_8.5.1\\Workspace\\plugins\\Can_TS_T40D2M10I2R0\\src\\Can.c", "763");
//  debugger_setRelativeFunctionBpAtLine("Can_SetControllerMode", "0");
   testStep("", "Run the debugger.");
  debugger_run();
   testStep("STEP", "Set a BP in function Can_SetControllerMode in order to put the CAN controller in START State --> BP was set");
  debugger_waitUntilBPisReached("2000");
  ExpectedTestResult(debugger_result, W8_UNTIL_BP_SUCCESSFUL, "Breakpoint is reached");

  debugger_setRelativeFunctionBpAtLine("BswM_OnStartupTwoA", "3");
   testStep("", "Run the debugger.");
  debugger_run();
   testStep("STEP", "Set a BP in function BswM_OnStartupTwoA for check the interface --> BP was set");
  debugger_waitUntilBPisReached("2000");
  ExpectedTestResult(debugger_result, W8_UNTIL_BP_SUCCESSFUL, "Breakpoint is reached");
  debugger_deleteAllBreakpoints();
  
  testCaseComment("Action: ARCH_SW_BswMIf_ptrrCanServicesBswMIf_Can_EnableControllerInterrupts_BswM_OnStartupTwoA");
  debugger_setRelativeFunctionBpAtLine("BswM_OnStartupTwoA", "3");
   testStep("", "Reset the debugger.");
  debugger_reset(); 
   testStep("", "Run the debugger.");
  debugger_run();
   testStep("STEP", "Set a BP in function BswM_OnStartupTwoA to call Can_EnableControllerInterrupts function --> BP was set");
  debugger_waitUntilBPisReached("2000");
  ExpectedTestResult(debugger_result, W8_UNTIL_BP_SUCCESSFUL, "Breakpoint is reached");

//  debugger_setBpAtLine("C:\\Projects\\eCS_R1.2\\Tools\\EB_BSW_8.5.1\\Workspace\\plugins\\Can_TS_T40D2M10I2R0\\src\\Can.c", "763");
  debugger_setRelativeFunctionBpAtLine("Can_EnableControllerInterrupts", "0");
   testStep("", "Run the debugger.");
  debugger_run();
   testStep("STEP", "Set a BP in function Can_EnableControllerInterrupts in order to enable CAN interrupts --> BP was set");
  debugger_waitUntilBPisReached("2000");
  ExpectedTestResult(debugger_result, W8_UNTIL_BP_SUCCESSFUL, "Breakpoint is reached");

  debugger_setRelativeFunctionBpAtLine("BswM_OnStartupTwoA", "4");
   testStep("", "Run the debugger.");
  debugger_run();
   testStep("STEP", "Set a BP in function BswM_OnStartupTwoA for check the interface --> BP was set");
  debugger_waitUntilBPisReached("2000");
  ExpectedTestResult(debugger_result, W8_UNTIL_BP_SUCCESSFUL, "Breakpoint is reached");

  //====================================================
  testCaseComment("Postcondition");
  testStep("STEP", "Return ECU to default values");
  RunPostTs();
}
testcase Sw_Int_BswMIf_ptrrAsrCanSMServicesBswMIf_01()
{
   /*-------------------------Test specific report info------------------------------*/
  
  testReportAddMiscInfoBlock("AUTOLIV ELECTRONICS document");
  TestReportAddMiscInfo("Nightly test", "No");
  TestReportAddMiscInfo("Test type", "Requirement-Based");
  TestReportAddMiscInfo("Regression Test", "No");
  TestReportAddMiscInfo("Fault injection method used", "No");
  TestReportAddMiscInfo("Resource usage evaluation", "No");
  TestReportAddMiscInfo("Priority", "No");
  TestReportAddMiscInfo("Safety relevant", "No");
  
  AddRequirementInfo("Requirement under test", "ARCH_SW_BswMIf_ptrrCanSMServicesBswMIf_CanSM_Init_BswM_OnStartupTwoA");
  AddRequirementInfo("ARCH_SW_BswMIf_ptrrCanSMServicesBswMIf_CanSM_Init_BswM_OnStartupTwoA", "The CanSM_Init runnable shall be called in the BswM_OnStartupTwoA runnable in order to initialize the CanSM module.");
  //***************************************************************************************
  
  testCaseComment("Preconditions");
  testStep("STEP", "Bench Initialization"); // If the first parameter of testStep() is "Step", the arguments will be written in the specification file and "Step" argument will be numbered by 1 for each iteration.
  RunPreTs();
//   /*------------------------- Test scenario start ------------------------------*/
   
  testCaseComment("Action: ARCH_SW_BswMIf_ptrrCanSMServicesBswMIf_CanSM_Init_BswM_OnStartupTwoA");
  debugger_setRelativeFunctionBpAtLine("BswM_OnStartupTwoA", "5");
   testStep("", "Reset the debugger.");
  debugger_reset(); 
   testStep("", "Run the debugger.");
  debugger_run();
   testStep("STEP", "Set a BP in function BswM_OnStartupTwoA to call CanSM_Init function --> BP was set");
  debugger_waitUntilBPisReached("2000");
  ExpectedTestResult(debugger_result, W8_UNTIL_BP_SUCCESSFUL, "Breakpoint is reached");

  debugger_setBpAtLine("C:\\Projects\\eCS_R1.2\\Tools\\EB_BSW_8.5.1\\Workspace\\plugins\\CanSM_TS_TxDxM3I6R0\\src\\CanSM_Init.c", "60");
//  debugger_setRelativeFunctionBpAtLine("CanSM_Init", "9");
   testStep("", "Run the debugger.");
  debugger_run();
   testStep("STEP", "Set a BP in function CanSM_Init in order to initialize the CanSM module --> BP was set");
  debugger_waitUntilBPisReached("2000");
  ExpectedTestResult(debugger_result, W8_UNTIL_BP_SUCCESSFUL, "Breakpoint is reached");

  debugger_setRelativeFunctionBpAtLine("BswM_OnStartupTwoA", "6");
   testStep("", "Run the debugger.");
  debugger_run();
   testStep("STEP", "Set a BP in function BswM_OnStartupTwoA for check the interface --> BP was set");
  debugger_waitUntilBPisReached("2000");
  ExpectedTestResult(debugger_result, W8_UNTIL_BP_SUCCESSFUL, "Breakpoint is reached");

  //====================================================
  testCaseComment("Postcondition");
  testStep("STEP", "Return ECU to default values");
  RunPostTs();
}
testcase Sw_Int_BswMIf_ptrrAsrCanIfServicesBswMIf_01()
{
   /*-------------------------Test specific report info------------------------------*/
  
  testReportAddMiscInfoBlock("AUTOLIV ELECTRONICS document");
  TestReportAddMiscInfo("Nightly test", "No");
  TestReportAddMiscInfo("Test type", "Requirement-Based");
  TestReportAddMiscInfo("Regression Test", "No");
  TestReportAddMiscInfo("Fault injection method used", "No");
  TestReportAddMiscInfo("Resource usage evaluation", "No");
  TestReportAddMiscInfo("Priority", "No");
  TestReportAddMiscInfo("Safety relevant", "No");
  
  AddRequirementInfo("Requirement under test", "ARCH_SW_BswMIf_ptrrCanIfServicesBswMIf_CanIf_Init_BswM_OnStartupTwoA, ARCH_SW_BswMIf_ptrrCanIfServicesBswMIf_CanIf_CheckWakeup_BswM_CB_NfyNvMJobEnd");
  AddRequirementInfo("ARCH_SW_BswMIf_ptrrCanIfServicesBswMIf_CanIf_Init_BswM_OnStartupTwoA", "The CanIf_Init runnable shall be called in the BswM_OnStartupTwoA runnable in order to initialize the CAN interface.");
  AddRequirementInfo("ARCH_SW_BswMIf_ptrrCanIfServicesBswMIf_CanIf_CheckWakeup_BswM_CB_NfyNvMJobEnd", "The CanIf_CheckWakeup runnable shall be called in the BswM_CB_NfyNvMJobEnd runnable in order to check for wakeup events.");
  //***************************************************************************************
  
  testCaseComment("Preconditions");
  testStep("STEP", "Bench Initialization"); // If the first parameter of testStep() is "Step", the arguments will be written in the specification file and "Step" argument will be numbered by 1 for each iteration.
  RunPreTs();
//   /*------------------------- Test scenario start ------------------------------*/
   
  testCaseComment("Action: ARCH_SW_BswMIf_ptrrCanIfServicesBswMIf_CanIf_Init_BswM_OnStartupTwoA");
  debugger_setRelativeFunctionBpAtLine("BswM_OnStartupTwoA", "4");
   testStep("", "Reset the debugger.");
  debugger_reset(); 
   testStep("", "Run the debugger.");
  debugger_run();
   testStep("STEP", "Set a BP in function BswM_OnStartupTwoA to call CanIf_Init function --> BP was set");
  debugger_waitUntilBPisReached("2000");
  ExpectedTestResult(debugger_result, W8_UNTIL_BP_SUCCESSFUL, "Breakpoint is reached");

  debugger_setBpAtLine("C:\\Projects\\eCS_R1.2\\Tools\\EB_BSW_8.5.1\\Workspace\\plugins\\CanIf_TS_TxDxM6I9R0\\src\\CanIf.c", "1137");
//  debugger_setRelativeFunctionBpAtLine("CanIf_Init", "0");
   testStep("", "Run the debugger.");
  debugger_run();
   testStep("STEP", "Set a BP in function CanIf_Init in order to initialize the CAN interface --> BP was set");
  debugger_waitUntilBPisReached("2000");
  ExpectedTestResult(debugger_result, W8_UNTIL_BP_SUCCESSFUL, "Breakpoint is reached");

  debugger_setRelativeFunctionBpAtLine("BswM_OnStartupTwoA", "5");
   testStep("", "Run the debugger.");
  debugger_run();
   testStep("STEP", "Set a BP in function BswM_OnStartupTwoA for check the interface --> BP was set");
  debugger_waitUntilBPisReached("2000");
  ExpectedTestResult(debugger_result, W8_UNTIL_BP_SUCCESSFUL, "Breakpoint is reached");
  debugger_deleteAllBreakpoints();
  
  testCaseComment("Action: ARCH_SW_BswMIf_ptrrCanIfServicesBswMIf_CanIf_CheckWakeup_BswM_CB_NfyNvMJobEnd");
  debugger_setRelativeFunctionBpAtLine("BswM_CB_NfyNvMJobEnd", "5");
   testStep("", "Reset the debugger.");
  debugger_reset(); 
   testStep("", "Run the debugger.");
  debugger_run();
   testStep("STEP", "Set a BP in function BswM_CB_NfyNvMJobEnd to call CanIf_CheckWakeup function --> BP was set");
  debugger_waitUntilBPisReached("2000");
  ExpectedTestResult(debugger_result, W8_UNTIL_BP_SUCCESSFUL, "Breakpoint is reached");

  debugger_setBpAtLine("C:\\Projects\\eCS_R1.2\\Tools\\EB_BSW_8.5.1\\Workspace\\plugins\\CanIf_TS_TxDxM6I9R0\\src\\CanIf.c", "2614");
//  debugger_setRelativeFunctionBpAtLine("CanIf_CheckWakeup", "1");
   testStep("", "Run the debugger.");
  debugger_run();
   testStep("STEP", "Set a BP in function CanIf_CheckWakeup in order to check for wakeup events --> BP was set");
  debugger_waitUntilBPisReached("2000");
  ExpectedTestResult(debugger_result, W8_UNTIL_BP_SUCCESSFUL, "Breakpoint is reached");

  debugger_setRelativeFunctionBpAtLine("BswM_CB_NfyNvMJobEnd", "8");
   testStep("", "Run the debugger.");
  debugger_run();
   testStep("STEP", "Set a BP in function BswM_CB_NfyNvMJobEnd for check the interface --> BP was set");
  debugger_waitUntilBPisReached("2000");
  ExpectedTestResult(debugger_result, W8_UNTIL_BP_SUCCESSFUL, "Breakpoint is reached");

  //====================================================
  testCaseComment("Postcondition");
  testStep("STEP", "Return ECU to default values");
  RunPostTs();
}
testcase Sw_Int_BswMIf_ptrrAsrBswMServicesBswMIf_01()
{
   /*-------------------------Test specific report info------------------------------*/
  
  testReportAddMiscInfoBlock("AUTOLIV ELECTRONICS document");
  TestReportAddMiscInfo("Nightly test", "No");
  TestReportAddMiscInfo("Test type", "Requirement-Based");
  TestReportAddMiscInfo("Regression Test", "No");
  TestReportAddMiscInfo("Fault injection method used", "No");
  TestReportAddMiscInfo("Resource usage evaluation", "No");
  TestReportAddMiscInfo("Priority", "No");
  TestReportAddMiscInfo("Safety relevant", "No");
  
  AddRequirementInfo("Requirement under test", "ARCH_SW_BswMIf_ptrrBswMServicesBswMIf_BswM_RequestMode_BswM_OnStartupTwoA, ARCH_SW_BswMIf_ptrrBswMServicesBswMIf_BswM_RequestMode_BswM_OnStartupTwoB, ARCH_SW_BswMIf_ptrrBswMServicesBswMIf_BswM_RequestMode_BswM_OnPostRunFromRun");
  AddRequirementInfo("ARCH_SW_BswMIf_ptrrBswMServicesBswMIf_BswM_RequestMode_BswM_OnStartupTwoA", "The BswM_RequestMode runnable shall be called in the BswM_OnStartupTwoA runnable in order to: - Request to start the process to fastened the ReadAll process");
  AddRequirementInfo("ARCH_SW_BswMIf_ptrrBswMServicesBswMIf_BswM_RequestMode_BswM_OnStartupTwoB", "The BswM_RequestMode runnable shall be called in the BswM_OnStartupTwoB runnable in order to: - Set BswM Request Port to be able to notify that initialization phase shall continue {wait for wake-up validation}");
  AddRequirementInfo("ARCH_SW_BswMIf_ptrrBswMServicesBswMIf_BswM_RequestMode_BswM_OnPostRunFromRun", "The BswM_RequestMode runnable shall be called in the BswM_OnPostRunFromRun runnable in order to: - Request to start the process to fastened the ReadAll process - Set BswM EcuState Port to be able to notify that POST RUN state is requested");
  //***************************************************************************************
  
  testCaseComment("Preconditions");
  testStep("STEP", "Bench Initialization"); // If the first parameter of testStep() is "Step", the arguments will be written in the specification file and "Step" argument will be numbered by 1 for each iteration.
  RunPreTs();
//   /*------------------------- Test scenario start ------------------------------*/
   
  testCaseComment("Action: ARCH_SW_BswMIf_ptrrBswMServicesBswMIf_BswM_RequestMode_BswM_OnStartupTwoA");
  debugger_setRelativeFunctionBpAtLine("BswM_OnStartupTwoA", "23");
   testStep("", "Reset the debugger.");
  debugger_reset(); 
   testStep("", "Run the debugger.");
  debugger_run();
   testStep("STEP", "Set a BP in function BswM_OnStartupTwoA to call BswM_RequestMode function --> BP was set");
  debugger_waitUntilBPisReached("2000");
  ExpectedTestResult(debugger_result, W8_UNTIL_BP_SUCCESSFUL, "Breakpoint is reached");

//  debugger_setBpAtLine("C:\\Projects\\eCS_R1.2\\Tools\\EB_BSW_8.5.1\\Workspace\\plugins\\CanSM_TS_TxDxM3I6R0\\src\\CanSM_Init.c", "60");
  debugger_setRelativeFunctionBpAtLine("BswM_RequestMode ", "2");
   testStep("", "Run the debugger.");
  debugger_run();
   testStep("STEP", "Set a BP in function BswM_RequestMode in order to: - Request to start the process to fastened the ReadAll process --> BP was set");
  debugger_waitUntilBPisReached("2000");
  ExpectedTestResult(debugger_result, W8_UNTIL_BP_SUCCESSFUL, "Breakpoint is reached");

  debugger_setRelativeFunctionBpAtLine("BswM_OnStartupTwoA", "26");
   testStep("", "Run the debugger.");
  debugger_run();
   testStep("STEP", "Set a BP in function BswM_OnStartupTwoA for check the interface --> BP was set");
  debugger_waitUntilBPisReached("2000");
  ExpectedTestResult(debugger_result, W8_UNTIL_BP_SUCCESSFUL, "Breakpoint is reached");

   testCaseComment("Action: ARCH_SW_BswMIf_ptrrBswMServicesBswMIf_BswM_RequestMode_BswM_OnStartupTwoB");
  debugger_deleteAllBreakpoints();
  debugger_setRelativeFunctionBpAtLine("BswM_OnStartupTwoB", "13");
   testStep("", "Reset the debugger.");
  debugger_reset(); 
   testStep("", "Run the debugger.");
  debugger_run();
   testStep("STEP", "Set a BP in function BswM_OnStartupTwoB to call BswM_RequestMode function --> BP was set");
  debugger_waitUntilBPisReached("2000");
  ExpectedTestResult(debugger_result, W8_UNTIL_BP_SUCCESSFUL, "Breakpoint is reached");

////    debugger_setBpAtLine("C:\\Projects\\eCS_R1.2\\Tools\\EB_BSW_8.5.1\\Workspace\\plugins\\PduR_TS_TxDxM5I3R0\\src\\PduR_Init.c", "213");
   debugger_setRelativeFunctionBpAtLine("BswM_RequestMode ", "2");
   testStep("", "Run the debugger.");
  debugger_run();
   testStep("STEP", "Set a BP in function BswM_RequestMode in order to: - Set BswM Request Port to be able to notify that initialization phase shall continue {wait for wake-up validation} --> BP was set");
  debugger_waitUntilBPisReached("2000");
  ExpectedTestResult(debugger_result, W8_UNTIL_BP_SUCCESSFUL, "Breakpoint is reached");
    
  debugger_setRelativeFunctionBpAtLine("BswM_OnStartupTwoB", "16");
   testStep("", "Run the debugger.");
  debugger_run();
   testStep("STEP", "Set a BP in function BswM_OnStartupTwoA for check the interface --> BP was set");
  debugger_waitUntilBPisReached("2000");
  ExpectedTestResult(debugger_result, W8_UNTIL_BP_SUCCESSFUL, "Breakpoint is reached");
  
  testCaseComment("Action: ARCH_SW_BswMIf_ptrrBswMServicesBswMIf_BswM_RequestMode_BswM_OnPostRunFromRun");
  debugger_deleteAllBreakpoints();
   debugger_setRelativeFunctionBpAtLine("BswM_OnPostRunFromRun", "26");
  testStep("", "Reset the debugger.");
   debugger_reset();
  testStep("", "Run the debugger.");
  debugger_run();
  testStep("STEP", "Disable comunication --> Comunication disable");
   TestDisableMsg(Airbag_01);
  TestDisableMsg(Airbag_02);
  TestDisableMsg(Airbag_eCS_01);
   TestWaitForTimeout(7000);
   debugger_waitUntilBPisReached("2000");
   testStep("STEP", "Set a BP in function BswM_OnPostRunFromRun in order to call BswM_RequestMode function --> BP was set");
  ExpectedTestResult(debugger_result, W8_UNTIL_BP_SUCCESSFUL, "Breakpoint is reached");

   debugger_setRelativeFunctionBpAtLine("BswM_RequestMode", "2"); 
  testStep("", "Run the debugger.");
  debugger_run();
   testStep("STEP", "Set a BP in function BswM_RequestMode in order to: - Request to start the process to fastened the ReadAll process - Set BswM EcuState Port to be able to notify that POST RUN state is requested");
  debugger_waitUntilBPisReached("2000");
  ExpectedTestResult(debugger_result, W8_UNTIL_BP_SUCCESSFUL, "Breakpoint is reached");
  
  debugger_setRelativeFunctionBpAtLine("BswM_OnPostRunFromRun", "29");
   testStep("", "Run the debugger.");
  debugger_run();
   testStep("STEP", "Set a BP in function BswM_OnPostRunFromRun for check the interface --> BP was set");
  debugger_waitUntilBPisReached("2000");
  ExpectedTestResult(debugger_result, W8_UNTIL_BP_SUCCESSFUL, "Breakpoint is reached");
  
}
testcase Sw_Int_BswMIf_ptrrAsrBswMServicesBswMIf_02()
{
   /*-------------------------Test specific report info------------------------------*/
  
  testReportAddMiscInfoBlock("AUTOLIV ELECTRONICS document");
  TestReportAddMiscInfo("Nightly test", "No");
  TestReportAddMiscInfo("Test type", "Requirement-Based");
  TestReportAddMiscInfo("Regression Test", "No");
  TestReportAddMiscInfo("Fault injection method used", "No");
  TestReportAddMiscInfo("Resource usage evaluation", "No");
  TestReportAddMiscInfo("Priority", "No");
  TestReportAddMiscInfo("Safety relevant", "No");
  
  AddRequirementInfo("Requirement under test", "ARCH_SW_BswMIf_ptrrBswMServicesBswMIf_BswM_RequestMode_BswM_OnRunFromPostRunBusAvailable");
  AddRequirementInfo("ARCH_SW_BswMIf_ptrrBswMServicesBswMIf_BswM_RequestMode_BswM_OnRunFromPostRunBusAvailable", "The BswM_RequestMode runnable shall be called in the BswM_OnRunFromPostRunBusAvailable runnable in order to: - Set BswM EcuState Port to be able to notify that RUN state is requested");
  //***************************************************************************************
  
  testCaseComment("Preconditions");
  testStep("STEP", "Bench Initialization"); // If the first parameter of testStep() is "Step", the arguments will be written in the specification file and "Step" argument will be numbered by 1 for each iteration.
  RunPreTs();
//   /*------------------------- Test scenario start ------------------------------*/
  
   testCaseComment("Action: ARCH_SW_BswMIf_ptrrBswMServicesBswMIf_BswM_RequestMode_BswM_OnRunFromPostRunBusAvailable");
  testStep("STEP", "Enable comunication --> Comunication enable");
   TestSetMsgEvent(Airbag_01);
  TestSetMsgEvent(Airbag_02);
  TestSetMsgEvent(Airbag_eCS_01);
   TestWaitForTimeout(10000);
  
   debugger_setRelativeFunctionBpAtLine("BswM_Cyclic_10msTimer", "5");
  testStep("", "Reset the debugger.");
   debugger_reset();
  testStep("", "Run the debugger.");
  debugger_run();
  
  testStep("STEP", "Disable comunication --> Comunication disable");
   TestDisableMsg(Airbag_01);
  TestDisableMsg(Airbag_02);
  TestDisableMsg(Airbag_eCS_01);
   TestWaitForTimeout(5000);
  
  debugger_waitUntilBPisReached("2000");
   testStep("STEP", "Set a BP in function BswM_Cyclic_10msTimer in order to call BswM_OnRunFromPostRunBusAvailable function --> BP was set");
  ExpectedTestResult(debugger_result, W8_UNTIL_BP_SUCCESSFUL, "Breakpoint is reached");
 debugger_deleteAllBreakpoints();
  
  debugger_setRelativeFunctionBpAtLine("BswM_OnRunFromPostRunBusAvailable", "5");
   testStep("", "Run the debugger.");
  debugger_run();
  
  testStep("STEP", "Enable comunication --> Comunication enable");
   TestSetMsgEvent(Airbag_01);
  TestSetMsgEvent(Airbag_02);
  TestSetMsgEvent(Airbag_eCS_01);
   TestWaitForTimeout(61240);
    
  debugger_waitUntilBPisReached("2000");
   testStep("STEP", "Set a BP in function BswM_OnRunFromPostRunBusAvailable in order to call BswM_RequestMode function --> BP was set");
  ExpectedTestResult(debugger_result, W8_UNTIL_BP_SUCCESSFUL, "Breakpoint is reached");
  
   debugger_setRelativeFunctionBpAtLine("BswM_RequestMode", "2"); 
  testStep("", "Run the debugger.");
  debugger_run();
   testStep("STEP", "Set a BP in function BswM_RequestMode in order to: - Set BswM EcuState Port to be able to notify that RUN state is requested");
  debugger_waitUntilBPisReached("2000");
  ExpectedTestResult(debugger_result, W8_UNTIL_BP_SUCCESSFUL, "Breakpoint is reached");
  
  debugger_setRelativeFunctionBpAtLine("BswM_OnRunFromPostRunBusAvailable", "8");
   testStep("", "Run the debugger.");
  debugger_run();
   testStep("STEP", "Set a BP in function BswM_OnRunFromPostRunBusAvailable for check the interface --> BP was set");
  debugger_waitUntilBPisReached("2000");
  ExpectedTestResult(debugger_result, W8_UNTIL_BP_SUCCESSFUL, "Breakpoint is reached");
  
  //====================================================
  testCaseComment("Postcondition");
  testStep("STEP", "Return ECU to default values");
  RunPostTs();
}
testcase Sw_Int_BswMIf_ptrrAsrBswMServicesBswMIf_03()
{
   /*-------------------------Test specific report info------------------------------*/
  
  testReportAddMiscInfoBlock("AUTOLIV ELECTRONICS document");
  TestReportAddMiscInfo("Nightly test", "No");
  TestReportAddMiscInfo("Test type", "Requirement-Based");
  TestReportAddMiscInfo("Regression Test", "No");
  TestReportAddMiscInfo("Fault injection method used", "No");
  TestReportAddMiscInfo("Resource usage evaluation", "No");
  TestReportAddMiscInfo("Priority", "No");
  TestReportAddMiscInfo("Safety relevant", "No");
  
  AddRequirementInfo("Requirement under test", "ARCH_SW_BswMIf_ptrrBswMServicesBswMIf_BswM_RequestMode_BswM_OnLowPwrFromPostRun, ARCH_SW_BswMIf_ptrrBswMServicesBswMIf_BswM_RequestMode_BswM_OnRunFromLowPwrBusAvailable");
  AddRequirementInfo("ARCH_SW_BswMIf_ptrrBswMServicesBswMIf_BswM_RequestMode_BswM_OnLowPwrFromPostRun", "The BswM_RequestMode runnable shall be called in the BswM_OnLowPwrFromPostRun runnable in order to: - Set BswM EcuState Port to be able to notify that LOW POWER state is requested");
  AddRequirementInfo("ARCH_SW_BswMIf_ptrrBswMServicesBswMIf_BswM_RequestMode_BswM_OnRunFromLowPwrBusAvailable", "The BswM_RequestMode runnable shall be called in the BswM_OnRunFromLowPwrBusAvailable runnable in order to: - Set BswM EcuState Port to be able to notify that RUN state is requested");
  //***************************************************************************************
  testCaseComment("Preconditions");
  testStep("STEP", "Bench Initialization"); // If the first parameter of testStep() is "Step", the arguments will be written in the specification file and "Step" argument will be numbered by 1 for each iteration.
  RunPreTs();
//   /*------------------------- Test scenario start ------------------------------*/
  
   testCaseComment("Action: ARCH_SW_BswMIf_ptrrBswMServicesBswMIf_BswM_RequestMode_BswM_OnLowPwrFromPostRun");
  testStep("STEP", "Enable comunication --> Comunication enable");
   TestSetMsgEvent(Airbag_01);
  TestSetMsgEvent(Airbag_02);
  TestSetMsgEvent(Airbag_eCS_01);
   TestWaitForTimeout(11000);
  
  debugger_setRelativeFunctionBpAtLine("BswM_Cyclic_10msTimer", "5");
  testStep("", "Reset the debugger.");
   debugger_reset();
   testStep("", "Run the debugger."); 
  debugger_run();
    
  testStep("STEP", "Disable comunication --> Comunication disable");
  TestDisableMsg(Airbag_01);
  TestDisableMsg(Airbag_02);
  TestDisableMsg(Airbag_eCS_01);
  TestWaitForTimeout(5000);
  testStep("STEP", "Set a BP in function BswM_Cyclic_10msTimer in order to go in  BswM_OnLowPwrFromPostRun function --> BP was set");
  debugger_waitUntilBPisReached("2000");
  ExpectedTestResult(debugger_result, W8_UNTIL_BP_SUCCESSFUL, "Breakpoint is reached");
  debugger_deleteAllBreakpoints();
  
  debugger_writeVariable("uint8","bswmif_u16TPostRunTimer,,app.elf", "1", "17EC");
  TestWaitForTimeout(2000);
   
//  debugger_setBpAtLine("C:\\Projects\\eCS_R1.2\\Components\\Application\\Autoliv\\BswMIf\\Implementation\\src\\BswM_Callouts.c", "1398");
  debugger_setRelativeFunctionBpAtLine("BswM_OnLowPwrFromPostRun", "2");
   testStep("", "Run the debugger.");
  debugger_run();
   testStep("STEP", "Set a BP in function BswM_OnLowPwrFromPostRun in order to call BswM_RequestMode function --> BP was set");
  debugger_waitUntilBPisReached("2000");
  ExpectedTestResult(debugger_result, W8_UNTIL_BP_SUCCESSFUL, "Breakpoint is reached");

  debugger_setRelativeFunctionBpAtLine("BswM_RequestMode", "2");
   testStep("", "Run the debugger.");
  debugger_run();
   testStep("STEP", "Set a BP in function BswM_RequestMode  in order to: - Set BswM EcuState Port to be able to notify that LOW POWER state is requested --> BP was set");
  debugger_waitUntilBPisReached("2000");
  ExpectedTestResult(debugger_result, W8_UNTIL_BP_SUCCESSFUL, "Breakpoint is reached");

   debugger_setRelativeFunctionBpAtLine("BswM_OnLowPwrFromPostRun", "5");
   testStep("", "Run the debugger.");
  debugger_run();
   testStep("STEP", "Set a BP in function BswM_OnLowPwrFromPostRun for check the interface --> BP was set");
  debugger_waitUntilBPisReached("2000");
   ExpectedTestResult(debugger_result, W8_UNTIL_BP_SUCCESSFUL, "Breakpoint is reached");
  debugger_deleteAllBreakpoints();
  
  testCaseComment("Action: ARCH_SW_BswMIf_ptrrBswMServicesBswMIf_BswM_RequestMode_BswM_OnRunFromLowPwrBusAvailable");
   debugger_setRelativeFunctionBpAtLine("BswM_OnRunFromLowPwrBusAvailable", "2");
   testStep("", "Run the debugger.");
  debugger_run();
  
  testStep("STEP", "Enable comunication --> Comunication enable");
   TestSetMsgEvent(Airbag_01);
  TestSetMsgEvent(Airbag_02);
  TestSetMsgEvent(Airbag_eCS_01);
   TestWaitForTimeout(61240);
    
  debugger_waitUntilBPisReached("2000");
   testStep("STEP", "Set a BP in function BswM_OnRunFromLowPwrBusAvailable in order to call BswM_RequestMode function --> BP was set");
  ExpectedTestResult(debugger_result, W8_UNTIL_BP_SUCCESSFUL, "Breakpoint is reached");
  
   debugger_setRelativeFunctionBpAtLine("BswM_RequestMode", "2"); 
  testStep("", "Run the debugger.");
  debugger_run();
   testStep("STEP", "Set a BP in function BswM_RequestMode in order to: - Set BswM EcuState Port to be able to notify that RUN state is requested");
  debugger_waitUntilBPisReached("2000");
  ExpectedTestResult(debugger_result, W8_UNTIL_BP_SUCCESSFUL, "Breakpoint is reached");
  
  debugger_setRelativeFunctionBpAtLine("BswM_OnRunFromLowPwrBusAvailable", "9");
   testStep("", "Run the debugger.");
  debugger_run();
   testStep("STEP", "Set a BP in function BswM_OnRunFromLowPwrBusAvailable for check the interface --> BP was set");
  debugger_waitUntilBPisReached("2000");
  ExpectedTestResult(debugger_result, W8_UNTIL_BP_SUCCESSFUL, "Breakpoint is reached");
  
  //====================================================
  testCaseComment("Postcondition");
  testStep("STEP", "Return ECU to default values");
  RunPostTs();
}
testcase Sw_Int_BswMIf_ptrrAsrBswMServicesBswMIf_04()
{
   /*-------------------------Test specific report info------------------------------*/
  
  testReportAddMiscInfoBlock("AUTOLIV ELECTRONICS document");
  TestReportAddMiscInfo("Nightly test", "No");
  TestReportAddMiscInfo("Test type", "Requirement-Based");
  TestReportAddMiscInfo("Regression Test", "No");
  TestReportAddMiscInfo("Fault injection method used", "No");
  TestReportAddMiscInfo("Resource usage evaluation", "No");
  TestReportAddMiscInfo("Priority", "No");
  TestReportAddMiscInfo("Safety relevant", "No");
  
  AddRequirementInfo("Requirement under test", "ARCH_SW_BswMIf_ptrrBswMServicesBswMIf_BswM_RequestMode_BswM_On_Prep_Shutdown, ARCH_SW_BswMIf_ptrrBswMServicesBswMIf_BswM_RequestMode_BswM_OnGoOffOneA");
  AddRequirementInfo("ARCH_SW_BswMIf_ptrrBswMServicesBswMIf_BswM_RequestMode_BswM_On_Prep_Shutdown", "The BswM_RequestMode runnable shall be called in the BswM_On_Prep_Shutdown runnable in order to: - Request to start the process to fastened the WriteAll process - Set BswM Request Port to be able to notify that de-initialization of modules shall be performed");
  AddRequirementInfo("ARCH_SW_BswMIf_ptrrBswMServicesBswMIf_BswM_RequestMode_BswM_OnGoOffOneA", "The BswM_RequestMode runnable shall be called in the BswM_OnGoOffOneA runnable in order to: - Set BswM Request Port to be able to notify that the second step of de-initialization of modules shall be performed");
  //***************************************************************************************
  testCaseComment("Preconditions");
  testStep("STEP", "Bench Initialization"); // If the first parameter of testStep() is "Step", the arguments will be written in the specification file and "Step" argument will be numbered by 1 for each iteration.
  RunPreTs();
//   /*------------------------- Test scenario start ------------------------------*/
  
   testCaseComment("Action: ARCH_SW_BswMIf_ptrrBswMServicesBswMIf_BswM_RequestMode_BswM_On_Prep_Shutdown");
   debugger_setRelativeFunctionBpAtLine("BswM_ProceedReset", "6");
  testStep("", "Reset the debugger.");
   debugger_reset();
  testStep("", "Run the debugger.");
  debugger_run();
  
  testStep("STEP", "Send diagnostic request in order to do soft Reset");
   SendDiagnosticRequest(dSoftResetRequest, dSoftResetResponse);
  
   debugger_waitUntilBPisReached("2000");
   testStep("STEP", "Set a BP in function BswM_ProceedReset in order to call BswM_On_Prep_Shutdown --> BP was set");
  ExpectedTestResult(debugger_result, W8_UNTIL_BP_SUCCESSFUL, "Breakpoint is reached");
  
  debugger_setRelativeFunctionBpAtLine("BswM_RequestMode ", "2"); 
  testStep("", "Run the debugger.");
  debugger_run();
   testStep("STEP", "Set a BP in BswM_RequestMode function in order to: - Request to start the process to fastened the WriteAll process - Set BswM Request Port to be able to notify that de-initialization of modules shall be performed --> BP was set");
  debugger_waitUntilBPisReached("2000");
  ExpectedTestResult(debugger_result, W8_UNTIL_BP_SUCCESSFUL, "Breakpoint is reached");
  
  debugger_setRelativeFunctionBpAtLine("BswM_CB_NfyNvMJobEnd", "58");
   testStep("", "Run the debugger.");
  debugger_run();
   testStep("STEP", "Set a BP in function BswM_CB_NfyNvMJobEnd for check the interface --> BP was set");
  debugger_waitUntilBPisReached("2000");
  ExpectedTestResult(debugger_result, W8_UNTIL_BP_SUCCESSFUL, "Breakpoint is reached");
  
   testCaseComment("Action: ARCH_SW_BswMIf_ptrrBswMServicesBswMIf_BswM_RequestMode_BswM_OnGoOffOneA");
   debugger_deleteAllBreakpoints();
  debugger_setRelativeFunctionBpAtLine("BswM_OnGoOffOneA", "8");
   testStep("", "Reset the debugger.");
  debugger_reset(); 
   testStep("", "Run the debugger.");
  debugger_run();
  
  testStep("STEP", "Send diagnostic request in order to do soft Reset");
   SendDiagnosticRequest(dSoftResetRequest, dSoftResetResponse);
  
   testStep("STEP", "Set a BP in function BswM_OnGoOffOneA in order call BswM_RequestMode function --> BP was set");
  debugger_waitUntilBPisReached("2000");
   ExpectedTestResult(debugger_result, W8_UNTIL_BP_SUCCESSFUL, "Breakpoint is reached");
   
   debugger_setRelativeFunctionBpAtLine("BswM_RequestMode ", "2"); 
  testStep("", "Run the debugger.");
  debugger_run();
   testStep("STEP", "Set a BP in BswM_RequestMode function in order to: - Set BswM Request Port to be able to notify that the second step of de-initialization of modules shall be performed --> BP was set");
  debugger_waitUntilBPisReached("2000");
  ExpectedTestResult(debugger_result, W8_UNTIL_BP_SUCCESSFUL, "Breakpoint is reached");
    
  //====================================================
  testCaseComment("Postcondition");
  testStep("STEP", "Return ECU to default values");
  RunPostTs();
}
testcase Sw_Int_BswMIf_ptrrAsrBswMServicesBswMIf_05()
{
   /*-------------------------Test specific report info------------------------------*/
  
  testReportAddMiscInfoBlock("AUTOLIV ELECTRONICS document");
  TestReportAddMiscInfo("Nightly test", "No");
  TestReportAddMiscInfo("Test type", "Requirement-Based");
  TestReportAddMiscInfo("Regression Test", "No");
  TestReportAddMiscInfo("Fault injection method used", "No");
  TestReportAddMiscInfo("Resource usage evaluation", "No");
  TestReportAddMiscInfo("Priority", "No");
  TestReportAddMiscInfo("Safety relevant", "No");
  
  AddRequirementInfo("Requirement under test", "ARCH_SW_BswMIf_ptrrBswMServicesBswMIf_BswM_RequestMode_BswM_Cyclic_10msTimer");
  AddRequirementInfo("ARCH_SW_BswMIf_ptrrBswMServicesBswMIf_BswM_RequestMode_BswM_Cyclic_10msTimer", "The BswM_RequestMode runnable shall be called in the BswM_Cyclic_10msTimer runnable in order to: - Set BswM Passenger Occupancy port to notify that pasager occupancy was detected - Set BswM Passenger Occupancy port to notify that pasager occupancy was not detected - Set BswM ECU Shutdown Port to be able to notify that SHUTDOWN state is requested - Set BswM EcuState Port to be able to notify that LOW POWER state is requested - Set BswM EcuState Port to be able to notify that RUN state is requested - Set BswM TX PDU request port to notify that TX Pdu disable is requested");
   //***************************************************************************************
  testCaseComment("Preconditions");
  testStep("STEP", "Bench Initialization"); // If the first parameter of testStep() is "Step", the arguments will be written in the specification file and "Step" argument will be numbered by 1 for each iteration.
  RunPreTs();
//   /*------------------------- Test scenario start ------------------------------*/
  
   testCaseComment("Action: ARCH_SW_BswMIf_ptrrBswMServicesBswMIf_BswM_RequestMode_BswM_Cyclic_10msTimer");
   testStep("STEP", "Enable comunication --> Comunication enable");
   TestSetMsgEvent(Airbag_01);
  TestSetMsgEvent(Airbag_02);
  TestSetMsgEvent(Airbag_eCS_01);
   TestWaitForTimeout(12000);
  
    debugger_setRelativeFunctionBpAtLine("BswM_Cyclic_10msTimer", "5");
   testStep("", "Reset the debugger.");
  debugger_reset(); 
  testStep("", "Run the debugger.");
  debugger_run();;
    
  testStep("STEP", "Disable comunication --> Comunication disable");
  TestDisableMsg(Airbag_01);
  TestDisableMsg(Airbag_02);
  TestDisableMsg(Airbag_eCS_01);
  TestWaitForTimeout(5000);
  testStep("STEP", "Set a BP in function BswM_Cyclic_10msTimer in order to change post run timer value --> BP was set");
  debugger_waitUntilBPisReached("2000");
  ExpectedTestResult(debugger_result, W8_UNTIL_BP_SUCCESSFUL, "Breakpoint is reached");
  
  debugger_setRelativeFunctionBpAtLine("BswM_Cyclic_10msTimer", "12");
   testStep("", "Run the debugger.");
  debugger_run();
   testStep("STEP", "Set a BP in function BswM_Cyclic_10msTimer in order to change Passenger Occupancy Status --> BP was set");
  debugger_waitUntilBPisReached("2000");
  ExpectedTestResult(debugger_result, W8_UNTIL_BP_SUCCESSFUL, "Breakpoint is reached");
  
  testStep("STEP", "Change value for Passenger Occupancy Status with pasager occupancy is detected--> Succesfully changed");
   debugger_writeLocalVariable("bswmif_u8PassengerOccupancyStatus", "1");
  TestWaitForTimeout(2000);
  
  debugger_setRelativeFunctionBpAtLine("BswM_Cyclic_10msTimer ", "15");
   testStep("", "Run the debugger.");
  debugger_run();
   testStep("STEP", "Set a BP in function BswM_Cyclic_10msTimer in order to call BswM_RequestMode --> BP was set");
  debugger_waitUntilBPisReached("2000");
  ExpectedTestResult(debugger_result, W8_UNTIL_BP_SUCCESSFUL, "Breakpoint is reached");
  
   debugger_setRelativeFunctionBpAtLine("BswM_RequestMode", "2");
   testStep("", "Run the debugger.");
  debugger_run();
   testStep("STEP", "Set a BP in function BswM_RequestMode in order to: - Set BswM Passenger Occupancy port to notify that pasager occupancy was detected - Set BswM Passenger Occupancy port to notify that pasager occupancy was not detected - Set BswM ECU Shutdown Port to be able to notify that SHUTDOWN state is requested - Set BswM EcuState Port to be able to notify that LOW POWER state is requested - Set BswM EcuState Port to be able to notify that RUN state is requested - Set BswM TX PDU request port to notify that TX Pdu disable is requested --> BP was set");
  debugger_waitUntilBPisReached("2000");
  ExpectedTestResult(debugger_result, W8_UNTIL_BP_SUCCESSFUL, "Breakpoint is reached");
  
   debugger_setRelativeFunctionBpAtLine("BswM_Cyclic_10msTimer ", "18");
   testStep("", "Run the debugger.");
  debugger_run();
   testStep("STEP", "Set a BP in function BswM_Cyclic_10msTimer in order to check the interface --> BP was set");
  debugger_waitUntilBPisReached("2000");
  ExpectedTestResult(debugger_result, W8_UNTIL_BP_SUCCESSFUL, "Breakpoint is reached");

  //====================================================
  testCaseComment("Postcondition");
  testStep("STEP", "Return ECU to default values");
  RunPostTs();
}
testcase Sw_Int_BswMIf_ptrrAdcIfServicesBswMIf_01()
{
   /*-------------------------Test specific report info------------------------------*/
  
  testReportAddMiscInfoBlock("AUTOLIV ELECTRONICS document");
  TestReportAddMiscInfo("Nightly test", "No");
  TestReportAddMiscInfo("Test type", "Requirement-Based");
  TestReportAddMiscInfo("Regression Test", "No");
  TestReportAddMiscInfo("Fault injection method used", "No");
  TestReportAddMiscInfo("Resource usage evaluation", "No");
  TestReportAddMiscInfo("Priority", "No");
  TestReportAddMiscInfo("Safety relevant", "No");
  
  AddRequirementInfo("Requirement under test", "ARCH_SW_BswMIf_ptrrAdcIfServicesBswMIf_AdcIf_runDeInit_BswM_OnGoOffOneA");
  AddRequirementInfo("ARCH_SW_BswMIf_ptrrAdcIfServicesBswMIf_AdcIf_runDeInit_BswM_OnGoOffOneA", "The AdcIf_runDeInit runnable shall be called in the BswM_OnGoOffOneA runnable in order to deinitialize the AdcIf module and to stop the Adc conversions.");
  //***************************************************************************************
  testCaseComment("Preconditions");
  testStep("STEP", "Bench Initialization"); // If the first parameter of testStep() is "Step", the arguments will be written in the specification file and "Step" argument will be numbered by 1 for each iteration.
  RunPreTs();
//   /*------------------------- Test scenario start ------------------------------*/

   testCaseComment("Action: ARCH_SW_BswMIf_ptrrAdcIfServicesBswMIf_AdcIf_runDeInit_BswM_OnGoOffOneA");
  debugger_setRelativeFunctionBpAtLine("BswM_OnGoOffOneA", "2");
   testStep("", "Reset the debugger.");
  debugger_reset(); 
   testStep("", "Run the debugger.");
  debugger_run();
  
  testStep("STEP", "Send diagnostic request in order to do soft Reset");
   SendDiagnosticRequest(dSoftResetRequest, dSoftResetResponse);
  
   testStep("STEP", "Set a BP in function BswM_OnGoOffOneA in order call AdcIf_runDeInit function --> BP was set");
  debugger_waitUntilBPisReached("2000");
   ExpectedTestResult(debugger_result, W8_UNTIL_BP_SUCCESSFUL, "Breakpoint is reached");
   
   debugger_setRelativeFunctionBpAtLine("AdcIf_runDeInit", "1"); 
  testStep("", "Run the debugger.");
  debugger_run();
   testStep("STEP", "Set a BP in AdcIf_runDeInit function in order to deinitialize the AdcIf module and to stop the Adc conversions --> BP was set");
  debugger_waitUntilBPisReached("2000");
  ExpectedTestResult(debugger_result, W8_UNTIL_BP_SUCCESSFUL, "Breakpoint is reached");
    
  debugger_setRelativeFunctionBpAtLine("BswM_OnGoOffOneA", "5");
   testStep("", "Run the debugger.");
  debugger_run();
   testStep("STEP", "Set a BP in function BswM_OnGoOffOneA for check the interface --> BP was set");
  debugger_waitUntilBPisReached("2000");
   ExpectedTestResult(debugger_result, W8_UNTIL_BP_SUCCESSFUL, "Breakpoint is reached");
  debugger_deleteAllBreakpoints();
  //====================================================
  testCaseComment("Postcondition");
  testStep("STEP", "Return ECU to default values");
  RunPostTs();
}
testcase Sw_Int_BswMIf_ptrrAdcIfServicesBswMIf_02()
{
   /*-------------------------Test specific report info------------------------------*/
  
  testReportAddMiscInfoBlock("AUTOLIV ELECTRONICS document");
  TestReportAddMiscInfo("Nightly test", "No");
  TestReportAddMiscInfo("Test type", "Requirement-Based");
  TestReportAddMiscInfo("Regression Test", "No");
  TestReportAddMiscInfo("Fault injection method used", "No");
  TestReportAddMiscInfo("Resource usage evaluation", "No");
  TestReportAddMiscInfo("Priority", "No");
  TestReportAddMiscInfo("Safety relevant", "No");
  
  AddRequirementInfo("Requirement under test", "ARCH_SW_BswMIf_ptrrAdcIfServicesBswMIf_AdcIf_runInit_BswM_OnStartupTwoA");
  AddRequirementInfo("ARCH_SW_BswMIf_ptrrAdcIfServicesBswMIf_AdcIf_runInit_BswM_OnStartupTwoA", "The AdcIf_runInit runnable shall be called in the BswM_OnStartupTwoA runnable in order to initialize the AdcIf module and to start the Adc conversions.");
  //***************************************************************************************
  testCaseComment("Preconditions");
  testStep("STEP", "Bench Initialization"); // If the first parameter of testStep() is "Step", the arguments will be written in the specification file and "Step" argument will be numbered by 1 for each iteration.
  RunPreTs();
//   /*------------------------- Test scenario start ------------------------------*/

   testCaseComment("Action: ARCH_SW_BswMIf_ptrrAdcIfServicesBswMIf_AdcIf_runInit_BswM_OnStartupTwoA");
  debugger_setRelativeFunctionBpAtLine("BswM_OnStartupTwoA", "20");
   testStep("", "Reset the debugger.");
  debugger_reset(); 
   testStep("", "Run the debugger.");
  debugger_run();
   testStep("STEP", "Set a BP in function BswM_OnStartupTwoA in order call AdcIf_runInit function --> BP was set");
  debugger_waitUntilBPisReached("2000");
   ExpectedTestResult(debugger_result, W8_UNTIL_BP_SUCCESSFUL, "Breakpoint is reached");
   
   debugger_setRelativeFunctionBpAtLine("AdcIf_runInit", "2"); 
  testStep("", "Run the debugger.");
  debugger_run();
   testStep("STEP", "Set a BP in AdcIf_runInit function in order to initialize the AdcIf module and to start the Adc conversions --> BP was set");
  debugger_waitUntilBPisReached("2000");
  ExpectedTestResult(debugger_result, W8_UNTIL_BP_SUCCESSFUL, "Breakpoint is reached");
    
  debugger_setRelativeFunctionBpAtLine("BswM_OnStartupTwoA", "23");
   testStep("", "Run the debugger.");
  debugger_run();
   testStep("STEP", "Set a BP in function BswM_OnStartupTwoA for check the interface --> BP was set");
  debugger_waitUntilBPisReached("2000");
   ExpectedTestResult(debugger_result, W8_UNTIL_BP_SUCCESSFUL, "Breakpoint is reached");
  debugger_deleteAllBreakpoints();
  //====================================================
  testCaseComment("Postcondition");
  testStep("STEP", "Return ECU to default values");
  RunPostTs();
}
testcase Sw_Int_BswMIf_ptrpAsrNvMServicesBswMIf_01()
{
   /*-------------------------Test specific report info------------------------------*/
  
  testReportAddMiscInfoBlock("AUTOLIV ELECTRONICS document");
  TestReportAddMiscInfo("Nightly test", "No");
  TestReportAddMiscInfo("Test type", "Requirement-Based");
  TestReportAddMiscInfo("Regression Test", "No");
  TestReportAddMiscInfo("Fault injection method used", "No");
  TestReportAddMiscInfo("Resource usage evaluation", "No");
  TestReportAddMiscInfo("Priority", "No");
  TestReportAddMiscInfo("Safety relevant", "No");
  
  AddRequirementInfo("Requirement under test", "ARCH_SW_BswMIf_ptrpAsrNvMServicesBswMIf_BswM_CB_NfyNvMJobEnd");
  AddRequirementInfo("ARCH_SW_BswMIf_ptrpAsrNvMServicesBswMIf_BswM_CB_NfyNvMJobEnd", "The BswM_CB_NfyNvMJobEnd runnable shall be called when the NvM Read or Write job is finished.");
  //***************************************************************************************
  testCaseComment("Preconditions");
  testStep("STEP", "Bench Initialization"); // If the first parameter of testStep() is "Step", the arguments will be written in the specification file and "Step" argument will be numbered by 1 for each iteration.
  RunPreTs();
//   /*------------------------- Test scenario start ------------------------------*/

   testCaseComment("Action: ARCH_SW_BswMIf_ptrpAsrNvMServicesBswMIf_BswM_CB_NfyNvMJobEnd");
   debugger_deleteAllBreakpoints();
  debugger_setRelativeFunctionBpAtLine("NvM_ReadAll", "39");
   testStep("", "Reset the debugger.");
  debugger_reset(); 
   testStep("", "Run the debugger.");
  debugger_run();
   testStep("STEP", "Set a BP in function NvM_ReadAll in order check if NvM Read job is finished --> BP was set");
  debugger_waitUntilBPisReached("2000");
   ExpectedTestResult(debugger_result, W8_UNTIL_BP_SUCCESSFUL, "Breakpoint is reached");
   
  debugger_setRelativeFunctionBpAtLine("BswM_CB_NfyNvMJobEnd", "2");
   testStep("", "Run the debugger.");
  debugger_run();
   testStep("STEP", "Set a BP in function BswM_CB_NfyNvMJobEnd for check the interface --> BP was set");
  debugger_waitUntilBPisReached("2000");
   ExpectedTestResult(debugger_result, W8_UNTIL_BP_SUCCESSFUL, "Breakpoint is reached");
  
  //====================================================
  testCaseComment("Postcondition");
  testStep("STEP", "Return ECU to default values");
  RunPostTs();
}
testcase Sw_Int_BswMIf_ptrpAsrGptServicesBswMIf_01()
{
   /*-------------------------Test specific report info------------------------------*/
  
  testReportAddMiscInfoBlock("AUTOLIV ELECTRONICS document");
  TestReportAddMiscInfo("Nightly test", "No");
  TestReportAddMiscInfo("Test type", "Requirement-Based");
  TestReportAddMiscInfo("Regression Test", "No");
  TestReportAddMiscInfo("Fault injection method used", "No");
  TestReportAddMiscInfo("Resource usage evaluation", "No");
  TestReportAddMiscInfo("Priority", "No");
  TestReportAddMiscInfo("Safety relevant", "No");
  
  AddRequirementInfo("Requirement under test", "ARCH_SW_BswMIf_ptrpAsrGptServicesBswMIf_BswM_Cyclic_10msTimer");
  AddRequirementInfo("ARCH_SW_BswMIf_ptrpAsrGptServicesBswMIf_BswM_Cyclic_10msTimer", "The BswM_Cyclic_10msTimer runnable shall be called when the Gpt timer expires via the Gpt_InitChannelPB_TDK_4G runnable.");
  //***************************************************************************************
  testCaseComment("Preconditions");
  testStep("STEP", "Bench Initialization"); // If the first parameter of testStep() is "Step", the arguments will be written in the specification file and "Step" argument will be numbered by 1 for each iteration.
  RunPreTs();
//   /*------------------------- Test scenario start ------------------------------*/

   testCaseComment("Action: ARCH_SW_BswMIf_ptrpAsrGptServicesBswMIf_BswM_Cyclic_10msTimer");
   debugger_deleteAllBreakpoints();
   testStep("STEP", "Enable comunication --> Comunication enable");
   TestSetMsgEvent(Airbag_01);
  TestSetMsgEvent(Airbag_02);
  TestSetMsgEvent(Airbag_eCS_01);
   TestWaitForTimeout(14000);
  
  debugger_setRelativeFunctionBpAtLine("BswM_Cyclic_10msTimer", "5");
   testStep("", "Reset the debugger.");
  debugger_reset(); 
   testStep("", "Run the debugger.");
  debugger_run();
  
  testStep("STEP", "Disable comunication --> Comunication disable");
  TestDisableMsg(Airbag_01);
  TestDisableMsg(Airbag_02);
  TestDisableMsg(Airbag_eCS_01);
  TestWaitForTimeout(6000);
  
   testStep("STEP", "Set a BP in function BswM_Cyclic_10msTimer in order check if Gpt timer expires --> BP was set");
  debugger_waitUntilBPisReached("2000");
   ExpectedTestResult(debugger_result, W8_UNTIL_BP_SUCCESSFUL, "Breakpoint is reached");
   debugger_deleteAllBreakpoints();
  
  //====================================================
  testCaseComment("Postcondition");
  testStep("STEP", "Return ECU to default values");
  RunPostTs();
}
testcase Sw_Int_BswMIf_ptrrAsrGptServicesBswMIf_01()
{
   /*-------------------------Test specific report info------------------------------*/
  
  testReportAddMiscInfoBlock("AUTOLIV ELECTRONICS document");
  TestReportAddMiscInfo("Nightly test", "No");
  TestReportAddMiscInfo("Test type", "Requirement-Based");
  TestReportAddMiscInfo("Regression Test", "No");
  TestReportAddMiscInfo("Fault injection method used", "No");
  TestReportAddMiscInfo("Resource usage evaluation", "No");
  TestReportAddMiscInfo("Priority", "No");
  TestReportAddMiscInfo("Safety relevant", "No");
  
  AddRequirementInfo("Requirement under test", "ARCH_SW_BswMIf_ptrrGptServicesBswMIf_Gpt_EnableNotification_BswM_OnStartupTwoB");
  AddRequirementInfo("ARCH_SW_BswMIf_ptrrGptServicesBswMIf_Gpt_EnableNotification_BswM_OnStartupTwoB", "The Gpt_EnableNotification runnable shall be called in the BswM_OnStartupTwoB runnable in order to enable notification function on GPT timer.");
  //***************************************************************************************
  testCaseComment("Preconditions");
  testStep("STEP", "Bench Initialization"); // If the first parameter of testStep() is "Step", the arguments will be written in the specification file and "Step" argument will be numbered by 1 for each iteration.
  RunPreTs();
//   /*------------------------- Test scenario start ------------------------------*/

   testCaseComment("Action: ARCH_SW_BswMIf_ptrrGptServicesBswMIf_Gpt_EnableNotification_BswM_OnStartupTwoB");
  debugger_setRelativeFunctionBpAtLine("BswM_OnStartupTwoB", "28");
   testStep("", "Reset the debugger.");
  debugger_reset(); 
   testStep("", "Run the debugger.");
  debugger_run();
   testStep("STEP", "Set a BP in function BswM_OnStartupTwoB to call Gpt_EnableNotification function --> BP was set");
  debugger_waitUntilBPisReached("2000");
  ExpectedTestResult(debugger_result, W8_UNTIL_BP_SUCCESSFUL, "Breakpoint is reached");

////    debugger_setBpAtLine("C:\\Projects\\eCS_R1.2\\Tools\\EB_BSW_8.5.1\\Workspace\\plugins\\PduR_TS_TxDxM5I3R0\\src\\PduR_Init.c", "213");
   debugger_setRelativeFunctionBpAtLine("Gpt_EnableNotification", "10");
   testStep("", "Run the debugger.");
  debugger_run();
   testStep("STEP", "Set a BP in function Gpt_EnableNotification in order to enable notification function on GPT timer --> BP was set");
  debugger_waitUntilBPisReached("2000");
  ExpectedTestResult(debugger_result, W8_UNTIL_BP_SUCCESSFUL, "Breakpoint is reached");
    
  debugger_setRelativeFunctionBpAtLine("BswM_OnStartupTwoB", "31");
   testStep("", "Run the debugger.");
  debugger_run();
   testStep("STEP", "Set a BP in function BswM_OnStartupTwoA for check the interface --> BP was set");
  debugger_waitUntilBPisReached("2000");
  ExpectedTestResult(debugger_result, W8_UNTIL_BP_SUCCESSFUL, "Breakpoint is reached");
  //====================================================
  testCaseComment("Postcondition");
  testStep("STEP", "Return ECU to default values");
  RunPostTs();
}
testcase Sw_Int_BswMIf_ptrrAsrGptServicesBswMIf_02()
{
   /*-------------------------Test specific report info------------------------------*/
  
  testReportAddMiscInfoBlock("AUTOLIV ELECTRONICS document");
  TestReportAddMiscInfo("Nightly test", "No");
  TestReportAddMiscInfo("Test type", "Requirement-Based");
  TestReportAddMiscInfo("Regression Test", "No");
  TestReportAddMiscInfo("Fault injection method used", "No");
  TestReportAddMiscInfo("Resource usage evaluation", "No");
  TestReportAddMiscInfo("Priority", "No");
  TestReportAddMiscInfo("Safety relevant", "No");
  
  AddRequirementInfo("Requirement under test", "ARCH_SW_BswMIf_ptrrGptServicesBswMIf_Gpt_StartTimer_BswM_CB_NfyNvMJobEnd");
  AddRequirementInfo("ARCH_SW_BswMIf_ptrrGptServicesBswMIf_Gpt_StartTimer_BswM_CB_NfyNvMJobEnd", "The Gpt_StartTimer runnable shall be called in the BswM_CB_NfyNvMJobEnd runnable in order to start GPT timer if: - WriteAll request was made by a valid transition from RUN in POST RUN");
  //***************************************************************************************
  testCaseComment("Preconditions");
  testStep("STEP", "Bench Initialization"); // If the first parameter of testStep() is "Step", the arguments will be written in the specification file and "Step" argument will be numbered by 1 for each iteration.
  RunPreTs();
//   /*------------------------- Test scenario start ------------------------------*/

   testCaseComment("Action: ARCH_SW_BswMIf_ptrrGptServicesBswMIf_Gpt_StartTimer_BswM_CB_NfyNvMJobEnd");
  testStep("STEP", "Enable comunication --> Comunication enable");
   TestSetMsgEvent(Airbag_01);
  TestSetMsgEvent(Airbag_02);
  TestSetMsgEvent(Airbag_eCS_01);
   TestWaitForTimeout(12000);
  
   debugger_deleteAllBreakpoints();
  debugger_setRelativeFunctionBpAtLine("NvM_WriteAll", "1");
   testStep("", "Reset the debugger.");
  debugger_reset(); 
   testStep("", "Run the debugger.");
  debugger_run();
  
  testStep("STEP", "Disable comunication --> Comunication disable");
  TestDisableMsg(Airbag_01);
  TestDisableMsg(Airbag_02);
  TestDisableMsg(Airbag_eCS_01);
  TestWaitForTimeout(6000);
  
   testStep("STEP", "Set a BP in function NvM_WriteAll in order WriteAll request --> BP was set");
  debugger_waitUntilBPisReached("2000");
   ExpectedTestResult(debugger_result, W8_UNTIL_BP_SUCCESSFUL, "Breakpoint is reached");
   
  debugger_setRelativeFunctionBpAtLine("BswM_CB_NfyNvMJobEnd", "49");
   testStep("", "Run the debugger.");
  debugger_run();
   testStep("STEP", "Set a BP in function BswM_CB_NfyNvMJobEnd in order to call Gpt_StartTimer function --> BP was set");
  debugger_waitUntilBPisReached("2000");
   ExpectedTestResult(debugger_result, W8_UNTIL_BP_SUCCESSFUL, "Breakpoint is reached");
  
    debugger_setRelativeFunctionBpAtLine("Gpt_StartTimer", "0");
   testStep("", "Run the debugger.");
  debugger_run();
   testStep("STEP", "Set a BP in function Gpt_StartTimer in order to start GPT timer if: - WriteAll request was made by a valid transition from RUN in POST RUN --> BP was set");
  debugger_waitUntilBPisReached("2000");
   ExpectedTestResult(debugger_result, W8_UNTIL_BP_SUCCESSFUL, "Breakpoint is reached");
  
  debugger_setRelativeFunctionBpAtLine("BswM_CB_NfyNvMJobEnd", "58");
   testStep("", "Run the debugger.");
  debugger_run();
   testStep("STEP", "Set a BP in function BswM_CB_NfyNvMJobEnd in order to check the interface --> BP was set");
  debugger_waitUntilBPisReached("2000");
   ExpectedTestResult(debugger_result, W8_UNTIL_BP_SUCCESSFUL, "Breakpoint is reached");
  
  //====================================================
  testCaseComment("Postcondition");
  testStep("STEP", "Return ECU to default values");
  RunPostTs();
}
testcase Sw_Int_BswMIf_ptrrAsrGptServicesBswMIf_03()
{
   /*-------------------------Test specific report info------------------------------*/
  
  testReportAddMiscInfoBlock("AUTOLIV ELECTRONICS document");
  TestReportAddMiscInfo("Nightly test", "No");
  TestReportAddMiscInfo("Test type", "Requirement-Based");
  TestReportAddMiscInfo("Regression Test", "No");
  TestReportAddMiscInfo("Fault injection method used", "No");
  TestReportAddMiscInfo("Resource usage evaluation", "No");
  TestReportAddMiscInfo("Priority", "No");
  TestReportAddMiscInfo("Safety relevant", "No");
  
  AddRequirementInfo("Requirement under test", "ARCH_SW_BswMIf_ptrrGptServicesBswMIf_Gpt_StopTimer_BswM_OnRunFromPostRunBusAvailable");
  AddRequirementInfo("ARCH_SW_BswMIf_ptrrGptServicesBswMIf_Gpt_StopTimer_BswM_OnRunFromPostRunBusAvailable", "The Gpt_StopTimer runnable shall be called in the BswM_OnRunFromPostRunBusAvailable runnable in order to stop GPT timer on LPIT2 if: - Ecu enters in RUN State {from POST RUN}");
  //***************************************************************************************
  testCaseComment("Preconditions");
  testStep("STEP", "Bench Initialization"); // If the first parameter of testStep() is "Step", the arguments will be written in the specification file and "Step" argument will be numbered by 1 for each iteration.
  RunPreTs();
//   /*------------------------- Test scenario start ------------------------------*/

   testCaseComment("Action: ARCH_SW_BswMIf_ptrrGptServicesBswMIf_Gpt_StopTimer_BswM_OnRunFromPostRunBusAvailable");
  TestSetMsgEvent(Airbag_01);
  TestSetMsgEvent(Airbag_02);
  TestSetMsgEvent(Airbag_eCS_01);
   TestWaitForTimeout(11000);
  
   debugger_setRelativeFunctionBpAtLine("BswM_Cyclic_10msTimer", "5");
  testStep("", "Reset the debugger.");
   debugger_reset();
   testStep("", "Run the debugger."); 
  debugger_run();
    
  testStep("STEP", "Disable comunication --> Comunication disable");
  TestDisableMsg(Airbag_01);
  TestDisableMsg(Airbag_02);
  TestDisableMsg(Airbag_eCS_01);
  TestWaitForTimeout(5000);
  
  testStep("STEP", "Set a BP in function BswM_Cyclic_10msTimer in order to go in  BswM_OnLowPwrFromPostRun function --> BP was set");
  debugger_waitUntilBPisReached("2000");
  ExpectedTestResult(debugger_result, W8_UNTIL_BP_SUCCESSFUL, "Breakpoint is reached");
  debugger_deleteAllBreakpoints();
  
  debugger_writeVariable("uint8","bswmif_u16TPostRunTimer,,app.elf", "1", "17EC");
  TestWaitForTimeout(2000);  

  debugger_setRelativeFunctionBpAtLine("BswM_OnRunFromPostRunBusAvailable", "2");
  testStep("STEP", "Enable comunication --> Comunication enable");
   TestSetMsgEvent(Airbag_01);
  TestSetMsgEvent(Airbag_02);
  TestSetMsgEvent(Airbag_eCS_01);
   TestWaitForTimeout(61240);
    
  debugger_waitUntilBPisReached("2000");
   testStep("STEP", "Set a BP in function BswM_OnRunFromPostRunBusAvailable in order to call Gpt_StopTimer function --> BP was set");
  ExpectedTestResult(debugger_result, W8_UNTIL_BP_SUCCESSFUL, "Breakpoint is reached");
  
   debugger_setRelativeFunctionBpAtLine("Gpt_StopTimer", "46"); 
  testStep("", "Run the debugger.");
  debugger_run();
   testStep("STEP", "Set a BP in function Gpt_StopTimer n order to stop GPT timer on LPIT2 if: - Ecu enters in RUN State {from POST RUN}");
  debugger_waitUntilBPisReached("2000");
  ExpectedTestResult(debugger_result, W8_UNTIL_BP_SUCCESSFUL, "Breakpoint is reached");
  debugger_deleteAllBreakpoints();
  
  //====================================================
  testCaseComment("Postcondition");
  testStep("STEP", "Return ECU to default values");
  RunPostTs();
}
testcase Sw_Int_BswMIf_ptrrAsrGptServicesBswMIf_04()
{
   /*-------------------------Test specific report info------------------------------*/
  
  testReportAddMiscInfoBlock("AUTOLIV ELECTRONICS document");
  TestReportAddMiscInfo("Nightly test", "No");
  TestReportAddMiscInfo("Test type", "Requirement-Based");
  TestReportAddMiscInfo("Regression Test", "No");
  TestReportAddMiscInfo("Fault injection method used", "No");
  TestReportAddMiscInfo("Resource usage evaluation", "No");
  TestReportAddMiscInfo("Priority", "No");
  TestReportAddMiscInfo("Safety relevant", "No");
  
  AddRequirementInfo("Requirement under test", "ARCH_SW_BswMIf_ptrrGptServicesBswMIf_Gpt_StopTimer_BswM_Cyclic_10msTimer");
  AddRequirementInfo("ARCH_SW_BswMIf_ptrrGptServicesBswMIf_Gpt_StopTimer_BswM_Cyclic_10msTimer", "The Gpt_StopTimer runnable shall be called in the BswM_Cyclic_10msTimer runnable in order to stop function of timer if: - Current ECU State is POST RUN AND Pasager occupancy is detected - Current ECU State is POST RUN AND Passenger occupancy OR CAN Activity is not detected - Current ECU State is AUTONOMOUS RUN {Passenger detected - valid transition from POST RUN} AND CAN Activity was detected on bus - Current ECU State is AUTONOMOUS RUN {Passenger detected - valid transition from POST RUN} AND CAN Activity was not detected on bus - Current ECU State is AUTONOMOUS RUN {Passenger detected - valid transition from LOW POWER} AND CAN Activity was detected on bus - Current ECU State is AUTONOMOUS RUN {Passenger detected - valid transition from LOW POWER} AND CAN Activity was not detected on bus");
//***************************************************************************************
  
  testCaseComment("Preconditions");
  testStep("STEP", "Bench Initialization"); // If the first parameter of testStep() is "Step", the arguments will be written in the specification file and "Step" argument will be numbered by 1 for each iteration.
  RunPreTs();
//   /*------------------------- Test scenario start ------------------------------*/
   testCaseComment("Action: ARCH_SW_BswMIf_ptrrGptServicesBswMIf_Gpt_StopTimer_BswM_Cyclic_10msTimer");
   testStep("STEP", "Enable comunication --> Comunication enable");
   TestSetMsgEvent(Airbag_01);
  TestSetMsgEvent(Airbag_02);
  TestSetMsgEvent(Airbag_eCS_01);
   TestWaitForTimeout(12000);
  
    debugger_setRelativeFunctionBpAtLine("BswM_Cyclic_10msTimer", "5");
   testStep("", "Reset the debugger.");
  debugger_reset(); 
  testStep("", "Run the debugger.");
  debugger_run();
    
  testStep("STEP", "Disable comunication --> Comunication disable");
  TestDisableMsg(Airbag_01);
  TestDisableMsg(Airbag_02);
  TestDisableMsg(Airbag_eCS_01);
  TestWaitForTimeout(5000);
  testStep("STEP", "Set a BP in function BswM_Cyclic_10msTimer in order to change post run timer value --> BP was set");
  debugger_waitUntilBPisReached("2000");
  ExpectedTestResult(debugger_result, W8_UNTIL_BP_SUCCESSFUL, "Breakpoint is reached");
  
  debugger_setRelativeFunctionBpAtLine("BswM_Cyclic_10msTimer", "12");
   testStep("", "Run the debugger.");
  debugger_run();
   testStep("STEP", "Set a BP in function BswM_Cyclic_10msTimer in order to change  Passenger Occupancy Status --> BP was set");
  debugger_waitUntilBPisReached("2000");
  ExpectedTestResult(debugger_result, W8_UNTIL_BP_SUCCESSFUL, "Breakpoint is reached");
  
  testStep("STEP", "Change value for Passenger Occupancy Status with pasager occupancy is detected--> Succesfully changed");
   debugger_writeLocalVariable("bswmif_u8PassengerOccupancyStatus", "1");
  TestWaitForTimeout(2000);
  
  debugger_setRelativeFunctionBpAtLine("BswM_Cyclic_10msTimer ", "18");
   testStep("", "Run the debugger.");
  debugger_run();
   testStep("STEP", "Set a BP in function BswM_Cyclic_10msTimer in order to call Gpt_StopTimer --> BP was set");
  debugger_waitUntilBPisReached("2000");
  ExpectedTestResult(debugger_result, W8_UNTIL_BP_SUCCESSFUL, "Breakpoint is reached");
  
   debugger_setRelativeFunctionBpAtLine("Gpt_StopTimer", "46");
   testStep("", "Run the debugger.");
  debugger_run();
   testStep("STEP", "Set a BP in function Gpt_StopTimer in order to stop function of timer --> BP was set");
  debugger_waitUntilBPisReached("2000");
  ExpectedTestResult(debugger_result, W8_UNTIL_BP_SUCCESSFUL, "Breakpoint is reached");
  
   debugger_setRelativeFunctionBpAtLine("BswM_Cyclic_10msTimer ", "21");
   testStep("", "Run the debugger.");
  debugger_run();
   testStep("STEP", "Set a BP in function BswM_Cyclic_10msTimer in order to check the interface --> BP was set");
  debugger_waitUntilBPisReached("2000");
  ExpectedTestResult(debugger_result, W8_UNTIL_BP_SUCCESSFUL, "Breakpoint is reached");

  //====================================================
  testCaseComment("Postcondition");
  testStep("STEP", "Return ECU to default values");
  RunPostTs();
}
testcase Sw_Int_BswMIf_pseEcuStateTransitions_01()
{
   /*-------------------------Test specific report info------------------------------*/
  
  testReportAddMiscInfoBlock("AUTOLIV ELECTRONICS document");
  TestReportAddMiscInfo("Nightly test", "No");
  TestReportAddMiscInfo("Test type", "Requirement-Based");
  TestReportAddMiscInfo("Regression Test", "No");
  TestReportAddMiscInfo("Fault injection method used", "No");
  TestReportAddMiscInfo("Resource usage evaluation", "No");
  TestReportAddMiscInfo("Priority", "No");
  TestReportAddMiscInfo("Safety relevant", "No");
  
  AddRequirementInfo("Requirement under test", "ARCH_SW_BswMIf_pseECUStateTransitions");
  AddRequirementInfo("ARCH_SW_BswMIf_pseECUStateTransitions", "The BswM_SetEcuStateTransitionStatus shall be called in order to set the current status of RunToLowPowerTransition. - This status is necessary because sometimes the BswM Rule is validated before RX Acknowledge and POST RUN state is reached.");
//***************************************************************************************
  testCaseComment("Preconditions");
  testStep("STEP", "Bench Initialization"); 
  RunPreTs();
//   /*------------------------- Test scenario start ------------------------------*/
  
  testCaseComment("Action: ARCH_SW_BswMIf_pseECUStateTransitions");
  
  teststep("STEP", "Perform a soft reset");
  SendDiagnosticRequest(dSoftResetRequest, dSoftResetResponse);
  
  teststep("STEP", "Set a breakpoint in BswM_SetEcuStateTransitionStatus");
  debugger_setRelativeFunctionBpAtLine("BswM_SetEcuStateTransitionStatus", "0");
  testStep("", "Reset the debugger.");
  debugger_reset(); 
  testStep("", "Run the debugger.");
  debugger_run();
  debugger_waitUntilBPisReached("5000");
  ExpectedTestResult(debugger_result, W8_UNTIL_BP_SUCCESSFUL, "Breakpoint is reached");
  
  teststep("STEP", "Evaluate Transition Status");
  debugger_readLocalVariable("u8TransitionStatus"); //0x55
  ExpectedTestResult(debugger_result, "0x55", "Transition Status is 0x55");
  //====================================================
  testCaseComment("Postcondition");
  testStep("STEP", "Return ECU to default values");
  RunPostTs();
}

testcase Sw_Int_BswMIf_psePassengerOccupancyState_01()
{
   /*-------------------------Test specific report info------------------------------*/
  
  testReportAddMiscInfoBlock("AUTOLIV ELECTRONICS document");
  TestReportAddMiscInfo("Nightly test", "No");
  TestReportAddMiscInfo("Test type", "Requirement-Based");
  TestReportAddMiscInfo("Regression Test", "No");
  TestReportAddMiscInfo("Fault injection method used", "No");
  TestReportAddMiscInfo("Resource usage evaluation", "No");
  TestReportAddMiscInfo("Priority", "No");
  TestReportAddMiscInfo("Safety relevant", "No");
  
  AddRequirementInfo("Requirement under test", "ARCH_SW_BswMIf_psePassengerOccupancyState ");
  AddRequirementInfo("ARCH_SW_BswMIf_psePassengerOccupancyState", "The BswM_UpdatePassangerOccupancyStatus shall be called in order to set the status of PassangerOccupancy state.");
//***************************************************************************************
  testCaseComment("Preconditions");
  testStep("STEP", "Bench Initialization"); 
  RunPreTs();
//   /*------------------------- Test scenario start ------------------------------*/
  
  testCaseComment("Action: ARCH_SW_BswMIf_psePassengerOccupancyState");
  teststep("STEP", "Set a breakpoint in function IoHwAb_DetectSeatOccupancy in order to change value of Wake Sense Prev State");
  debugger_setRelativeFunctionBpAtLine("IoHwAb_DetectSeatOccupancy", "37");
 testStep("", "Reset the debugger.");
  debugger_reset(); 
  testStep("", "Run the debugger.");
  debugger_run();
  debugger_waitUntilBPisReached("2000");
  ExpectedTestResult(debugger_result, W8_UNTIL_BP_SUCCESSFUL, "Breakpoint is reached");
  
  testStep("STEP", "Change value for Wake Sense Prev State in order to past condition--> Succesfully changed");
   debugger_writeVariable("uint8","iohwab_au8WakeSensePrevState", "0", "0");
  TestWaitForTimeout(2000);
  
  teststep("STEP", "Set a breakpoint in function IoHwAb_DetectSeatOccupancy in order to call BswM_UpdatePassangerOccupancyStatus function");
  debugger_setRelativeFunctionBpAtLine("IoHwAb_DetectSeatOccupancy", "40");
  testStep("", "Run the debugger.");
  debugger_run();
  debugger_waitUntilBPisReached("2000");
    
  teststep("STEP", "Set a breakpoint in function BswM_UpdatePassangerOccupancyStatus in order to to set the status of PassangerOccupancy state");
  debugger_setRelativeFunctionBpAtLine("BswM_UpdatePassangerOccupancyStatus", "0");
  testStep("", "Run the debugger.");
  debugger_run();
  debugger_waitUntilBPisReached("2000");

  //====================================================
  testCaseComment("Postcondition");
  testStep("STEP", "Return ECU to default values");
  RunPostTs();
}

testcase Sw_Int_BswMIf_ptrpAsrBswMServicesBswMIf_01()
{
   /*-------------------------Test specific report info------------------------------*/
  
  testReportAddMiscInfoBlock("AUTOLIV ELECTRONICS document");
  TestReportAddMiscInfo("Nightly test", "No");
  TestReportAddMiscInfo("Test type", "Requirement-Based");
  TestReportAddMiscInfo("Regression Test", "No");
  TestReportAddMiscInfo("Fault injection method used", "No");
  TestReportAddMiscInfo("Resource usage evaluation", "No");
  TestReportAddMiscInfo("Priority", "No");
  TestReportAddMiscInfo("Safety relevant", "No");
  
  AddRequirementInfo("Requirement under test", "ARCH_SW_BswMIf_ptrpAsrBswMServicesBswMIf_BswM_JumpToFBLNotification");
  AddRequirementInfo("ARCH_SW_BswMIf_ptrpAsrBswMServicesBswMIf_BswM_JumpToFBLNotification", "The BswM_JumpToFBLNotification runnable shall be called by the Autosar BswM in case of: - Jump to Bootloader Reset Request.");
//***************************************************************************************
  testCaseComment("Preconditions");
  testStep("STEP", "Bench Initialization"); 
  RunPreTs();
//   /*------------------------- Test scenario start ------------------------------*/
  
  testCaseComment("Action: ARCH_SW_BswMIf_ptrpAsrBswMServicesBswMIf_BswM_JumpToFBLNotification");
    
  teststep("STEP", "Set a breakpoint in function BswM_Action_BswMAction_BswM_PrepareJumpToFBL in order to call BswM_JumpToFBLNotification function.");
  debugger_setRelativeFunctionBpAtLine("BswM_Action_BswMAction_BswM_PrepareJumpToFBL", "2");
  testStep("", "Reset the debugger.");
  debugger_reset(); 
  testStep("", "Run the debugger.");
  debugger_run();
  
  teststep("STEP", "Send request for Extended Diagnostic Session Start");
   SendDiagnosticRequest(dExtendedSessionRequest, dExtendedSessionResponse);
  
  teststep("STEP", "Send request for Programming Session Start");
   SendDiagnosticRequestNegativeResponse(dProgrammingSessionRequest, dProgrammingSessionResponse, TRUE);
  
  debugger_waitUntilBPisReached("2000");
   ExpectedTestResult(debugger_result, W8_UNTIL_BP_SUCCESSFUL, "Breakpoint is reached");
    
  debugger_setRelativeFunctionBpAtLine("BswM_JumpToFBLNotification", "3");
   testStep("", "Run the debugger.");
  debugger_run();
   testStep("STEP", "Set a BP in function BswM_JumpToFBLNotification in order to check if Jump to Bootloader Reset Request was made --> BP was set");
  debugger_waitUntilBPisReached("2000");
  ExpectedTestResult(debugger_result, W8_UNTIL_BP_SUCCESSFUL, "Breakpoint is reached");
  
  debugger_setRelativeFunctionBpAtLine("BswM_Action_BswMAction_BswM_PrepareJumpToFBL", "4");
   testStep("", "Run the debugger.");
  debugger_run();
  testStep("STEP", "Set a BP in function BswM_Action_BswMAction_BswM_PrepareJumpToFBL in order to check the interface --> BP was set");
  debugger_waitUntilBPisReached("2000");
  ExpectedTestResult(debugger_result, W8_UNTIL_BP_SUCCESSFUL, "Breakpoint is reached");

  //====================================================
  testCaseComment("Postcondition");
  testStep("STEP", "Return ECU to default values");
  RunPostTs();
}

testcase Sw_Int_BswMIf_ptrpAsrBswMServicesBswMIf_02()
{
   /*-------------------------Test specific report info------------------------------*/
  
  testReportAddMiscInfoBlock("AUTOLIV ELECTRONICS document");
  TestReportAddMiscInfo("Nightly test", "No");
  TestReportAddMiscInfo("Test type", "Requirement-Based");
  TestReportAddMiscInfo("Regression Test", "No");
  TestReportAddMiscInfo("Fault injection method used", "No");
  TestReportAddMiscInfo("Resource usage evaluation", "No");
  TestReportAddMiscInfo("Priority", "No");
  TestReportAddMiscInfo("Safety relevant", "No");
  
  AddRequirementInfo("Requirement under test", "ARCH_SW_BswMIf_ptrpAsrBswMServicesBswMIf_BswM_SWResetNotification");
  AddRequirementInfo("ARCH_SW_BswMIf_ptrpAsrBswMServicesBswMIf_BswM_SWResetNotification", "The BswM_SWResetNotification runnable shall be called by the Autosar BswM in case of: - SW Reset Request.");
//***************************************************************************************
  testCaseComment("Preconditions");
  testStep("STEP", "Bench Initialization"); 
  RunPreTs();
//   /*------------------------- Test scenario start ------------------------------*/
  
  testCaseComment("Action: ARCH_SW_BswMIf_ptrpAsrBswMServicesBswMIf_BswM_SWResetNotification");
  
  debugger_setRelativeFunctionBpAtLine("BswM_Action_BswMAction_BswM_SWResetNotification", "2"); 
   testStep("", "Reset the debugger.");
  debugger_reset(); 
   testStep("", "Run the debugger.");
  debugger_run();
  
   testStep("STEP", "Send request for press ECU SW reset button");
  @Platform::DIAG_ECUResetSW = 1;
    
  teststep("STEP", "Set a breakpoint in function BswM_Action_BswMAction_BswM_SWResetNotification at BswM_SWResetNotification function call.");
   debugger_waitUntilBPisReached("2000");
  ExpectedTestResult(debugger_result, W8_UNTIL_BP_SUCCESSFUL, "Breakpoint is reached");
    
  debugger_setRelativeFunctionBpAtLine("BswM_SWResetNotification", "0");
   testStep("", "Run the debugger.");
  debugger_run();
   testStep("STEP", "Set a BP in function BswM_SWResetNotification in order to check if SW Reset Request --> BP was set");
  debugger_waitUntilBPisReached("2000");
  ExpectedTestResult(debugger_result, W8_UNTIL_BP_SUCCESSFUL, "Breakpoint is reached");
  
  debugger_setRelativeFunctionBpAtLine("BswM_Action_BswMAction_BswM_SWResetNotification", "4");
   testStep("", "Run the debugger.");
  debugger_run();
  testStep("STEP", "Set a BP in function BswM_Action_BswMAction_BswM_SWResetNotification in order to check the interface --> BP was set");
  debugger_waitUntilBPisReached("2000");
  ExpectedTestResult(debugger_result, W8_UNTIL_BP_SUCCESSFUL, "Breakpoint is reached");

  //====================================================
  testCaseComment("Postcondition");
  testStep("STEP", "Return ECU to default values");
  RunPostTs();
}

testcase Sw_Int_BswMIf_ptrpAsrBswMServicesBswMIf_03()
{
   /*-------------------------Test specific report info------------------------------*/
  
  testReportAddMiscInfoBlock("AUTOLIV ELECTRONICS document");
  TestReportAddMiscInfo("Nightly test", "No");
  TestReportAddMiscInfo("Test type", "Requirement-Based");
  TestReportAddMiscInfo("Regression Test", "No");
  TestReportAddMiscInfo("Fault injection method used", "No");
  TestReportAddMiscInfo("Resource usage evaluation", "No");
  TestReportAddMiscInfo("Priority", "No");
  TestReportAddMiscInfo("Safety relevant", "No");
  
  AddRequirementInfo("Requirement under test", "ARCH_SW_BswMIf_ptrpAsrBswMServicesBswMIf_BswM_On_Prep_Shutdown");
  AddRequirementInfo("ARCH_SW_BswMIf_ptrpAsrBswMServicesBswMIf_BswM_On_Prep_Shutdown", "The BswM_On_Prep_Shutdown runnable shall be called by the Autosar BswM in case of: - Post Run timer exceed his maximum value AND buckle and SBS sensors are not available - Low Power timer exceed his maximum value AND no valid passenger occupancy or bus activity is detected.");
//***************************************************************************************
  testCaseComment("Preconditions");
  testStep("STEP", "Bench Initialization"); 
  RunPreTs();
//   /*------------------------- Test scenario start ------------------------------*/
  testCaseComment("Action: ARCH_SW_BswMIf_ptrpAsrBswMServicesBswMIf_BswM_On_Prep_Shutdown");
  testStep("STEP", "Enable comunication --> Comunication enable");
   TestSetMsgEvent(Airbag_01);
  TestSetMsgEvent(Airbag_02);
  TestSetMsgEvent(Airbag_eCS_01);
   TestWaitForTimeout(12000);
  
  debugger_setRelativeFunctionBpAtLine("BswM_Cyclic_10msTimer", "5");
   testStep("", "Reset the debugger.");
  debugger_reset(); 
   testStep("", "Run the debugger.");
  debugger_run();
    
  testStep("STEP", "Disable comunication --> Comunication disable");
  TestDisableMsg(Airbag_01);
  TestDisableMsg(Airbag_02);
  TestDisableMsg(Airbag_eCS_01);
  TestWaitForTimeout(3000);
  testStep("STEP", "Set a BP in function BswM_Cyclic_10msTimer in order to change post run timer value --> BP was set");
  debugger_waitUntilBPisReached("6100");
  ExpectedTestResult(debugger_result, W8_UNTIL_BP_SUCCESSFUL, "Breakpoint is reached");
  
  testStep("STEP", "Change value for Post Run Timer in order to go in LPM_sleepMainLoop function --> Succesfully changed");
  debugger_writeVariable("uint8","bswmif_u16TPostRunTimer,,app.elf", "1", "17EC");
  TestWaitForTimeout(500);
  
  debugger_setRelativeFunctionBpAtLine("LPM_sleepMainLoop", "22");
  TestWaitForTimeout(500);
   testStep("", "Run the debugger.");
  debugger_run();
   testStep("STEP", "Set a BP in function LPM_sleepMainLoop in order to change Timer value --> BP was set");
  debugger_waitUntilBPisReached("2000");
  ExpectedTestResult(debugger_result, W8_UNTIL_BP_SUCCESSFUL, "Breakpoint is reached");

  testStep("STEP", "Change value for timer --> Succesfully changed");
   debugger_writeLocalVariable("u32Timer", "599");
  TestWaitForTimeout(2000);
  
  debugger_setRelativeFunctionBpAtLine("BswM_Action_BswMAction_BswM_On_Prep_Shutdown", "2");
   testStep("", "Run the debugger.");
  debugger_run();
   debugger_waitUntilBPisReached("2000");
  testStep("STEP", "Set a BP in function BswM_Action_BswMAction_BswM_On_Prep_Shutdown in order to call BswM_On_Prep_Shutdown function --> BP was set");
   ExpectedTestResult(debugger_result, W8_UNTIL_BP_SUCCESSFUL, "Breakpoint is reached");
  
  debugger_setRelativeFunctionBpAtLine("BswM_On_Prep_Shutdown", "2");
   testStep("", "Run the debugger.");
  debugger_run();
   testStep("STEP", "Set a BP in function BswM_On_Prep_Shutdown  in order to check if Post Run timer exceed his maximum value AND buckle and SBS sensors are not available - Low Power timer exceed his maximum value AND no valid passenger occupancy or bus activity was detected --> BP was set");
  debugger_waitUntilBPisReached("2000");
   ExpectedTestResult(debugger_result, W8_UNTIL_BP_SUCCESSFUL, "Breakpoint is reached");
    
  debugger_setRelativeFunctionBpAtLine("BswM_Action_BswMAction_BswM_On_Prep_Shutdown", "4");
   testStep("", "Run the debugger.");
  debugger_run();
   testStep("STEP", "Set a BP in function BswM_Action_BswMAction_BswM_On_Prep_Shutdown for check the interface --> BP was set");
  debugger_waitUntilBPisReached("2000");
  ExpectedTestResult(debugger_result, W8_UNTIL_BP_SUCCESSFUL, "Breakpoint is reached");


  //====================================================
  testCaseComment("Postcondition");
  testStep("STEP", "Return ECU to default values");
  RunPostTs();
}

testcase Sw_Int_BswMIf_ptrpAsrBswMServicesBswMIf_04()
{
   /*-------------------------Test specific report info------------------------------*/
  
  testReportAddMiscInfoBlock("AUTOLIV ELECTRONICS document");
  TestReportAddMiscInfo("Nightly test", "No");
  TestReportAddMiscInfo("Test type", "Requirement-Based");
  TestReportAddMiscInfo("Regression Test", "No");
  TestReportAddMiscInfo("Fault injection method used", "No");
  TestReportAddMiscInfo("Resource usage evaluation", "No");
  TestReportAddMiscInfo("Priority", "No");
  TestReportAddMiscInfo("Safety relevant", "No");
  
  AddRequirementInfo("Requirement under test", "ARCH_SW_BswMIf_ptrpAsrBswMServicesBswMIf_BswM_OnGoOffOneA");
  AddRequirementInfo("ARCH_SW_BswMIf_ptrpAsrBswMServicesBswMIf_BswM_OnGoOffOneA", "The BswM_OnGoOffOneA runnable shall be called by the Autosar BswM in case of: - First part of the shutdown procedure {BswM_On_Prep_Shutdown} is made.");
//***************************************************************************************
  testCaseComment("Preconditions");
  testStep("STEP", "Bench Initialization"); 
  RunPreTs();
//   /*------------------------- Test scenario start ------------------------------*/
  
  testCaseComment("Action: ARCH_SW_BswMIf_ptrpAsrBswMServicesBswMIf_BswM_OnGoOffOneA");
  debugger_setRelativeFunctionBpAtLine("BswM_Action_BswMAction_BswM_OnGoOffOneA", "2"); 
   testStep("", "Reset the debugger.");
  debugger_reset(); 
   testStep("", "Run the debugger.");
  debugger_run();
  
   testStep("STEP", "Send request for Soft Reset");
  SendDiagnosticRequest(dSoftResetRequest, dSoftResetResponse);
    
  teststep("STEP", "Set a breakpoint in function BswM_Action_BswMAction_BswM_OnGoOffOneA at BswM_OnGoOffOneA function call.");
   debugger_waitUntilBPisReached("2000");
  ExpectedTestResult(debugger_result, W8_UNTIL_BP_SUCCESSFUL, "Breakpoint is reached");
    
  debugger_setRelativeFunctionBpAtLine("BswM_OnGoOffOneA", "0");
   testStep("", "Run the debugger.");
  debugger_run();
   testStep("STEP", "Set a BP in function BswM_OnGoOffOneA in order to check if First part of the shutdown procedure {BswM_On_Prep_Shutdown} was made --> BP was set");
  debugger_waitUntilBPisReached("2000");
  ExpectedTestResult(debugger_result, W8_UNTIL_BP_SUCCESSFUL, "Breakpoint is reached");
  
  debugger_setRelativeFunctionBpAtLine("BswM_Action_BswMAction_BswM_OnGoOffOneA", "4");
   testStep("", "Run the debugger.");
  debugger_run();
  testStep("STEP", "Set a BP in function BswM_Action_BswMAction_BswM_OnGoOffOneA in order to check the interface --> BP was set");
  debugger_waitUntilBPisReached("2000");
  ExpectedTestResult(debugger_result, W8_UNTIL_BP_SUCCESSFUL, "Breakpoint is reached");
  //====================================================
  testCaseComment("Postcondition");
  testStep("STEP", "Return ECU to default values");
  RunPostTs();
}

testcase Sw_Int_BswMIf_ptrpAsrBswMServicesBswMIf_05()
{
   /*-------------------------Test specific report info------------------------------*/
  
  testReportAddMiscInfoBlock("AUTOLIV ELECTRONICS document");
  TestReportAddMiscInfo("Nightly test", "No");
  TestReportAddMiscInfo("Test type", "Requirement-Based");
  TestReportAddMiscInfo("Regression Test", "No");
  TestReportAddMiscInfo("Fault injection method used", "No");
  TestReportAddMiscInfo("Resource usage evaluation", "No");
  TestReportAddMiscInfo("Priority", "No");
  TestReportAddMiscInfo("Safety relevant", "No");
  
  AddRequirementInfo("Requirement under test", "ARCH_SW_BswMIf_ptrpAsrBswMServicesBswMIf_BswM_OnLowPwrFromPostRun");
  AddRequirementInfo("ARCH_SW_BswMIf_ptrpAsrBswMServicesBswMIf_BswM_OnLowPwrFromPostRun", "The BswM_OnLowPwrFromPostRun runnable shall be called by the Autosar BswM in case of: - Low Power state is requested {current state of ECU is POST RUN State}.");
//***************************************************************************************
  testCaseComment("Preconditions");
  testStep("STEP", "Bench Initialization"); 
  RunPreTs();
//   /*------------------------- Test scenario start ------------------------------*/
  
  testCaseComment("Action: ARCH_SW_BswMIf_ptrpAsrBswMServicesBswMIf_BswM_OnLowPwrFromPostRun");
   testStep("STEP", "Enable comunication --> Comunication enable");
   TestSetMsgEvent(Airbag_01);
  TestSetMsgEvent(Airbag_02);
  TestSetMsgEvent(Airbag_eCS_01);
   TestWaitForTimeout(10000);
  
  debugger_setRelativeFunctionBpAtLine("BswM_Cyclic_10msTimer", "5");
   testStep("", "Reset the debugger.");
  debugger_reset(); 
   testStep("", "Run the debugger.");
  debugger_run();
    
  testStep("STEP", "Disable comunication --> Comunication disable");
  TestDisableMsg(Airbag_01);
  TestDisableMsg(Airbag_02);
  TestDisableMsg(Airbag_eCS_01);
  TestWaitForTimeout(6100);
  testStep("STEP", "Set a BP in function BswM_Cyclic_10msTimer in order to change post run timer value --> BP was set");
  debugger_waitUntilBPisReached("2000");
  ExpectedTestResult(debugger_result, W8_UNTIL_BP_SUCCESSFUL, "Breakpoint is reached");
  
  testStep("STEP", "Change value for Post Run Timer in order to go in BswM_Action_BswMAction_BswM_LowPwrStateFromPostRun function --> Succesfully changed");
  debugger_writeVariable("uint8","bswmif_u16TPostRunTimer,,app.elf", "1", "17EC");
  TestWaitForTimeout(500);
  
  debugger_setRelativeFunctionBpAtLine("BswM_Action_BswMAction_BswM_LowPwrStateFromPostRun", "2");
   testStep("", "Run the debugger.");
  debugger_run();
   debugger_waitUntilBPisReached("2000");
  testStep("STEP", "Set a BP in function BswM_Action_BswMAction_BswM_LowPwrStateFromPostRun in order to call BswM_OnLowPwrFromPostRun function --> BP was set");
   ExpectedTestResult(debugger_result, W8_UNTIL_BP_SUCCESSFUL, "Breakpoint is reached");
  
  debugger_setRelativeFunctionBpAtLine("BswM_OnLowPwrFromPostRun", "2");
   testStep("", "Run the debugger.");
  debugger_run();
   testStep("STEP", "Set a BP in function BswM_OnLowPwrFromPostRun in order to check if Low Power state was requested {current state of ECU is POST RUN State} --> BP was set");
  debugger_waitUntilBPisReached("2000");
   ExpectedTestResult(debugger_result, W8_UNTIL_BP_SUCCESSFUL, "Breakpoint is reached");
    
  //====================================================
  testCaseComment("Postcondition");
  testStep("STEP", "Return ECU to default values");
  RunPostTs();
}

testcase Sw_Int_BswMIf_ptrpAsrBswMServicesBswMIf_06()
{
   /*-------------------------Test specific report info------------------------------*/
  
  testReportAddMiscInfoBlock("AUTOLIV ELECTRONICS document");
  TestReportAddMiscInfo("Nightly test", "No");
  TestReportAddMiscInfo("Test type", "Requirement-Based");
  TestReportAddMiscInfo("Regression Test", "No");
  TestReportAddMiscInfo("Fault injection method used", "No");
  TestReportAddMiscInfo("Resource usage evaluation", "No");
  TestReportAddMiscInfo("Priority", "No");
  TestReportAddMiscInfo("Safety relevant", "No");
  
  AddRequirementInfo("Requirement under test", "ARCH_SW_BswMIf_ptrpAsrBswMServicesBswMIf_BswM_OnRunFromLowPwrPassengerDetected");
  AddRequirementInfo("ARCH_SW_BswMIf_ptrpAsrBswMServicesBswMIf_BswM_OnRunFromLowPwrPassengerDetected", "The BswM_OnRunFromLowPwrPassengerDetected runnable shall be called by the Autosar BswM in case of: - The current state of ECU is LOW POWER AND an Active wakeup is detected {passenger occupancy detected}.");
//***************************************************************************************
  testCaseComment("Preconditions");
  testStep("STEP", "Bench Initialization"); 
  RunPreTs();
//   /*------------------------- Test scenario start ------------------------------*/
  
  testCaseComment("Action: ARCH_SW_BswMIf_ptrpAsrBswMServicesBswMIf_BswM_OnRunFromLowPwrPassengerDetected");
   testStep("STEP", "Enable comunication --> Comunication enable");
   TestSetMsgEvent(Airbag_01);
  TestSetMsgEvent(Airbag_02);
  TestSetMsgEvent(Airbag_eCS_01);
   TestWaitForTimeout(10000);
  
  debugger_setRelativeFunctionBpAtLine("BswM_Cyclic_10msTimer", "5");
   testStep("", "Reset the debugger.");
  debugger_reset(); 
   testStep("", "Run the debugger.");
  debugger_run();
    
  testStep("STEP", "Disable comunication --> Comunication disable");
  TestDisableMsg(Airbag_01);
  TestDisableMsg(Airbag_02);
  TestDisableMsg(Airbag_eCS_01);
  TestWaitForTimeout(6100);
  testStep("STEP", "Set a BP in function BswM_Cyclic_10msTimer in order to change post run timer value --> BP was set");
  debugger_waitUntilBPisReached("2000");
  ExpectedTestResult(debugger_result, W8_UNTIL_BP_SUCCESSFUL, "Breakpoint is reached");
  
  
  testStep("STEP", "Change value for Post Run Timer in order to go in LPM_sleepMainLoop function --> Succesfully changed");
  debugger_writeVariable("uint8","bswmif_u16TPostRunTimer,,app.elf", "1", "17EC");
  TestWaitForTimeout(500);
  
  debugger_setRelativeFunctionBpAtLine("LPM_sleepMainLoop", "46");
  TestWaitForTimeout(500);
   testStep("", "Run the debugger.");
  debugger_run();
   testStep("STEP", "Set a BP in function LPM_sleepMainLoop in order to change Adc Wakeup value --> BP was set");
  debugger_waitUntilBPisReached("3000");
  ExpectedTestResult(debugger_result, W8_UNTIL_BP_SUCCESSFUL, "Breakpoint is reached");

  testStep("STEP", "Change value for Adc wakeup in True --> Succesfully changed");
   debugger_writeLocalVariable("bAdcWakeup", "AA");
  TestWaitForTimeout(2000);
  
    debugger_setRelativeFunctionBpAtLine("BswM_Action_BswMAction_BswM_RunStateFromLowPwr_ActiveWake ", "2");
   testStep("", "Run the debugger.");
  debugger_run();
   testStep("STEP", "Set a BP in function BswM_Action_BswMAction_BswM_RunStateFromLowPwr_ActiveWake in order to call BswM_OnRunFromLowPwrPassengerDetected function --> BP was set");
  debugger_waitUntilBPisReached("2000");
  ExpectedTestResult(debugger_result, W8_UNTIL_BP_SUCCESSFUL, "Breakpoint is reached");
  
  debugger_setRelativeFunctionBpAtLine("BswM_OnRunFromLowPwrPassengerDetected", "0");
   testStep("", "Run the debugger.");
  debugger_run();
   testStep("STEP", "Set a BP in function BswM_OnRunFromLowPwrPassengerDetected in order to check Bus if Current state of ECU is RUN AND Bus communication timeout was received --> BP was set");
  debugger_waitUntilBPisReached("2000");
  ExpectedTestResult(debugger_result, W8_UNTIL_BP_SUCCESSFUL, "Breakpoint is reached");
  
  debugger_setRelativeFunctionBpAtLine("BswM_Action_BswMAction_BswM_RunStateFromLowPwr_ActiveWake", "4");
   testStep("", "Run the debugger.");
  debugger_run();
  testStep("STEP", "Set a BP in function BswM_Action_BswMAction_BswM_RunStateFromLowPwr_ActiveWake in order to check the interface --> BP was set");
  debugger_waitUntilBPisReached("2000");
  ExpectedTestResult(debugger_result, W8_UNTIL_BP_SUCCESSFUL, "Breakpoint is reached");
  //====================================================
  testCaseComment("Postcondition");
  testStep("STEP", "Return ECU to default values");
  RunPostTs();
}
testcase Sw_Int_BswMIf_ptrpAsrBswMServicesBswMIf_07()
{
   /*-------------------------Test specific report info------------------------------*/
  
  testReportAddMiscInfoBlock("AUTOLIV ELECTRONICS document");
  TestReportAddMiscInfo("Nightly test", "No");
  TestReportAddMiscInfo("Test type", "Requirement-Based");
  TestReportAddMiscInfo("Regression Test", "No");
  TestReportAddMiscInfo("Fault injection method used", "No");
  TestReportAddMiscInfo("Resource usage evaluation", "No");
  TestReportAddMiscInfo("Priority", "No");
  TestReportAddMiscInfo("Safety relevant", "No");
  
  AddRequirementInfo("Requirement under test", "ARCH_SW_BswMIf_ptrpAsrBswMServicesBswMIf_BswM_ProceedReset");
  AddRequirementInfo("ARCH_SW_BswMIf_ptrpAsrBswMServicesBswMIf_BswM_ProceedReset", "The BswM_ProceedReset runnable shall be called by the Autosar BswM in case of: - SW Reset diagnosis request is made - HW Reset diagnosis request is made - FBL Reset diagnosis request is made");
//***************************************************************************************
  
  testCaseComment("Preconditions");
  testStep("STEP", "Bench Initialization"); // If the first parameter of testStep() is "Step", the arguments will be written in the specification file and "Step" argument will be numbered by 1 for each iteration.
  RunPreTs();
//   /*------------------------- Test scenario start ------------------------------*/
   testCaseComment("Action: ARCH_SW_BswMIf_ptrpAsrBswMServicesBswMIf_BswM_ProceedReset");  
  debugger_setRelativeFunctionBpAtLine("BswM_Action_BswMAction_BswM_ProceedReset", "2");
  testStep("", "Reset the debugger.");
   debugger_reset();
  testStep("", "Run the debugger.");
  debugger_run();
 
  testStep("STEP", "Send diagnostic request in order to do soft Reset");
   SendDiagnosticRequest(dSoftResetRequest, dSoftResetResponse);
  
   debugger_waitUntilBPisReached("2000");
   testStep("STEP", "Set a BP in function BswM_Action_BswMAction_BswM_ProceedReset in order to call BswM_ProceedReset function --> BP was set");
  ExpectedTestResult(debugger_result, W8_UNTIL_BP_SUCCESSFUL, "Breakpoint is reached");
  
  debugger_setRelativeFunctionBpAtLine("BswM_ProceedReset", "2");
   testStep("", "Run the debugger.");
  debugger_run();
   testStep("STEP", "Set a BP in function BswM_ProceedReset in order to check if SW Reset diagnosis request was made --> BP was set");
  debugger_waitUntilBPisReached("2000");
  ExpectedTestResult(debugger_result, W8_UNTIL_BP_SUCCESSFUL, "Breakpoint is reached");
  
  debugger_setRelativeFunctionBpAtLine("BswM_Action_BswMAction_BswM_ProceedReset", "4");
   testStep("", "Run the debugger.");
  debugger_run();
  testStep("STEP", "Set a BP in function BswM_Action_BswMAction_BswM_ProceedReset in order to check the interface --> BP was set");
  debugger_waitUntilBPisReached("2000");
  ExpectedTestResult(debugger_result, W8_UNTIL_BP_SUCCESSFUL, "Breakpoint is reached");
  
  //====================================================
  testCaseComment("Postcondition");
  testStep("STEP", "Return ECU to default values");
  RunPostTs();
}
testcase Sw_Int_BswMIf_ptrpAsrBswMServicesBswMIf_08()
{
   /*-------------------------Test specific report info------------------------------*/
  
  testReportAddMiscInfoBlock("AUTOLIV ELECTRONICS document");
  TestReportAddMiscInfo("Nightly test", "No");
  TestReportAddMiscInfo("Test type", "Requirement-Based");
  TestReportAddMiscInfo("Regression Test", "No");
  TestReportAddMiscInfo("Fault injection method used", "No");
  TestReportAddMiscInfo("Resource usage evaluation", "No");
  TestReportAddMiscInfo("Priority", "No");
  TestReportAddMiscInfo("Safety relevant", "No");
  
  AddRequirementInfo("Requirement under test", "ARCH_SW_BswMIf_ptrpAsrBswMServicesBswMIf_BswM_OnDisableTxPdu");
  AddRequirementInfo("ARCH_SW_BswMIf_ptrpAsrBswMServicesBswMIf_BswM_OnDisableTxPdu", " The BswM_OnDisableTxPdu runnable shall be called by the Autosar BswM in case of: - Current state of ECU is RUN AND Bus communication timeout is received");
//***************************************************************************************
  
  testCaseComment("Preconditions");
  testStep("STEP", "Bench Initialization"); // If the first parameter of testStep() is "Step", the arguments will be written in the specification file and "Step" argument will be numbered by 1 for each iteration.
  RunPreTs();
//   /*------------------------- Test scenario start ------------------------------*/
   testCaseComment("Action: ARCH_SW_BswMIf_ptrpAsrBswMServicesBswMIf_BswM_OnDisableTxPdu");  
  debugger_setRelativeFunctionBpAtLine("BswM_Action_BswMAction_ComM_DisableTxPduConfirmation", "2");
   testStep("", "Reset the debugger.");
  debugger_reset(); 
  testStep("", "Run the debugger.");
  debugger_run();
    
  testStep("STEP", "Disable comunication --> Comunication disable");
  TestDisableMsg(Airbag_01);
  TestDisableMsg(Airbag_02);
  TestDisableMsg(Airbag_eCS_01);
  TestWaitForTimeout(5000);
  testStep("STEP", "Set a BP in function BswM_Action_BswMAction_ComM_DisableTxPduConfirmation in order to call BswM_OnDisableTxPdu function --> BP was set");
  debugger_waitUntilBPisReached("2000");
  ExpectedTestResult(debugger_result, W8_UNTIL_BP_SUCCESSFUL, "Breakpoint is reached");
  
  debugger_setRelativeFunctionBpAtLine("BswM_OnDisableTxPdu", "0");
   testStep("", "Run the debugger.");
  debugger_run();
   testStep("STEP", "Set a BP in function BswM_OnDisableTxPdu in order to check Bus if Current state of ECU is RUN AND Bus communication timeout was received --> BP was set");
  debugger_waitUntilBPisReached("2000");
  ExpectedTestResult(debugger_result, W8_UNTIL_BP_SUCCESSFUL, "Breakpoint is reached");
  
  debugger_setRelativeFunctionBpAtLine("BswM_Action_BswMAction_ComM_DisableTxPduConfirmation", "4");
   testStep("", "Run the debugger.");
  debugger_run();
  testStep("STEP", "Set a BP in function BswM_Action_BswMAction_ComM_DisableTxPduConfirmation in order to check the interface --> BP was set");
  debugger_waitUntilBPisReached("2000");
  ExpectedTestResult(debugger_result, W8_UNTIL_BP_SUCCESSFUL, "Breakpoint is reached");
  
  //====================================================
  testCaseComment("Postcondition");
  testStep("STEP", "Return ECU to default values");
  RunPostTs();
}
testcase Sw_Int_BswMIf_ptrpAsrBswMServicesBswMIf_09()
{
   /*-------------------------Test specific report info------------------------------*/
  
  testReportAddMiscInfoBlock("AUTOLIV ELECTRONICS document");
  TestReportAddMiscInfo("Nightly test", "No");
  TestReportAddMiscInfo("Test type", "Requirement-Based");
  TestReportAddMiscInfo("Regression Test", "No");
  TestReportAddMiscInfo("Fault injection method used", "No");
  TestReportAddMiscInfo("Resource usage evaluation", "No");
  TestReportAddMiscInfo("Priority", "No");
  TestReportAddMiscInfo("Safety relevant", "No");
  
  AddRequirementInfo("Requirement under test", "ARCH_SW_BswMIf_ptrpAsrBswMServicesBswMIf_BswM_OnRunFromLowPwrBusAvailable");
  AddRequirementInfo("ARCH_SW_BswMIf_ptrpAsrBswMServicesBswMIf_BswM_OnRunFromLowPwrBusAvailable", "The BswM_OnRunFromLowPwrBusAvailable runnable shall be called by the Autosar BswM in case of: - The current state of ECU is LOW POWER AND a Passive wakeup is detected {CAN Bus activity}");
//***************************************************************************************
  
  testCaseComment("Preconditions");
  testStep("STEP", "Bench Initialization"); // If the first parameter of testStep() is "Step", the arguments will be written in the specification file and "Step" argument will be numbered by 1 for each iteration.
  RunPreTs();
//   /*------------------------- Test scenario start ------------------------------*/
   testCaseComment("Action: ARCH_SW_BswMIf_ptrpAsrBswMServicesBswMIf_BswM_OnRunFromLowPwrBusAvailable"); 
  testStep("STEP", "Enable comunication --> Comunication enable");
   TestSetMsgEvent(Airbag_01);
   TestSetMsgEvent(Airbag_02);
   TestSetMsgEvent(Airbag_eCS_01);
  TestWaitForTimeout(12000);
  
  debugger_setRelativeFunctionBpAtLine("BswM_Cyclic_10msTimer", "5");
  testStep("", "Reset the debugger.");
   debugger_reset();
   testStep("", "Run the debugger."); 
  debugger_run();
    
  testStep("STEP", "Disable comunication --> Comunication disable");
  TestDisableMsg(Airbag_01);
  TestDisableMsg(Airbag_02);
  TestDisableMsg(Airbag_eCS_01);
  TestWaitForTimeout(5000);
  testStep("STEP", "Set a BP in function BswM_Cyclic_10msTimer in order to go in  BswM_OnLowPwrFromPostRun function --> BP was set");
  debugger_waitUntilBPisReached("2000");
  ExpectedTestResult(debugger_result, W8_UNTIL_BP_SUCCESSFUL, "Breakpoint is reached");
  debugger_deleteAllBreakpoints();
  
  debugger_writeVariable("uint8","bswmif_u16TPostRunTimer,,app.elf", "1", "17EC");
  TestWaitForTimeout(2000);
   
  debugger_setRelativeFunctionBpAtLine("BswM_OnLowPwrFromPostRun", "14");
   testStep("", "Run the debugger.");
  debugger_run();
   testStep("STEP", "Set a BP in function BswM_OnLowPwrFromPostRun in order to go in BswM_Action_BswMAction_BswM_RunStateFromLowPwr_PassiveWake function --> BP was set");
  debugger_waitUntilBPisReached("2000");
  ExpectedTestResult(debugger_result, W8_UNTIL_BP_SUCCESSFUL, "Breakpoint is reached");
  
  debugger_setRelativeFunctionBpAtLine("BswM_Action_BswMAction_BswM_RunStateFromLowPwr_PassiveWake", "2"); 
  testStep("", "Run the debugger.");
  debugger_run();
    
  testStep("STEP", "Enable comunication --> Comunication enable");
   TestSetMsgEvent(Airbag_01);
  TestSetMsgEvent(Airbag_02);
  TestSetMsgEvent(Airbag_eCS_01);
   TestWaitForTimeout(61240);
  testStep("STEP", "Set a BP in function BswM_Action_BswMAction_BswM_RunStateFromLowPwr_PassiveWake in order to call BswM_OnPostRunFromRun function --> BP was set");
  debugger_waitUntilBPisReached("2000");
  ExpectedTestResult(debugger_result, W8_UNTIL_BP_SUCCESSFUL, "Breakpoint is reached");
  
  debugger_setRelativeFunctionBpAtLine("BswM_OnRunFromLowPwrBusAvailable", "2");
   testStep("", "Run the debugger.");
  debugger_run();
   testStep("STEP", "Set a BP in function BswM_OnRunFromLowPwrBusAvailable in order to check if The current state of ECU is LOW POWER AND a Passive wakeup was detected {CAN Bus activity} --> BP was set");
  debugger_waitUntilBPisReached("2000");
  ExpectedTestResult(debugger_result, W8_UNTIL_BP_SUCCESSFUL, "Breakpoint is reached");
  
  debugger_setRelativeFunctionBpAtLine("BswM_Action_BswMAction_BswM_RunStateFromLowPwr_PassiveWake", "4");
   testStep("", "Run the debugger.");
  debugger_run();
  testStep("STEP", "Set a BP in function BswM_Action_BswMAction_BswM_RunStateFromLowPwr_PassiveWake in order to check the interface --> BP was set");
  debugger_waitUntilBPisReached("2000");
  ExpectedTestResult(debugger_result, W8_UNTIL_BP_SUCCESSFUL, "Breakpoint is reached");
  
  //====================================================
  testCaseComment("Postcondition");
  testStep("STEP", "Return ECU to default values");
  RunPostTs();
}
testcase Sw_Int_BswMIf_ptrpAsrBswMServicesBswMIf_10()
{
   /*-------------------------Test specific report info------------------------------*/
  
  testReportAddMiscInfoBlock("AUTOLIV ELECTRONICS document");
  TestReportAddMiscInfo("Nightly test", "No");
  TestReportAddMiscInfo("Test type", "Requirement-Based");
  TestReportAddMiscInfo("Regression Test", "No");
  TestReportAddMiscInfo("Fault injection method used", "No");
  TestReportAddMiscInfo("Resource usage evaluation", "No");
  TestReportAddMiscInfo("Priority", "No");
  TestReportAddMiscInfo("Safety relevant", "No");
  
  AddRequirementInfo("Requirement under test", "ARCH_SW_BswMIf_ptrpAsrBswMServicesBswMIf_BswM_OnWakeupValidation");
  AddRequirementInfo("ARCH_SW_BswMIf_ptrpAsrBswMServicesBswMIf_BswM_OnWakeupValidation", "The BswM_OnWakeupValidation runnable shall be called by the Autosar BswM in case of: - Wakeup event is validated");
//***************************************************************************************
  
  testCaseComment("Preconditions");
  testStep("STEP", "Bench Initialization"); // If the first parameter of testStep() is "Step", the arguments will be written in the specification file and "Step" argument will be numbered by 1 for each iteration.
  RunPreTs();
//   /*------------------------- Test scenario start ------------------------------*/
   testCaseComment("Action: ARCH_SW_BswMIf_ptrpAsrBswMServicesBswMIf_BswM_OnWakeupValidation");
   testStep("STEP", "Enable comunication --> Comunication enable");
   TestSetMsgEvent(Airbag_01);
  TestSetMsgEvent(Airbag_02);
  TestSetMsgEvent(Airbag_eCS_01);
   TestWaitForTimeout(12000);
  
    debugger_setRelativeFunctionBpAtLine("BswM_Action_BswMAction_BswM_OnWakeupValidation", "2");
   testStep("", "Reset the debugger.");
  debugger_reset(); 
   testStep("", "Run the debugger.");
  debugger_run();
  testStep("STEP", "Set a BP in function BswM_Action_BswMAction_BswM_OnWakeupValidation in order call BswM_OnWakeupValidation function --> BP was set");
  debugger_waitUntilBPisReached("2000");
  ExpectedTestResult(debugger_result, W8_UNTIL_BP_SUCCESSFUL, "Breakpoint is reached");
  
  debugger_setRelativeFunctionBpAtLine("BswM_OnWakeupValidation ", "0");
   testStep("", "Run the debugger.");
  debugger_run();
   testStep("STEP", "Set a BP in function BswM_Cyclic_10msTimer in order to check Wakeup event was validated --> BP was set");
  debugger_waitUntilBPisReached("2000");
  ExpectedTestResult(debugger_result, W8_UNTIL_BP_SUCCESSFUL, "Breakpoint is reached");
  
  debugger_setRelativeFunctionBpAtLine("BswM_Action_BswMAction_BswM_OnWakeupValidation", "4");
   testStep("", "Run the debugger.");
  debugger_run();
  testStep("STEP", "Set a BP in function BswM_Action_BswMAction_BswM_OnWakeupValidation in order to check the interface --> BP was set");
  debugger_waitUntilBPisReached("2000");
  ExpectedTestResult(debugger_result, W8_UNTIL_BP_SUCCESSFUL, "Breakpoint is reached");
  
  //====================================================
  testCaseComment("Postcondition");
  testStep("STEP", "Return ECU to default values");
  RunPostTs();
}
testcase Sw_Int_BswMIf_ptrpAsrBswMServicesBswMIf_11()
{
   /*-------------------------Test specific report info------------------------------*/
  
  testReportAddMiscInfoBlock("AUTOLIV ELECTRONICS document");
  TestReportAddMiscInfo("Nightly test", "No");
  TestReportAddMiscInfo("Test type", "Requirement-Based");
  TestReportAddMiscInfo("Regression Test", "No");
  TestReportAddMiscInfo("Fault injection method used", "No");
  TestReportAddMiscInfo("Resource usage evaluation", "No");
  TestReportAddMiscInfo("Priority", "No");
  TestReportAddMiscInfo("Safety relevant", "No");
  
  AddRequirementInfo("Requirement under test", "ARCH_SW_BswMIf_ptrpAsrBswMServicesBswMIf_BswM_OnStartupTwoB");
  AddRequirementInfo("ARCH_SW_BswMIf_ptrpAsrBswMServicesBswMIf_BswM_OnStartupTwoB", "The BswM_OnStartupTwoB runnable shall be called by the Autosar BswM in case of: - ReadAll NvM procedure is made {After second part of ECU initialization - BswM_OnStartupTwoB}");
//***************************************************************************************
  
  testCaseComment("Preconditions");
  testStep("STEP", "Bench Initialization"); // If the first parameter of testStep() is "Step", the arguments will be written in the specification file and "Step" argument will be numbered by 1 for each iteration.
  RunPreTs();
//   /*------------------------- Test scenario start ------------------------------*/
   testCaseComment("Action: ARCH_SW_BswMIf_ptrpAsrBswMServicesBswMIf_BswM_OnStartupTwoB");
  debugger_setRelativeFunctionBpAtLine("NvM_ReadAll", "0");
   testStep("", "Reset the debugger.");
  debugger_reset(); 
   testStep("", "Run the debugger.");
  debugger_run();
  testStep("STEP", "Set a BP in function BswM_Action_BswMAction_BswM_OnStartupTwoB in order execute ReadAll NvM procedure --> BP was set");
  debugger_waitUntilBPisReached("2000");
  ExpectedTestResult(debugger_result, W8_UNTIL_BP_SUCCESSFUL, "Breakpoint is reached");
  
  debugger_setRelativeFunctionBpAtLine("BswM_Action_BswMAction_BswM_OnStartupTwoB", "2");
   testStep("", "Run the debugger.");
  debugger_run();
  testStep("STEP", "Set a BP in function BswM_Action_BswMAction_BswM_OnStartupTwoB in order to call BswM_OnStartupTwoB function --> BP was set");
  debugger_waitUntilBPisReached("2000");
  ExpectedTestResult(debugger_result, W8_UNTIL_BP_SUCCESSFUL, "Breakpoint is reached");
  
  debugger_setRelativeFunctionBpAtLine("BswM_OnStartupTwoB", "0");
   testStep("", "Run the debugger.");
  debugger_run();
   testStep("STEP", "Set a BP in function BswM_OnStartupTwoB in order to check if ReadAll NvM procedure was made--> BP was set");
  debugger_waitUntilBPisReached("2000");
  ExpectedTestResult(debugger_result, W8_UNTIL_BP_SUCCESSFUL, "Breakpoint is reached");
  
  debugger_setRelativeFunctionBpAtLine("BswM_Action_BswMAction_BswM_OnStartupTwoB", "4");
   testStep("", "Run the debugger.");
  debugger_run();
  testStep("STEP", "Set a BP in function BswM_Action_BswMAction_BswM_OnStartupTwoB in order to check the interface --> BP was set");
  debugger_waitUntilBPisReached("2000");
  ExpectedTestResult(debugger_result, W8_UNTIL_BP_SUCCESSFUL, "Breakpoint is reached");
  
  //====================================================
  testCaseComment("Postcondition");
  testStep("STEP", "Return ECU to default values");
  RunPostTs();
}
testcase Sw_Int_BswMIf_ptrpAsrBswMServicesBswMIf_12()
{
   /*-------------------------Test specific report info------------------------------*/
  
  testReportAddMiscInfoBlock("AUTOLIV ELECTRONICS document");
  TestReportAddMiscInfo("Nightly test", "No");
  TestReportAddMiscInfo("Test type", "Requirement-Based");
  TestReportAddMiscInfo("Regression Test", "No");
  TestReportAddMiscInfo("Fault injection method used", "No");
  TestReportAddMiscInfo("Resource usage evaluation", "No");
  TestReportAddMiscInfo("Priority", "No");
  TestReportAddMiscInfo("Safety relevant", "No");
  
  AddRequirementInfo("Requirement under test", "ARCH_SW_BswMIf_ptrpAsrBswMServicesBswMIf_BswM_OnStartComEffective, ARCH_SW_BswMIf_ptrpAsrBswMServicesBswMIf_BswM_OnRunFromWakeup");
  AddRequirementInfo("ARCH_SW_BswMIf_ptrpAsrBswMServicesBswMIf_BswM_OnStartComEffective", "The BswM_OnStartComEffective runnable shall be called by the Autosar BswM in case of: - Bus communication is available AND wakeup was validated");
  AddRequirementInfo("ARCH_SW_BswMIf_ptrpAsrBswMServicesBswMIf_BswM_OnRunFromWakeup", "The BswM_OnRunFromWakeup runnable shall be called by the Autosar BswM in case of: - Wakeup is validated and all modules were initialized {BswM_OnStartComEffective}");
//***************************************************************************************
  
  testCaseComment("Preconditions");
  testStep("STEP", "Bench Initialization"); // If the first parameter of testStep() is "Step", the arguments will be written in the specification file and "Step" argument will be numbered by 1 for each iteration.
  RunPreTs();
//   /*------------------------- Test scenario start ------------------------------*/
   testCaseComment("Action: ARCH_SW_BswMIf_ptrpAsrBswMServicesBswMIf_BswM_OnStartComEffective");  
    debugger_setRelativeFunctionBpAtLine("BswM_Action_BswMAction_BswM_OnStartComEffective", "2");
   testStep("", "Reset the debugger.");
  debugger_reset(); 
   testStep("", "Run the debugger.");
  debugger_run();
  testStep("STEP", "Set a BP in function BswM_Action_BswMAction_BswM_OnStartComEffective in order call BswM_OnStartComEffective function --> BP was set");
  debugger_waitUntilBPisReached("2000");
  ExpectedTestResult(debugger_result, W8_UNTIL_BP_SUCCESSFUL, "Breakpoint is reached");
  
  debugger_setRelativeFunctionBpAtLine("BswM_OnStartComEffective", "0");
   testStep("", "Run the debugger.");
  debugger_run();
   testStep("STEP", "Set a BP in function BswM_OnStartComEffective in order to check Bus if communication is available AND wakeup was validated --> BP was set");
  debugger_waitUntilBPisReached("2000");
  ExpectedTestResult(debugger_result, W8_UNTIL_BP_SUCCESSFUL, "Breakpoint is reached");
  
  debugger_setRelativeFunctionBpAtLine("BswM_Action_BswMAction_BswM_OnStartComEffective", "4");
   testStep("", "Run the debugger.");
  debugger_run();
  testStep("STEP", "Set a BP in function BswM_Action_BswMAction_BswM_OnStartComEffective in order to check the interface --> BP was set");
  debugger_waitUntilBPisReached("2000");
  ExpectedTestResult(debugger_result, W8_UNTIL_BP_SUCCESSFUL, "Breakpoint is reached");
  debugger_deleteAllBreakpoints();
  
  testCaseComment("Action: ARCH_SW_BswMIf_ptrpAsrBswMServicesBswMIf_BswM_OnRunFromWakeup");  
    debugger_setRelativeFunctionBpAtLine("BswM_Action_BswMAction_BswM_RunStateFromWakeup", "2");
   testStep("", "Run the debugger.");
  debugger_run();
  testStep("STEP", "Set a BP in function BswM_Action_BswMAction_BswM_RunStateFromWakeup in order call BswM_OnRunFromWakeup function --> BP was set");
  debugger_waitUntilBPisReached("2000");
  ExpectedTestResult(debugger_result, W8_UNTIL_BP_SUCCESSFUL, "Breakpoint is reached");
  
  debugger_setRelativeFunctionBpAtLine("BswM_OnRunFromWakeup", "0");
   testStep("", "Run the debugger.");
  debugger_run();
   testStep("STEP", "Set a BP in function BswM_OnRunFromWakeup in order to check Bus if Wakeup is validated and all modules were initialized --> BP was set");
  debugger_waitUntilBPisReached("2000");
  ExpectedTestResult(debugger_result, W8_UNTIL_BP_SUCCESSFUL, "Breakpoint is reached");
  
  debugger_setRelativeFunctionBpAtLine("BswM_Action_BswMAction_BswM_RunStateFromWakeup", "4");
   testStep("", "Run the debugger.");
  debugger_run();
  testStep("STEP", "Set a BP in function BswM_Action_BswMAction_BswM_RunStateFromWakeup in order to check the interface --> BP was set");
  debugger_waitUntilBPisReached("2000");
  ExpectedTestResult(debugger_result, W8_UNTIL_BP_SUCCESSFUL, "Breakpoint is reached");
  
  //====================================================
  testCaseComment("Postcondition");
  testStep("STEP", "Return ECU to default values");
  RunPostTs();
}
testcase Sw_Int_BswMIf_ptrpAsrBswMServicesBswMIf_13()
{
   /*-------------------------Test specific report info------------------------------*/
  
  testReportAddMiscInfoBlock("AUTOLIV ELECTRONICS document");
  TestReportAddMiscInfo("Nightly test", "No");
  TestReportAddMiscInfo("Test type", "Requirement-Based");
  TestReportAddMiscInfo("Regression Test", "No");
  TestReportAddMiscInfo("Fault injection method used", "No");
  TestReportAddMiscInfo("Resource usage evaluation", "No");
  TestReportAddMiscInfo("Priority", "No");
  TestReportAddMiscInfo("Safety relevant", "No");
  
  AddRequirementInfo("Requirement under test", "ARCH_SW_BswMIf_ptrpAsrBswMServicesBswMIf_BswM_OnRunFromPostRunPassengerDetected");
  AddRequirementInfo("ARCH_SW_BswMIf_ptrpAsrBswMServicesBswMIf_BswM_OnRunFromPostRunPassengerDetected", "The BswM_OnRunFromPostRunPassengerDetected runnable shall be called by the Autosar BswM in case of: - The current state of ECU is POST RUN AND Valid Passenger occupancy is detected");
//***************************************************************************************
  
  testCaseComment("Preconditions");
  testStep("STEP", "Bench Initialization"); // If the first parameter of testStep() is "Step", the arguments will be written in the specification file and "Step" argument will be numbered by 1 for each iteration.
  RunPreTs();
//   /*------------------------- Test scenario start ------------------------------*/
   testCaseComment("Action: ARCH_SW_BswMIf_ptrpAsrBswMServicesBswMIf_BswM_OnRunFromPostRunPassengerDetected");
   testStep("STEP", "Enable comunication --> Comunication enable");
   TestSetMsgEvent(Airbag_01);
  TestSetMsgEvent(Airbag_02);
  TestSetMsgEvent(Airbag_eCS_01);
   TestWaitForTimeout(11000);
  
    debugger_setRelativeFunctionBpAtLine("BswM_Cyclic_10msTimer", "9");
   testStep("", "Reset the debugger.");
  debugger_reset(); 
  testStep("", "Run the debugger.");
  debugger_run();
    
  testStep("STEP", "Disable comunication --> Comunication disable");
  TestDisableMsg(Airbag_01);
  TestDisableMsg(Airbag_02);
  TestDisableMsg(Airbag_eCS_01);
  TestWaitForTimeout(5000);
  testStep("STEP", "Set a BP in function BswM_Cyclic_10msTimer in order to change post run timer value --> BP was set");
  debugger_waitUntilBPisReached("2000");
  ExpectedTestResult(debugger_result, W8_UNTIL_BP_SUCCESSFUL, "Breakpoint is reached");
  
  debugger_setRelativeFunctionBpAtLine("BswM_Cyclic_10msTimer", "12");
   testStep("", "Run the debugger.");
  debugger_run();
   testStep("STEP", "Set a BP in function BswM_Cyclic_10msTimer in order to change Passenger Occupancy Status value --> BP was set");
  debugger_waitUntilBPisReached("2000");
  ExpectedTestResult(debugger_result, W8_UNTIL_BP_SUCCESSFUL, "Breakpoint is reached");
  
  testStep("STEP", "Change value for Passenger Occupancy Status with pasager occupancy is detected--> Succesfully changed");
   debugger_writeLocalVariable("bswmif_u8PassengerOccupancyStatus", "1");
  TestWaitForTimeout(2000);
  
  debugger_setRelativeFunctionBpAtLine("BswM_Cyclic_10msTimer", "15");
   testStep("", "Run the debugger.");
  debugger_run();
   testStep("STEP", "Set a BP in function BswM_Cyclic_10msTimer in order to call BswM_RequestMode function --> BP was set");
  debugger_waitUntilBPisReached("3000");
  ExpectedTestResult(debugger_result, W8_UNTIL_BP_SUCCESSFUL, "Breakpoint is reached");
  
  debugger_setRelativeFunctionBpAtLine("BswM_Action_BswMAction_BswM_RunStateFromPostRunPassengerDetected", "2");
   testStep("", "Run the debugger.");
  debugger_run();
  testStep("STEP", "Set a BP in function BswM_Action_BswMAction_BswM_RunStateFromPostRunPassengerDetected in order to call BswM_OnRunFromPostRunPassengerDetected function --> BP was set");
  debugger_waitUntilBPisReached("2000");
  ExpectedTestResult(debugger_result, W8_UNTIL_BP_SUCCESSFUL, "Breakpoint is reached");
  
  debugger_setRelativeFunctionBpAtLine("BswM_OnRunFromPostRunPassengerDetected", "0");
   testStep("", "Run the debugger.");
  debugger_run();
   testStep("STEP", "Set a BP in function BswM_OnRunFromPostRunPassengerDetected in order to check Bus if communication is available AND wakeup was validated --> BP was set");
  debugger_waitUntilBPisReached("2000");
  ExpectedTestResult(debugger_result, W8_UNTIL_BP_SUCCESSFUL, "Breakpoint is reached");
  
  debugger_setRelativeFunctionBpAtLine("BswM_Action_BswMAction_BswM_RunStateFromPostRunPassengerDetected", "4");
   testStep("", "Run the debugger.");
  debugger_run();
  testStep("STEP", "Set a BP in function BswM_Action_BswMAction_BswM_RunStateFromPostRunPassengerDetected in order to check the interface --> BP was set");
  debugger_waitUntilBPisReached("2000");
  ExpectedTestResult(debugger_result, W8_UNTIL_BP_SUCCESSFUL, "Breakpoint is reached");
  
  //====================================================
  testCaseComment("Postcondition");
  testStep("STEP", "Return ECU to default values");
  RunPostTs();
}
testcase Sw_Int_BswMIf_ptrpAsrBswMServicesBswMIf_14()
{
   /*-------------------------Test specific report info------------------------------*/
  
  testReportAddMiscInfoBlock("AUTOLIV ELECTRONICS document");
  TestReportAddMiscInfo("Nightly test", "No");
  TestReportAddMiscInfo("Test type", "Requirement-Based");
  TestReportAddMiscInfo("Regression Test", "No");
  TestReportAddMiscInfo("Fault injection method used", "No");
  TestReportAddMiscInfo("Resource usage evaluation", "No");
  TestReportAddMiscInfo("Priority", "No");
  TestReportAddMiscInfo("Safety relevant", "No");
  
  AddRequirementInfo("Requirement under test", "ARCH_SW_BswMIf_ptrpAsrBswMServicesBswMIf_BswM_OnRunFromPostRunBusAvailable");
  AddRequirementInfo("ARCH_SW_BswMIf_ptrpAsrBswMServicesBswMIf_BswM_OnRunFromPostRunBusAvailable", "The BswM_OnRunFromPostRunBusAvailable runnable shall be called by the Autosar BswM in case of: - The current state of ECU is POST RUN AND Bus communication is available {reception aknowledge is received}");
//***************************************************************************************
  
  testCaseComment("Preconditions");
  testStep("STEP", "Bench Initialization"); // If the first parameter of testStep() is "Step", the arguments will be written in the specification file and "Step" argument will be numbered by 1 for each iteration.
  RunPreTs();
//   /*------------------------- Test scenario start ------------------------------*/
testCaseComment("Action: ARCH_SW_BswMIf_ptrpAsrBswMServicesBswMIf_BswM_OnRunFromPostRunBusAvailable");
   debugger_setRelativeFunctionBpAtLine("BswM_OnPostRunFromRun", "26");
  testStep("", "Reset the debugger.");
   debugger_reset();
  testStep("", "Run the debugger.");
  debugger_run();
  testStep("STEP", "Disable comunication --> Comunication disable");
   TestDisableMsg(Airbag_01);
  TestDisableMsg(Airbag_02);
  TestDisableMsg(Airbag_eCS_01);
   TestWaitForTimeout(5000);
   debugger_waitUntilBPisReached("2000");
   testStep("STEP", "Set a BP in function BswM_OnPostRunFromRun in order to call BswM_RequestMode function --> BP was set");
  ExpectedTestResult(debugger_result, W8_UNTIL_BP_SUCCESSFUL, "Breakpoint is reached");
  
   debugger_setRelativeFunctionBpAtLine("BswM_Action_BswMAction_BswM_RunStateFromPostRunBusAvailable", "2");
  testStep("", "Run the debugger.");
  debugger_run();
  
  testStep("STEP", "Enable comunication --> Comunication enable");
   TestSetMsgEvent(Airbag_01);
  TestSetMsgEvent(Airbag_02);
  TestSetMsgEvent(Airbag_eCS_01);
   TestWaitForTimeout(5000);

   testStep("STEP", "Set a BP in function BswM_Action_BswMAction_BswM_RunStateFromPostRunBusAvailable in order to call BswM_OnRunFromPostRunPassengerDetected function --> BP was set");
  debugger_waitUntilBPisReached("2000");
  ExpectedTestResult(debugger_result, W8_UNTIL_BP_SUCCESSFUL, "Breakpoint is reached");
  
  debugger_setRelativeFunctionBpAtLine("BswM_OnRunFromPostRunBusAvailable", "0");
   testStep("", "Run the debugger.");
  debugger_run();
   testStep("STEP", "Set a BP in function BswM_OnRunFromPostRunBusAvailable in order to check if The current state of ECU is POST RUN AND Bus communication is available --> BP was set");
  debugger_waitUntilBPisReached("2000");
  ExpectedTestResult(debugger_result, W8_UNTIL_BP_SUCCESSFUL, "Breakpoint is reached");
  
  debugger_setRelativeFunctionBpAtLine("BswM_Action_BswMAction_BswM_RunStateFromPostRunBusAvailable", "4");
   testStep("", "Run the debugger.");
  debugger_run();
  testStep("STEP", "Set a BP in function BswM_Action_BswMAction_BswM_RunStateFromPostRunBusAvailable in order to check the interface --> BP was set");
  debugger_waitUntilBPisReached("2000");
  ExpectedTestResult(debugger_result, W8_UNTIL_BP_SUCCESSFUL, "Breakpoint is reached");
  
  //====================================================
  testCaseComment("Postcondition");
  testStep("STEP", "Return ECU to default values");
  RunPostTs();
}
testcase Sw_Int_BswMIf_ptrpAsrBswMServicesBswMIf_15()
{
   /*-------------------------Test specific report info------------------------------*/
  
  testReportAddMiscInfoBlock("AUTOLIV ELECTRONICS document");
  TestReportAddMiscInfo("Nightly test", "No");
  TestReportAddMiscInfo("Test type", "Requirement-Based");
  TestReportAddMiscInfo("Regression Test", "No");
  TestReportAddMiscInfo("Fault injection method used", "No");
  TestReportAddMiscInfo("Resource usage evaluation", "No");
  TestReportAddMiscInfo("Priority", "No");
  TestReportAddMiscInfo("Safety relevant", "No");
  
  AddRequirementInfo("Requirement under test", "ARCH_SW_BswMIf_ptrpAsrBswMServices_BswMIf_BswM_OnStartupTwoA");
  AddRequirementInfo("ARCH_SW_BswMIf_ptrpAsrBswMServices_BswMIf_BswM_OnStartupTwoA", "The BswM_OnStartupTwoA runnable shall be called by the Autosar BswM in case of: - First part of ECU initialization is done {EcuM_StartupOne, EcuM_StartupTwo}");
//***************************************************************************************
  
  testCaseComment("Preconditions");
  testStep("STEP", "Bench Initialization"); // If the first parameter of testStep() is "Step", the arguments will be written in the specification file and "Step" argument will be numbered by 1 for each iteration.
  RunPreTs();
//   /*------------------------- Test scenario start ------------------------------*/
   testCaseComment("Action: ARCH_SW_BswMIf_ptrpAsrBswMServices_BswMIf_BswM_OnStartupTwoA");  
  debugger_setRelativeFunctionBpAtLine("BswM_Action_BswMAction_BswM_OnStartupTwoA", "2");
  testStep("", "Reset the debugger.");
   debugger_reset();
  testStep("", "Run the debugger.");
  debugger_run();
  debugger_waitUntilBPisReached("2000");
   testStep("STEP", "Set a BP in function BswM_Action_BswMAction_BswM_OnStartupTwoA in order to call BswM_OnStartupTwoA function --> BP was set");
  ExpectedTestResult(debugger_result, W8_UNTIL_BP_SUCCESSFUL, "Breakpoint is reached");
  
  debugger_setRelativeFunctionBpAtLine("BswM_OnStartupTwoA", "2");
   testStep("", "Run the debugger.");
  debugger_run();
   testStep("STEP", "Set a BP in function BswM_OnStartupTwoA in order to check if First part of ECU initialization was done --> BP was set");
  debugger_waitUntilBPisReached("2000");
  ExpectedTestResult(debugger_result, W8_UNTIL_BP_SUCCESSFUL, "Breakpoint is reached");
  
  debugger_setRelativeFunctionBpAtLine("BswM_Action_BswMAction_BswM_OnStartupTwoA", "4");
   testStep("", "Run the debugger.");
  debugger_run();
  testStep("STEP", "Set a BP in function BswM_Action_BswMAction_BswM_OnStartupTwoA in order to check the interface --> BP was set");
  debugger_waitUntilBPisReached("2000");
  ExpectedTestResult(debugger_result, W8_UNTIL_BP_SUCCESSFUL, "Breakpoint is reached");
  
  //====================================================
  testCaseComment("Postcondition");
  testStep("STEP", "Return ECU to default values");
  RunPostTs();
}
testcase Sw_Int_BswMIf_ptrpAsrBswMServicesBswMIf_16()
{
   /*-------------------------Test specific report info------------------------------*/
  
  testReportAddMiscInfoBlock("AUTOLIV ELECTRONICS document");
  TestReportAddMiscInfo("Nightly test", "No");
  TestReportAddMiscInfo("Test type", "Requirement-Based");
  TestReportAddMiscInfo("Regression Test", "No");
  TestReportAddMiscInfo("Fault injection method used", "No");
  TestReportAddMiscInfo("Resource usage evaluation", "No");
  TestReportAddMiscInfo("Priority", "No");
  TestReportAddMiscInfo("Safety relevant", "No");
  
  AddRequirementInfo("Requirement under test", "ARCH_SW_BswMIf_ptrpAsrBswMServicesBswMIf_BswM_OnEnableTxPdu, ARCH_SW_BswMIf_ptrpAsrOsServicesBswMIf_BswMIf_runMainFunction, ARCH_SW_BswMIf_ptrpAsrBswMServicesBswMIf_BswM_OnDisableTxPdu");
  AddRequirementInfo("ARCH_SW_BswMIf_ptrpAsrBswMServicesBswMIf_BswM_OnEnableTxPdu", "The BswM_OnEnableTxPdu runnable shall be called by the Autosar BswM in case of: - Bus communication is available {reception aknowledge is received}");
  AddRequirementInfo("ARCH_SW_BswMIf_ptrpAsrOsServicesBswMIf_BswMIf_runMainFunction", "The BswMIf_runMainFunction runnable shall be called when the Os task {OsTask_Alv_Autotests} is executed");
  AddRequirementInfo("ARCH_SW_BswMIf_ptrpAsrBswMServicesBswMIf_BswM_OnDisableTxPdu", " The BswM_OnDisableTxPdu runnable shall be called by the Autosar BswM in case of: - Current state of ECU is RUN AND Bus communication timeout is received");
//***************************************************************************************
  
  testCaseComment("Preconditions");
  testStep("STEP", "Bench Initialization"); // If the first parameter of testStep() is "Step", the arguments will be written in the specification file and "Step" argument will be numbered by 1 for each iteration.
  RunPreTs();
//   /*------------------------- Test scenario start ------------------------------*/
   testCaseComment("Action: ARCH_SW_BswMIf_ptrpAsrBswMServicesBswMIf_BswM_OnEnableTxPdu"); 
  debugger_setRelativeFunctionBpAtLine("BswM_Action_BswMAction_ComM_EnableTxPduConfirmation", "2");
  testStep("", "Reset the debugger.");
   debugger_reset();
  testStep("", "Run the debugger.");
  debugger_run();
  
  testStep("STEP", "Enable comunication --> Comunication enable");
   TestSetMsgEvent(Airbag_01);
  TestSetMsgEvent(Airbag_02);
  TestSetMsgEvent(Airbag_eCS_01);
   TestWaitForTimeout(3000);
  
  debugger_waitUntilBPisReached("2000");
   testStep("STEP", "Set a BP in function BswM_Action_BswMAction_ComM_EnableTxPduConfirmation in order to call BswM_OnEnableTxPdu function --> BP was set");
  ExpectedTestResult(debugger_result, W8_UNTIL_BP_SUCCESSFUL, "Breakpoint is reached");
  
  debugger_setRelativeFunctionBpAtLine("BswM_OnEnableTxPdu", "4");
   testStep("", "Run the debugger.");
  debugger_run();
   testStep("STEP", "Set a BP in function BswM_OnEnableTxPdu in order to check if Bus communication is available {reception aknowledge is received} --> BP was set");
  debugger_waitUntilBPisReached("2000");
  ExpectedTestResult(debugger_result, W8_UNTIL_BP_SUCCESSFUL, "Breakpoint is reached");
  
  debugger_setRelativeFunctionBpAtLine("BswM_Action_BswMAction_ComM_EnableTxPduConfirmation", "4");
   testStep("", "Run the debugger.");
  debugger_run();
  testStep("STEP", "Set a BP in function BswM_Action_BswMAction_ComM_EnableTxPduConfirmation in order to check the interface --> BP was set");
  debugger_waitUntilBPisReached("2000");
  ExpectedTestResult(debugger_result, W8_UNTIL_BP_SUCCESSFUL, "Breakpoint is reached");
  
  testCaseComment("Action: ARCH_SW_BswMIf_ptrpAsrOsServicesBswMIf_BswMIf_runMainFunction"); 
   debugger_deleteAllBreakpoints();
  debugger_setBpAtLine("C:\\Projects\\eCS_R1.2\\Components\\Application\\Supplier\\Tresos_Configuration_8.5.1\\Workspace\\Application\\Tresos_BSW_generated\\src\\Rte.c", "5212");
  testStep("", "Reset the debugger.");
   debugger_reset();
  testStep("", "Run the debugger.");
   debugger_run();
  debugger_waitUntilBPisReached("2000");
   testStep("STEP", "Set a BP in OsTask_Alv_Autotests in order to call BswMIf_runMainFunction function --> BP was set");
  ExpectedTestResult(debugger_result, W8_UNTIL_BP_SUCCESSFUL, "Breakpoint is reached");
  
  debugger_setRelativeFunctionBpAtLine("BswMIf_runMainFunction", "0");
   testStep("", "Run the debugger.");
  debugger_run();
   testStep("STEP", "Set a BP in function BswMIf_runMainFunction in order to check if Os task {OsTask_Alv_Autotests} was executed --> BP was set");
  debugger_waitUntilBPisReached("2000");
  ExpectedTestResult(debugger_result, W8_UNTIL_BP_SUCCESSFUL, "Breakpoint is reached");
  
  debugger_setBpAtLine("c:\\Projects\\eCS_R1.2\\Components\\Application\\Supplier\\Tresos_Configuration_8.5.1\\Workspace\\Application\\Tresos_BSW_generated\\src\\Rte.c", "5213");
   testStep("", "Run the debugger.");
  debugger_run();
   testStep("STEP", "Set a BP in OsTask_Alv_Autotests in order to check the interface --> BP was set");
  debugger_waitUntilBPisReached("2000");
   ExpectedTestResult(debugger_result, W8_UNTIL_BP_SUCCESSFUL, "Breakpoint is reached");
  
  testCaseComment("Action: ARCH_SW_BswMIf_ptrpAsrBswMServicesBswMIf_BswM_OnDisableTxPdu");
   debugger_deleteAllBreakpoints();
  debugger_setRelativeFunctionBpAtLine("BswM_Action_BswMAction_ComM_DisableTxPduConfirmation", "2");
   testStep("", "Reset the debugger.");
  debugger_reset(); 
  testStep("", "Run the debugger.");
  debugger_run();
    
  testStep("STEP", "Disable comunication --> Comunication disable");
  TestDisableMsg(Airbag_01);
  TestDisableMsg(Airbag_02);
  TestDisableMsg(Airbag_eCS_01);
  TestWaitForTimeout(5000);
  testStep("STEP", "Set a BP in function BswM_Action_BswMAction_ComM_DisableTxPduConfirmation in order call BswM_OnDisableTxPdu function --> BP was set");
  debugger_waitUntilBPisReached("2000");
  ExpectedTestResult(debugger_result, W8_UNTIL_BP_SUCCESSFUL, "Breakpoint is reached");
  
  debugger_setRelativeFunctionBpAtLine("BswM_OnDisableTxPdu", "4");
   testStep("", "Run the debugger.");
  debugger_run();
   testStep("STEP", "Set a BP in function BswM_OnDisableTxPdu in order to check Bus if Current state of ECU is RUN AND Bus communication timeout was received --> BP was set");
  debugger_waitUntilBPisReached("2000");
  ExpectedTestResult(debugger_result, W8_UNTIL_BP_SUCCESSFUL, "Breakpoint is reached");
  
  debugger_setRelativeFunctionBpAtLine("BswM_Action_BswMAction_ComM_DisableTxPduConfirmation", "4");
   testStep("", "Run the debugger.");
  debugger_run();
  TestWaitForTimeout(5000);
  testStep("STEP", "Set a BP in function BswM_Action_BswMAction_ComM_DisableTxPduConfirmation in order to check the interface --> BP was set");
  debugger_waitUntilBPisReached("2000");
  ExpectedTestResult(debugger_result, W8_UNTIL_BP_SUCCESSFUL, "Breakpoint is reached");

  //====================================================
  testCaseComment("Postcondition");
  testStep("STEP", "Return ECU to default values");
  RunPostTs();
}
testcase Sw_Int_BswMIf_ptrpAsrBswMServicesBswMIf_17()
{
   /*-------------------------Test specific report info------------------------------*/
  
  testReportAddMiscInfoBlock("AUTOLIV ELECTRONICS document");
  TestReportAddMiscInfo("Nightly test", "No");
  TestReportAddMiscInfo("Test type", "Requirement-Based");
  TestReportAddMiscInfo("Regression Test", "No");
  TestReportAddMiscInfo("Fault injection method used", "No");
  TestReportAddMiscInfo("Resource usage evaluation", "No");
  TestReportAddMiscInfo("Priority", "No");
  TestReportAddMiscInfo("Safety relevant", "No");
  
  AddRequirementInfo("Requirement under test", "ARCH_SW_BswMIf_ptrpAsrBswMServicesBswMIf_BswM_OnWakeupExpired");
  AddRequirementInfo("ARCH_SW_BswMIf_ptrpAsrBswMServicesBswMIf_BswM_OnWakeupExpired", "The BswM_OnWakeupExpired runnable shall be called by the Autosar BswM in case of: - wakeup validation expired and wakeup status expired after 5000ms");
//***************************************************************************************
  
  testCaseComment("Preconditions");
  testStep("STEP", "Bench Initialization"); // If the first parameter of testStep() is "Step", the arguments will be written in the specification file and "Step" argument will be numbered by 1 for each iteration.
  RunPreTs();
//   /*------------------------- Test scenario start ------------------------------*/
testCaseComment("Action: ARCH_SW_BswMIf_ptrpAsrBswMServicesBswMIf_BswM_OnWakeupExpired");
  
   debugger_setRelativeFunctionBpAtLine("BswM_Action_BswMAction_OnWakeupExpired", "2");
  testStep("", "Reset the debugger.");
   debugger_reset();
  testStep("", "Run the debugger.");
  debugger_run();
  
   testStep("STEP", "Send diagnostic request in order to do ProcessMode Start ");
  SendDiagnosticRequestNegativeResponse(dProcessMode_StartRequest, dProcessMode_StartResponse, TRUE);
    
  testStep("STEP", "Send diagnostic request in order to do soft Reset");
   SendDiagnosticRequest(dSoftResetRequest, dSoftResetResponse);
  
  debugger_waitUntilBPisReached("1000");
   testStep("STEP", "Set a BP in function BswM_Action_BswMAction_OnWakeupExpired in order to call BswM_RequestMode function --> BP was set");
  ExpectedTestResult(debugger_result, W8_UNTIL_BP_SUCCESSFUL, "Breakpoint is reached");
    
  debugger_setRelativeFunctionBpAtLine("BswM_OnWakeupExpired", "2");
   testStep("", "Run the debugger.");
  debugger_run();
   testStep("STEP", "Set a BP in function BswM_OnWakeupExpired in order to check if wakeup validation expired and wakeup status expired after 5000ms --> BP was set");
  debugger_waitUntilBPisReached("2000");
  ExpectedTestResult(debugger_result, W8_UNTIL_BP_SUCCESSFUL, "Breakpoint is reached");
   
  //====================================================
  testCaseComment("Postcondition");
  testStep("STEP", "Return ECU to default values");
  RunPostTs();
}
testcase Sw_Int_BswMIf_ptrpIoHwAbServicesBswMIf_01()
{
   /*-------------------------Test specific report info------------------------------*/
  
  testReportAddMiscInfoBlock("AUTOLIV ELECTRONICS document");
  TestReportAddMiscInfo("Nightly test", "No");
  TestReportAddMiscInfo("Test type", "Requirement-Based");
  TestReportAddMiscInfo("Regression Test", "No");
  TestReportAddMiscInfo("Fault injection method used", "No");
  TestReportAddMiscInfo("Resource usage evaluation", "No");
  TestReportAddMiscInfo("Priority", "No");
  TestReportAddMiscInfo("Safety relevant", "No");
  
  AddRequirementInfo("Requirement under test", "ARCH_SW_BswMIf_ptrpIoHwAbServicesBswMIf_BswM_UpdatePassangerOccupancyStatus");
  AddRequirementInfo("ARCH_SW_BswMIf_ptrpIoHwAbServicesBswMIf_BswM_UpdatePassangerOccupancyStatus", "The BswM_UpdatePassangerOccupancyStatus runnable shall be called when valid transition of buckle/SBS sensor is detected in IoHwAb_DetectSeatOccupancy runnable.");
//***************************************************************************************
  
  testCaseComment("Preconditions");
  testStep("STEP", "Bench Initialization"); // If the first parameter of testStep() is "Step", the arguments will be written in the specification file and "Step" argument will be numbered by 1 for each iteration.
  RunPreTs();
//   /*------------------------- Test scenario start ------------------------------*/
   testCaseComment("Action: ARCH_SW_BswMIf_ptrpIoHwAbServicesBswMIf_BswM_UpdatePassangerOccupancyStatus");  
  teststep("STEP", "Set a breakpoint in function IoHwAb_DetectSeatOccupancy in order to change value of Wake Sense Prev State");
  debugger_setRelativeFunctionBpAtLine("IoHwAb_DetectSeatOccupancy", "37");
  testStep("", "Reset the debugger.");
  debugger_reset(); 
  testStep("", "Run the debugger.");
  debugger_run();
  debugger_waitUntilBPisReached("2000");
  ExpectedTestResult(debugger_result, W8_UNTIL_BP_SUCCESSFUL, "Breakpoint is reached");
  
  testStep("STEP", "Change value for Wake Sense Prev State in order to past condition--> Succesfully changed");
   debugger_writeVariable("uint8","iohwab_au8WakeSensePrevState", "0", "0");
  TestWaitForTimeout(2000);
  
  teststep("STEP", "Set a breakpoint in function IoHwAb_DetectSeatOccupancy in order to call BswM_UpdatePassangerOccupancyStatus function");
  debugger_setRelativeFunctionBpAtLine("IoHwAb_DetectSeatOccupancy", "40");
  testStep("", "Run the debugger.");
  debugger_run();
  debugger_waitUntilBPisReached("2000");
    
  teststep("STEP", "Set a breakpoint in function BswM_UpdatePassangerOccupancyStatus in order to to set the status of PassangerOccupancy state");
  debugger_setRelativeFunctionBpAtLine("BswM_UpdatePassangerOccupancyStatus", "0");
  testStep("", "Run the debugger.");
  debugger_run();
  debugger_waitUntilBPisReached("2000");

  //====================================================
  testCaseComment("Postcondition");
  testStep("STEP", "Return ECU to default values");
  RunPostTs();
}
testcase Sw_Int_BswMIf_ptrpAsrBswMServicesBswMIf_18()
{
   /*-------------------------Test specific report info------------------------------*/
  
  testReportAddMiscInfoBlock("AUTOLIV ELECTRONICS document");
  TestReportAddMiscInfo("Nightly test", "No");
  TestReportAddMiscInfo("Test type", "Requirement-Based");
  TestReportAddMiscInfo("Regression Test", "No");
  TestReportAddMiscInfo("Fault injection method used", "No");
  TestReportAddMiscInfo("Resource usage evaluation", "No");
  TestReportAddMiscInfo("Priority", "No");
  TestReportAddMiscInfo("Safety relevant", "No");
  
  AddRequirementInfo("Requirement under test", "ARCH_SW_BswMIf_ptrpAsrBswMServicesBswMIf_BswM_OnPostRunFromRun");
  AddRequirementInfo("ARCH_SW_BswMIf_ptrpAsrBswMServicesBswMIf_BswM_OnPostRunFromRun", "The BswM_OnPostRunFromRun runnable shall be called by the Autosar BswM in case of: - The current state of ECU is RUN AND Bus communication timeout is received");
//***************************************************************************************
  
  testCaseComment("Preconditions");
  testStep("STEP", "Bench Initialization"); // If the first parameter of testStep() is "Step", the arguments will be written in the specification file and "Step" argument will be numbered by 1 for each iteration.
  RunPreTs();
//   /*------------------------- Test scenario start ------------------------------*/
   testCaseComment("Action: ARCH_SW_BswMIf_ptrpAsrBswMServicesBswMIf_BswM_OnPostRunFromRun");
  testStep("STEP", "Enable comunication --> Comunication enable");
   TestSetMsgEvent(Airbag_01);
  TestSetMsgEvent(Airbag_02);
  TestSetMsgEvent(Airbag_eCS_01);
   TestWaitForTimeout(5000);
  
    debugger_setRelativeFunctionBpAtLine("BswM_Action_BswMAction_BswM_PostRunStateFromRun", "2");
   testStep("", "Reset the debugger.");
  debugger_reset();
   testStep("", "Run the debugger.");
  debugger_run();
    
  testStep("STEP", "Disable comunication --> Comunication disable");
  TestDisableMsg(Airbag_01);
  TestDisableMsg(Airbag_02);
  TestDisableMsg(Airbag_eCS_01);
  TestWaitForTimeout(5000);
  testStep("STEP", "Set a BP in function BswM_Action_BswMAction_BswM_PostRunStateFromRun in order to call BswM_OnPostRunFromRun function --> BP was set");
  debugger_waitUntilBPisReached("2000");
  ExpectedTestResult(debugger_result, W8_UNTIL_BP_SUCCESSFUL, "Breakpoint is reached");
  
  debugger_setRelativeFunctionBpAtLine("BswM_OnPostRunFromRun", "4");
   testStep("", "Run the debugger.");
  debugger_run();
   testStep("STEP", "Set a BP in function BswM_OnPostRunFromRun in order to check if The current state of ECU is RUN AND Bus communication timeout was received --> BP was set");
  debugger_waitUntilBPisReached("2000");
  ExpectedTestResult(debugger_result, W8_UNTIL_BP_SUCCESSFUL, "Breakpoint is reached");

  debugger_setRelativeFunctionBpAtLine("BswM_Action_BswMAction_BswM_PostRunStateFromRun", "4");
   testStep("", "Run the debugger.");
  debugger_run();
  testStep("STEP", "Set a BP in function BswM_Action_BswMAction_BswM_PostRunStateFromRun in order to check the interface --> BP was set");
  debugger_waitUntilBPisReached("2000");
  ExpectedTestResult(debugger_result, W8_UNTIL_BP_SUCCESSFUL, "Breakpoint is reached");
  
  //====================================================
  testCaseComment("Postcondition");
  testStep("STEP", "Return ECU to default values");
  RunPostTs();
}
testcase Sw_Int_BswMIf_psrFsmSolenoidReqBswMIf_01()
{
   /*-------------------------Test specific report info------------------------------*/
  
  testReportAddMiscInfoBlock("AUTOLIV ELECTRONICS document");
  TestReportAddMiscInfo("Nightly test", "No");
  TestReportAddMiscInfo("Test type", "Requirement-Based");
  TestReportAddMiscInfo("Regression Test", "No");
  TestReportAddMiscInfo("Fault injection method used", "No");
  TestReportAddMiscInfo("Resource usage evaluation", "No");
  TestReportAddMiscInfo("Priority", "No");
  TestReportAddMiscInfo("Safety relevant", "No");
  
  AddRequirementInfo("Requirement under test", "ARCH_SW_BswMIf_psrFsmSolenoidReqBswMIf_BswM_OnSafeStateFromPostRun");
  AddRequirementInfo("ARCH_SW_BswMIf_psrFsmSolenoidReqBswMIf_BswM_OnSafeStateFromPostRun", "The runnable shall write the interface in order to trigger an unlock/lock for a certain solenoid");
   //***************************************************************************************
  testCaseComment("Preconditions");
  testStep("STEP", "Bench Initialization"); // If the first parameter of testStep() is "Step", the arguments will be written in the specification file and "Step" argument will be numbered by 1 for each iteration.
  RunPreTs();
//   /*------------------------- Test scenario start ------------------------------*/
  
   testCaseComment("Action: ARCH_SW_BswMIf_psrFsmSolenoidReqBswMIf_BswM_OnSafeStateFromPostRun");
  testStep("STEP", "Enable comunication --> Comunication enable");
   TestSetMsgEvent(Airbag_01);
  TestSetMsgEvent(Airbag_02);
  TestSetMsgEvent(Airbag_eCS_01);
   TestWaitForTimeout(11000);
  
  debugger_setRelativeFunctionBpAtLine("BswM_Cyclic_10msTimer", "5");
  testStep("", "Reset the debugger.");
   debugger_reset();
   testStep("", "Run the debugger."); 
  debugger_run();
    
  testStep("STEP", "Disable comunication --> Comunication disable");
  TestDisableMsg(Airbag_01);
  TestDisableMsg(Airbag_02);
  TestDisableMsg(Airbag_eCS_01);
  TestWaitForTimeout(5000);
  testStep("STEP", "Set a BP in function BswM_Cyclic_10msTimer in order to go in  BswM_OnLowPwrFromPostRun function --> BP was set");
  debugger_waitUntilBPisReached("2000");
  ExpectedTestResult(debugger_result, W8_UNTIL_BP_SUCCESSFUL, "Breakpoint is reached");
  debugger_deleteAllBreakpoints();
  
  debugger_writeVariable("uint8","bswmif_u16TPostRunTimer,,app.elf", "1", "17EC");
  TestWaitForTimeout(2000);
   
  debugger_setRelativeFunctionBpAtLine("BswM_Action_BswMAction_BswM_OnSafeStateFromPostRun", "2");
   testStep("", "Run the debugger.");
  debugger_run();
   testStep("STEP", "Set a BP in function BswM_Action_BswMAction_BswM_OnSafeStateFromPostRun in order to call BswM_OnSafeStateFromPostRun  function --> BP was set");
  debugger_waitUntilBPisReached("2000");
  ExpectedTestResult(debugger_result, W8_UNTIL_BP_SUCCESSFUL, "Breakpoint is reached");

  debugger_setRelativeFunctionBpAtLine("BswM_OnSafeStateFromPostRun ", "6");
   testStep("", "Run the debugger.");
  debugger_run();
   testStep("STEP", "Set a BP in function BswM_OnSafeStateFromPostRun  in order to write the interface in order to trigger an unlock/lock for a certain solenoid --> BP was set");
  debugger_waitUntilBPisReached("2000");
  ExpectedTestResult(debugger_result, W8_UNTIL_BP_SUCCESSFUL, "Breakpoint is reached");

   debugger_setRelativeFunctionBpAtLine("Rte_Write_BswMIf_psrFsmSolenoidReqBswMIf_ab8DiagReq", "12");
   testStep("", "Run the debugger.");
  debugger_run();
   testStep("STEP", "Set a BP in function Rte_Write_BswMIf_psrFsmSolenoidReqBswMIf_ab8DiagReq for check the interface --> BP was set");
  debugger_waitUntilBPisReached("2000");
   ExpectedTestResult(debugger_result, W8_UNTIL_BP_SUCCESSFUL, "Breakpoint is reached");
  debugger_deleteAllBreakpoints();
 
  //====================================================
  testCaseComment("Postcondition");
  testStep("STEP", "Return ECU to default values");
  RunPostTs();
}

void MainTest()
{
  InitTestModule();
//  Sw_Int_BswMIf_ptrrAsrNvMServicesBswMIf_01();
//  Sw_Int_BswMIf_ptrrAsrNvMServicesBswMIf_02();
//  Sw_Int_BswMIf_ptrrAsrOsServicesBswMIf_01();
//  Sw_Int_BswMIf_ptrrAsrOsServicesBswMIf_02();
//  Sw_Int_BswMIf_ptrrAsrPduRServicesBswMIf_01();
//  Sw_Int_BswMIf_ptrrAsrRteServicesBswMIf_01();
//  Sw_Int_BswMIf_ptrrAtmServicesBswMIf_01();
//  Sw_Int_BswMIf_ptrrCilServicesBswMIf_01();
//  Sw_Int_BswMIf_ptrrDiaServicesBswMIf_01();
//  Sw_Int_BswMIf_ptrrFsmServicesBswMIf_01();
//  Sw_Int_BswMIf_ptrrSadServicesBswMIf_01();
//  Sw_Int_BswMIf_ptrrRcmServicesBswMIf_01();
//  Sw_Int_BswMIf_ptrrLpmServicesBswMIf_01();
//  Sw_Int_BswMIf_ptrrLpmServicesBswMIf_02();
//  Sw_Int_BswMIf_ptrrAsrFlsServicesBswMIf_01();
//  Sw_Int_BswMIf_ptrrAsrFeeServicesBswMIf_01();
//  Sw_Int_BswMIf_ptrrAsrEcuMServicesBswMIf_01();
//  Sw_Int_BswMIf_ptrrAsrDemServicesBswMIf_01();
//  Sw_Int_BswMIf_ptrrAsrDcmServicesBswMIf_01();
//  Sw_Int_BswMIf_ptrrAsrComServicesBswMIf_01();
//  Sw_Int_BswMIf_ptrrAsrComMServicesBswMIf_01();
//  Sw_Int_BswMIf_ptrrAsrCanTpServicesBswMIf_01();
//  Sw_Int_BswMIf_ptrrAsrCanServicesBswMIf_01();
//  Sw_Int_BswMIf_ptrrAsrCanSMServicesBswMIf_01();
//  Sw_Int_BswMIf_ptrrAsrCanIfServicesBswMIf_01();
//  Sw_Int_BswMIf_ptrrAsrBswMServicesBswMIf_01();
//  Sw_Int_BswMIf_ptrrAsrBswMServicesBswMIf_02();
//  Sw_Int_BswMIf_ptrrAsrBswMServicesBswMIf_03();
//  Sw_Int_BswMIf_ptrrAsrBswMServicesBswMIf_04();
//  Sw_Int_BswMIf_ptrrAsrBswMServicesBswMIf_05();
//  Sw_Int_BswMIf_ptrrAdcIfServicesBswMIf_01();
//  Sw_Int_BswMIf_ptrrAdcIfServicesBswMIf_02();
//  Sw_Int_BswMIf_ptrpAsrNvMServicesBswMIf_01();
//  Sw_Int_BswMIf_ptrpAsrGptServicesBswMIf_01();
//  Sw_Int_BswMIf_ptrrAsrGptServicesBswMIf_01();
//  Sw_Int_BswMIf_ptrrAsrGptServicesBswMIf_02();
//  Sw_Int_BswMIf_ptrrAsrGptServicesBswMIf_03();
//  Sw_Int_BswMIf_ptrrAsrGptServicesBswMIf_04();
//  Sw_Int_BswMIf_pseEcuStateTransitions_01();
//  Sw_Int_BswMIf_psePassengerOccupancyState_01(); 
//  Sw_Int_BswMIf_ptrpAsrBswMServicesBswMIf_01();
//  Sw_Int_BswMIf_ptrpAsrBswMServicesBswMIf_02();
//  Sw_Int_BswMIf_ptrpAsrBswMServicesBswMIf_03();
//  Sw_Int_BswMIf_ptrpAsrBswMServicesBswMIf_04();
//  Sw_Int_BswMIf_ptrpAsrBswMServicesBswMIf_05();
//  Sw_Int_BswMIf_ptrpAsrBswMServicesBswMIf_06();
//  Sw_Int_BswMIf_ptrpAsrBswMServicesBswMIf_07();
//  Sw_Int_BswMIf_ptrpAsrBswMServicesBswMIf_08();
//  Sw_Int_BswMIf_ptrpAsrBswMServicesBswMIf_09();
//  Sw_Int_BswMIf_ptrpAsrBswMServicesBswMIf_10();
//  Sw_Int_BswMIf_ptrpAsrBswMServicesBswMIf_11();
//  Sw_Int_BswMIf_ptrpAsrBswMServicesBswMIf_12();
//  Sw_Int_BswMIf_ptrpAsrBswMServicesBswMIf_13();
//  Sw_Int_BswMIf_ptrpAsrBswMServicesBswMIf_14();
//  Sw_Int_BswMIf_ptrpAsrBswMServicesBswMIf_15();
//  Sw_Int_BswMIf_ptrpAsrBswMServicesBswMIf_16(); 
//  Sw_Int_BswMIf_ptrpAsrBswMServicesBswMIf_17();
//  Sw_Int_BswMIf_ptrpIoHwAbServicesBswMIf_01();
//  Sw_Int_BswMIf_ptrpAsrBswMServicesBswMIf_18();
  Sw_Int_BswMIf_psrFsmSolenoidReqBswMIf_01();       //asta nu e ok req va fi refacut pe r2.0
}