/*@!Encoding:1252*/
/*------------------------------------------------------------------------------
                                IMPORT LIBRARY
 ------------------------------------------------------------------------------*/
/* To include all the libraries used by the .capl script. */
/* WARNING: Some things such as diagnostic functions are different from project
to project, change those according to your project requirements */
includes
{
  #include "S:\\Tools\\CANoe\\Config\\ECS_AUDI_INT\\Includes\\Debugger_Defines.cin"
  #include "S:\\Tools\\CANoe\\Config\\ECS_AUDI_INT\\Includes\\Debugger_Functions.cin"
  #include "S:\\Tools\\CANoe\\Config\\ECS_AUDI_INT\\Includes\\Project_Functions.cin"
  #include "S:\\Tools\\CANoe\\Config\\ECS_AUDI_INT\\Includes\\Diagnostic_Functions.cin"
}

/*------------------------------------------------------------------------------
                                    GLOBALS
 ------------------------------------------------------------------------------*/
/* To declare the constants used throurough the entire module, and global variables */
variables
{

/*----------------------------Global Variables---------------------------------*/
  float sEcs_HW_defekt;
 
}


/*------------------------------------------------------------------------------
                                TEST FUNCTIONS
------------------------------------------------------------------------------*/
/*------------------------- Test Preconditions ------------------------------*/
/* For operations to ensure the correct execution of the test case, such as IGN_ON,
checking that CAN communication is present, etc.
/* Varies from module to module, use from Helper_Functions.cin only the ones you need */
testfunction RunPreTs()
{
  DisplayRequirementsInfo();
  AddTestSetupInformation();
  
  PreTS_StartLogging();
  
  testCaseComment("Preconditions");
  testStep("STEP", "Bench Initialization");
  
  testStep("", "Delete all breakpoint from debugger.");
  debugger_deleteAllBreakpoints();
  
  testStep("", "Reset the debugger.");
  debugger_reset();
  
  testStep("", "Run the debugger.");
  debugger_run();
}

/*------------------------- Test Postconditions ------------------------------*/
/* For operations to ensure that after the test case was executed, the enviroment
would go back to a blank state, to be ready for the next test step in queue. Call it a Cleanup phase. */
testfunction RunPostTs()
{
  stopLogging("TestCaseLogASC");
  stopLogging("TestCaseLogBLF");
}

testcase InitTestModule()
{
  ConfigureTestModuleInformation();
  strncpy(cLogPathAndName, "S:\\Tools\\CANoe\\Config\\ECS_AUDI_INT\\Logs\\",  elcount(cLogPathAndName));
}

/*------------------------------------------------------------------------------
                                TEST EXECUTION
------------------------------------------------------------------------------*/
testcase Sw_Int_SAD_pseCheckSolenoidOpenCircuit_01()
{
   /*-------------------------Test specific report info------------------------------*/
  
  testReportAddMiscInfoBlock("AUTOLIV ELECTRONICS document");
  TestReportAddMiscInfo("Nightly test", "No");
  TestReportAddMiscInfo("Test type", "Requirement-Based");
  TestReportAddMiscInfo("Regression Test", "No");
  TestReportAddMiscInfo("Fault injection method used", "No");
  TestReportAddMiscInfo("Resource usage evaluation", "No");
  TestReportAddMiscInfo("Priority", "No");
  TestReportAddMiscInfo("Safety relevant", "No");
  
  AddRequirementInfo("Requirement under test", "ARCH_SW_SAD_pseCheckSolenoidOpenCircuit_SAD_CheckSolenoidOpenCircuitAutotest");
  AddRequirementInfo("ARCH_SW_SAD_pseCheckSolenoidOpenCircuit_SAD_CheckSolenoidOpenCircuitAutotest", "The auto-test shall detect for all conected and configured solenoids if they are electrically conected. - In order to detect an open-circuit hardware fault, all measurements on solenoid ADC lines shall be done with unlock profile or diagnostic profile active. - If the measured solenoid voltage is in range between +20% of NVP_u16OpenCircuitUnlockProfThrs and -20% of NVP_u16OpenCircuitUnlockProfThrs when unlock profile is active, than autotest shall return OK. - If the measured solenoid voltage is not in range between +20% of NVP_u16OpenCircuitUnlockProfThrs and -20% of NVP_u16OpenCircuitUnlockProfThrs when unlock profile is active, than autotest shall return NOK. - If the measured solenoid voltage is in range between +20% of {NVP_u16OpenCircuitDiagProfThrs} and -20% of {NVP_u16OpenCircuitDiagProfThrs} when diagnostic profile is active, than autotest shall return OK. - If the measured solenoid voltage is not in range between +20% of {NVP_u16OpenCircuitDiagProfThrs} and -20% of {NVP_u16OpenCircuitDiagProfThrs} when diagnostic profile is active, than autotest shall NOK. - If unlock profile or diagnostic profile is not active, than autotest shall return last valid autotest result.");
//***************************************************************************************
  
  testCaseComment("Preconditions");
  testStep("STEP", "Bench Initialization"); // If the first parameter of testStep() is "Step", the arguments will be written in the specification file and "Step" argument will be numbered by 1 for each iteration.
  RunPreTs();
//   /*------------------------- Test scenario start ------------------------------*/
  testCaseComment("Action: ARCH_SW_SAD_pseCheckSolenoidOpenCircuit_SAD_CheckSolenoidOpenCircuitAutotest");
  // If a profile is currently running, measured solenoid voltage is not in range 
  testStep("STEP", "Set a BP in function SAD_CheckSolenoidOpenCircuitAutotest in order to call sad_CheckSolenoidOpenCircuitAutotest function --> BP was set");
   debugger_setRelativeFunctionBpAtLine("SAD_CheckSolenoidOpenCircuitAutotest", "28");
  testStep("", "Reset the debugger.");
   debugger_reset();
  testStep("", "Run the debugger.");
  debugger_run();

  testStep("STEP", "Send diagnostic request in order to go in Supplier Session");
   SendDiagnosticRequestNegativeResponse(dSupplierSessionRequest, dSupplierSessionResponse, TRUE);
  TestWaitForTimeout(100);
  
  testStep("STEP", "Send request for press Supplier Security Access button");
   @Platform::DIAG_Security_Control_Update = 1;
  TestWaitForTimeout(500);
  
  testStep("STEP", "Send request for press ECUUnlock button");
   @Platform::DIAG_ECUUnlock = 1;
  TestWaitForTimeout(500);
  
   debugger_waitUntilBPisReached("2000");
  ExpectedTestResult(debugger_result, W8_UNTIL_BP_SUCCESSFUL, "Breakpoint is reached");
  
  testStep("STEP", "Set a BP in function sad_CheckSolenoidOpenCircuitAutotest in order to check if Solenoid is in open circuit and read the auto test result--> BP was set");
  debugger_setBpAtLine("c:\\Projects\\eCS_R1.2\\Components\\Application\\Autoliv\\SAD\\Implementation\\src\\SAD_autotests.c", "270");
//  debugger_setRelativeFunctionBpAtLine("sad_CheckSolenoidOpenCircuitAutotest", "76");
   testStep("", "Run the debugger.");
  debugger_run();
   debugger_waitUntilBPisReached("2000");
  ExpectedTestResult(debugger_result, W8_UNTIL_BP_SUCCESSFUL, "Breakpoint is reached");
 
  testStep("STEP", "Set a BP in function SAD_CheckSolenoidOpenCircuitAutotest in order to check if auto test result is not ok--> BP was set");
  debugger_setRelativeFunctionBpAtLine("SAD_CheckSolenoidOpenCircuitAutotest", "69");
   testStep("", "Run the debugger.");
  debugger_run();
  debugger_run();
   debugger_waitUntilBPisReached("2000");
  ExpectedTestResult(debugger_result, W8_UNTIL_BP_SUCCESSFUL, "Breakpoint is reached");
  
  testStep("STEP", "Read Result of Test value  --> Result Of Test succesfully read");
  debugger_readLocalVariable("*pu8TestResult");
  ExpectedTestResult(debugger_result, "0x2", "Local variable *pu8TestResult is equal to 0x2");
  
  //====================================================
  testCaseComment("Postcondition");
  testStep("STEP", "Return ECU to default values");
  RunPostTs();
}
testcase Sw_Int_SAD_pseCheckSolenoidShortToGND_01()
{
   /*-------------------------Test specific report info------------------------------*/
  
  testReportAddMiscInfoBlock("AUTOLIV ELECTRONICS document");
  TestReportAddMiscInfo("Nightly test", "No");
  TestReportAddMiscInfo("Test type", "Requirement-Based");
  TestReportAddMiscInfo("Regression Test", "No");
  TestReportAddMiscInfo("Fault injection method used", "No");
  TestReportAddMiscInfo("Resource usage evaluation", "No");
  TestReportAddMiscInfo("Priority", "No");
  TestReportAddMiscInfo("Safety relevant", "No");
  
  AddRequirementInfo("Requirement under test", "ARCH_SW_SAD_pseCheckSolenoidShortToGND_SAD_CheckSolenoidShortToGNDAutotest");
  AddRequirementInfo("ARCH_SW_SAD_pseCheckSolenoidShortToGND_SAD_CheckSolenoidShortToGNDAutotest", "The auto-test shall detect for all conected and configured solenoids if they have electrical . - In order to detect an open-circuit hardware fault, all measurements on solenoid ADC lines shall be done with unlock profile or diagnostic profile active. - If the measured solenoid voltage is different than NVP_u16ShortToGNDUnlockProfThrs when unlock profile is active, than autotest shall return OK. - If the measured solenoid voltage is equal to NVP_u16ShortToGNDUnlockProfThrs when unlock profile is active, than autotest shall return NOK. - If the measured solenoid voltage is different than NVP_u16ShortToGNDDiagProfThrs when diagnostic profile is active, than autotest shall return OK. - If the measured solenoid voltage is equal to NVP_u16ShortToGNDDiagProfThrs when diagnostic profile is active, than autotest shall return NOK. - If unlock profile or diagnostic profile is not active, than autotest shall return last valid autotest result.");
//***************************************************************************************
  
  testCaseComment("Preconditions");
  testStep("STEP", "Bench Initialization"); // If the first parameter of testStep() is "Step", the arguments will be written in the specification file and "Step" argument will be numbered by 1 for each iteration.
  RunPreTs();
//   /*------------------------- Test scenario start ------------------------------*/

  testCaseComment("Action: ARCH_SW_SAD_pseCheckSolenoidShortToGND_SAD_CheckSolenoidShortToGNDAutotest");
  // If a profile is currently running, measured solenoid voltage is not in range 
  testStep("STEP", "Set a BP in function SAD_CheckSolenoidShortToGNDAutotest in order to call sad_CheckSolenoidOpenCircuitAutotest function --> BP was set");
   debugger_setRelativeFunctionBpAtLine("SAD_CheckSolenoidShortToGNDAutotest", "30");
  testStep("", "Reset the debugger.");
   debugger_reset();
  testStep("", "Run the debugger.");
  debugger_run();

  testStep("STEP", "Send diagnostic request in order to go in Supplier Session");
   SendDiagnosticRequestNegativeResponse(dSupplierSessionRequest, dSupplierSessionResponse, TRUE);
  TestWaitForTimeout(100);
  
  testStep("STEP", "Send request for press Supplier Security Access button");
   @Platform::DIAG_Security_Control_Update = 1;
  TestWaitForTimeout(500);
  
  testStep("STEP", "Send request for press ECUUnlock button");
   @Platform::DIAG_ECUUnlock = 1;
  TestWaitForTimeout(500);
  
   debugger_waitUntilBPisReached("2000");
  ExpectedTestResult(debugger_result, W8_UNTIL_BP_SUCCESSFUL, "Breakpoint is reached");
  
  testStep("STEP", "Set a BP in function SAD_CheckSolenoidShortToGNDAutotest in order to check if auto test result is ok--> BP was set");
  debugger_setRelativeFunctionBpAtLine("SAD_CheckSolenoidShortToGNDAutotest", "55");
   testStep("", "Run the debugger.");
  debugger_run();
//  debugger_run();
   debugger_waitUntilBPisReached("2000");
  ExpectedTestResult(debugger_result, W8_UNTIL_BP_SUCCESSFUL, "Breakpoint is reached");
  
  testStep("STEP", "Read Result of Test value  --> Result Of Test succesfully read");
  debugger_readLocalVariable("*pu8TestResult");
  ExpectedTestResult(debugger_result, "0x2", "Local variable *pu8TestResult is equal to 0x2");
  //====================================================
  testCaseComment("Postcondition");
  testStep("STEP", "Return ECU to default values");
  RunPostTs();
}












void MainTest()
{
  InitTestModule();
//  Sw_Int_SAD_pseCheckSolenoidOpenCircuit_01();
  Sw_Int_SAD_pseCheckSolenoidShortToGND_01();
  
  
  
}