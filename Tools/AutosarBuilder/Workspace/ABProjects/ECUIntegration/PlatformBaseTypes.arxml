AUTOSAR XML (schema 4-2-2)
standard types defined: VOID, boolean, float32, float64, sint16, sint32, sint8, uint16, uint32, uint8
