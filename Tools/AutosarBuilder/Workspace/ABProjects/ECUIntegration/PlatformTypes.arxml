AUTOSAR XML (schema 4-2-2)
standard types defined: boolean, VOID, float32, float64, sint16, sint32, sint8, uint16, uint32, uint8
package /AUTOSAR_PlatformTypes/Documentations
  documentation SWS_PlatformTypes
package /AUTOSAR_PlatformTypes/SwAddrMethods
  sw addr method CODE: section-initialization-policy=INIT, section-type=CODE
  sw addr method VAR: section-initialization-policy=INIT, section-type=VAR
