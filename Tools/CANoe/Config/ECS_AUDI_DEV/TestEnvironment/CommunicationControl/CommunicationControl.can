/*@!Encoding:1252*/
includes
{
  
}

variables
{

}

void MainTest()
{
  if(@sysvar::PanelControl::enableAirbag_01 == 1)
  {
    TestEnableMsg(Airbag_01);
  }
  
  if(@sysvar::PanelControl::enableAirbag_02 == 1)
  {
    TestEnableMsg(Airbag_02);
  }
  
  if(@sysvar::PanelControl::enableAirbag_eCS_01 == 1)
  {
    TestEnableMsg(Airbag_eCS_01);
  }
  
  if(@sysvar::PanelControl::enableAirbag_01 == 0)
  {
    TestDisableMsg(Airbag_01);
  }
  
  if(@sysvar::PanelControl::enableAirbag_02 == 0)
  {
    TestDisableMsg(Airbag_02);
  }
  
  if(@sysvar::PanelControl::enableAirbag_eCS_01 == 0)
  {
    TestDisableMsg(Airbag_eCS_01);
  }
}
