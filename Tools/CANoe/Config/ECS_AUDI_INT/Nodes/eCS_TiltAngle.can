/*@!Encoding:1252*/
includes
{
 
}

variables
{
  diagRequest eCS.AccCalibStart_Start Req_AccCalibStart_Start;
  diagResponse eCS.AccCalibStart_Start Resp_AccCalibStart_Start;
  diagResponse eCS.DefaultSession_Start Resp_Default_Start;
  mstimer tWaitMSAccCalibStartStart;  
}
 
on preStart  
{
  @TiltAngle::sysLEDcontrol = sysvar::TiltAngle::sysLEDcontrol::`Off;
  setControlVisibility("Tilt Angle","LED_AccCalibOutput",1); 
}

on timer tWaitMSAccCalibStartStart
{  
  Req_AccCalibStart_Start.SendRequest();
  write("Req_AccCalibStart_Start was called"); 
  @Platform::DIAG_Security_Control_Update = 0;
}

on sysvar sysvar::TiltAngle::sysAccCalibStart
  
{
  if (@this == sysvar::TiltAngle::sysAccCalibStart::AccCalibStartButton)
    
  {    
   @Platform::DIAG_Security_Control == 97;    
   @Platform::DIAG_Security_Control_Update = 1;    
   setTimer(tWaitMSAccCalibStartStart, 500);  
  }
  
}


on diagResponse eCS.AccCalibStart_Start
  
{      
    diagGetLastResponse(Resp_AccCalibStart_Start); 
    if (diagIsPositiveResponse(Resp_AccCalibStart_Start) == 1)
  {
    @TiltAngle::sysLEDcontrol = sysvar::TiltAngle::sysLEDcontrol::`On;
    setControlVisibility("Tilt Angle","LED_AccCalibOutput",1);
  }
  
  else if ((diagGetResponseCode(Resp_AccCalibStart_Start) != 0x78))
  {
    @TiltAngle::sysLEDcontrol = sysvar::TiltAngle::sysLEDcontrol::Fail;
    setControlVisibility("Tilt Angle","LED_AccCalibOutput",1);
    Write("Unexpected NRC received !");    
  }
  
}

on message DevKit_01
  
{
  if (@TiltAngle::sysAutoupdate == sysvar::TiltAngle::sysAutoupdate::`On || @TiltAngle::sysAutoupdate == sysvar::TiltAngle::sysAutoupdate::SingleUpdate)
  {    
  float sigValZ;
  float sigValY;
  float sigValX;
    
  sigValZ = getSignal(TDK_4g_AZ);  
  sigValY = getSignal(TDK_4g_AY);  
  sigValX = getSignal(TDK_4g_AX);
  
  @sysvar::TiltAngle::sysX_AxisDisplay = (arctan(sigValX / (sqrt ((sigValY * sigValY) + (sigValZ * sigValZ))))) * (180/ 3.1415);
  
  @sysvar::TiltAngle::sysY_AxisDisplay = (arctan(sigValY / (sqrt ((sigValX * sigValX) + (sigValZ * sigValZ))))) * (180/ 3.1415);
    if (sigValZ == 0)
    {
      sigValZ = 1;
    }
  @sysvar::TiltAngle::sysZ_AxisDisplay = (arctan( (sqrt ((sigValX * sigValX) + (sigValY * sigValY))) / sigValZ   )) * (180/ 3.1415);
  }
  
  if(@TiltAngle::sysAutoupdate == sysvar::TiltAngle::sysAutoupdate::SingleUpdate)
  {
    @sysvar::TiltAngle::sysAutoupdate = 0;
  }

}
//Set target
on sysvar_update TiltDevice_Parameters::Button_SET_Target_C0
{ 
  if (@sysvar::TiltDevice_Parameters::Button_SET_Target_C0 == 1)
  {  
    /* Trigger testcase */
    @sysvar::TiltDevice_Parameters::tiltControlTrigger = 1;
    @sysvar::TiltDevice_Parameters::tiltControlStatus = 1;
  }
}

on sysvar_update TiltDevice_Parameters::Button_SET_Target_C1
{
  if (@sysvar::TiltDevice_Parameters::Button_SET_Target_C1 == 1)
  { 
    @sysvar::TiltDevice_Parameters::tiltControlTrigger = 1;
    @sysvar::TiltDevice_Parameters::tiltControlStatus = 2;
  }
}

//Set speed and acceleration
on sysvar_update TiltDevice_Parameters::Button_SET_Speed_C0
{ 
  if (@sysvar::TiltDevice_Parameters::Button_SET_Speed_C0 == 1)
  {  
    @sysvar::TiltDevice_Parameters::tiltControlTrigger = 1;
    @sysvar::TiltDevice_Parameters::tiltControlStatus = 3;
  }
}

on sysvar_update TiltDevice_Parameters::Button_SET_Speed_C1
{ 
  if (@sysvar::TiltDevice_Parameters::Button_SET_Speed_C1 == 1)
  {  
    @sysvar::TiltDevice_Parameters::tiltControlTrigger = 1;
    @sysvar::TiltDevice_Parameters::tiltControlStatus = 4;
  }
}

//clear console
on sysvar_update TiltDevice_Parameters::Button_Clear_Console
{
  if (@sysvar::TiltDevice_Parameters::Button_Clear_Console == 1)
  {    
  deleteControlContent("TiltDeviceControl","TiltOutput");
  }
}