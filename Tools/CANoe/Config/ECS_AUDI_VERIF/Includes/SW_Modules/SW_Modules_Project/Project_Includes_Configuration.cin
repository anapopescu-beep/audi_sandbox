/*@!Encoding:1252*/
includes
{
 // <<< CORE Software Modules >>>
  #include "Core_Functions_Configuration.cin"  
  #include "..\SW_Modules_Core\Core_Functions.cin"
  
  
 // <<< CORE Hardware Modules >>>
  #include "..\..\HW_Modules\PSM\PowerSupplyControl.cin"
  #include "..\..\HW_Modules\OSC\OSCILLOSCOPE_Control.cin"
  #include "..\..\HW_Modules\FIB\FIB_Control.cin"
  #include "..\..\HW_Modules\DMM\DMMControl.cin"
  #include "..\..\HW_Modules\TMP\ThermalChamberControl.cin" 

  
 // <<< Project specific modules >>>
  #include "Project_functions.cin"
  #include "..\SW_Modules_ECS\eCS_Functions.cin" 
  #include "..\SW_Modules_Project\eCS_Functions_Configuration.cin"
  #include "..\..\HW_Modules\TILT\TiltDeviceControl.cin"
  #include "DTC_Configuration.cin"
  #include "eCS_Steps_Cycles_Parameters_Config.cin"
  
  // <<< Project Hardware Modules >>>
  #include "..\..\HW_Modules\DPOT\DigitalPotentiometerControl.cin"  
}

variables
{

}