/*@!Encoding:1252*/

variables
{ 
  //variables to define theseat / solenoid side
  int iLeft = 1;
  int iRight = 2;
  
  //variables to define rear seats options
  int iNotAvailable = 0;
  int iNonRemovableSeats = 1;
  int iRemovableSeats = 2;  
  
  //variables to define rear seats occupancy sensor variant
  int iVariant1 = 1;
  int iVariant2 = 2;
  
  //variables to define rear seats status
  int iShortToGround = -1;
  int iSeatRemoved = 0;
  int iImplausible = 1;
  int iSeatOccupiedBeltNotPlugged = 2;
  int iSeatNotOccupied = 3;
  int iSeatOccupiedBeltPlugged = 4;
  
  //variables to define rear seat status basec on resistance values in ohms
  int iVariant1_SeatRemoved = 0;
  int iVariant1_ShortToGND = 0;
  int iVariant1_Implausibile = 200;
  int iVariant1_SeatOccupiedBeltNotPlugged = 100;
  int iVariant2_SeatOccupiedBeltNotPlugged = 0;
  int iVariant1_SeatNotOccupied = 400;
  int iVariant2_SeatNotOccupied = 500;
  int iVariant1_SeatOccupiedBeltPlugged = 1000;
  int iVariant2_SeatOccupiedBeltPlugged = 2500;
  
  //solenoid status  
  const int Solenoid_Init_State     = 0;
  const int Solenoid_Locked_State   = 1;
  const int Solenoid_Unlocked_State = 2;
  const int Solenoid_Error_State    = 3; 
  
}
