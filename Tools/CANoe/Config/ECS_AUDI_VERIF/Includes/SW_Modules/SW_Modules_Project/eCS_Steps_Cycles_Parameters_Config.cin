/*@!Encoding:1252*/
includes
{
  
}

variables
{

  // DEFAULT CYCLE CONFIGURATION VALUES - Read 
  byte bDefaultProfilesDefinitionRead  [51] = {0x62, 0xFD, 0xE3, 0xFF, 0xFF, 0xFF, 0x01, 0x05, 0x00, 0x02, 0x03, 0xFF, 0xFF, 0xFF, 0xFF, 0xFF, 0xFF, 0xFF, 0x01, 0x05, 0x01, 0x02, 0x03, 0xFF, 0xFF, 0xFF, 0xFF, 0xFF, 0xFF, 0xFF, 0x01, 0x05, 0x04, 0xFF, 0xFF, 0xFF, 0xFF, 0xFF, 0xFF, 0xFF, 0xFF, 0xFF, 0xFF, 0xFF, 0xFF, 0xFF, 0xFF, 0xFF, 0xFF, 0xFF, 0xFF};
  
  // DEFAULT CYCLE CONFIGURATION VALUES - Write  
  byte bDefaultProfilesDefinitionWrite [51] = {0x2E, 0xFD, 0xE3, 0xFF, 0xFF, 0xFF, 0x01, 0x05, 0x00, 0x02, 0x03, 0xFF, 0xFF, 0xFF, 0xFF, 0xFF, 0xFF, 0xFF, 0x01, 0x05, 0x01, 0x02, 0x03, 0xFF, 0xFF, 0xFF, 0xFF, 0xFF, 0xFF, 0xFF, 0x01, 0x05, 0x04, 0xFF, 0xFF, 0xFF, 0xFF, 0xFF, 0xFF, 0xFF, 0xFF, 0xFF, 0xFF, 0xFF, 0xFF, 0xFF, 0xFF, 0xFF, 0xFF, 0xFF, 0xFF};
  
  // DEFAULT STEPS CONFIGURATION VALUES - Read  
  byte bDefaultStepsDefinitionRead     [59] = {0x62, 0xFD, 0xE4, 0x00, 0x18, 0x00, 0x0C, 0xAD, 0x46, 0x02, 0x00, 0x18, 0x00, 0x0D, 0x9D, 0xA9, 0x02, 0x00, 0x78, 0x00, 0x04, 0x39, 0xC2, 0x82, 0x00, 0xCC, 0x00, 0x04, 0x39, 0xC2, 0x42, 0x02, 0x58, 0x00, 0x03, 0x49, 0x5E, 0x02, 0x00, 0x24, 0x00, 0x00, 0xFC, 0x69, 0x02, 0x03, 0xE4, 0x00, 0x00, 0xFC, 0x69, 0x02, 0x00, 0x00, 0x00, 0x00, 0x00, 0x00, 0x00};
  
  // DEFAULT STEPS CONFIGURATION VALUES - Write
  byte bDefaultStepsDefinitionWrite    [59] = {0x2E, 0xFD, 0xE4, 0x00, 0x18, 0x00, 0x0C, 0xAD, 0x46, 0x02, 0x00, 0x18, 0x00, 0x0D, 0x9D, 0xA9, 0x02, 0x00, 0x78, 0x00, 0x04, 0x39, 0xC2, 0x82, 0x00, 0xCC, 0x00, 0x04, 0x39, 0xC2, 0x42, 0x02, 0x58, 0x00, 0x03, 0x49, 0x5E, 0x02, 0x00, 0x24, 0x00, 0x00, 0xFC, 0x69, 0x02, 0x03, 0xE4, 0x00, 0x00, 0xFC, 0x69, 0x02, 0x00, 0x00, 0x00, 0x00, 0x00, 0x00, 0x00};
  
    
}