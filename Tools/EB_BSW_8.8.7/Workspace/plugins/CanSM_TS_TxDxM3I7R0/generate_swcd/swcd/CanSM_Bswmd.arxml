<?xml version="1.0" encoding="ISO-8859-1"?>
[!INCLUDE "CanSM_Vars.m"!]
[!AUTOSPACING!][!//
<AUTOSAR xmlns="http://autosar.org/schema/r4.0"
  xmlns:xsi="http://www.w3.org/2001/XMLSchema-instance"
  xsi:schemaLocation="http://autosar.org/schema/r4.0 AUTOSAR_4-2-1_STRICT_COMPACT.xsd">
  <AR-PACKAGES>
    <AR-PACKAGE>
      <SHORT-NAME>AUTOSAR_CanSM</SHORT-NAME>
      <AR-PACKAGES>
        <AR-PACKAGE>
          <SHORT-NAME>BswModuleDescriptions</SHORT-NAME>
          <ELEMENTS>
            <BSW-MODULE-DESCRIPTION>
              <SHORT-NAME>CanSM</SHORT-NAME>
              <MODULE-ID>140</MODULE-ID>
              <PROVIDED-ENTRYS>
                <BSW-MODULE-ENTRY-REF-CONDITIONAL>
                  <BSW-MODULE-ENTRY-REF DEST="BSW-MODULE-ENTRY">/AUTOSAR_CanSM/BswModuleEntrys/CanSM_MainFunction</BSW-MODULE-ENTRY-REF>
                </BSW-MODULE-ENTRY-REF-CONDITIONAL>
[!IF "CanSMGeneral/CanSMMultiCoreSupport = 'true'"!]
                <BSW-MODULE-ENTRY-REF-CONDITIONAL>
                  <BSW-MODULE-ENTRY-REF DEST="BSW-MODULE-ENTRY">/AUTOSAR_CanSM/BswModuleEntrys/CanSM_RequestComMode</BSW-MODULE-ENTRY-REF>
                </BSW-MODULE-ENTRY-REF-CONDITIONAL>
[!ENDIF!]
[!IF "$multiCoreSupport = 'true'"!]
  [!IF "($ChannelsDistributionSupport = 'true')"!]
    [!VAR "CANSM_EcuC_Partition"="'false'"!]
    [!LOOP "(node:order(as:modconf('CanSM')[1]/CanSMConfiguration/*[1]/CanSMManagerNetwork/*))"!]
      [!IF "node:exists(node:ref(./CanSMComMNetworkHandleRef)/ComMChannelPartitionRef)"!]
        [!VAR "CANSM_EcuC_Partition"="'true'"!]
        [!BREAK!]
      [!ENDIF!]  
    [!ENDLOOP!]
    [!IF "($CANSM_EcuC_Partition = 'true')"!]
      [!LOOP "as:modconf('EcuC')[1]/EcucPartitionCollection/EcucPartition/*"!]
      [!VAR "EcuC_Partition_Referenced"="'false'"!]
        [!VAR "PartitionName" = "as:name(.)"!]
        [!LOOP "as:modconf('CanSM')[1]/CanSMConfiguration/*[1]/CanSMManagerNetwork/*"!]
          [!IF "node:exists(node:ref(./CanSMComMNetworkHandleRef)/ComMChannelPartitionRef)"!]
            [!IF "($PartitionName = name(as:ref(as:ref(CanSMComMNetworkHandleRef)/ComMChannelPartitionRef))) and ($EcuC_Partition_Referenced = 'false')"!]
              [!VAR "EcuC_Partition_Referenced"="'true'"!]
                <BSW-MODULE-ENTRY-REF-CONDITIONAL>
                  <BSW-MODULE-ENTRY-REF DEST="BSW-MODULE-ENTRY">/AUTOSAR_CanSM/BswModuleEntrys/CanSM_MainFunction_[!"$PartitionName"!]</BSW-MODULE-ENTRY-REF>
                </BSW-MODULE-ENTRY-REF-CONDITIONAL>
            [!ENDIF!]
          [!ENDIF!]
        [!ENDLOOP!]
      [!ENDLOOP!][!//Partitions loop
    [!ENDIF!]
  [!ENDIF!]
[!ENDIF!]
              </PROVIDED-ENTRYS>
[!IF "CanSMGeneral/CanSMMultiCoreSupport = 'true'"!]
              <PROVIDED-CLIENT-SERVER-ENTRYS>
              [!LOOP "CanSMConfiguration/*[1]/CanSMManagerNetwork/*"!]
                <BSW-MODULE-CLIENT-SERVER-ENTRY>
                  <SHORT-NAME>ProvidedCSEntry_CanSM_RequestComMode_[!"as:ref(./CanSMComMNetworkHandleRef)/ComMChannelId"!]</SHORT-NAME>
                  <ENCAPSULATED-ENTRY-REF DEST="BSW-MODULE-ENTRY">/AUTOSAR_CanSM/BswModuleEntrys/CanSM_RequestComMode</ENCAPSULATED-ENTRY-REF>
                  <IS-REENTRANT>true</IS-REENTRANT>
                  <IS-SYNCHRONOUS>false</IS-SYNCHRONOUS>
                </BSW-MODULE-CLIENT-SERVER-ENTRY>
              [!ENDLOOP!]
              </PROVIDED-CLIENT-SERVER-ENTRYS>
              
              <REQUIRED-CLIENT-SERVER-ENTRYS>
              [!LOOP "CanSMConfiguration/*[1]/CanSMManagerNetwork/*"!]
                <BSW-MODULE-CLIENT-SERVER-ENTRY>
                  <SHORT-NAME>RequiredCSEntry_ComM_BusSM_ModeIndication_[!"as:ref(./CanSMComMNetworkHandleRef)/ComMChannelId"!]</SHORT-NAME>
                  <ENCAPSULATED-ENTRY-REF DEST="BSW-MODULE-ENTRY">/AUTOSAR_ComM/BswModuleEntrys/ComM_BusSM_ModeIndication</ENCAPSULATED-ENTRY-REF>
                  <IS-REENTRANT>true</IS-REENTRANT>
                  <IS-SYNCHRONOUS>false</IS-SYNCHRONOUS>
                </BSW-MODULE-CLIENT-SERVER-ENTRY>
              [!ENDLOOP!]
              </REQUIRED-CLIENT-SERVER-ENTRYS>
[!ENDIF!][!//[!
              
              <INTERNAL-BEHAVIORS>
                <BSW-INTERNAL-BEHAVIOR>
                  <SHORT-NAME>InternalBehavior_0</SHORT-NAME>
                  <EXCLUSIVE-AREAS>
                    <EXCLUSIVE-AREA>
                      <SHORT-NAME>SCHM_CANSM_EXCLUSIVE_AREA_0</SHORT-NAME>
                    </EXCLUSIVE-AREA>
                  </EXCLUSIVE-AREAS>
                  <ENTITYS>
                    <BSW-SCHEDULABLE-ENTITY>
                      <SHORT-NAME>CanSM_MainFunction</SHORT-NAME>
                      <CAN-ENTER-EXCLUSIVE-AREA-REFS>
                        <CAN-ENTER-EXCLUSIVE-AREA-REF DEST="EXCLUSIVE-AREA">/AUTOSAR_CanSM/BswModuleDescriptions/CanSM/InternalBehavior_0/SCHM_CANSM_EXCLUSIVE_AREA_0</CAN-ENTER-EXCLUSIVE-AREA-REF>
                      </CAN-ENTER-EXCLUSIVE-AREA-REFS>
                      <MINIMUM-START-INTERVAL>0.0</MINIMUM-START-INTERVAL>
[!IF "CanSMGeneral/CanSMMultiCoreSupport = 'true'"!]
                      <CALL-POINTS>
                        [!LOOP "CanSMConfiguration/*[1]/CanSMManagerNetwork/*"!]
                        <BSW-ASYNCHRONOUS-SERVER-CALL-POINT>
                          <SHORT-NAME>AsynchCallPoint_ComM_BusSM_ModeIndication_[!"as:ref(./CanSMComMNetworkHandleRef)/ComMChannelId"!]</SHORT-NAME>
                          <CALLED-ENTRY-REF DEST="BSW-MODULE-CLIENT-SERVER-ENTRY">/AUTOSAR_CanSM/BswModuleDescriptions/CanSM/RequiredCSEntry_ComM_BusSM_ModeIndication_[!"as:ref(./CanSMComMNetworkHandleRef)/ComMChannelId"!]</CALLED-ENTRY-REF>
                        </BSW-ASYNCHRONOUS-SERVER-CALL-POINT>
                        [!ENDLOOP!]
                      </CALL-POINTS>
[!ENDIF!][!//[!
                      <IMPLEMENTED-ENTRY-REF DEST="BSW-MODULE-ENTRY">/AUTOSAR_CanSM/BswModuleEntrys/CanSM_MainFunction</IMPLEMENTED-ENTRY-REF>
                    </BSW-SCHEDULABLE-ENTITY>
[!IF "CanSMGeneral/CanSMMultiCoreSupport = 'true'"!]
                    [!LOOP "CanSMConfiguration/*[1]/CanSMManagerNetwork/*"!]
                    <BSW-CALLED-ENTITY>
                      <SHORT-NAME>CanSM_RequestComMode_CalledEntity_[!"as:ref(./CanSMComMNetworkHandleRef)/ComMChannelId"!]</SHORT-NAME>
                      <MINIMUM-START-INTERVAL>0.0</MINIMUM-START-INTERVAL>
                      <IMPLEMENTED-ENTRY-REF DEST="BSW-MODULE-ENTRY">/AUTOSAR_CanSM/BswModuleEntrys/CanSM_RequestComMode</IMPLEMENTED-ENTRY-REF>
                    </BSW-CALLED-ENTITY>   
                    [!ENDLOOP!]
[!ENDIF!][!//[!
                  </ENTITYS>
                  <EVENTS>
                    <BSW-TIMING-EVENT>
                      <SHORT-NAME>TimingEvent_MainFunction</SHORT-NAME>
                      <STARTS-ON-EVENT-REF DEST="BSW-SCHEDULABLE-ENTITY">/AUTOSAR_CanSM/BswModuleDescriptions/CanSM/InternalBehavior_0/CanSM_MainFunction</STARTS-ON-EVENT-REF>
                      <PERIOD>[!"CanSMGeneral/CanSMMainFunctionTimePeriod"!]</PERIOD>
                    </BSW-TIMING-EVENT>
[!IF "CanSMGeneral/CanSMMultiCoreSupport = 'true'"!]
                    [!LOOP "CanSMConfiguration/*[1]/CanSMManagerNetwork/*"!]
                    <BSW-OPERATION-INVOKED-EVENT>
                      <SHORT-NAME>OpInokedEv_CanSM_RequestComMode_[!"as:ref(./CanSMComMNetworkHandleRef)/ComMChannelId"!]</SHORT-NAME>
                      <STARTS-ON-EVENT-REF DEST="BSW-CALLED-ENTITY">/AUTOSAR_CanSM/BswModuleDescriptions/CanSM/InternalBehavior_0/CanSM_RequestComMode_CalledEntity_[!"as:ref(./CanSMComMNetworkHandleRef)/ComMChannelId"!]</STARTS-ON-EVENT-REF>
                      <ENTRY-REF DEST="BSW-MODULE-CLIENT-SERVER-ENTRY">/AUTOSAR_CanSM/BswModuleDescriptions/CanSM/ProvidedCSEntry_CanSM_RequestComMode_[!"as:ref(./CanSMComMNetworkHandleRef)/ComMChannelId"!]</ENTRY-REF>
                    </BSW-OPERATION-INVOKED-EVENT>
                    [!ENDLOOP!]
[!ENDIF!][!//[!
                  </EVENTS>
                </BSW-INTERNAL-BEHAVIOR>
[!IF "$multiCoreSupport = 'true'"!]
  [!IF "($ChannelsDistributionSupport = 'true')"!]
    [!VAR "CANSM_EcuC_Partition"="'false'"!]
    [!LOOP "(node:order(as:modconf('CanSM')[1]/CanSMConfiguration/*[1]/CanSMManagerNetwork/*))"!]
      [!IF "node:exists(node:ref(./CanSMComMNetworkHandleRef)/ComMChannelPartitionRef)"!]
        [!VAR "CANSM_EcuC_Partition"="'true'"!]
        [!BREAK!]
      [!ENDIF!]  
    [!ENDLOOP!]
    [!VAR "MainFunctionPeriod"="CanSMGeneral/CanSMMainFunctionTimePeriod"!]
    [!IF "($CANSM_EcuC_Partition = 'true')"!]
      [!LOOP "as:modconf('EcuC')[1]/EcucPartitionCollection/EcucPartition/*"!]
      [!VAR "EcuC_Partition_Referenced"="'false'"!]
        [!VAR "PartitionName" = "as:name(.)"!]
        [!LOOP "as:modconf('CanSM')[1]/CanSMConfiguration/*[1]/CanSMManagerNetwork/*"!]
          [!IF "node:exists(node:ref(./CanSMComMNetworkHandleRef)/ComMChannelPartitionRef)"!]
            [!IF "($PartitionName = name(as:ref(as:ref(CanSMComMNetworkHandleRef)/ComMChannelPartitionRef))) and ($EcuC_Partition_Referenced = 'false')"!]
              [!VAR "EcuC_Partition_Referenced"="'true'"!]
                <BSW-INTERNAL-BEHAVIOR>
                  <SHORT-NAME>InternalBehavior_[!"$PartitionName"!]</SHORT-NAME>
                  <EXCLUSIVE-AREAS>
                    <EXCLUSIVE-AREA>
                      <SHORT-NAME>SCHM_CANSM_EXCLUSIVE_AREA_0</SHORT-NAME>
                    </EXCLUSIVE-AREA>
                  </EXCLUSIVE-AREAS>
                  <ENTITYS>
                    <BSW-SCHEDULABLE-ENTITY>
                      <SHORT-NAME>CanSM_MainFunction_[!"$PartitionName"!]</SHORT-NAME>
                      <CAN-ENTER-EXCLUSIVE-AREA-REFS>
                        <CAN-ENTER-EXCLUSIVE-AREA-REF DEST="EXCLUSIVE-AREA">/AUTOSAR_CanSM/BswModuleDescriptions/CanSM/InternalBehavior_[!"$PartitionName"!]/SCHM_CANSM_EXCLUSIVE_AREA_0</CAN-ENTER-EXCLUSIVE-AREA-REF>
                      </CAN-ENTER-EXCLUSIVE-AREA-REFS>
                      <MINIMUM-START-INTERVAL>0.0</MINIMUM-START-INTERVAL>
                      <CALL-POINTS>
                        [!LOOP "CanSMConfiguration/*[1]/CanSMManagerNetwork/*"!]
                        [!IF "($PartitionName = name(as:ref(as:ref(CanSMComMNetworkHandleRef)/ComMChannelPartitionRef)))"!]
                        <BSW-ASYNCHRONOUS-SERVER-CALL-POINT>
                          <SHORT-NAME>AsynchCallPoint_ComM_BusSM_ModeIndication_[!"as:ref(./CanSMComMNetworkHandleRef)/ComMChannelId"!]</SHORT-NAME>
                          <CALLED-ENTRY-REF DEST="BSW-MODULE-CLIENT-SERVER-ENTRY">/AUTOSAR_CanSM/BswModuleDescriptions/CanSM/RequiredCSEntry_ComM_BusSM_ModeIndication_[!"as:ref(./CanSMComMNetworkHandleRef)/ComMChannelId"!]</CALLED-ENTRY-REF>
                        </BSW-ASYNCHRONOUS-SERVER-CALL-POINT>
                        [!ENDIF!]
                        [!ENDLOOP!]
                      </CALL-POINTS>
                      <IMPLEMENTED-ENTRY-REF DEST="BSW-MODULE-ENTRY">/AUTOSAR_CanSM/BswModuleEntrys/CanSM_MainFunction_[!"$PartitionName"!]</IMPLEMENTED-ENTRY-REF>
                    </BSW-SCHEDULABLE-ENTITY>
                    [!LOOP "CanSMConfiguration/*[1]/CanSMManagerNetwork/*"!]
                    [!IF "($PartitionName = name(as:ref(as:ref(CanSMComMNetworkHandleRef)/ComMChannelPartitionRef)))"!]
                    <BSW-CALLED-ENTITY>
                      <SHORT-NAME>CanSM_RequestComMode_CalledEntity_[!"as:ref(./CanSMComMNetworkHandleRef)/ComMChannelId"!]</SHORT-NAME>
                      <MINIMUM-START-INTERVAL>0.0</MINIMUM-START-INTERVAL>
                      <IMPLEMENTED-ENTRY-REF DEST="BSW-MODULE-ENTRY">/AUTOSAR_CanSM/BswModuleEntrys/CanSM_RequestComMode</IMPLEMENTED-ENTRY-REF>
                    </BSW-CALLED-ENTITY>
                    [!ENDIF!]
                    [!ENDLOOP!]
                  </ENTITYS>
                  <EVENTS>
                    <BSW-TIMING-EVENT>
                      <SHORT-NAME>TimingEvent_MainFunction</SHORT-NAME>
                      <STARTS-ON-EVENT-REF DEST="BSW-SCHEDULABLE-ENTITY">/AUTOSAR_CanSM/BswModuleDescriptions/CanSM/InternalBehavior_[!"$PartitionName"!]/CanSM_MainFunction_[!"$PartitionName"!]</STARTS-ON-EVENT-REF>
                      <PERIOD>[!"$MainFunctionPeriod"!]</PERIOD>
                    </BSW-TIMING-EVENT>
                    [!LOOP "CanSMConfiguration/*[1]/CanSMManagerNetwork/*"!]
                    [!IF "($PartitionName = name(as:ref(as:ref(CanSMComMNetworkHandleRef)/ComMChannelPartitionRef)))"!]
                    <BSW-OPERATION-INVOKED-EVENT>
                      <SHORT-NAME>OpInokedEv_CanSM_RequestComMode_[!"as:ref(./CanSMComMNetworkHandleRef)/ComMChannelId"!]</SHORT-NAME>
                      <STARTS-ON-EVENT-REF DEST="BSW-CALLED-ENTITY">/AUTOSAR_CanSM/BswModuleDescriptions/CanSM/InternalBehavior_[!"$PartitionName"!]/CanSM_RequestComMode_CalledEntity_[!"as:ref(./CanSMComMNetworkHandleRef)/ComMChannelId"!]</STARTS-ON-EVENT-REF>
                      <ENTRY-REF DEST="BSW-MODULE-CLIENT-SERVER-ENTRY">/AUTOSAR_CanSM/BswModuleDescriptions/CanSM/ProvidedCSEntry_CanSM_RequestComMode_[!"as:ref(./CanSMComMNetworkHandleRef)/ComMChannelId"!]</ENTRY-REF>
                    </BSW-OPERATION-INVOKED-EVENT>
                    [!ENDIF!]
                    [!ENDLOOP!]
                  </EVENTS>
                </BSW-INTERNAL-BEHAVIOR>
            [!ENDIF!]
          [!ENDIF!]
        [!ENDLOOP!]
      [!ENDLOOP!][!//Partitions loop
    [!ENDIF!]
  [!ENDIF!]
[!ENDIF!]
              </INTERNAL-BEHAVIORS>
            </BSW-MODULE-DESCRIPTION>
          </ELEMENTS>
        </AR-PACKAGE>

        <AR-PACKAGE>
          <SHORT-NAME>BswModuleEntrys</SHORT-NAME>
          <ELEMENTS>
            <BSW-MODULE-ENTRY>
              <SHORT-NAME>CanSM_MainFunction</SHORT-NAME>
              <SERVICE-ID>5</SERVICE-ID>
              <IS-REENTRANT>false</IS-REENTRANT>
              <IS-SYNCHRONOUS>true</IS-SYNCHRONOUS>
              <CALL-TYPE>SCHEDULED</CALL-TYPE>
              <EXECUTION-CONTEXT>TASK</EXECUTION-CONTEXT>
              <SW-SERVICE-IMPL-POLICY>STANDARD</SW-SERVICE-IMPL-POLICY>
              <ARGUMENTS>
              </ARGUMENTS>
            </BSW-MODULE-ENTRY>
[!IF "CanSMGeneral/CanSMMultiCoreSupport = 'true'"!]
            <BSW-MODULE-ENTRY>
              <SHORT-NAME>CanSM_RequestComMode</SHORT-NAME>
              <ADMIN-DATA>
                <SDGS>
                  <SDG GID="EB:DnT">
                    <SD GID="FunctionGroup">Extern</SD>
                    <SD GID="EnableTracing">true</SD>
                  </SDG>
                 </SDGS>
              </ADMIN-DATA>
              <SERVICE-ID>98</SERVICE-ID>
              <IS-REENTRANT>false</IS-REENTRANT>
              <IS-SYNCHRONOUS>false</IS-SYNCHRONOUS>
              <CALL-TYPE>REGULAR</CALL-TYPE>
              <EXECUTION-CONTEXT>TASK</EXECUTION-CONTEXT>
              <SW-SERVICE-IMPL-POLICY>STANDARD</SW-SERVICE-IMPL-POLICY>
              <RETURN-TYPE>
                <SHORT-NAME>RetVal</SHORT-NAME>
                <DIRECTION>OUT</DIRECTION>
                <SW-DATA-DEF-PROPS>
                  <SW-DATA-DEF-PROPS-VARIANTS>
                    <SW-DATA-DEF-PROPS-CONDITIONAL>
                      <IMPLEMENTATION-DATA-TYPE-REF DEST="IMPLEMENTATION-DATA-TYPE">/AUTOSAR_Std/ImplementationDataTypes/Std_ReturnType</IMPLEMENTATION-DATA-TYPE-REF>
                    </SW-DATA-DEF-PROPS-CONDITIONAL>
                  </SW-DATA-DEF-PROPS-VARIANTS>
                </SW-DATA-DEF-PROPS>
              </RETURN-TYPE>
              <ARGUMENTS>
                <SW-SERVICE-ARG>
                  <SHORT-NAME>nmNetworkHandle</SHORT-NAME>
                  <DIRECTION>IN</DIRECTION>
                  <SW-DATA-DEF-PROPS>
                    <SW-DATA-DEF-PROPS-VARIANTS>
                      <SW-DATA-DEF-PROPS-CONDITIONAL>
                        <IMPLEMENTATION-DATA-TYPE-REF DEST="IMPLEMENTATION-DATA-TYPE">/AUTOSAR_Platform/ImplementationDataTypes/uint8</IMPLEMENTATION-DATA-TYPE-REF>
                      </SW-DATA-DEF-PROPS-CONDITIONAL>
                    </SW-DATA-DEF-PROPS-VARIANTS>
                  </SW-DATA-DEF-PROPS>
                </SW-SERVICE-ARG>
                <SW-SERVICE-ARG>
                  <SHORT-NAME>ComM_Mode</SHORT-NAME>
                  <DIRECTION>IN</DIRECTION>
                  <SW-DATA-DEF-PROPS>
                    <SW-DATA-DEF-PROPS-VARIANTS>
                      <SW-DATA-DEF-PROPS-CONDITIONAL>
                        <IMPLEMENTATION-DATA-TYPE-REF DEST="IMPLEMENTATION-DATA-TYPE">/AUTOSAR_Platform/ImplementationDataTypes/uint8</IMPLEMENTATION-DATA-TYPE-REF>
                      </SW-DATA-DEF-PROPS-CONDITIONAL>
                    </SW-DATA-DEF-PROPS-VARIANTS>
                  </SW-DATA-DEF-PROPS>
                </SW-SERVICE-ARG>                
              </ARGUMENTS>
            </BSW-MODULE-ENTRY>
  [!IF "($ChannelsDistributionSupport = 'true')"!]
    [!VAR "CANSM_EcuC_Partition"="'false'"!]
    [!LOOP "(node:order(as:modconf('CanSM')[1]/CanSMConfiguration/*[1]/CanSMManagerNetwork/*))"!]
      [!IF "node:exists(node:ref(./CanSMComMNetworkHandleRef)/ComMChannelPartitionRef)"!]
        [!VAR "CANSM_EcuC_Partition"="'true'"!]
        [!BREAK!]
      [!ENDIF!]  
    [!ENDLOOP!]
    [!IF "($CANSM_EcuC_Partition = 'true')"!]
      [!LOOP "as:modconf('EcuC')[1]/EcucPartitionCollection/EcucPartition/*"!]
      [!VAR "EcuC_Partition_Referenced"="'false'"!]
        [!VAR "PartitionName" = "as:name(.)"!]
        [!LOOP "as:modconf('CanSM')[1]/CanSMConfiguration/*[1]/CanSMManagerNetwork/*"!]
          [!IF "node:exists(node:ref(./CanSMComMNetworkHandleRef)/ComMChannelPartitionRef)"!]
            [!IF "($PartitionName = name(as:ref(as:ref(CanSMComMNetworkHandleRef)/ComMChannelPartitionRef))) and ($EcuC_Partition_Referenced = 'false')"!]
              [!VAR "EcuC_Partition_Referenced"="'true'"!]
            <BSW-MODULE-ENTRY>
              <SHORT-NAME>CanSM_MainFunction_[!"$PartitionName"!]</SHORT-NAME>
              <SERVICE-ID>5</SERVICE-ID>
              <IS-REENTRANT>false</IS-REENTRANT>
              <IS-SYNCHRONOUS>true</IS-SYNCHRONOUS>
              <CALL-TYPE>SCHEDULED</CALL-TYPE>
              <EXECUTION-CONTEXT>TASK</EXECUTION-CONTEXT>
              <SW-SERVICE-IMPL-POLICY>STANDARD</SW-SERVICE-IMPL-POLICY>
              <ARGUMENTS>
              </ARGUMENTS>
            </BSW-MODULE-ENTRY>
            [!ENDIF!]
          [!ENDIF!]
        [!ENDLOOP!]
      [!ENDLOOP!][!//Partitions loop
    [!ENDIF!]
  [!ENDIF!]
[!ENDIF!][!//[!
          </ELEMENTS>
        </AR-PACKAGE>

      </AR-PACKAGES>
    </AR-PACKAGE>

    <AR-PACKAGE>
      <SHORT-NAME>EB_CanSM</SHORT-NAME>
      <AR-PACKAGES>
        <AR-PACKAGE>
          <SHORT-NAME>Implementations</SHORT-NAME>
          <ELEMENTS>
            <BSW-IMPLEMENTATION>
              <SHORT-NAME>BswImplementation_0</SHORT-NAME>
              <CODE-DESCRIPTORS>
                <CODE>
                  <SHORT-NAME>Files</SHORT-NAME>
                  <ARTIFACT-DESCRIPTORS>
                    <AUTOSAR-ENGINEERING-OBJECT>
                      <SHORT-LABEL>Autosar::include::CanSM.h</SHORT-LABEL>
                      <CATEGORY>SWHDR</CATEGORY>
                    </AUTOSAR-ENGINEERING-OBJECT>
                    <AUTOSAR-ENGINEERING-OBJECT>
                      <SHORT-LABEL>Autosar::include::CanSM_Api.h</SHORT-LABEL>
                      <CATEGORY>SWHDR</CATEGORY>
                    </AUTOSAR-ENGINEERING-OBJECT>
                    <AUTOSAR-ENGINEERING-OBJECT>
                      <SHORT-LABEL>Autosar::include::CanSM_Api_Static.h</SHORT-LABEL>
                      <CATEGORY>SWHDR</CATEGORY>
                    </AUTOSAR-ENGINEERING-OBJECT>
                    <AUTOSAR-ENGINEERING-OBJECT>
                      <SHORT-LABEL>Autosar::include::CanSM_BswM.h</SHORT-LABEL>
                      <CATEGORY>SWHDR</CATEGORY>
                    </AUTOSAR-ENGINEERING-OBJECT>
                    <AUTOSAR-ENGINEERING-OBJECT>
                      <SHORT-LABEL>Autosar::include::CanSM_Cbk.h</SHORT-LABEL>
                      <CATEGORY>SWHDR</CATEGORY>
                    </AUTOSAR-ENGINEERING-OBJECT>
                    <AUTOSAR-ENGINEERING-OBJECT>
                      <SHORT-LABEL>Autosar::include::CanSM_ComM.h</SHORT-LABEL>
                      <CATEGORY>SWHDR</CATEGORY>
                    </AUTOSAR-ENGINEERING-OBJECT>
                    <AUTOSAR-ENGINEERING-OBJECT>
                      <SHORT-LABEL>Autosar::include::CanSM_Dcm.h</SHORT-LABEL>
                      <CATEGORY>SWHDR</CATEGORY>
                    </AUTOSAR-ENGINEERING-OBJECT>
                    <AUTOSAR-ENGINEERING-OBJECT>
                      <SHORT-LABEL>Autosar::include::CanSM_Int_Stc.h</SHORT-LABEL>
                      <CATEGORY>SWHDR</CATEGORY>
                    </AUTOSAR-ENGINEERING-OBJECT>
                    <AUTOSAR-ENGINEERING-OBJECT>
                      <SHORT-LABEL>Autosar::include::CanSM_Internal.h</SHORT-LABEL>
                      <CATEGORY>SWHDR</CATEGORY>
                    </AUTOSAR-ENGINEERING-OBJECT>
                    <AUTOSAR-ENGINEERING-OBJECT>
                      <SHORT-LABEL>Autosar::include::CanSM_SchM.h</SHORT-LABEL>
                      <CATEGORY>SWHDR</CATEGORY>
                    </AUTOSAR-ENGINEERING-OBJECT>
                    <AUTOSAR-ENGINEERING-OBJECT>
                      <SHORT-LABEL>Autosar::include::CanSM_Trace.h</SHORT-LABEL>
                      <CATEGORY>SWHDR</CATEGORY>
                    </AUTOSAR-ENGINEERING-OBJECT>
                    <AUTOSAR-ENGINEERING-OBJECT>
                      <SHORT-LABEL>Autosar::include::CanSM_Trace_Internal.h</SHORT-LABEL>
                      <CATEGORY>SWHDR</CATEGORY>
                    </AUTOSAR-ENGINEERING-OBJECT>
                    <AUTOSAR-ENGINEERING-OBJECT>
                      <SHORT-LABEL>Autosar::include::CanSM_TxTimeoutException.h</SHORT-LABEL>
                      <CATEGORY>SWHDR</CATEGORY>
                    </AUTOSAR-ENGINEERING-OBJECT>
                    <AUTOSAR-ENGINEERING-OBJECT>
                      <SHORT-LABEL>Autosar::include::CanSM_Version.h</SHORT-LABEL>
                      <CATEGORY>SWHDR</CATEGORY>
                    </AUTOSAR-ENGINEERING-OBJECT>
                    <AUTOSAR-ENGINEERING-OBJECT>
                      <SHORT-LABEL>Autosar::src::CanSM.c</SHORT-LABEL>
                      <CATEGORY>SWSRC</CATEGORY>
                    </AUTOSAR-ENGINEERING-OBJECT>
                    <AUTOSAR-ENGINEERING-OBJECT>
                      <SHORT-LABEL>Autosar::src::CanSM_Cbk.c</SHORT-LABEL>
                      <CATEGORY>SWSRC</CATEGORY>
                    </AUTOSAR-ENGINEERING-OBJECT>
                    <AUTOSAR-ENGINEERING-OBJECT>
                      <SHORT-LABEL>Autosar::src::CanSM_GetCurrentComMode.c</SHORT-LABEL>
                      <CATEGORY>SWSRC</CATEGORY>
                    </AUTOSAR-ENGINEERING-OBJECT>
                    <AUTOSAR-ENGINEERING-OBJECT>
                      <SHORT-LABEL>Autosar::src::CanSM_GetVersionInfo.c</SHORT-LABEL>
                      <CATEGORY>SWSRC</CATEGORY>
                    </AUTOSAR-ENGINEERING-OBJECT>
                    <AUTOSAR-ENGINEERING-OBJECT>
                      <SHORT-LABEL>Autosar::src::CanSM_Init.c</SHORT-LABEL>
                      <CATEGORY>SWSRC</CATEGORY>
                    </AUTOSAR-ENGINEERING-OBJECT>
                    <AUTOSAR-ENGINEERING-OBJECT>
                      <SHORT-LABEL>Autosar::src::CanSM_MainFunction.c</SHORT-LABEL>
                      <CATEGORY>SWSRC</CATEGORY>
                    </AUTOSAR-ENGINEERING-OBJECT>
                    <AUTOSAR-ENGINEERING-OBJECT>
                      <SHORT-LABEL>Autosar::src::CanSM_Merged.c</SHORT-LABEL>
                      <CATEGORY>SWSRC</CATEGORY>
                    </AUTOSAR-ENGINEERING-OBJECT>
                    <AUTOSAR-ENGINEERING-OBJECT>
                      <SHORT-LABEL>Autosar::src::CanSM_RequestComMode.c</SHORT-LABEL>
                      <CATEGORY>SWSRC</CATEGORY>
                    </AUTOSAR-ENGINEERING-OBJECT>
                    <AUTOSAR-ENGINEERING-OBJECT>
                      <SHORT-LABEL>Autosar::src::CanSM_SetBaudrate.c</SHORT-LABEL>
                      <CATEGORY>SWSRC</CATEGORY>
                    </AUTOSAR-ENGINEERING-OBJECT>
                    <AUTOSAR-ENGINEERING-OBJECT>
                      <SHORT-LABEL>Autosar::src::CanSM_StateMachine.c</SHORT-LABEL>
                      <CATEGORY>SWSRC</CATEGORY>
                    </AUTOSAR-ENGINEERING-OBJECT>
                    <AUTOSAR-ENGINEERING-OBJECT>
                      <SHORT-LABEL>make::CanSM_defs.mak</SHORT-LABEL>
                      <CATEGORY>SWMAKE</CATEGORY>
                    </AUTOSAR-ENGINEERING-OBJECT>
                    <AUTOSAR-ENGINEERING-OBJECT>
                      <SHORT-LABEL>make::CanSM_rules.mak</SHORT-LABEL>
                      <CATEGORY>SWMAKE</CATEGORY>
                    </AUTOSAR-ENGINEERING-OBJECT>
                  </ARTIFACT-DESCRIPTORS>
                </CODE>
              </CODE-DESCRIPTORS>
              <PROGRAMMING-LANGUAGE>C</PROGRAMMING-LANGUAGE>
              <RESOURCE-CONSUMPTION>
                <SHORT-NAME>ResourceConsumption</SHORT-NAME>
                <MEMORY-SECTIONS>
                  <MEMORY-SECTION>
                    <SHORT-NAME>VAR_INIT_UNSPECIFIED</SHORT-NAME>
                    <ALIGNMENT>UNSPECIFIED</ALIGNMENT>
                    <SW-ADDRMETHOD-REF DEST="SW-ADDR-METHOD">/AUTOSAR_MemMap/SwAddrMethods/VAR</SW-ADDRMETHOD-REF>
                  </MEMORY-SECTION>
                  <MEMORY-SECTION>
                    <SHORT-NAME>VAR_INIT_8</SHORT-NAME>
                    <ALIGNMENT>8</ALIGNMENT>
                    <SW-ADDRMETHOD-REF DEST="SW-ADDR-METHOD">/AUTOSAR_MemMap/SwAddrMethods/VAR</SW-ADDRMETHOD-REF>
                  </MEMORY-SECTION>
                  <MEMORY-SECTION>
                    <SHORT-NAME>VAR_CLEARED_8</SHORT-NAME>
                    <ALIGNMENT>8</ALIGNMENT>
                    <SW-ADDRMETHOD-REF DEST="SW-ADDR-METHOD">/AUTOSAR_MemMap/SwAddrMethods/VAR_CLEARED</SW-ADDRMETHOD-REF>
                  </MEMORY-SECTION>
                  <MEMORY-SECTION>
                    <SHORT-NAME>VAR_CLEARED_UNSPECIFIED</SHORT-NAME>
                    <ALIGNMENT>UNSPECIFIED</ALIGNMENT>
                    <SW-ADDRMETHOD-REF DEST="SW-ADDR-METHOD">/AUTOSAR_MemMap/SwAddrMethods/VAR_CLEARED</SW-ADDRMETHOD-REF>
                  </MEMORY-SECTION>
                  <MEMORY-SECTION>
                  <SHORT-NAME>CONST_8</SHORT-NAME>
                    <ALIGNMENT>8</ALIGNMENT>
                    <SW-ADDRMETHOD-REF DEST="SW-ADDR-METHOD">/AUTOSAR_MemMap/SwAddrMethods/CONST</SW-ADDRMETHOD-REF>
                  </MEMORY-SECTION>
                  <MEMORY-SECTION>
                    <SHORT-NAME>CODE</SHORT-NAME>
                    <SW-ADDRMETHOD-REF DEST="SW-ADDR-METHOD">/AUTOSAR_MemMap/SwAddrMethods/CODE</SW-ADDRMETHOD-REF>
                  </MEMORY-SECTION>
                  <MEMORY-SECTION>
                    <SHORT-NAME>CONFIG_DATA_8</SHORT-NAME>
                    <ALIGNMENT>8</ALIGNMENT>
                    <SW-ADDRMETHOD-REF DEST="SW-ADDR-METHOD">/AUTOSAR_MemMap/SwAddrMethods/CONFIG_DATA</SW-ADDRMETHOD-REF>
                  </MEMORY-SECTION>
                  <MEMORY-SECTION>
                    <SHORT-NAME>CONFIG_DATA_UNSPECIFIED</SHORT-NAME>
                    <ALIGNMENT>UNSPECIFIED</ALIGNMENT>
                    <SW-ADDRMETHOD-REF DEST="SW-ADDR-METHOD">/AUTOSAR_MemMap/SwAddrMethods/CONFIG_DATA</SW-ADDRMETHOD-REF>
                  </MEMORY-SECTION>
                </MEMORY-SECTIONS>
              </RESOURCE-CONSUMPTION>
              <SW-VERSION>3.7.13</SW-VERSION>
              <VENDOR-ID>1</VENDOR-ID>
              <AR-RELEASE-VERSION>4.0.3</AR-RELEASE-VERSION>
              <BEHAVIOR-REF DEST="BSW-INTERNAL-BEHAVIOR">/AUTOSAR_CanSM/BswModuleDescriptions/CanSM/InternalBehavior_0</BEHAVIOR-REF>
              <VENDOR-SPECIFIC-MODULE-DEF-REFS>
                <VENDOR-SPECIFIC-MODULE-DEF-REF DEST="ECUC-MODULE-DEF">/TS_TxDxM3I7R0/CanSM</VENDOR-SPECIFIC-MODULE-DEF-REF>
              </VENDOR-SPECIFIC-MODULE-DEF-REFS>
            </BSW-IMPLEMENTATION>
[!IF "$multiCoreSupport = 'true'"!]
  [!IF "($ChannelsDistributionSupport = 'true')"!]
    [!VAR "CANSM_EcuC_Partition"="'false'"!]
    [!LOOP "(node:order(as:modconf('CanSM')[1]/CanSMConfiguration/*[1]/CanSMManagerNetwork/*))"!]
      [!IF "node:exists(node:ref(./CanSMComMNetworkHandleRef)/ComMChannelPartitionRef)"!]
        [!VAR "CANSM_EcuC_Partition"="'true'"!]
        [!BREAK!]
      [!ENDIF!]  
    [!ENDLOOP!]
    [!IF "($CANSM_EcuC_Partition = 'true')"!]
      [!LOOP "as:modconf('EcuC')[1]/EcucPartitionCollection/EcucPartition/*"!]
      [!VAR "EcuC_Partition_Referenced"="'false'"!]
        [!VAR "PartitionName" = "as:name(.)"!]
        [!LOOP "as:modconf('CanSM')[1]/CanSMConfiguration/*[1]/CanSMManagerNetwork/*"!]
          [!IF "node:exists(node:ref(./CanSMComMNetworkHandleRef)/ComMChannelPartitionRef)"!]
            [!IF "($PartitionName = name(as:ref(as:ref(CanSMComMNetworkHandleRef)/ComMChannelPartitionRef))) and ($EcuC_Partition_Referenced = 'false')"!]
              [!VAR "EcuC_Partition_Referenced"="'true'"!]
            <BSW-IMPLEMENTATION>
              <SHORT-NAME>BswImplementation_[!"$PartitionName"!]</SHORT-NAME>
              <CODE-DESCRIPTORS>
                <CODE>
                  <SHORT-NAME>Files</SHORT-NAME>
                  <ARTIFACT-DESCRIPTORS>
                    <AUTOSAR-ENGINEERING-OBJECT>
                      <SHORT-LABEL>Autosar::include::CanSM.h</SHORT-LABEL>
                      <CATEGORY>SWHDR</CATEGORY>
                    </AUTOSAR-ENGINEERING-OBJECT>
                    <AUTOSAR-ENGINEERING-OBJECT>
                      <SHORT-LABEL>Autosar::include::CanSM_Api.h</SHORT-LABEL>
                      <CATEGORY>SWHDR</CATEGORY>
                    </AUTOSAR-ENGINEERING-OBJECT>
                    <AUTOSAR-ENGINEERING-OBJECT>
                      <SHORT-LABEL>Autosar::include::CanSM_Api_Static.h</SHORT-LABEL>
                      <CATEGORY>SWHDR</CATEGORY>
                    </AUTOSAR-ENGINEERING-OBJECT>
                    <AUTOSAR-ENGINEERING-OBJECT>
                      <SHORT-LABEL>Autosar::include::CanSM_BswM.h</SHORT-LABEL>
                      <CATEGORY>SWHDR</CATEGORY>
                    </AUTOSAR-ENGINEERING-OBJECT>
                    <AUTOSAR-ENGINEERING-OBJECT>
                      <SHORT-LABEL>Autosar::include::CanSM_Cbk.h</SHORT-LABEL>
                      <CATEGORY>SWHDR</CATEGORY>
                    </AUTOSAR-ENGINEERING-OBJECT>
                    <AUTOSAR-ENGINEERING-OBJECT>
                      <SHORT-LABEL>Autosar::include::CanSM_ComM.h</SHORT-LABEL>
                      <CATEGORY>SWHDR</CATEGORY>
                    </AUTOSAR-ENGINEERING-OBJECT>
                    <AUTOSAR-ENGINEERING-OBJECT>
                      <SHORT-LABEL>Autosar::include::CanSM_Dcm.h</SHORT-LABEL>
                      <CATEGORY>SWHDR</CATEGORY>
                    </AUTOSAR-ENGINEERING-OBJECT>
                    <AUTOSAR-ENGINEERING-OBJECT>
                      <SHORT-LABEL>Autosar::include::CanSM_Int_Stc.h</SHORT-LABEL>
                      <CATEGORY>SWHDR</CATEGORY>
                    </AUTOSAR-ENGINEERING-OBJECT>
                    <AUTOSAR-ENGINEERING-OBJECT>
                      <SHORT-LABEL>Autosar::include::CanSM_Internal.h</SHORT-LABEL>
                      <CATEGORY>SWHDR</CATEGORY>
                    </AUTOSAR-ENGINEERING-OBJECT>
                    <AUTOSAR-ENGINEERING-OBJECT>
                      <SHORT-LABEL>Autosar::include::CanSM_SchM.h</SHORT-LABEL>
                      <CATEGORY>SWHDR</CATEGORY>
                    </AUTOSAR-ENGINEERING-OBJECT>
                    <AUTOSAR-ENGINEERING-OBJECT>
                      <SHORT-LABEL>Autosar::include::CanSM_Trace.h</SHORT-LABEL>
                      <CATEGORY>SWHDR</CATEGORY>
                    </AUTOSAR-ENGINEERING-OBJECT>
                    <AUTOSAR-ENGINEERING-OBJECT>
                      <SHORT-LABEL>Autosar::include::CanSM_Trace_Internal.h</SHORT-LABEL>
                      <CATEGORY>SWHDR</CATEGORY>
                    </AUTOSAR-ENGINEERING-OBJECT>
                    <AUTOSAR-ENGINEERING-OBJECT>
                      <SHORT-LABEL>Autosar::include::CanSM_TxTimeoutException.h</SHORT-LABEL>
                      <CATEGORY>SWHDR</CATEGORY>
                    </AUTOSAR-ENGINEERING-OBJECT>
                    <AUTOSAR-ENGINEERING-OBJECT>
                      <SHORT-LABEL>Autosar::include::CanSM_Version.h</SHORT-LABEL>
                      <CATEGORY>SWHDR</CATEGORY>
                    </AUTOSAR-ENGINEERING-OBJECT>
                    <AUTOSAR-ENGINEERING-OBJECT>
                      <SHORT-LABEL>Autosar::src::CanSM.c</SHORT-LABEL>
                      <CATEGORY>SWSRC</CATEGORY>
                    </AUTOSAR-ENGINEERING-OBJECT>
                    <AUTOSAR-ENGINEERING-OBJECT>
                      <SHORT-LABEL>Autosar::src::CanSM_Cbk.c</SHORT-LABEL>
                      <CATEGORY>SWSRC</CATEGORY>
                    </AUTOSAR-ENGINEERING-OBJECT>
                    <AUTOSAR-ENGINEERING-OBJECT>
                      <SHORT-LABEL>Autosar::src::CanSM_GetCurrentComMode.c</SHORT-LABEL>
                      <CATEGORY>SWSRC</CATEGORY>
                    </AUTOSAR-ENGINEERING-OBJECT>
                    <AUTOSAR-ENGINEERING-OBJECT>
                      <SHORT-LABEL>Autosar::src::CanSM_GetVersionInfo.c</SHORT-LABEL>
                      <CATEGORY>SWSRC</CATEGORY>
                    </AUTOSAR-ENGINEERING-OBJECT>
                    <AUTOSAR-ENGINEERING-OBJECT>
                      <SHORT-LABEL>Autosar::src::CanSM_Init.c</SHORT-LABEL>
                      <CATEGORY>SWSRC</CATEGORY>
                    </AUTOSAR-ENGINEERING-OBJECT>
                    <AUTOSAR-ENGINEERING-OBJECT>
                      <SHORT-LABEL>Autosar::src::CanSM_MainFunction.c</SHORT-LABEL>
                      <CATEGORY>SWSRC</CATEGORY>
                    </AUTOSAR-ENGINEERING-OBJECT>
                    <AUTOSAR-ENGINEERING-OBJECT>
                      <SHORT-LABEL>Autosar::src::CanSM_Merged.c</SHORT-LABEL>
                      <CATEGORY>SWSRC</CATEGORY>
                    </AUTOSAR-ENGINEERING-OBJECT>
                    <AUTOSAR-ENGINEERING-OBJECT>
                      <SHORT-LABEL>Autosar::src::CanSM_RequestComMode.c</SHORT-LABEL>
                      <CATEGORY>SWSRC</CATEGORY>
                    </AUTOSAR-ENGINEERING-OBJECT>
                    <AUTOSAR-ENGINEERING-OBJECT>
                      <SHORT-LABEL>Autosar::src::CanSM_SetBaudrate.c</SHORT-LABEL>
                      <CATEGORY>SWSRC</CATEGORY>
                    </AUTOSAR-ENGINEERING-OBJECT>
                    <AUTOSAR-ENGINEERING-OBJECT>
                      <SHORT-LABEL>Autosar::src::CanSM_StateMachine.c</SHORT-LABEL>
                      <CATEGORY>SWSRC</CATEGORY>
                    </AUTOSAR-ENGINEERING-OBJECT>
                    <AUTOSAR-ENGINEERING-OBJECT>
                      <SHORT-LABEL>make::CanSM_defs.mak</SHORT-LABEL>
                      <CATEGORY>SWMAKE</CATEGORY>
                    </AUTOSAR-ENGINEERING-OBJECT>
                    <AUTOSAR-ENGINEERING-OBJECT>
                      <SHORT-LABEL>make::CanSM_rules.mak</SHORT-LABEL>
                      <CATEGORY>SWMAKE</CATEGORY>
                    </AUTOSAR-ENGINEERING-OBJECT>
                  </ARTIFACT-DESCRIPTORS>
                </CODE>
              </CODE-DESCRIPTORS>
              <PROGRAMMING-LANGUAGE>C</PROGRAMMING-LANGUAGE>
              <RESOURCE-CONSUMPTION>
                <SHORT-NAME>ResourceConsumption_[!"$PartitionName"!]</SHORT-NAME>
                <MEMORY-SECTIONS>
                  <MEMORY-SECTION>
                    <SHORT-NAME>CODE</SHORT-NAME>
                    <SW-ADDRMETHOD-REF DEST="SW-ADDR-METHOD">/AUTOSAR_MemMap/SwAddrMethods/CODE</SW-ADDRMETHOD-REF>
                  </MEMORY-SECTION>
                </MEMORY-SECTIONS>
              </RESOURCE-CONSUMPTION>
              <SW-VERSION>3.7.13</SW-VERSION>
              <VENDOR-ID>1</VENDOR-ID>
              <AR-RELEASE-VERSION>4.0.3</AR-RELEASE-VERSION>
              <BEHAVIOR-REF DEST="BSW-INTERNAL-BEHAVIOR">/AUTOSAR_CanSM/BswModuleDescriptions/CanSM/InternalBehavior_[!"$PartitionName"!]</BEHAVIOR-REF>
              <VENDOR-API-INFIX>[!"$PartitionName"!]</VENDOR-API-INFIX>
              <VENDOR-SPECIFIC-MODULE-DEF-REFS>
                <VENDOR-SPECIFIC-MODULE-DEF-REF DEST="ECUC-MODULE-DEF">/TS_TxDxM3I7R0/CanSM</VENDOR-SPECIFIC-MODULE-DEF-REF>
              </VENDOR-SPECIFIC-MODULE-DEF-REFS>
            </BSW-IMPLEMENTATION>
            [!ENDIF!]
          [!ENDIF!]
        [!ENDLOOP!]
      [!ENDLOOP!][!//Partitions loop
    [!ENDIF!]
  [!ENDIF!]
[!ENDIF!]
          </ELEMENTS>
        </AR-PACKAGE>
      </AR-PACKAGES>
    </AR-PACKAGE>
  </AR-PACKAGES>
</AUTOSAR>
