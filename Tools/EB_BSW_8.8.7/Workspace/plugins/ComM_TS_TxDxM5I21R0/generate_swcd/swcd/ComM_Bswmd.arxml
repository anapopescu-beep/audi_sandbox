[part 1 of 2]
<?xml version="1.0" encoding="ISO-8859-1"?>
[!AUTOSPACING!][!//
<AUTOSAR
  xmlns="http://autosar.org/schema/r4.0"
  xmlns:xsi="http://www.w3.org/2001/XMLSchema-instance"
  xsi:schemaLocation="http://autosar.org/schema/r4.0 AUTOSAR_4-2-1_STRICT_COMPACT.xsd">
[!IF "not(node:exists(as:modconf('ComM')[1]/ComMConfigSet/*[1]))"!][!//
[!ERROR "Configuration not exist!"!][!//
[!ENDIF!][!//
[!INCLUDE "ComM_Functions.m"!][!//
[!INCLUDE "ComM_Checks.m"!]
[!IF "as:modconf('ComM')[1]/ComMGeneral/ComMPncSupport = 'true'"!]
[!IF "as:modconf('ComM')[1]/ComMGeneral/ComMMultiCoreSupport='true'"!]
[!CALL "GetMasterCoreId"!][!//
[!CALL "GetUsedCores"!][!//
[!ENDIF!]
[!CALL "GetPnInfoLength"!][!//
[!ENDIF!]
[!IF "ComMGeneral/ComMServiceAPI/ComMDefaultASRServiceAPI = 'AUTOSAR_32'"!][!//
[!VAR "bswModuleEntryPackageName" = "'SwServices'"!][!//
[!VAR "swComponentTypePackageName" = "'ComponentTypes'"!][!//
[!ELSE!][!//
[!VAR "bswModuleEntryPackageName" = "'BswModuleEntrys'"!][!//
[!VAR "swComponentTypePackageName" = "'SwComponentTypes'"!][!//
[!ENDIF!][!//
[!CALL "GetUsedUserPlusChannelPlusMasterPncPlusInhibitionOsApplications"!][!//
[!IF "(count(text:split($FoundUserPlusChannePlusMasterPncPlusInhibitionOsApplications,' ')) > 1) and (as:modconf('ComM')[1]/ComMGeneral/ComMMultiCoreSupport = 'false')"!]
[!IF "num:i(count(as:modconf('ComM')[1]/ComMConfigSet/*[1]/ComMUser/*)) > 0"!]
  [!CALL "GetUsedUserOsApplications"!]
  [!IF "(as:modconf('ComM')[1]/ComMGeneral/ComMRteUsage = 'true') or (as:modconf('ComM')[1]/ComMGeneral/ComMModeLimitationEnabled = 'true')"!]  
    [!CALL "GetChToUser_FromOsAppToOsAppList"!]
  [!ENDIF!] [!/*[!IF "(as:modconf('ComM')[1]/ComMGeneral/ComMRteUsage = 'true') or (as:modconf('ComM')[1]/ComMGeneral/ComMModeLimitationEnabled = 'true')"!]*/!]
  [!CALL "GetUserToCh_FromOsAppToOsAppList"!]
[!ENDIF!] [!/*[!IF "num:i(count(as:modconf('ComM')[1]/ComMConfigSet/*[1]/ComMUser/*)) > 0"!]*/!]
[!IF "as:modconf('ComM')[1]/ComMGeneral/ComMPncSupport = 'true'"!]
  [!CALL "GetMasterPncOsApplication"!]
  [!CALL "GetUsedSignalsPlusMasterPncOsApplications"!]
  [!CALL "GetChToMasterPnc_FromOsAppToOsAppList"!]
  [!CALL "GetMasterPncToCh_FromOsAppToOsAppList"!]
  [!IF "num:i(count(as:modconf('ComM')[1]/ComMConfigSet/*[1]/ComMUser/*)) > 0"!]
    [!CALL "GetUserToMasterPnc_FromOsAppToOsAppList"!]
  [!ENDIF!] [!/*[!IF "num:i(count(as:modconf('ComM')[1]/ComMConfigSet/*[1]/ComMUser/*)) > 0"!]*/!]
[!ENDIF!] [!/*[!IF "as:modconf('ComM')[1]/ComMGeneral/ComMPncSupport = 'true'"!]*/!]
[!IF "(as:modconf('ComM')[1]/ComMGeneral/ComMModeLimitationEnabled = 'true') or (as:modconf('ComM')[1]/ComMGeneral/ComMWakeupInhibitionEnabled = 'true')"!]
  [!CALL "GetInhibitionOsApplication"!]
  [!CALL "GetInhibitionToCh_FromOsAppToOsAppList"!]
  [!CALL "GetChToInhibition_FromOsAppToOsAppList"!]
  [!IF "num:i(count(as:modconf('ComM')[1]/ComMConfigSet/*[1]/ComMUser/*)) > 0"!]
    [!CALL "GetUserToInhibition_FromOsAppToOsAppList"!]
  [!ENDIF!][!/*[!IF "num:i(count(as:modconf('ComM')[1]/ComMConfigSet/*[1]/ComMUser/*)) > 0"!]*/!]
[!ENDIF!] [!/*[!IF "(as:modconf('ComM')[1]/ComMGeneral/ComMModeLimitationEnabled = 'true') or (as:modconf('ComM')[1]/ComMGeneral/ComMWakeupInhibitionEnabled = 'true')"!]*/!]  
[!CALL "GetUsedChannelsOsApplications"!]
[!CALL "GetChToCh_FromOsAppToOsAppList"!]
[!IF "node:exists(as:modconf('ComM')[1]/ComMGeneral/ComMSynchronizedPncShutdownEnabled) and (as:modconf('ComM')[1]/ComMGeneral/ComMSynchronizedPncShutdownEnabled = 'true')"!]
  [!CALL "GetSynchShutDownChToMasterPnc_FromOsAppToOsAppList"!]
[!ENDIF!] [!/*[!IF "node:exists(as:modconf('ComM')[1]/ComMGeneral/ComMSynchronizedPncShutdownEnabled) and (as:modconf('ComM')[1]/ComMGeneral/ComMSynchronizedPncShutdownEnabled = 'true')"!]*/!]
  <AR-PACKAGES>
    <AR-PACKAGE>
      <SHORT-NAME>AUTOSAR_ComM</SHORT-NAME>
      <AR-PACKAGES>
        <AR-PACKAGE> <!-- ImplementationDataTypes -->
          <SHORT-NAME>ImplementationDataTypes</SHORT-NAME>
          <ELEMENTS>
[!IF "as:modconf('ComM')[1]/ComMGeneral/ComMPncSupport = 'true'"!]
            <IMPLEMENTATION-DATA-TYPE>
              <SHORT-NAME>ComM_PnInfoArray</SHORT-NAME>
              <CATEGORY>ARRAY</CATEGORY>
              <SUB-ELEMENTS>
                <IMPLEMENTATION-DATA-TYPE-ELEMENT>
                  <SHORT-NAME>ComM_PnInfoArray</SHORT-NAME>
                  <CATEGORY>TYPE_REFERENCE</CATEGORY>
                  <ARRAY-SIZE>[!"$PnInfoLength"!]</ARRAY-SIZE>
                  <ARRAY-SIZE-SEMANTICS>FIXED-SIZE</ARRAY-SIZE-SEMANTICS>
                  <SW-DATA-DEF-PROPS>
                    <SW-DATA-DEF-PROPS-VARIANTS>
                      <SW-DATA-DEF-PROPS-CONDITIONAL>
                        <IMPLEMENTATION-DATA-TYPE-REF DEST="IMPLEMENTATION-DATA-TYPE">/AUTOSAR_Platform/ImplementationDataTypes/uint8</IMPLEMENTATION-DATA-TYPE-REF>
                      </SW-DATA-DEF-PROPS-CONDITIONAL>
                    </SW-DATA-DEF-PROPS-VARIANTS>
                  </SW-DATA-DEF-PROPS>
                </IMPLEMENTATION-DATA-TYPE-ELEMENT>
              </SUB-ELEMENTS>
            </IMPLEMENTATION-DATA-TYPE>
[!ENDIF!] [!/*[!IF "as:modconf('ComM')[1]/ComMGeneral/ComMPncSupport = 'true'"!]*/!]
            <IMPLEMENTATION-DATA-TYPE>
              <SHORT-NAME>ComM_Ch_To_Ch_DataType</SHORT-NAME>
              <CATEGORY>STRUCTURE</CATEGORY>
              <SUB-ELEMENTS>
                <IMPLEMENTATION-DATA-TYPE-ELEMENT>
                  <SHORT-NAME>Channel</SHORT-NAME>
                  <CATEGORY>TYPE_REFERENCE</CATEGORY>
                  <SW-DATA-DEF-PROPS>
                    <SW-DATA-DEF-PROPS-VARIANTS>
                      <SW-DATA-DEF-PROPS-CONDITIONAL>
                        <IMPLEMENTATION-DATA-TYPE-REF DEST="IMPLEMENTATION-DATA-TYPE">/AUTOSAR_Platform/ImplementationDataTypes/uint8</IMPLEMENTATION-DATA-TYPE-REF>
                      </SW-DATA-DEF-PROPS-CONDITIONAL>
                    </SW-DATA-DEF-PROPS-VARIANTS>
                  </SW-DATA-DEF-PROPS>
                </IMPLEMENTATION-DATA-TYPE-ELEMENT>
                <IMPLEMENTATION-DATA-TYPE-ELEMENT>
                  <SHORT-NAME>Operation</SHORT-NAME>
                  <CATEGORY>TYPE_REFERENCE</CATEGORY>
                  <SW-DATA-DEF-PROPS>
                    <SW-DATA-DEF-PROPS-VARIANTS>
                      <SW-DATA-DEF-PROPS-CONDITIONAL>
                        <IMPLEMENTATION-DATA-TYPE-REF DEST="IMPLEMENTATION-DATA-TYPE">/AUTOSAR_Platform/ImplementationDataTypes/uint8</IMPLEMENTATION-DATA-TYPE-REF>
                      </SW-DATA-DEF-PROPS-CONDITIONAL>
                    </SW-DATA-DEF-PROPS-VARIANTS>
                  </SW-DATA-DEF-PROPS>
                </IMPLEMENTATION-DATA-TYPE-ELEMENT>
              </SUB-ELEMENTS>
            </IMPLEMENTATION-DATA-TYPE>

            <IMPLEMENTATION-DATA-TYPE>
              <SHORT-NAME>ComM_Ch_To_User_DataType</SHORT-NAME>
              <CATEGORY>STRUCTURE</CATEGORY>
              <SUB-ELEMENTS>
                <IMPLEMENTATION-DATA-TYPE-ELEMENT>
                  <SHORT-NAME>User</SHORT-NAME>
                  <CATEGORY>TYPE_REFERENCE</CATEGORY>
                  <SW-DATA-DEF-PROPS>
                    <SW-DATA-DEF-PROPS-VARIANTS>
                      <SW-DATA-DEF-PROPS-CONDITIONAL>
                        <IMPLEMENTATION-DATA-TYPE-REF DEST="IMPLEMENTATION-DATA-TYPE">/AUTOSAR_Platform/ImplementationDataTypes/uint8</IMPLEMENTATION-DATA-TYPE-REF>
                      </SW-DATA-DEF-PROPS-CONDITIONAL>
                    </SW-DATA-DEF-PROPS-VARIANTS>
                  </SW-DATA-DEF-PROPS>
                </IMPLEMENTATION-DATA-TYPE-ELEMENT>
                <IMPLEMENTATION-DATA-TYPE-ELEMENT>
                  <SHORT-NAME>ComMode</SHORT-NAME>
                  <CATEGORY>TYPE_REFERENCE</CATEGORY>
                  <SW-DATA-DEF-PROPS>
                    <SW-DATA-DEF-PROPS-VARIANTS>
                      <SW-DATA-DEF-PROPS-CONDITIONAL>
                        <IMPLEMENTATION-DATA-TYPE-REF DEST="IMPLEMENTATION-DATA-TYPE">/AUTOSAR_Platform/ImplementationDataTypes/uint8</IMPLEMENTATION-DATA-TYPE-REF>
                      </SW-DATA-DEF-PROPS-CONDITIONAL>
                    </SW-DATA-DEF-PROPS-VARIANTS>
                  </SW-DATA-DEF-PROPS>
                </IMPLEMENTATION-DATA-TYPE-ELEMENT>                
                <IMPLEMENTATION-DATA-TYPE-ELEMENT>
                  <SHORT-NAME>Operation</SHORT-NAME>
                  <CATEGORY>TYPE_REFERENCE</CATEGORY>
                  <SW-DATA-DEF-PROPS>
                    <SW-DATA-DEF-PROPS-VARIANTS>
                      <SW-DATA-DEF-PROPS-CONDITIONAL>
                        <IMPLEMENTATION-DATA-TYPE-REF DEST="IMPLEMENTATION-DATA-TYPE">/AUTOSAR_Platform/ImplementationDataTypes/uint8</IMPLEMENTATION-DATA-TYPE-REF>
                      </SW-DATA-DEF-PROPS-CONDITIONAL>
                    </SW-DATA-DEF-PROPS-VARIANTS>
                  </SW-DATA-DEF-PROPS>
                </IMPLEMENTATION-DATA-TYPE-ELEMENT>
              </SUB-ELEMENTS>
            </IMPLEMENTATION-DATA-TYPE>            
            
            
            <IMPLEMENTATION-DATA-TYPE>
              <SHORT-NAME>ComM_Ch_To_MasterPnc_DataType</SHORT-NAME>
              <CATEGORY>STRUCTURE</CATEGORY>
              <SUB-ELEMENTS>
                <IMPLEMENTATION-DATA-TYPE-ELEMENT>
                  <SHORT-NAME>Operation</SHORT-NAME>
                  <CATEGORY>TYPE_REFERENCE</CATEGORY>
                  <SW-DATA-DEF-PROPS>
                    <SW-DATA-DEF-PROPS-VARIANTS>
                      <SW-DATA-DEF-PROPS-CONDITIONAL>
                        <IMPLEMENTATION-DATA-TYPE-REF DEST="IMPLEMENTATION-DATA-TYPE">/AUTOSAR_Platform/ImplementationDataTypes/uint8</IMPLEMENTATION-DATA-TYPE-REF>
                      </SW-DATA-DEF-PROPS-CONDITIONAL>
                    </SW-DATA-DEF-PROPS-VARIANTS>
                  </SW-DATA-DEF-PROPS>
                </IMPLEMENTATION-DATA-TYPE-ELEMENT>
              </SUB-ELEMENTS>
            </IMPLEMENTATION-DATA-TYPE>            
            
            
            <IMPLEMENTATION-DATA-TYPE>
              <SHORT-NAME>ComM_Inhibition_To_Ch_DataType</SHORT-NAME>
              <CATEGORY>STRUCTURE</CATEGORY>
              <SUB-ELEMENTS>
                <IMPLEMENTATION-DATA-TYPE-ELEMENT>
                  <SHORT-NAME>Channel</SHORT-NAME>
                  <CATEGORY>TYPE_REFERENCE</CATEGORY>
                  <SW-DATA-DEF-PROPS>
                    <SW-DATA-DEF-PROPS-VARIANTS>
                      <SW-DATA-DEF-PROPS-CONDITIONAL>
                        <IMPLEMENTATION-DATA-TYPE-REF DEST="IMPLEMENTATION-DATA-TYPE">/AUTOSAR_Platform/ImplementationDataTypes/uint8</IMPLEMENTATION-DATA-TYPE-REF>
                      </SW-DATA-DEF-PROPS-CONDITIONAL>
                    </SW-DATA-DEF-PROPS-VARIANTS>
                  </SW-DATA-DEF-PROPS>
                </IMPLEMENTATION-DATA-TYPE-ELEMENT>
                <IMPLEMENTATION-DATA-TYPE-ELEMENT>
                  <SHORT-NAME>Operation</SHORT-NAME>
                  <CATEGORY>TYPE_REFERENCE</CATEGORY>
                  <SW-DATA-DEF-PROPS>
                    <SW-DATA-DEF-PROPS-VARIANTS>
                      <SW-DATA-DEF-PROPS-CONDITIONAL>
                        <IMPLEMENTATION-DATA-TYPE-REF DEST="IMPLEMENTATION-DATA-TYPE">/AUTOSAR_Platform/ImplementationDataTypes/uint8</IMPLEMENTATION-DATA-TYPE-REF>
                      </SW-DATA-DEF-PROPS-CONDITIONAL>
                    </SW-DATA-DEF-PROPS-VARIANTS>
                  </SW-DATA-DEF-PROPS>
                </IMPLEMENTATION-DATA-TYPE-ELEMENT>
              </SUB-ELEMENTS>
            </IMPLEMENTATION-DATA-TYPE>                        
			
            <IMPLEMENTATION-DATA-TYPE>
              <SHORT-NAME>ComM_Ch_To_Inhibition_DataType</SHORT-NAME>
              <CATEGORY>STRUCTURE</CATEGORY>
              <SUB-ELEMENTS>
                <IMPLEMENTATION-DATA-TYPE-ELEMENT>
                  <SHORT-NAME>Channel</SHORT-NAME>
                  <CATEGORY>TYPE_REFERENCE</CATEGORY>
                  <SW-DATA-DEF-PROPS>
                    <SW-DATA-DEF-PROPS-VARIANTS>
                      <SW-DATA-DEF-PROPS-CONDITIONAL>
                        <IMPLEMENTATION-DATA-TYPE-REF DEST="IMPLEMENTATION-DATA-TYPE">/AUTOSAR_Platform/ImplementationDataTypes/uint8</IMPLEMENTATION-DATA-TYPE-REF>
                      </SW-DATA-DEF-PROPS-CONDITIONAL>
                    </SW-DATA-DEF-PROPS-VARIANTS>
                  </SW-DATA-DEF-PROPS>
                </IMPLEMENTATION-DATA-TYPE-ELEMENT>
                <IMPLEMENTATION-DATA-TYPE-ELEMENT>
                  <SHORT-NAME>Operation</SHORT-NAME>
                  <CATEGORY>TYPE_REFERENCE</CATEGORY>
                  <SW-DATA-DEF-PROPS>
                    <SW-DATA-DEF-PROPS-VARIANTS>
                      <SW-DATA-DEF-PROPS-CONDITIONAL>
                        <IMPLEMENTATION-DATA-TYPE-REF DEST="IMPLEMENTATION-DATA-TYPE">/AUTOSAR_Platform/ImplementationDataTypes/uint8</IMPLEMENTATION-DATA-TYPE-REF>
                      </SW-DATA-DEF-PROPS-CONDITIONAL>
                    </SW-DATA-DEF-PROPS-VARIANTS>
                  </SW-DATA-DEF-PROPS>
                </IMPLEMENTATION-DATA-TYPE-ELEMENT>
              </SUB-ELEMENTS>
            </IMPLEMENTATION-DATA-TYPE>                        			

            <IMPLEMENTATION-DATA-TYPE>
              <SHORT-NAME>ComM_MasterPnc_To_Ch_DataType</SHORT-NAME>
              <CATEGORY>STRUCTURE</CATEGORY>
              <SUB-ELEMENTS>
[!IF "node:exists(as:modconf('ComM')[1]/ComMGeneral/ComMSynchronizedPncShutdownEnabled) and
      (as:modconf('ComM')[1]/ComMGeneral/ComMSynchronizedPncShutdownEnabled = 'true')"!]
                <IMPLEMENTATION-DATA-TYPE-ELEMENT>
                  <SHORT-NAME>PncId</SHORT-NAME>
                  <CATEGORY>TYPE_REFERENCE</CATEGORY>
                  <SW-DATA-DEF-PROPS>
                    <SW-DATA-DEF-PROPS-VARIANTS>
                      <SW-DATA-DEF-PROPS-CONDITIONAL>
                        <IMPLEMENTATION-DATA-TYPE-REF DEST="IMPLEMENTATION-DATA-TYPE">/AUTOSAR_ComStack_Types/ImplementationDataTypes/PNCHandleType</IMPLEMENTATION-DATA-TYPE-REF>
                      </SW-DATA-DEF-PROPS-CONDITIONAL>
                    </SW-DATA-DEF-PROPS-VARIANTS>
                  </SW-DATA-DEF-PROPS>
                </IMPLEMENTATION-DATA-TYPE-ELEMENT>                              
[!ENDIF!] [!/*[!IF "node:exists(as:modconf('ComM')[1]/ComMGeneral/ComMSynchronizedPncShutdownEnabled) and
             *      (as:modconf('ComM')[1]/ComMGeneral/ComMSynchronizedPncShutdownEnabled = 'true')"!]
             */!]                  
                <IMPLEMENTATION-DATA-TYPE-ELEMENT>
                  <SHORT-NAME>Channel</SHORT-NAME>
                  <CATEGORY>TYPE_REFERENCE</CATEGORY>
                  <SW-DATA-DEF-PROPS>
                    <SW-DATA-DEF-PROPS-VARIANTS>
                      <SW-DATA-DEF-PROPS-CONDITIONAL>
                        <IMPLEMENTATION-DATA-TYPE-REF DEST="IMPLEMENTATION-DATA-TYPE">/AUTOSAR_Platform/ImplementationDataTypes/uint8</IMPLEMENTATION-DATA-TYPE-REF>
                      </SW-DATA-DEF-PROPS-CONDITIONAL>
                    </SW-DATA-DEF-PROPS-VARIANTS>
                  </SW-DATA-DEF-PROPS>
                </IMPLEMENTATION-DATA-TYPE-ELEMENT>
                <IMPLEMENTATION-DATA-TYPE-ELEMENT>
                  <SHORT-NAME>Operation</SHORT-NAME>
                  <CATEGORY>TYPE_REFERENCE</CATEGORY>
                  <SW-DATA-DEF-PROPS>
                    <SW-DATA-DEF-PROPS-VARIANTS>
                      <SW-DATA-DEF-PROPS-CONDITIONAL>
                        <IMPLEMENTATION-DATA-TYPE-REF DEST="IMPLEMENTATION-DATA-TYPE">/AUTOSAR_Platform/ImplementationDataTypes/uint8</IMPLEMENTATION-DATA-TYPE-REF>
                      </SW-DATA-DEF-PROPS-CONDITIONAL>
                    </SW-DATA-DEF-PROPS-VARIANTS>
                  </SW-DATA-DEF-PROPS>
                </IMPLEMENTATION-DATA-TYPE-ELEMENT>
              </SUB-ELEMENTS>
            </IMPLEMENTATION-DATA-TYPE>
            
            <IMPLEMENTATION-DATA-TYPE>
              <SHORT-NAME>ComM_User_To_Ch_DataType</SHORT-NAME>
              <CATEGORY>STRUCTURE</CATEGORY>
              <SUB-ELEMENTS>
                <IMPLEMENTATION-DATA-TYPE-ELEMENT>
                  <SHORT-NAME>Channel</SHORT-NAME>
                  <CATEGORY>TYPE_REFERENCE</CATEGORY>
                  <SW-DATA-DEF-PROPS>
                    <SW-DATA-DEF-PROPS-VARIANTS>
                      <SW-DATA-DEF-PROPS-CONDITIONAL>
                        <IMPLEMENTATION-DATA-TYPE-REF DEST="IMPLEMENTATION-DATA-TYPE">/AUTOSAR_Platform/ImplementationDataTypes/uint8</IMPLEMENTATION-DATA-TYPE-REF>
                      </SW-DATA-DEF-PROPS-CONDITIONAL>
                    </SW-DATA-DEF-PROPS-VARIANTS>
                  </SW-DATA-DEF-PROPS>
                </IMPLEMENTATION-DATA-TYPE-ELEMENT>
                <IMPLEMENTATION-DATA-TYPE-ELEMENT>
                  <SHORT-NAME>Operation</SHORT-NAME>
                  <CATEGORY>TYPE_REFERENCE</CATEGORY>
                  <SW-DATA-DEF-PROPS>
                    <SW-DATA-DEF-PROPS-VARIANTS>
                      <SW-DATA-DEF-PROPS-CONDITIONAL>
                        <IMPLEMENTATION-DATA-TYPE-REF DEST="IMPLEMENTATION-DATA-TYPE">/AUTOSAR_Platform/ImplementationDataTypes/uint8</IMPLEMENTATION-DATA-TYPE-REF>
                      </SW-DATA-DEF-PROPS-CONDITIONAL>
                    </SW-DATA-DEF-PROPS-VARIANTS>
                  </SW-DATA-DEF-PROPS>
                </IMPLEMENTATION-DATA-TYPE-ELEMENT>
              </SUB-ELEMENTS>
            </IMPLEMENTATION-DATA-TYPE>
            <IMPLEMENTATION-DATA-TYPE>
              <SHORT-NAME>ComM_User_To_MasterPnc_DataType</SHORT-NAME>
              <CATEGORY>STRUCTURE</CATEGORY>
              <SUB-ELEMENTS>
                <IMPLEMENTATION-DATA-TYPE-ELEMENT>
                  <SHORT-NAME>User</SHORT-NAME>
                  <CATEGORY>TYPE_REFERENCE</CATEGORY>
                  <SW-DATA-DEF-PROPS>
                    <SW-DATA-DEF-PROPS-VARIANTS>
                      <SW-DATA-DEF-PROPS-CONDITIONAL>
                        <IMPLEMENTATION-DATA-TYPE-REF DEST="IMPLEMENTATION-DATA-TYPE">/AUTOSAR_Platform/ImplementationDataTypes/uint8</IMPLEMENTATION-DATA-TYPE-REF>
                      </SW-DATA-DEF-PROPS-CONDITIONAL>
                    </SW-DATA-DEF-PROPS-VARIANTS>
                  </SW-DATA-DEF-PROPS>
                </IMPLEMENTATION-DATA-TYPE-ELEMENT>
                <IMPLEMENTATION-DATA-TYPE-ELEMENT>
                  <SHORT-NAME>Operation</SHORT-NAME>
                  <CATEGORY>TYPE_REFERENCE</CATEGORY>
                  <SW-DATA-DEF-PROPS>
                    <SW-DATA-DEF-PROPS-VARIANTS>
                      <SW-DATA-DEF-PROPS-CONDITIONAL>
                        <IMPLEMENTATION-DATA-TYPE-REF DEST="IMPLEMENTATION-DATA-TYPE">/AUTOSAR_Platform/ImplementationDataTypes/uint8</IMPLEMENTATION-DATA-TYPE-REF>
                      </SW-DATA-DEF-PROPS-CONDITIONAL>
                    </SW-DATA-DEF-PROPS-VARIANTS>
                  </SW-DATA-DEF-PROPS>
                </IMPLEMENTATION-DATA-TYPE-ELEMENT>
                <IMPLEMENTATION-DATA-TYPE-ELEMENT>
                  <SHORT-NAME>ComMode</SHORT-NAME>
                  <CATEGORY>TYPE_REFERENCE</CATEGORY>
                  <SW-DATA-DEF-PROPS>
                    <SW-DATA-DEF-PROPS-VARIANTS>
                      <SW-DATA-DEF-PROPS-CONDITIONAL>
                        <IMPLEMENTATION-DATA-TYPE-REF DEST="IMPLEMENTATION-DATA-TYPE">/AUTOSAR_Platform/ImplementationDataTypes/uint8</IMPLEMENTATION-DATA-TYPE-REF>
                      </SW-DATA-DEF-PROPS-CONDITIONAL>
                    </SW-DATA-DEF-PROPS-VARIANTS>
                  </SW-DATA-DEF-PROPS>
                </IMPLEMENTATION-DATA-TYPE-ELEMENT>                
              </SUB-ELEMENTS>
            </IMPLEMENTATION-DATA-TYPE>            

[!IF "node:exists(as:modconf('ComM')[1]/ComMGeneral/ComMSynchronizedPncShutdownEnabled) and (as:modconf('ComM')[1]/ComMGeneral/ComMSynchronizedPncShutdownEnabled = 'true')"!]
            <IMPLEMENTATION-DATA-TYPE>
              <SHORT-NAME>ComM_SynchShutDownCh_To_MasterPnc_DataType</SHORT-NAME>
              <CATEGORY>STRUCTURE</CATEGORY>
              <SUB-ELEMENTS>
                <IMPLEMENTATION-DATA-TYPE-ELEMENT>
                  <SHORT-NAME>PnInfo</SHORT-NAME>
                  <CATEGORY>TYPE_REFERENCE</CATEGORY>
                  <SW-DATA-DEF-PROPS>
                    <SW-DATA-DEF-PROPS-VARIANTS>
                      <SW-DATA-DEF-PROPS-CONDITIONAL>
                        <IMPLEMENTATION-DATA-TYPE-REF DEST="IMPLEMENTATION-DATA-TYPE">/AUTOSAR_ComM/ImplementationDataTypes/ComM_PnInfoArray</IMPLEMENTATION-DATA-TYPE-REF>
                      </SW-DATA-DEF-PROPS-CONDITIONAL>
                    </SW-DATA-DEF-PROPS-VARIANTS>
                  </SW-DATA-DEF-PROPS>
                </IMPLEMENTATION-DATA-TYPE-ELEMENT>
              </SUB-ELEMENTS>
            </IMPLEMENTATION-DATA-TYPE>            
[!ENDIF!] [!/*[!IF "node:exists(as:modconf('ComM')[1]/ComMGeneral/ComMSynchronizedPncShutdownEnabled) and (as:modconf('ComM')[1]/ComMGeneral/ComMSynchronizedPncShutdownEnabled = 'true')"!]*/!]            
          </ELEMENTS>
        </AR-PACKAGE> <!-- ImplementationDataTypes -->

        <AR-PACKAGE>
          <SHORT-NAME>BswModuleDescriptions</SHORT-NAME>
          <ELEMENTS>
            <BSW-MODULE-DESCRIPTION>
              <SHORT-NAME>ComM</SHORT-NAME>
              <MODULE-ID>12</MODULE-ID>
              <PROVIDED-ENTRYS>
[!LOOP "ComMConfigSet/*[1]/ComMChannel/*"!]
                <BSW-MODULE-ENTRY-REF-CONDITIONAL>
                  <BSW-MODULE-ENTRY-REF DEST="BSW-MODULE-ENTRY">/AUTOSAR_ComM/BswModuleEntrys/ComM_MainFunction_[!"ComMChannelId"!]</BSW-MODULE-ENTRY-REF>
                </BSW-MODULE-ENTRY-REF-CONDITIONAL>
[!ENDLOOP!] [!/* [!LOOP "ComMConfigSet/*[1]/ComMChannel/*"!] */!]
 
[!IF "(as:modconf('ComM')[1]/ComMGeneral/ComMModeLimitationEnabled = 'true') or (as:modconf('ComM')[1]/ComMGeneral/ComMWakeupInhibitionEnabled = 'true')"!]
  [!IF "num:i(count(as:modconf('ComM')[1]/ComMConfigSet/*[1]/ComMUser/*)) > 0"!]
    [!FOR "Idx1" = "1" TO "count(text:split($UserToInhibitionFromOsApp_ToOsApp,' '))"!]
      [!VAR "FromOsApplicationToOsApplication" = "string(text:split($UserToInhibitionFromOsApp_ToOsApp,' ')[position() = $Idx1])"!]
      [!VAR "FromOsApplication" = "string(text:split($FromOsApplicationToOsApplication,'->')[position() = 1])"!]
      [!VAR "ToOsApplication" = "string(text:split($FromOsApplicationToOsApplication,'->')[position() = 2])"!]            
                <BSW-MODULE-ENTRY-REF-CONDITIONAL>
                  <BSW-MODULE-ENTRY-REF DEST="BSW-MODULE-ENTRY">/AUTOSAR_ComM/BswModuleEntrys/ComM_User_To_Inhibition_From_[!"$FromOsApplication"!]_To_[!"$ToOsApplication"!]_RcvFnct</BSW-MODULE-ENTRY-REF>
                </BSW-MODULE-ENTRY-REF-CONDITIONAL>
    [!ENDFOR!] [!/*[!FOR "Idx1" = "1" TO "count(text:split($UserToInhibitionFromOsApp_ToOsApp,' '))"!]*/!]
                <BSW-MODULE-ENTRY-REF-CONDITIONAL>
                  <BSW-MODULE-ENTRY-REF DEST="BSW-MODULE-ENTRY">/AUTOSAR_ComM/BswModuleEntrys/ComM_User_To_Inhibition_DataSntFnct</BSW-MODULE-ENTRY-REF>
                </BSW-MODULE-ENTRY-REF-CONDITIONAL>    
  [!ENDIF!] [!/*[!IF "num:i(count(as:modconf('ComM')[1]/ComMConfigSet/*[1]/ComMUser/*)) > 0"!]*/!]
  
  [!FOR "Idx1" = "1" TO "count(text:split($InhibitionToChFromOsApp_ToOsApp,' '))"!]
    [!VAR "FromOsApplicationToOsApplication" = "string(text:split($InhibitionToChFromOsApp_ToOsApp,' ')[position() = $Idx1])"!]
    [!VAR "FromOsApplication" = "string(text:split($FromOsApplicationToOsApplication,'->')[position() = 1])"!]
    [!VAR "ToOsApplication" = "string(text:split($FromOsApplicationToOsApplication,'->')[position() = 2])"!]
                <BSW-MODULE-ENTRY-REF-CONDITIONAL>
                  <BSW-MODULE-ENTRY-REF DEST="BSW-MODULE-ENTRY">/AUTOSAR_ComM/BswModuleEntrys/ComM_Inhibition_To_Ch_From_[!"$FromOsApplication"!]_To_[!"$ToOsApplication"!]_RcvFnct</BSW-MODULE-ENTRY-REF>
                </BSW-MODULE-ENTRY-REF-CONDITIONAL>
  [!ENDFOR!] [!/*[!FOR "Idx1" = "1" TO "count(text:split($InhibitionToChFromOsApp_ToOsApp,' '))"!]*/!]
                <BSW-MODULE-ENTRY-REF-CONDITIONAL>
                  <BSW-MODULE-ENTRY-REF DEST="BSW-MODULE-ENTRY">/AUTOSAR_ComM/BswModuleEntrys/ComM_Inhibition_To_Ch_DataSntFnct</BSW-MODULE-ENTRY-REF>
                </BSW-MODULE-ENTRY-REF-CONDITIONAL>

  [!FOR "Idx1" = "1" TO "count(text:split($ChToInhibitionFromOsApp_ToOsApp,' '))"!]
    [!VAR "FromOsApplicationToOsApplication" = "string(text:split($ChToInhibitionFromOsApp_ToOsApp,' ')[position() = $Idx1])"!]
    [!VAR "FromOsApplication" = "string(text:split($FromOsApplicationToOsApplication,'->')[position() = 1])"!]
    [!VAR "ToOsApplication" = "string(text:split($FromOsApplicationToOsApplication,'->')[position() = 2])"!]
                <BSW-MODULE-ENTRY-REF-CONDITIONAL>
                  <BSW-MODULE-ENTRY-REF DEST="BSW-MODULE-ENTRY">/AUTOSAR_ComM/BswModuleEntrys/ComM_Ch_To_Inhibition_From_[!"$FromOsApplication"!]_To_[!"$ToOsApplication"!]_RcvFnct</BSW-MODULE-ENTRY-REF>
                </BSW-MODULE-ENTRY-REF-CONDITIONAL>
  [!ENDFOR!] [!/*[!FOR "Idx1" = "1" TO "count(text:split($InhibitionToChFromOsApp_ToOsApp,' '))"!]*/!]
                <BSW-MODULE-ENTRY-REF-CONDITIONAL>
                  <BSW-MODULE-ENTRY-REF DEST="BSW-MODULE-ENTRY">/AUTOSAR_ComM/BswModuleEntrys/ComM_Ch_To_Inhibition_DataSntFnct</BSW-MODULE-ENTRY-REF>
                </BSW-MODULE-ENTRY-REF-CONDITIONAL>                    
				
[!ENDIF!] [!/*[!IF "(as:modconf('ComM')[1]/ComMGeneral/ComMModeLimitationEnabled = 'true') or (as:modconf('ComM')[1]/ComMGeneral/ComMWakeupInhibitionEnabled = 'true')"!]*/!]                
[!IF "num:i(count(as:modconf('ComM')[1]/ComMConfigSet/*[1]/ComMUser/*)) > 0"!]
  [!LOOP "as:modconf('ComM')[1]/ComMConfigSet/*[1]/ComMUser/*"!]
                <BSW-MODULE-ENTRY-REF-CONDITIONAL>
                  <BSW-MODULE-ENTRY-REF DEST="BSW-MODULE-ENTRY">/AUTOSAR_ComM/BswModuleEntrys/ComM_MainFunction_User_[!"ComMUserIdentifier"!]</BSW-MODULE-ENTRY-REF>
                </BSW-MODULE-ENTRY-REF-CONDITIONAL>
  [!ENDLOOP!] [!/*[!LOOP "as:modconf('ComM')[1]/ComMConfigSet/*[1]/ComMUser/*"!]*/!]
                <BSW-MODULE-ENTRY-REF-CONDITIONAL>
                  <BSW-MODULE-ENTRY-REF DEST="BSW-MODULE-ENTRY">/AUTOSAR_ComM/BswModuleEntrys/ComM_User_To_Ch_DataSntFnct</BSW-MODULE-ENTRY-REF>
                </BSW-MODULE-ENTRY-REF-CONDITIONAL>
  [!FOR "Idx1" = "1" TO "count(text:split($UserToChFromOsApp_ToOsApp,' '))"!]
    [!VAR "FromOsApplicationToOsApplication" = "string(text:split($UserToChFromOsApp_ToOsApp,' ')[position() = $Idx1])"!]
    [!VAR "FromOsApplication" = "string(text:split($FromOsApplicationToOsApplication,'->')[position() = 1])"!]
    [!VAR "ToOsApplication" = "string(text:split($FromOsApplicationToOsApplication,'->')[position() = 2])"!]
                <BSW-MODULE-ENTRY-REF-CONDITIONAL>
                  <BSW-MODULE-ENTRY-REF DEST="BSW-MODULE-ENTRY">/AUTOSAR_ComM/BswModuleEntrys/ComM_User_To_Ch_From_[!"$FromOsApplication"!]_To_[!"$ToOsApplication"!]_RcvFnct</BSW-MODULE-ENTRY-REF>
                </BSW-MODULE-ENTRY-REF-CONDITIONAL>
  [!ENDFOR!] [!/*[!FOR "Idx1" = "1" TO "count(text:split($FoundChannelsOsApplications,' '))"!]*/!]
  [!IF "as:modconf('ComM')[1]/ComMGeneral/ComMPncSupport = 'true'"!]
    [!IF "num:i(count(as:modconf('ComM')[1]/ComMConfigSet/*[1]/ComMUser/*)) > 0"!]
                <BSW-MODULE-ENTRY-REF-CONDITIONAL>
                  <BSW-MODULE-ENTRY-REF DEST="BSW-MODULE-ENTRY">/AUTOSAR_ComM/BswModuleEntrys/ComM_User_To_MasterPnc_DataSntFnct</BSW-MODULE-ENTRY-REF>
                </BSW-MODULE-ENTRY-REF-CONDITIONAL>
      [!FOR "Idx1" = "1" TO "count(text:split($UserToMasterPncFromOsApp_ToOsApp,' '))"!]
        [!VAR "FromOsApplicationToOsApplication" = "string(text:split($UserToMasterPncFromOsApp_ToOsApp,' ')[position() = $Idx1])"!]
        [!VAR "FromOsApplication" = "string(text:split($FromOsApplicationToOsApplication,'->')[position() = 1])"!]
        [!VAR "ToOsApplication" = "string(text:split($FromOsApplicationToOsApplication,'->')[position() = 2])"!]            
                <BSW-MODULE-ENTRY-REF-CONDITIONAL>
                  <BSW-MODULE-ENTRY-REF DEST="BSW-MODULE-ENTRY">/AUTOSAR_ComM/BswModuleEntrys/ComM_User_To_MasterPnc_From_[!"$FromOsApplication"!]_To_[!"$ToOsApplication"!]_RcvFnct</BSW-MODULE-ENTRY-REF>
                </BSW-MODULE-ENTRY-REF-CONDITIONAL>    
      [!ENDFOR!] [!/*[!FOR "Idx1" = "1" TO "count(text:split($UserToMasterPncFromOsApp_ToOsApp,' '))"!]*/!]
    [!ENDIF!] [!/*[!IF "num:i(count(as:modconf('ComM')[1]/ComMConfigSet/*[1]/ComMUser/*)) > 0"!]*/!]
  [!ENDIF!] [!/* [!IF "as:modconf('ComM')[1]/ComMGeneral/ComMPncSupport = 'true'"!] */!]
[!ENDIF!] [!/*[!IF "num:i(count(as:modconf('ComM')[1]/ComMConfigSet/*[1]/ComMUser/*)) > 0"!]*/!]
[!IF "as:modconf('ComM')[1]/ComMGeneral/ComMPncSupport = 'true'"!]
                <BSW-MODULE-ENTRY-REF-CONDITIONAL>
                  <BSW-MODULE-ENTRY-REF DEST="BSW-MODULE-ENTRY">/AUTOSAR_ComM/BswModuleEntrys/ComM_MainFunction_MasterPnc</BSW-MODULE-ENTRY-REF>
                </BSW-MODULE-ENTRY-REF-CONDITIONAL>
[!ENDIF!][!/*[!IF "as:modconf('ComM')[1]/ComMGeneral/ComMPncSupport = 'true'"!]*/!]
                <BSW-MODULE-ENTRY-REF-CONDITIONAL>
                  <BSW-MODULE-ENTRY-REF DEST="BSW-MODULE-ENTRY">/AUTOSAR_ComM/BswModuleEntrys/ComM_DummyMainFunction</BSW-MODULE-ENTRY-REF>
                </BSW-MODULE-ENTRY-REF-CONDITIONAL>
                <BSW-MODULE-ENTRY-REF-CONDITIONAL>
                  <BSW-MODULE-ENTRY-REF DEST="BSW-MODULE-ENTRY">/AUTOSAR_ComM/BswModuleEntrys/ComM_DummyInhibitionMainFunction</BSW-MODULE-ENTRY-REF>
                </BSW-MODULE-ENTRY-REF-CONDITIONAL>                                
[!IF "as:modconf('ComM')[1]/ComMGeneral/ComMDcmUsage = 'true'"!]
                <BSW-MODULE-ENTRY-REF-CONDITIONAL>
                  <BSW-MODULE-ENTRY-REF DEST="BSW-MODULE-ENTRY">/AUTOSAR_ComM/BswModuleEntrys/ComM_DCM_ActiveDiagnostic</BSW-MODULE-ENTRY-REF>
                </BSW-MODULE-ENTRY-REF-CONDITIONAL>

                <BSW-MODULE-ENTRY-REF-CONDITIONAL>
                  <BSW-MODULE-ENTRY-REF DEST="BSW-MODULE-ENTRY">/AUTOSAR_ComM/BswModuleEntrys/ComM_DCM_InactiveDiagnostic</BSW-MODULE-ENTRY-REF>
                </BSW-MODULE-ENTRY-REF-CONDITIONAL>
[!ENDIF!] [!/* [!IF "as:modconf('ComM')[1]/ComMGeneral/ComMDcmUsage = 'true'"!] */!]

[!IF "node:exists(as:modconf('EcuM')[1]/EcuMGeneral/EcuMCrossCoreComMWakeup) and (node:value(as:modconf('EcuM')[1]/EcuMGeneral/EcuMCrossCoreComMWakeup) = 'true')"!]
                <BSW-MODULE-ENTRY-REF-CONDITIONAL>
                  <BSW-MODULE-ENTRY-REF DEST="BSW-MODULE-ENTRY">/AUTOSAR_ComM/BswModuleEntrys/ComM_EcuM_WakeUpIndication</BSW-MODULE-ENTRY-REF>
                </BSW-MODULE-ENTRY-REF-CONDITIONAL>
[!IF "as:modconf('ComM')[1]/ComMGeneral/ComMPncSupport = 'true'"!]
                <BSW-MODULE-ENTRY-REF-CONDITIONAL>
                  <BSW-MODULE-ENTRY-REF DEST="BSW-MODULE-ENTRY">/AUTOSAR_ComM/BswModuleEntrys/ComM_EcuM_PNCWakeUpIndication</BSW-MODULE-ENTRY-REF>
                </BSW-MODULE-ENTRY-REF-CONDITIONAL>
[!ENDIF!]
[!ENDIF!]
[!IF "as:modconf('ComM')[1]/ComMGeneral/ComMPncSupport = 'true'"!]
  [!IF "count(text:split($FoundMasterPncPlusSignalsOsApplications,' ')) > 1 "!]
    [!LOOP "node:order(node:refs(as:modconf('ComM')[1]/ComMConfigSet/*[1]/ComMPnc/*/ComMPncComSignal/*[ComMPncComSignalDirection='TX']/ComMPncComSignalRef), 'ComHandleId')"!]
      [!CALL "GetSignalOsApplication","SignalHandle"="ComHandleId","Direction"="'TX'"!]
      [!IF "($SignalOsApplication) != ($MasterPncOsApplication)"!]
                <BSW-MODULE-ENTRY-REF-CONDITIONAL>
                  <BSW-MODULE-ENTRY-REF DEST="BSW-MODULE-ENTRY">/AUTOSAR_ComM/BswModuleEntrys/ComM_SgnSlavePnc_From_[!"$MasterPncOsApplication"!]_To_[!"$SignalOsApplication"!]_RcvFnct_[!"node:name(.)"!]</BSW-MODULE-ENTRY-REF>
                </BSW-MODULE-ENTRY-REF-CONDITIONAL>
      [!ENDIF!]
    [!ENDLOOP!]
                <BSW-MODULE-ENTRY-REF-CONDITIONAL>
                  <BSW-MODULE-ENTRY-REF DEST="BSW-MODULE-ENTRY">/AUTOSAR_ComM/BswModuleEntrys/ComM_SgnMasterPnc_DataSntFnct</BSW-MODULE-ENTRY-REF>
                </BSW-MODULE-ENTRY-REF-CONDITIONAL>
    [!LOOP "node:order(node:refs(as:modconf('ComM')[1]/ComMConfigSet/*[1]/ComMPnc/*/ComMPncComSignal/*[ComMPncComSignalDirection='RX']/ComMPncComSignalRef), 'ComHandleId')"!]
      [!CALL "GetSignalOsApplication","SignalHandle"="ComHandleId","Direction"="'RX'"!]
      [!IF "($SignalOsApplication) != ($MasterPncOsApplication)"!]
                <BSW-MODULE-ENTRY-REF-CONDITIONAL>
                  <BSW-MODULE-ENTRY-REF DEST="BSW-MODULE-ENTRY">/AUTOSAR_ComM/BswModuleEntrys/ComM_SgnMasterPnc_From_[!"$SignalOsApplication"!]_To_[!"$MasterPncOsApplication"!]_RcvFnct_[!"node:name(.)"!]</BSW-MODULE-ENTRY-REF>
                </BSW-MODULE-ENTRY-REF-CONDITIONAL>
                <BSW-MODULE-ENTRY-REF-CONDITIONAL>
                  <BSW-MODULE-ENTRY-REF DEST="BSW-MODULE-ENTRY">/AUTOSAR_ComM/BswModuleEntrys/ComM_COMCbk_[!"node:name(.)"!]</BSW-MODULE-ENTRY-REF>
                </BSW-MODULE-ENTRY-REF-CONDITIONAL>
      [!ENDIF!]
    [!ENDLOOP!]
  [!ENDIF!] [!/* [!IF "count(text:split($FoundMasterPncPlusSignalsOsApplications,' ')) > 1 "!] */!]
[!ENDIF!] [!/* [!IF "as:modconf('ComM')[1]/ComMGeneral/ComMPncSupport = 'true'"!] */!]
[!FOR "Idx1" = "1" TO "count(text:split($ChToChFromOsApp_ToOsApp,' '))"!]
  [!VAR "FromOsApplicationToOsApplication" = "string(text:split($ChToChFromOsApp_ToOsApp,' ')[position() = $Idx1])"!]
  [!VAR "FromOsApplication" = "string(text:split($FromOsApplicationToOsApplication,'->')[position() = 1])"!]
  [!VAR "ToOsApplication" = "string(text:split($FromOsApplicationToOsApplication,'->')[position() = 2])"!]
                <BSW-MODULE-ENTRY-REF-CONDITIONAL>
                  <BSW-MODULE-ENTRY-REF DEST="BSW-MODULE-ENTRY">/AUTOSAR_ComM/BswModuleEntrys/ComM_Ch_To_Ch_From_[!"$FromOsApplication"!]_To_[!"$ToOsApplication"!]_RcvFnct</BSW-MODULE-ENTRY-REF>
                </BSW-MODULE-ENTRY-REF-CONDITIONAL>
[!ENDFOR!] [!/* [!FOR "Idx1" = "1" TO "count(text:split($ChToChFromOsApp_ToOsApp,' '))"!] */!]
                <BSW-MODULE-ENTRY-REF-CONDITIONAL>
                  <BSW-MODULE-ENTRY-REF DEST="BSW-MODULE-ENTRY">/AUTOSAR_ComM/BswModuleEntrys/ComM_Ch_To_Ch_DataSntFnct</BSW-MODULE-ENTRY-REF>
                </BSW-MODULE-ENTRY-REF-CONDITIONAL>
[!IF "as:modconf('ComM')[1]/ComMGeneral/ComMPncSupport = 'true'"!]                
                <BSW-MODULE-ENTRY-REF-CONDITIONAL>
                  <BSW-MODULE-ENTRY-REF DEST="BSW-MODULE-ENTRY">/AUTOSAR_ComM/BswModuleEntrys/ComM_Ch_To_MasterPnc_DataSntFnct</BSW-MODULE-ENTRY-REF>
                </BSW-MODULE-ENTRY-REF-CONDITIONAL>
  [!FOR "Idx1" = "1" TO "count(text:split($ChToMasterPncFromOsApp_ToOsApp,' '))"!]
    [!VAR "FromOsApplicationToOsApplication" = "string(text:split($ChToMasterPncFromOsApp_ToOsApp,' ')[position() = $Idx1])"!]
    [!VAR "FromOsApplication" = "string(text:split($FromOsApplicationToOsApplication,'->')[position() = 1])"!]
    [!VAR "ToOsApplication" = "string(text:split($FromOsApplicationToOsApplication,'->')[position() = 2])"!]
                <BSW-MODULE-ENTRY-REF-CONDITIONAL>
                  <BSW-MODULE-ENTRY-REF DEST="BSW-MODULE-ENTRY">/AUTOSAR_ComM/BswModuleEntrys/ComM_Ch_To_MasterPnc_From_[!"$FromOsApplication"!]_To_[!"$ToOsApplication"!]_RcvFnct</BSW-MODULE-ENTRY-REF>
                </BSW-MODULE-ENTRY-REF-CONDITIONAL>
  [!ENDFOR!][!/*[!FOR "Idx1" = "1" TO "count(text:split($ChToMasterPncFromOsApp_ToOsApp,' '))"!]*/!]                
[!ENDIF!] [!/* [!IF "as:modconf('ComM')[1]/ComMGeneral/ComMPncSupport = 'true'"!] */!]                

[!IF "node:exists(as:modconf('ComM')[1]/ComMGeneral/ComMSynchronizedPncShutdownEnabled) and (as:modconf('ComM')[1]/ComMGeneral/ComMSynchronizedPncShutdownEnabled = 'true')"!]            
                <BSW-MODULE-ENTRY-REF-CONDITIONAL>
                  <BSW-MODULE-ENTRY-REF DEST="BSW-MODULE-ENTRY">/AUTOSAR_ComM/BswModuleEntrys/ComM_SynchShutDownCh_To_MasterPnc_DataSntFnct</BSW-MODULE-ENTRY-REF>
                </BSW-MODULE-ENTRY-REF-CONDITIONAL>
  [!FOR "Idx1" = "1" TO "count(text:split($SynchShutDownChToMasterPncFromOsApp_ToOsApp,' '))"!]
    [!VAR "FromOsApplicationToOsApplication" = "string(text:split($SynchShutDownChToMasterPncFromOsApp_ToOsApp,' ')[position() = $Idx1])"!]
    [!VAR "FromOsApplication" = "string(text:split($FromOsApplicationToOsApplication,'->')[position() = 1])"!]
    [!VAR "ToOsApplication" = "string(text:split($FromOsApplicationToOsApplication,'->')[position() = 2])"!]
                <BSW-MODULE-ENTRY-REF-CONDITIONAL>
                  <BSW-MODULE-ENTRY-REF DEST="BSW-MODULE-ENTRY">/AUTOSAR_ComM/BswModuleEntrys/ComM_SynchShutDownCh_To_MasterPnc_From_[!"$FromOsApplication"!]_To_[!"$ToOsApplication"!]_RcvFnct</BSW-MODULE-ENTRY-REF>
                </BSW-MODULE-ENTRY-REF-CONDITIONAL>
  [!ENDFOR!][!/*[!FOR "Idx1" = "1" TO "count(text:split($SynchShutDownChToMasterPncFromOsApp_ToOsApp,' '))"!]*/!]                
[!ENDIF!] [!/* [!IF "node:exists(as:modconf('ComM')[1]/ComMGeneral/ComMSynchronizedPncShutdownEnabled) and (as:modconf('ComM')[1]/ComMGeneral/ComMSynchronizedPncShutdownEnabled = 'true')"!] */!]

[!IF "(as:modconf('ComM')[1]/ComMGeneral/ComMRteUsage = 'true') or (as:modconf('ComM')[1]/ComMGeneral/ComMModeLimitationEnabled = 'true')"!]
  [!IF "num:i(count(as:modconf('ComM')[1]/ComMConfigSet/*[1]/ComMUser/*)) > 0"!]
                <BSW-MODULE-ENTRY-REF-CONDITIONAL>
                  <BSW-MODULE-ENTRY-REF DEST="BSW-MODULE-ENTRY">/AUTOSAR_ComM/BswModuleEntrys/ComM_Ch_To_User_DataSntFnct</BSW-MODULE-ENTRY-REF>
                </BSW-MODULE-ENTRY-REF-CONDITIONAL>
    [!FOR "Idx1" = "1" TO "count(text:split($FoundUserOsApplications,' '))"!]
      [!VAR "CurrentOsApplication" = "string(text:split($FoundUserOsApplications,' ')[position() = $Idx1])"!]                
      [!FOR "Idx2" = "1" TO "count(text:split($ChToUserFromOsApp_ToOsApp,' '))"!]
        [!VAR "FromOsApplicationToOsApplication" = "string(text:split($ChToUserFromOsApp_ToOsApp,' ')[position() = $Idx2])"!]
        [!VAR "FromOsApplication" = "string(text:split($FromOsApplicationToOsApplication,'->')[position() = 1])"!]
        [!VAR "ToOsApplication" = "string(text:split($FromOsApplicationToOsApplication,'->')[position() = 2])"!]
        [!IF "$CurrentOsApplication = $ToOsApplication"!]    
                <BSW-MODULE-ENTRY-REF-CONDITIONAL>
                  <BSW-MODULE-ENTRY-REF DEST="BSW-MODULE-ENTRY">/AUTOSAR_ComM/BswModuleEntrys/ComM_Ch_To_User_From_[!"$FromOsApplication"!]_To_[!"$ToOsApplication"!]_RcvFnct</BSW-MODULE-ENTRY-REF>
                </BSW-MODULE-ENTRY-REF-CONDITIONAL> 
        [!ENDIF!] [!/*[!IF "$CurrentOsApplication = $ToOsApplication"!]*/!]
      [!ENDFOR!] [!/*[!FOR "Idx2" = "1" TO "count(text:split($ChToUserFromOsApp_ToOsApp,' '))"!]*/!]
    [!ENDFOR!] [!/*[!FOR "Idx1" = "1" TO "count(text:split($FoundUserOsApplications,' '))"!] */!]
  [!ENDIF!] [!/*[!IF "num:i(count(as:modconf('ComM')[1]/ComMConfigSet/*[1]/ComMUser/*)) > 0"!]*/!]
[!ENDIF!] [!/*[!IF "(as:modconf('ComM')[1]/ComMGeneral/ComMRteUsage = 'true') or (as:modconf('ComM')[1]/ComMGeneral/ComMModeLimitationEnabled = 'true')"!]*/!]  

[!IF "as:modconf('ComM')[1]/ComMGeneral/ComMPncSupport = 'true'"!]
                <BSW-MODULE-ENTRY-REF-CONDITIONAL>
                  <BSW-MODULE-ENTRY-REF DEST="BSW-MODULE-ENTRY">/AUTOSAR_ComM/BswModuleEntrys/ComM_MasterPnc_To_Ch_DataSntFnct</BSW-MODULE-ENTRY-REF>
                </BSW-MODULE-ENTRY-REF-CONDITIONAL>
  [!FOR "Idx1" = "1" TO "count(text:split($MasterPncToChFromOsApp_ToOsApp,' '))"!]
    [!VAR "FromOsApplicationToOsApplication" = "string(text:split($MasterPncToChFromOsApp_ToOsApp,' ')[position() = $Idx1])"!]
    [!VAR "FromOsApplication" = "string(text:split($FromOsApplicationToOsApplication,'->')[position() = 1])"!]
    [!VAR "ToOsApplication" = "string(text:split($FromOsApplicationToOsApplication,'->')[position() = 2])"!]            
              <BSW-MODULE-ENTRY-REF-CONDITIONAL>
                <BSW-MODULE-ENTRY-REF DEST="BSW-MODULE-ENTRY">/AUTOSAR_ComM/BswModuleEntrys/ComM_MasterPnc_To_Ch_From_[!"$FromOsApplication"!]_To_[!"$ToOsApplication"!]_RcvFnct</BSW-MODULE-ENTRY-REF>
              </BSW-MODULE-ENTRY-REF-CONDITIONAL>
  [!ENDFOR!] [!/*[!FOR "Idx1" = "1" TO "count(text:split($MasterPncToChFromOsApp_ToOsApp,' '))"!]*/!]
[!ENDIF!] [!/*[!IF "as:modconf('ComM')[1]/ComMGeneral/ComMPncSupport = 'true'"!]*/!]
              </PROVIDED-ENTRYS>
              <PROVIDED-CLIENT-SERVER-ENTRYS>
[!IF "as:modconf('ComM')[1]/ComMGeneral/ComMDcmUsage = 'true'"!]
  [!LOOP "node:order(node:refs(as:modconf('Dcm')[1]/DcmConfigSet/*/DcmDsl/DcmDslProtocol/DcmDslProtocolRow/*/DcmDslConnection/*/DcmDslProtocolRx/*/DcmDslProtocolRxComMChannelRef), 'ComMChannelId')"!]
                <BSW-MODULE-CLIENT-SERVER-ENTRY>
                  <SHORT-NAME>ProvidedCSEntry_ComM_DCM_ActiveDiagnostic_[!"node:name(.)"!]</SHORT-NAME>
                  <ENCAPSULATED-ENTRY-REF DEST="BSW-MODULE-ENTRY">/AUTOSAR_ComM/BswModuleEntrys/ComM_DCM_ActiveDiagnostic</ENCAPSULATED-ENTRY-REF>
                  <IS-SYNCHRONOUS>false</IS-SYNCHRONOUS>
                </BSW-MODULE-CLIENT-SERVER-ENTRY>
                <BSW-MODULE-CLIENT-SERVER-ENTRY>
                  <SHORT-NAME>ProvidedCSEntry_ComM_DCM_InactiveDiagnostic_[!"node:name(.)"!]</SHORT-NAME>
                  <ENCAPSULATED-ENTRY-REF DEST="BSW-MODULE-ENTRY">/AUTOSAR_ComM/BswModuleEntrys/ComM_DCM_InactiveDiagnostic</ENCAPSULATED-ENTRY-REF>
                  <IS-SYNCHRONOUS>false</IS-SYNCHRONOUS>
                </BSW-MODULE-CLIENT-SERVER-ENTRY>

  [!ENDLOOP!] [!/* [!LOOP "node:order(node:refs(as:modconf('Dcm')[1]/DcmConfigSet/*/DcmDsl/DcmDslProtocol/DcmDslProtocolRow/*/DcmDslConnection/*/DcmDslProtocolRx/*/DcmDslProtocolRxComMChannelRef), 'ComMChannelId')"!] */!]
[!ENDIF!] [!/* [!IF "as:modconf('ComM')[1]/ComMGeneral/ComMDcmUsage = 'true'"!] */!]
[!IF "node:exists(as:modconf('EcuM')[1]/EcuMGeneral/EcuMCrossCoreComMWakeup) and (node:value(as:modconf('EcuM')[1]/EcuMGeneral/EcuMCrossCoreComMWakeup) = 'true')"!]
  [!FOR "Idx1" = "0" TO "(as:modconf('Os')[1]/OsOS/OsNumberOfCores) - 1"!]
    [!LOOP "node:order(node:refs(as:modconf('EcuM')[1]/EcuMConfiguration/*[1]/EcuMCommonConfiguration/EcuMWakeupSource/*/EcuMComMChannelRef), 'ComMChannelId')"!]
                <BSW-MODULE-CLIENT-SERVER-ENTRY>
                  <SHORT-NAME>ProvidedCSEntry_ComM_EcuM_WakeUpIndication_[!"node:name(.)"!]_ToCore_[!"$Idx1"!]</SHORT-NAME>
                  <ENCAPSULATED-ENTRY-REF DEST="BSW-MODULE-ENTRY">/AUTOSAR_ComM/BswModuleEntrys/ComM_EcuM_WakeUpIndication</ENCAPSULATED-ENTRY-REF>
                  <IS-SYNCHRONOUS>false</IS-SYNCHRONOUS>
                </BSW-MODULE-CLIENT-SERVER-ENTRY>
    [!ENDLOOP!]
  [!ENDFOR!]
  [!IF "as:modconf('ComM')[1]/ComMGeneral/ComMPncSupport = 'true'"!]
    [!FOR "Idx1" = "0" TO "(as:modconf('Os')[1]/OsOS/OsNumberOfCores) - 1"!]
      [!LOOP "node:order(node:refs(as:modconf('EcuM')[1]/EcuMConfiguration/*[1]/EcuMCommonConfiguration/EcuMWakeupSource/*/EcuMComMPNCRef), 'ComMPncId')"!]
                <BSW-MODULE-CLIENT-SERVER-ENTRY>
                  <SHORT-NAME>ProvidedCSEntry_ComM_EcuM_PNCWakeUpIndication_[!"node:name(.)"!]_Core_[!"$Idx1"!]</SHORT-NAME>
                  <ENCAPSULATED-ENTRY-REF DEST="BSW-MODULE-ENTRY">/AUTOSAR_ComM/BswModuleEntrys/ComM_EcuM_PNCWakeUpIndication</ENCAPSULATED-ENTRY-REF>
                  <IS-SYNCHRONOUS>false</IS-SYNCHRONOUS>
                </BSW-MODULE-CLIENT-SERVER-ENTRY>
      [!ENDLOOP!]
    [!ENDFOR!]
  [!ENDIF!]
[!ENDIF!] [!/* [!IF "node:exists(as:modconf('EcuM')[1]/EcuMGeneral/EcuMCrossCoreComMWakeup) and (node:value(as:modconf('EcuM')[1]/EcuMGeneral/EcuMCrossCoreComMWakeup) = 'true')"!] */!]
              </PROVIDED-CLIENT-SERVER-ENTRYS>
              <REQUIRED-CLIENT-SERVER-ENTRYS>
[!IF "as:modconf('ComM')[1]/ComMGeneral/ComMDcmUsage = 'true'"!]
[!LOOP "node:order(node:refs(as:modconf('Dcm')[1]/DcmConfigSet/*/DcmDsl/DcmDslProtocol/DcmDslProtocolRow/*/DcmDslConnection/*/DcmDslProtocolRx/*/DcmDslProtocolRxComMChannelRef), 'ComMChannelId')"!]
                <BSW-MODULE-CLIENT-SERVER-ENTRY>
                  <SHORT-NAME>RequiredCSEntry_Dcm_ComM_FullComModeEntered_[!"node:name(.)"!]</SHORT-NAME>
                  <ENCAPSULATED-ENTRY-REF DEST="BSW-MODULE-ENTRY">/AUTOSAR_ComM/BswModuleEntrys/ComM_MainFunction_[!"ComMChannelId"!]</ENCAPSULATED-ENTRY-REF>
                  <IS-SYNCHRONOUS>false</IS-SYNCHRONOUS>
                </BSW-MODULE-CLIENT-SERVER-ENTRY>
[!IF "(ComMBusType = 'COMM_BUS_TYPE_CAN' or ComMBusType = 'COMM_BUS_TYPE_ETH') and (ComMNetworkManagement/ComMNmVariant = 'FULL' or ComMNetworkManagement/ComMNmVariant = 'PASSIVE')"!]
                <BSW-MODULE-CLIENT-SERVER-ENTRY>
                  <SHORT-NAME>RequiredCSEntry_Dcm_ComM_SilentComModeEntered_[!"node:name(.)"!]</SHORT-NAME>
                  <ENCAPSULATED-ENTRY-REF DEST="BSW-MODULE-ENTRY">/AUTOSAR_ComM/BswModuleEntrys/ComM_MainFunction_[!"ComMChannelId"!]</ENCAPSULATED-ENTRY-REF>
                  <IS-SYNCHRONOUS>false</IS-SYNCHRONOUS>
                </BSW-MODULE-CLIENT-SERVER-ENTRY>
[!ENDIF!]
                <BSW-MODULE-CLIENT-SERVER-ENTRY>
                  <SHORT-NAME>RequiredCSEntry_Dcm_ComM_NoComModeEntered_[!"node:name(.)"!]</SHORT-NAME>
                  <ENCAPSULATED-ENTRY-REF DEST="BSW-MODULE-ENTRY">/AUTOSAR_ComM/BswModuleEntrys/ComM_MainFunction_[!"ComMChannelId"!]</ENCAPSULATED-ENTRY-REF>
                  <IS-SYNCHRONOUS>false</IS-SYNCHRONOUS>
                </BSW-MODULE-CLIENT-SERVER-ENTRY>
[!ENDLOOP!] [!/* [!LOOP "node:order(node:refs(as:modconf('Dcm')[1]/DcmConfigSet/*/DcmDsl/DcmDslProtocol/DcmDslProtocolRow/*/DcmDslConnection/*/DcmDslProtocolRx/*/DcmDslProtocolRxComMChannelRef), 'ComMChannelId')"!] */!]
[!ENDIF!] [!/* [!IF "as:modconf('ComM')[1]/ComMGeneral/ComMDcmUsage = 'true'"!] */!]
              </REQUIRED-CLIENT-SERVER-ENTRYS>
              <PROVIDED-DATAS>
[!IF "(as:modconf('ComM')[1]/ComMGeneral/ComMModeLimitationEnabled = 'true') or (as:modconf('ComM')[1]/ComMGeneral/ComMWakeupInhibitionEnabled = 'true')"!]
  [!IF "num:i(count(as:modconf('ComM')[1]/ComMConfigSet/*[1]/ComMUser/*)) > 0"!]    
    [!FOR "Idx1" = "1" TO "count(text:split($UserToInhibitionFromOsApp_ToOsApp,' '))"!]
      [!VAR "FromOsApplicationToOsApplication" = "string(text:split($UserToInhibitionFromOsApp_ToOsApp,' ')[position() = $Idx1])"!]
      [!VAR "FromOsApplication" = "string(text:split($FromOsApplicationToOsApplication,'->')[position() = 1])"!]
      [!VAR "ToOsApplication" = "string(text:split($FromOsApplicationToOsApplication,'->')[position() = 2])"!]            
                <VARIABLE-DATA-PROTOTYPE>
                  <SHORT-NAME>ComM_User_To_Inhibition_From_[!"$FromOsApplication"!]_To_[!"$ToOsApplication"!]_DataSet</SHORT-NAME>
                  <TYPE-TREF DEST="IMPLEMENTATION-DATA-TYPE">/AUTOSAR_Platform/ImplementationDataTypes/uint8</TYPE-TREF>
                </VARIABLE-DATA-PROTOTYPE>
    [!ENDFOR!] [!/*[!FOR "Idx1" = "1" TO "count(text:split($UserToInhibitionFromOsApp_ToOsApp,' '))"!]*/!]
  [!ENDIF!] [!/* [!IF "num:i(count(as:modconf('ComM')[1]/ComMConfigSet/*[1]/ComMUser/*)) > 0"!] */!]
  [!FOR "Idx1" = "1" TO "count(text:split($InhibitionToChFromOsApp_ToOsApp,' '))"!]
    [!VAR "FromOsApplicationToOsApplication" = "string(text:split($InhibitionToChFromOsApp_ToOsApp,' ')[position() = $Idx1])"!]
    [!VAR "FromOsApplication" = "string(text:split($FromOsApplicationToOsApplication,'->')[position() = 1])"!]
    [!VAR "ToOsApplication" = "string(text:split($FromOsApplicationToOsApplication,'->')[position() = 2])"!]           
                <VARIABLE-DATA-PROTOTYPE>
                  <SHORT-NAME>ComM_Inhibition_To_Ch_From_[!"$FromOsApplication"!]_To_[!"$ToOsApplication"!]_DataSet</SHORT-NAME>
                  <TYPE-TREF DEST="IMPLEMENTATION-DATA-TYPE">/AUTOSAR_ComM/ImplementationDataTypes/ComM_Inhibition_To_Ch_DataType</TYPE-TREF>
                </VARIABLE-DATA-PROTOTYPE>
  [!ENDFOR!] [!/*[!FOR "Idx1" = "1" TO "count(text:split($InhibitionToChFromOsApp_ToOsApp,' '))"!]*/!]
  [!FOR "Idx1" = "1" TO "count(text:split($ChToInhibitionFromOsApp_ToOsApp,' '))"!]
    [!VAR "FromOsApplicationToOsApplication" = "string(text:split($ChToInhibitionFromOsApp_ToOsApp,' ')[position() = $Idx1])"!]
    [!VAR "FromOsApplication" = "string(text:split($FromOsApplicationToOsApplication,'->')[position() = 1])"!]
    [!VAR "ToOsApplication" = "string(text:split($FromOsApplicationToOsApplication,'->')[position() = 2])"!]           
                <VARIABLE-DATA-PROTOTYPE>
                  <SHORT-NAME>ComM_Ch_To_Inhibition_From_[!"$FromOsApplication"!]_To_[!"$ToOsApplication"!]_DataSet</SHORT-NAME>
                  <TYPE-TREF DEST="IMPLEMENTATION-DATA-TYPE">/AUTOSAR_ComM/ImplementationDataTypes/ComM_Ch_To_Inhibition_DataType</TYPE-TREF>
                </VARIABLE-DATA-PROTOTYPE>
  [!ENDFOR!] [!/*[!FOR "Idx1" = "1" TO "count(text:split($ChToInhibitionFromOsApp_ToOsApp,' '))"!]*/!]
[!ENDIF!] [!/*[!IF "(as:modconf('ComM')[1]/ComMGeneral/ComMModeLimitationEnabled = 'true') or (as:modconf('ComM')[1]/ComMGeneral/ComMWakeupInhibitionEnabled = 'true')"!]*/!]                
[!IF "as:modconf('ComM')[1]/ComMGeneral/ComMPncSupport = 'true'"!]
  [!IF "count(text:split($FoundMasterPncPlusSignalsOsApplications,' ')) > 1 "!]
    [!LOOP "node:order(node:refs(as:modconf('ComM')[1]/ComMConfigSet/*[1]/ComMPnc/*/ComMPncComSignal/*[ComMPncComSignalDirection='TX']/ComMPncComSignalRef), 'ComHandleId')"!]
      [!CALL "GetSignalOsApplication","SignalHandle"="ComHandleId","Direction"="'TX'"!]
      [!IF "($SignalOsApplication) != ($MasterPncOsApplication)"!]
                <VARIABLE-DATA-PROTOTYPE>
                  <SHORT-NAME>ComM_SgnMasterPnc_From_[!"$MasterPncOsApplication"!]_To_[!"$SignalOsApplication"!]_DataSet_[!"node:name(.)"!]</SHORT-NAME>
                  <TYPE-TREF DEST="IMPLEMENTATION-DATA-TYPE">/AUTOSAR_ComM/ImplementationDataTypes/ComM_PnInfoArray</TYPE-TREF>
                </VARIABLE-DATA-PROTOTYPE>
      [!ENDIF!]
    [!ENDLOOP!]
    [!LOOP "node:order(node:refs(as:modconf('ComM')[1]/ComMConfigSet/*[1]/ComMPnc/*/ComMPncComSignal/*[ComMPncComSignalDirection='RX']/ComMPncComSignalRef), 'ComHandleId')"!]
      [!CALL "GetSignalOsApplication","SignalHandle"="ComHandleId","Direction"="'RX'"!]
      [!IF "($SignalOsApplication) != ($MasterPncOsApplication)"!]
                <VARIABLE-DATA-PROTOTYPE>
                  <SHORT-NAME>ComM_SgnSlavePnc_From_[!"$SignalOsApplication"!]_To_[!"$MasterPncOsApplication"!]_DataSet_[!"node:name(.)"!]</SHORT-NAME>
                  <TYPE-TREF DEST="IMPLEMENTATION-DATA-TYPE">/AUTOSAR_ComM/ImplementationDataTypes/ComM_PnInfoArray</TYPE-TREF>
                </VARIABLE-DATA-PROTOTYPE>
      [!ENDIF!]
    [!ENDLOOP!]
  [!ENDIF!] [!/*[!IF "count(text:split($FoundMasterPncPlusSignalsOsApplications,' ')) > 1 "!]*/!]
[!ENDIF!] [!/*[!IF "as:modconf('ComM')[1]/ComMGeneral/ComMPncSupport = 'true'"!]*/!]
[!FOR "Idx1" = "1" TO "count(text:split($ChToChFromOsApp_ToOsApp,' '))"!]
  [!VAR "FromOsApplicationToOsApplication" = "string(text:split($ChToChFromOsApp_ToOsApp,' ')[position() = $Idx1])"!]
  [!VAR "FromOsApplication" = "string(text:split($FromOsApplicationToOsApplication,'->')[position() = 1])"!]
  [!VAR "ToOsApplication" = "string(text:split($FromOsApplicationToOsApplication,'->')[position() = 2])"!]
                <VARIABLE-DATA-PROTOTYPE>
                  <SHORT-NAME>ComM_Ch_To_Ch_From_[!"$FromOsApplication"!]_To_[!"$ToOsApplication"!]_DataSet</SHORT-NAME>
                  <TYPE-TREF DEST="IMPLEMENTATION-DATA-TYPE">/AUTOSAR_ComM/ImplementationDataTypes/ComM_Ch_To_Ch_DataType</TYPE-TREF>
                </VARIABLE-DATA-PROTOTYPE>
[!ENDFOR!] [!/*[!FOR "Idx1" = "1" TO "count(text:split($ChToChFromOsApp_ToOsApp,' '))"!]*/!]

[!IF "as:modconf('ComM')[1]/ComMGeneral/ComMPncSupport = 'true'"!]
  [!FOR "Idx1" = "1" TO "count(text:split($ChToMasterPncFromOsApp_ToOsApp,' '))"!]
    [!VAR "FromOsApplicationToOsApplication" = "string(text:split($ChToMasterPncFromOsApp_ToOsApp,' ')[position() = $Idx1])"!]
    [!VAR "FromOsApplication" = "string(text:split($FromOsApplicationToOsApplication,'->')[position() = 1])"!]
    [!VAR "ToOsApplication" = "string(text:split($FromOsApplicationToOsApplication,'->')[position() = 2])"!]
                <VARIABLE-DATA-PROTOTYPE>
                  <SHORT-NAME>ComM_Ch_To_MasterPnc_From_[!"$FromOsApplication"!]_To_[!"$ToOsApplication"!]_DataSet</SHORT-NAME>
                  <TYPE-TREF DEST="IMPLEMENTATION-DATA-TYPE">/AUTOSAR_ComM/ImplementationDataTypes/ComM_Ch_To_MasterPnc_DataType</TYPE-TREF>
                </VARIABLE-DATA-PROTOTYPE>
  [!ENDFOR!] [!/*[!FOR "Idx1" = "1" TO "count(text:split($ChToMasterPncFromOsApp_ToOsApp,' '))"!]*/!]
  
  [!FOR "Idx1" = "1" TO "count(text:split($MasterPncToChFromOsApp_ToOsApp,' '))"!]
    [!VAR "FromOsApplicationToOsApplication" = "string(text:split($MasterPncToChFromOsApp_ToOsApp,' ')[position() = $Idx1])"!]
    [!VAR "FromOsApplication" = "string(text:split($FromOsApplicationToOsApplication,'->')[position() = 1])"!]
    [!VAR "ToOsApplication" = "string(text:split($FromOsApplicationToOsApplication,'->')[position() = 2])"!]            
                <VARIABLE-DATA-PROTOTYPE>
                  <SHORT-NAME>ComM_MasterPnc_To_Ch_From_[!"$FromOsApplication"!]_To_[!"$ToOsApplication"!]_DataSet</SHORT-NAME>
                  <TYPE-TREF DEST="IMPLEMENTATION-DATA-TYPE">/AUTOSAR_ComM/ImplementationDataTypes/ComM_MasterPnc_To_Ch_DataType</TYPE-TREF>
                </VARIABLE-DATA-PROTOTYPE>
  [!ENDFOR!] [!/* [!FOR "Idx1" = "1" TO "count(text:split($MasterPncToChFromOsApp_ToOsApp,' '))"!] */!]
[!ENDIF!] [!/*[!IF "as:modconf('ComM')[1]/ComMGeneral/ComMPncSupport = 'true'"!]*/!]

[!IF "node:exists(as:modconf('ComM')[1]/ComMGeneral/ComMSynchronizedPncShutdownEnabled) and (as:modconf('ComM')[1]/ComMGeneral/ComMSynchronizedPncShutdownEnabled = 'true')"!]
  [!FOR "Idx1" = "1" TO "count(text:split($SynchShutDownChToMasterPncFromOsApp_ToOsApp,' '))"!]
    [!VAR "FromOsApplicationToOsApplication" = "string(text:split($SynchShutDownChToMasterPncFromOsApp_ToOsApp,' ')[position() = $Idx1])"!]
    [!VAR "FromOsApplication" = "string(text:split($FromOsApplicationToOsApplication,'->')[position() = 1])"!]
    [!VAR "ToOsApplication" = "string(text:split($FromOsApplicationToOsApplication,'->')[position() = 2])"!]
                <VARIABLE-DATA-PROTOTYPE>
                  <SHORT-NAME>ComM_SynchShutDownCh_To_MasterPnc_From_[!"$FromOsApplication"!]_To_[!"$ToOsApplication"!]_DataSet</SHORT-NAME>
                  <TYPE-TREF DEST="IMPLEMENTATION-DATA-TYPE">/AUTOSAR_ComM/ImplementationDataTypes/ComM_SynchShutDownCh_To_MasterPnc_DataType</TYPE-TREF>
                </VARIABLE-DATA-PROTOTYPE>
  [!ENDFOR!] [!/*[!FOR "Idx1" = "1" TO "count(text:split($SynchShutDownChToMasterPncFromOsApp_ToOsApp,' '))"!]*/!]
[!ENDIF!] [!/*[!IF "node:exists(as:modconf('ComM')[1]/ComMGeneral/ComMSynchronizedPncShutdownEnabled) and (as:modconf('ComM')[1]/ComMGeneral/ComMSynchronizedPncShutdownEnabled = 'true')"!]*/!]


[!FOR "Idx1" = "1" TO "count(text:split($UserToChFromOsApp_ToOsApp,' '))"!]
  [!VAR "FromOsApplicationToOsApplication" = "string(text:split($UserToChFromOsApp_ToOsApp,' ')[position() = $Idx1])"!]
  [!VAR "FromOsApplication" = "string(text:split($FromOsApplicationToOsApplication,'->')[position() = 1])"!]
  [!VAR "ToOsApplication" = "string(text:split($FromOsApplicationToOsApplication,'->')[position() = 2])"!]
                <VARIABLE-DATA-PROTOTYPE>
                  <SHORT-NAME>ComM_User_To_Ch_From_[!"$FromOsApplication"!]_To_[!"$ToOsApplication"!]_DataSet</SHORT-NAME>
                  <TYPE-TREF DEST="IMPLEMENTATION-DATA-TYPE">/AUTOSAR_ComM/ImplementationDataTypes/ComM_User_To_Ch_DataType</TYPE-TREF>
                </VARIABLE-DATA-PROTOTYPE>
[!ENDFOR!] [!/*[!FOR "Idx1" = "1" TO "count(text:split($FoundChannelsOsApplications,' '))"!]*/!]


[!IF "num:i(count(as:modconf('ComM')[1]/ComMConfigSet/*[1]/ComMUser/*)) > 0"!]
  [!IF "as:modconf('ComM')[1]/ComMGeneral/ComMPncSupport = 'true'"!]
    [!FOR "Idx1" = "1" TO "count(text:split($UserToMasterPncFromOsApp_ToOsApp,' '))"!]
      [!VAR "FromOsApplicationToOsApplication" = "string(text:split($UserToMasterPncFromOsApp_ToOsApp,' ')[position() = $Idx1])"!]
      [!VAR "FromOsApplication" = "string(text:split($FromOsApplicationToOsApplication,'->')[position() = 1])"!]
      [!VAR "ToOsApplication" = "string(text:split($FromOsApplicationToOsApplication,'->')[position() = 2])"!]                   
                <VARIABLE-DATA-PROTOTYPE>
                  <SHORT-NAME>ComM_User_To_MasterPnc_From_[!"$FromOsApplication"!]_To_[!"$ToOsApplication"!]_DataSet</SHORT-NAME>
                  <TYPE-TREF DEST="IMPLEMENTATION-DATA-TYPE">/AUTOSAR_ComM/ImplementationDataTypes/ComM_User_To_MasterPnc_DataType</TYPE-TREF>
                </VARIABLE-DATA-PROTOTYPE>
    [!ENDFOR!] [!/*[!FOR "Idx1" = "1" TO "count(text:split($UserToMasterPncFromOsApp_ToOsApp,' '))"!]*/!]
  [!ENDIF!] [!/*[!IF "as:modconf('ComM')[1]/ComMGeneral/ComMPncSupport = 'true'"!]*/!]

  [!IF "(as:modconf('ComM')[1]/ComMGeneral/ComMRteUsage = 'true') or (as:modconf('ComM')[1]/ComMGeneral/ComMModeLimitationEnabled = 'true')"!]
    [!FOR "Idx1" = "1" TO "count(text:split($FoundUserOsApplications,' '))"!]
      [!VAR "CurrentOsApplication" = "string(text:split($FoundUserOsApplications,' ')[position() = $Idx1])"!]                
      [!FOR "Idx2" = "1" TO "count(text:split($ChToUserFromOsApp_ToOsApp,' '))"!]
        [!VAR "FromOsApplicationToOsApplication" = "string(text:split($ChToUserFromOsApp_ToOsApp,' ')[position() = $Idx2])"!]
        [!VAR "FromOsApplication" = "string(text:split($FromOsApplicationToOsApplication,'->')[position() = 1])"!]
        [!VAR "ToOsApplication" = "string(text:split($FromOsApplicationToOsApplication,'->')[position() = 2])"!]
        [!IF "$CurrentOsApplication = $ToOsApplication"!]    
                <VARIABLE-DATA-PROTOTYPE>
                  <SHORT-NAME>ComM_Ch_To_User_From_[!"$FromOsApplication"!]_To_[!"$ToOsApplication"!]_DataSet</SHORT-NAME>
                  <TYPE-TREF DEST="IMPLEMENTATION-DATA-TYPE">/AUTOSAR_ComM/ImplementationDataTypes/ComM_Ch_To_User_DataType</TYPE-TREF>
                </VARIABLE-DATA-PROTOTYPE>
        [!ENDIF!] [!/*[!IF "$CurrentOsApplication = $ToOsApplication"!]*/!]
      [!ENDFOR!] [!/*[!FOR "Idx2" = "1" TO "count(text:split($ChToUserFromOsApp_ToOsApp,' '))"!]*/!]
    [!ENDFOR!] [!/*[!FOR "Idx1" = "1" TO "count(text:split($FoundUserOsApplications,' '))"!] */!]
  [!ENDIF!] [!/*[!IF "(as:modconf('ComM')[1]/ComMGeneral/ComMRteUsage = 'true') or (as:modconf('ComM')[1]/ComMGeneral/ComMModeLimitationEnabled = 'true')"!]*/!]
[!ENDIF!] [!/*[!IF "num:i(count(as:modconf('ComM')[1]/ComMConfigSet/*[1]/ComMUser/*)) > 0"!]*/!]
              </PROVIDED-DATAS>

              <REQUIRED-DATAS>
[!IF "as:modconf('ComM')[1]/ComMGeneral/ComMPncSupport = 'true'"!]
  [!IF "count(text:split($FoundMasterPncPlusSignalsOsApplications,' ')) > 1 "!]
    [!LOOP "node:order(node:refs(as:modconf('ComM')[1]/ComMConfigSet/*[1]/ComMPnc/*/ComMPncComSignal/*[ComMPncComSignalDirection='TX']/ComMPncComSignalRef), 'ComHandleId')"!]
      [!CALL "GetSignalOsApplication","SignalHandle"="ComHandleId","Direction"="'TX'"!]
      [!IF "($SignalOsApplication) != ($MasterPncOsApplication)"!]
                <VARIABLE-DATA-PROTOTYPE>
                  <SHORT-NAME>ComM_SgnSlavePnc_From_[!"$MasterPncOsApplication"!]_To_[!"$SignalOsApplication"!]_DataGet_[!"node:name(.)"!]</SHORT-NAME>
                  <TYPE-TREF DEST="IMPLEMENTATION-DATA-TYPE">/AUTOSAR_ComM/ImplementationDataTypes/ComM_PnInfoArray</TYPE-TREF>
                </VARIABLE-DATA-PROTOTYPE>
      [!ENDIF!]
    [!ENDLOOP!]
    [!LOOP "node:order(node:refs(as:modconf('ComM')[1]/ComMConfigSet/*[1]/ComMPnc/*/ComMPncComSignal/*[ComMPncComSignalDirection='RX']/ComMPncComSignalRef), 'ComHandleId')"!]
      [!CALL "GetSignalOsApplication","SignalHandle"="ComHandleId","Direction"="'RX'"!]
      [!IF "($SignalOsApplication) != ($MasterPncOsApplication)"!]
                <VARIABLE-DATA-PROTOTYPE>
                  <SHORT-NAME>ComM_SgnMasterPnc_From_[!"$SignalOsApplication"!]_To_[!"$MasterPncOsApplication"!]_DataGet_[!"node:name(.)"!]</SHORT-NAME>
                  <TYPE-TREF DEST="IMPLEMENTATION-DATA-TYPE">/AUTOSAR_ComM/ImplementationDataTypes/ComM_PnInfoArray</TYPE-TREF>
                </VARIABLE-DATA-PROTOTYPE>
      [!ENDIF!]
    [!ENDLOOP!]
  [!ENDIF!] [!/*[!IF "count(text:split($FoundMasterPncPlusSignalsOsApplications,' ')) > 1 "!]*/!]
  
  [!FOR "Idx1" = "1" TO "count(text:split($ChToMasterPncFromOsApp_ToOsApp,' '))"!]
    [!VAR "FromOsApplicationToOsApplication" = "string(text:split($ChToMasterPncFromOsApp_ToOsApp,' ')[position() = $Idx1])"!]
    [!VAR "FromOsApplication" = "string(text:split($FromOsApplicationToOsApplication,'->')[position() = 1])"!]
    [!VAR "ToOsApplication" = "string(text:split($FromOsApplicationToOsApplication,'->')[position() = 2])"!]
              <VARIABLE-DATA-PROTOTYPE>
                <SHORT-NAME>ComM_Ch_To_MasterPnc_From_[!"$FromOsApplication"!]_To_[!"$ToOsApplication"!]_DataGet</SHORT-NAME>
                <TYPE-TREF DEST="IMPLEMENTATION-DATA-TYPE">/AUTOSAR_ComM/ImplementationDataTypes/ComM_Ch_To_MasterPnc_DataType</TYPE-TREF>
              </VARIABLE-DATA-PROTOTYPE>
  [!ENDFOR!] [!/*[!FOR "Idx1" = "1" TO "count(text:split($ChToMasterPncFromOsApp_ToOsApp,' '))"!]*/!]
[!ENDIF!] [!/*[!IF "as:modconf('ComM')[1]/ComMGeneral/ComMPncSupport = 'true'"!]*/!]

[!IF "node:exists(as:modconf('ComM')[1]/ComMGeneral/ComMSynchronizedPncShutdownEnabled) and (as:modconf('ComM')[1]/ComMGeneral/ComMSynchronizedPncShutdownEnabled = 'true')"!]
  [!FOR "Idx1" = "1" TO "count(text:split($SynchShutDownChToMasterPncFromOsApp_ToOsApp,' '))"!]
    [!VAR "FromOsApplicationToOsApplication" = "string(text:split($SynchShutDownChToMasterPncFromOsApp_ToOsApp,' ')[position() = $Idx1])"!]
    [!VAR "FromOsApplication" = "string(text:split($FromOsApplicationToOsApplication,'->')[position() = 1])"!]
    [!VAR "ToOsApplication" = "string(text:split($FromOsApplicationToOsApplication,'->')[position() = 2])"!]
              <VARIABLE-DATA-PROTOTYPE>
                <SHORT-NAME>ComM_SynchShutDownCh_To_MasterPnc_From_[!"$FromOsApplication"!]_To_[!"$ToOsApplication"!]_DataGet</SHORT-NAME>
                <TYPE-TREF DEST="IMPLEMENTATION-DATA-TYPE">/AUTOSAR_ComM/ImplementationDataTypes/ComM_SynchShutDownCh_To_MasterPnc_DataType</TYPE-TREF>
              </VARIABLE-DATA-PROTOTYPE>
  [!ENDFOR!] [!/*[!FOR "Idx1" = "1" TO "count(text:split($SynchShutDownChToMasterPncFromOsApp_ToOsApp,' '))"!]*/!]
[!ENDIF!] [!/*[!IF "node:exists(as:modconf('ComM')[1]/ComMGeneral/ComMSynchronizedPncShutdownEnabled) and (as:modconf('ComM')[1]/ComMGeneral/ComMSynchronizedPncShutdownEnabled = 'true')"!]*/!]

[!FOR "Idx1" = "1" TO "count(text:split($ChToChFromOsApp_ToOsApp,' '))"!]
  [!VAR "FromOsApplicationToOsApplication" = "string(text:split($ChToChFromOsApp_ToOsApp,' ')[position() = $Idx1])"!]
  [!VAR "FromOsApplication" = "string(text:split($FromOsApplicationToOsApplication,'->')[position() = 1])"!]
  [!VAR "ToOsApplication" = "string(text:split($FromOsApplicationToOsApplication,'->')[position() = 2])"!]
                <VARIABLE-DATA-PROTOTYPE>
                  <SHORT-NAME>ComM_Ch_To_Ch_From_[!"$FromOsApplication"!]_To_[!"$ToOsApplication"!]_DataGet</SHORT-NAME>
                  <TYPE-TREF DEST="IMPLEMENTATION-DATA-TYPE">/AUTOSAR_ComM/ImplementationDataTypes/ComM_Ch_To_Ch_DataType</TYPE-TREF>
                </VARIABLE-DATA-PROTOTYPE>
[!ENDFOR!]
[!IF "as:modconf('ComM')[1]/ComMGeneral/ComMPncSupport = 'true'"!]
  [!FOR "Idx1" = "1" TO "count(text:split($MasterPncToChFromOsApp_ToOsApp,' '))"!]
    [!VAR "FromOsApplicationToOsApplication" = "string(text:split($MasterPncToChFromOsApp_ToOsApp,' ')[position() = $Idx1])"!]
    [!VAR "FromOsApplication" = "string(text:split($FromOsApplicationToOsApplication,'->')[position() = 1])"!]
    [!VAR "ToOsApplication" = "string(text:split($FromOsApplicationToOsApplication,'->')[position() = 2])"!]            
                <VARIABLE-DATA-PROTOTYPE>
                  <SHORT-NAME>ComM_MasterPnc_To_Ch_From_[!"$FromOsApplication"!]_To_[!"$ToOsApplication"!]_DataGet</SHORT-NAME>
                  <TYPE-TREF DEST="IMPLEMENTATION-DATA-TYPE">/AUTOSAR_ComM/ImplementationDataTypes/ComM_MasterPnc_To_Ch_DataType</TYPE-TREF>
                </VARIABLE-DATA-PROTOTYPE>
  [!ENDFOR!] [!/*[!FOR "Idx1" = "1" TO "count(text:split($MasterPncToChFromOsApp_ToOsApp,' '))"!]*/!]
[!ENDIF!] [!/*[!IF "as:modconf('ComM')[1]/ComMGeneral/ComMPncSupport = 'true'"!]*/!]

[!FOR "Idx1" = "1" TO "count(text:split($UserToChFromOsApp_ToOsApp,' '))"!]
  [!VAR "FromOsApplicationToOsApplication" = "string(text:split($UserToChFromOsApp_ToOsApp,' ')[position() = $Idx1])"!]
  [!VAR "FromOsApplication" = "string(text:split($FromOsApplicationToOsApplication,'->')[position() = 1])"!]
  [!VAR "ToOsApplication" = "string(text:split($FromOsApplicationToOsApplication,'->')[position() = 2])"!]
                <VARIABLE-DATA-PROTOTYPE>
                  <SHORT-NAME>ComM_User_To_Ch_From_[!"$FromOsApplication"!]_To_[!"$ToOsApplication"!]_DataGet</SHORT-NAME>
                  <TYPE-TREF DEST="IMPLEMENTATION-DATA-TYPE">/AUTOSAR_ComM/ImplementationDataTypes/ComM_User_To_Ch_DataType</TYPE-TREF>
                </VARIABLE-DATA-PROTOTYPE>
[!ENDFOR!] [!/*[!FOR "Idx1" = "1" TO "count(text:split($FoundChannelsOsApplications,' '))"!]*/!]

[!IF "num:i(count(as:modconf('ComM')[1]/ComMConfigSet/*[1]/ComMUser/*)) > 0"!]
  [!IF "as:modconf('ComM')[1]/ComMGeneral/ComMPncSupport = 'true'"!]
    [!FOR "Idx1" = "1" TO "count(text:split($UserToMasterPncFromOsApp_ToOsApp,' '))"!]
      [!VAR "FromOsApplicationToOsApplication" = "string(text:split($UserToMasterPncFromOsApp_ToOsApp,' ')[position() = $Idx1])"!]
      [!VAR "FromOsApplication" = "string(text:split($FromOsApplicationToOsApplication,'->')[position() = 1])"!]
      [!VAR "ToOsApplication" = "string(text:split($FromOsApplicationToOsApplication,'->')[position() = 2])"!]                    
              <VARIABLE-DATA-PROTOTYPE>
                <SHORT-NAME>ComM_User_To_MasterPnc_From_[!"$FromOsApplication"!]_To_[!"$ToOsApplication"!]_DataGet</SHORT-NAME>
                <TYPE-TREF DEST="IMPLEMENTATION-DATA-TYPE">/AUTOSAR_ComM/ImplementationDataTypes/ComM_User_To_MasterPnc_DataType</TYPE-TREF>
              </VARIABLE-DATA-PROTOTYPE>
    [!ENDFOR!] [!/*[!FOR "Idx1" = "1" TO "count(text:split($UserToMasterPncFromOsApp_ToOsApp,' '))"!]*/!]
  [!ENDIF!] [!/*[!IF "as:modconf('ComM')[1]/ComMGeneral/ComMPncSupport = 'true'"!]*/!]  

  [!IF "(as:modconf('ComM')[1]/ComMGeneral/ComMRteUsage = 'true') or (as:modconf('ComM')[1]/ComMGeneral/ComMModeLimitationEnabled = 'true')"!]
    [!FOR "Idx1" = "1" TO "count(text:split($FoundUserOsApplications,' '))"!]
      [!VAR "CurrentOsApplication" = "string(text:split($FoundUserOsApplications,' ')[position() = $Idx1])"!]                
      [!FOR "Idx2" = "1" TO "count(text:split($ChToUserFromOsApp_ToOsApp,' '))"!]
        [!VAR "FromOsApplicationToOsApplication" = "string(text:split($ChToUserFromOsApp_ToOsApp,' ')[position() = $Idx2])"!]
        [!VAR "FromOsApplication" = "string(text:split($FromOsApplicationToOsApplication,'->')[position() = 1])"!]
        [!VAR "ToOsApplication" = "string(text:split($FromOsApplicationToOsApplication,'->')[position() = 2])"!]
        [!IF "$CurrentOsApplication = $ToOsApplication"!]    
                <VARIABLE-DATA-PROTOTYPE>
                  <SHORT-NAME>ComM_Ch_To_User_From_[!"$FromOsApplication"!]_To_[!"$ToOsApplication"!]_DataGet</SHORT-NAME>
                  <TYPE-TREF DEST="IMPLEMENTATION-DATA-TYPE">/AUTOSAR_ComM/ImplementationDataTypes/ComM_Ch_To_User_DataType</TYPE-TREF>
                </VARIABLE-DATA-PROTOTYPE>
        [!ENDIF!] [!/*[!IF "$CurrentOsApplication = $ToOsApplication"!]*/!]
      [!ENDFOR!] [!/*[!FOR "Idx2" = "1" TO "count(text:split($ChToUserFromOsApp_ToOsApp,' '))"!]*/!]
    [!ENDFOR!] [!/*[!FOR "Idx1" = "1" TO "count(text:split($FoundUserOsApplications,' '))"!] */!]
  [!ENDIF!] [!/*[!IF "(as:modconf('ComM')[1]/ComMGeneral/ComMRteUsage = 'true') or (as:modconf('ComM')[1]/ComMGeneral/ComMModeLimitationEnabled = 'true')"!]*/!]
[!ENDIF!] [!/*[!IF "num:i(count(as:modconf('ComM')[1]/ComMConfigSet/*[1]/ComMUser/*)) > 0"!]*/!]

[!IF "(as:modconf('ComM')[1]/ComMGeneral/ComMModeLimitationEnabled = 'true') or (as:modconf('ComM')[1]/ComMGeneral/ComMWakeupInhibitionEnabled = 'true')"!]
  [!IF "num:i(count(as:modconf('ComM')[1]/ComMConfigSet/*[1]/ComMUser/*)) > 0"!]    
    [!FOR "Idx1" = "1" TO "count(text:split($UserToInhibitionFromOsApp_ToOsApp,' '))"!]
      [!VAR "FromOsApplicationToOsApplication" = "string(text:split($UserToInhibitionFromOsApp_ToOsApp,' ')[position() = $Idx1])"!]
      [!VAR "FromOsApplication" = "string(text:split($FromOsApplicationToOsApplication,'->')[position() = 1])"!]
      [!VAR "ToOsApplication" = "string(text:split($FromOsApplicationToOsApplication,'->')[position() = 2])"!]            
                <VARIABLE-DATA-PROTOTYPE>
                  <SHORT-NAME>ComM_User_To_Inhibition_From_[!"$FromOsApplication"!]_To_[!"$ToOsApplication"!]_DataGet</SHORT-NAME>
                  <TYPE-TREF DEST="IMPLEMENTATION-DATA-TYPE">/AUTOSAR_Platform/ImplementationDataTypes/uint8</TYPE-TREF>
                </VARIABLE-DATA-PROTOTYPE>    
    [!ENDFOR!] [!/*[!FOR "Idx1" = "1" TO "count(text:split($UserToInhibitionFromOsApp_ToOsApp,' '))"!]*/!]
  [!ENDIF!] [!/* [!IF "num:i(count(as:modconf('ComM')[1]/ComMConfigSet/*[1]/ComMUser/*)) > 0"!] */!]
  [!FOR "Idx1" = "1" TO "count(text:split($InhibitionToChFromOsApp_ToOsApp,' '))"!]
    [!VAR "FromOsApplicationToOsApplication" = "string(text:split($InhibitionToChFromOsApp_ToOsApp,' ')[position() = $Idx1])"!]
    [!VAR "FromOsApplication" = "string(text:split($FromOsApplicationToOsApplication,'->')[position() = 1])"!]
    [!VAR "ToOsApplication" = "string(text:split($FromOsApplicationToOsApplication,'->')[position() = 2])"!]
                <VARIABLE-DATA-PROTOTYPE>
                  <SHORT-NAME>ComM_Inhibition_To_Ch_From_[!"$FromOsApplication"!]_To_[!"$ToOsApplication"!]_DataGet</SHORT-NAME>
                  <TYPE-TREF DEST="IMPLEMENTATION-DATA-TYPE">/AUTOSAR_ComM/ImplementationDataTypes/ComM_Inhibition_To_Ch_DataType</TYPE-TREF>
                </VARIABLE-DATA-PROTOTYPE>
  [!ENDFOR!] [!/*[!FOR "Idx1" = "1" TO "count(text:split($InhibitionToChFromOsApp_ToOsApp,' '))"!]*/!]
  [!FOR "Idx1" = "1" TO "count(text:split($ChToInhibitionFromOsApp_ToOsApp,' '))"!]
    [!VAR "FromOsApplicationToOsApplication" = "string(text:split($ChToInhibitionFromOsApp_ToOsApp,' ')[position() = $Idx1])"!]
    [!VAR "FromOsApplication" = "string(text:split($FromOsApplicationToOsApplication,'->')[position() = 1])"!]
    [!VAR "ToOsApplication" = "string(text:split($FromOsApplicationToOsApplication,'->')[position() = 2])"!]
                <VARIABLE-DATA-PROTOTYPE>
                  <SHORT-NAME>ComM_Ch_To_Inhibition_From_[!"$FromOsApplication"!]_To_[!"$ToOsApplication"!]_DataGet</SHORT-NAME>
                  <TYPE-TREF DEST="IMPLEMENTATION-DATA-TYPE">/AUTOSAR_ComM/ImplementationDataTypes/ComM_Ch_To_Inhibition_DataType</TYPE-TREF>
                </VARIABLE-DATA-PROTOTYPE>
  [!ENDFOR!] [!/*[!FOR "Idx1" = "1" TO "count(text:split($ChToInhibitionFromOsApp_ToOsApp,' '))"!]*/!]
  
[!ENDIF!] [!/*[!IF "(as:modconf('ComM')[1]/ComMGeneral/ComMModeLimitationEnabled = 'true') or (as:modconf('ComM')[1]/ComMGeneral/ComMWakeupInhibitionEnabled = 'true')"!]*/!]                
              </REQUIRED-DATAS>
              <INTERNAL-BEHAVIORS>
                <BSW-INTERNAL-BEHAVIOR>
                  <SHORT-NAME>InternalBehavior_0</SHORT-NAME>
                  <EXCLUSIVE-AREAS>
                    <EXCLUSIVE-AREA>
                      <SHORT-NAME>SCHM_COMM_EXCLUSIVE_AREA_0</SHORT-NAME>
                    </EXCLUSIVE-AREA>
                  </EXCLUSIVE-AREAS>
                  <ENTITYS>
                    <BSW-SCHEDULABLE-ENTITY>
                      <SHORT-NAME>ComM_DummyMainFunction</SHORT-NAME>
                      <CAN-ENTER-EXCLUSIVE-AREA-REFS>
                        <CAN-ENTER-EXCLUSIVE-AREA-REF DEST="EXCLUSIVE-AREA">/AUTOSAR_ComM/BswModuleDescriptions/ComM/InternalBehavior_0/SCHM_COMM_EXCLUSIVE_AREA_0</CAN-ENTER-EXCLUSIVE-AREA-REF>
                      </CAN-ENTER-EXCLUSIVE-AREA-REFS>
                      <MINIMUM-START-INTERVAL>0.0</MINIMUM-START-INTERVAL>
                      <IMPLEMENTED-ENTRY-REF DEST="BSW-MODULE-ENTRY">/AUTOSAR_ComM/[!"$bswModuleEntryPackageName"!]/ComM_DummyMainFunction</IMPLEMENTED-ENTRY-REF>
                    </BSW-SCHEDULABLE-ENTITY>
                  </ENTITYS>
                </BSW-INTERNAL-BEHAVIOR>
[!IF "(as:modconf('ComM')[1]/ComMGeneral/ComMModeLimitationEnabled = 'true') or (as:modconf('ComM')[1]/ComMGeneral/ComMWakeupInhibitionEnabled = 'true')"!]
                <BSW-INTERNAL-BEHAVIOR>
                  <SHORT-NAME>InternalBehavior_Inhibition</SHORT-NAME>
                  <EXCLUSIVE-AREAS>
                    <EXCLUSIVE-AREA>
                      <SHORT-NAME>SCHM_COMM_EXCLUSIVE_AREA_INHIBITION</SHORT-NAME>
                    </EXCLUSIVE-AREA>
                  </EXCLUSIVE-AREAS>
                  <ENTITYS>
  [!VAR "ComMDummyMainfunctionNeeded"="'true'"!]
  [!IF "num:i(count(as:modconf('ComM')[1]/ComMConfigSet/*[1]/ComMUser/*)) > 0"!]    
    [!FOR "Idx1" = "1" TO "count(text:split($UserToInhibitionFromOsApp_ToOsApp,' '))"!]
      [!VAR "FromOsApplicationToOsApplication" = "string(text:split($UserToInhibitionFromOsApp_ToOsApp,' ')[position() = $Idx1])"!]
      [!VAR "FromOsApplication" = "string(text:split($FromOsApplicationToOsApplication,'->')[position() = 1])"!]
      [!VAR "ToOsApplication" = "string(text:split($FromOsApplicationToOsApplication,'->')[position() = 2])"!]
        [!VAR "ComMDummyMainfunctionNeeded"="'false'"!]
                    <BSW-SCHEDULABLE-ENTITY>
                      <SHORT-NAME>BswSchEnt_ComM_User_To_Inhibition_From_[!"$FromOsApplication"!]_To_[!"$ToOsApplication"!]_RcvFnct</SHORT-NAME>
                      <CAN-ENTER-EXCLUSIVE-AREA-REFS>
                        <CAN-ENTER-EXCLUSIVE-AREA-REF DEST="EXCLUSIVE-AREA">/AUTOSAR_ComM/BswModuleDescriptions/ComM/InternalBehavior_Inhibition/SCHM_COMM_EXCLUSIVE_AREA_INHIBITION</CAN-ENTER-EXCLUSIVE-AREA-REF>
                      </CAN-ENTER-EXCLUSIVE-AREA-REFS>
                      <MINIMUM-START-INTERVAL>0.0</MINIMUM-START-INTERVAL>
                      <DATA-RECEIVE-POINTS>
                        <!-- MasterPnc core only -->
                        <BSW-VARIABLE-ACCESS>
                          <SHORT-NAME>BswVarAccess_ComM_User_To_Inhibition_From_[!"$FromOsApplication"!]_To_[!"$InhibitionOsApplication"!]_DataGet</SHORT-NAME>
                          <ACCESSED-VARIABLE-REF DEST="VARIABLE-DATA-PROTOTYPE">/AUTOSAR_ComM/BswModuleDescriptions/ComM/ComM_User_To_Inhibition_From_[!"$FromOsApplication"!]_To_[!"$ToOsApplication"!]_DataGet</ACCESSED-VARIABLE-REF>
                        </BSW-VARIABLE-ACCESS>
                      </DATA-RECEIVE-POINTS>
                      <IMPLEMENTED-ENTRY-REF DEST="BSW-MODULE-ENTRY">/AUTOSAR_ComM/[!"$bswModuleEntryPackageName"!]/ComM_User_To_Inhibition_From_[!"$FromOsApplication"!]_To_[!"$ToOsApplication"!]_RcvFnct</IMPLEMENTED-ENTRY-REF>
                    </BSW-SCHEDULABLE-ENTITY>
    [!ENDFOR!] [!/*[!FOR "Idx1" = "1" TO "count(text:split($UserToInhibitionFromOsApp_ToOsApp,' '))"!]*/!]
  [!ENDIF!] [!/* [!IF "num:i(count(as:modconf('ComM')[1]/ComMConfigSet/*[1]/ComMUser/*)) > 0"!] */!]  

  [!FOR "Idx1" = "1" TO "count(text:split($ChToInhibitionFromOsApp_ToOsApp,' '))"!]
    [!VAR "FromOsApplicationToOsApplication" = "string(text:split($ChToInhibitionFromOsApp_ToOsApp,' ')[position() = $Idx1])"!]
    [!VAR "FromOsApplication" = "string(text:split($FromOsApplicationToOsApplication,'->')[position() = 1])"!]
    [!VAR "ToOsApplication" = "string(text:split($FromOsApplicationToOsApplication,'->')[position() = 2])"!]
    [!VAR "ComMDummyMainfunctionNeeded"="'false'"!]
                    <BSW-SCHEDULABLE-ENTITY>
                      <SHORT-NAME>BswSchEnt_ComM_Ch_To_Inhibition_From_[!"$FromOsApplication"!]_To_[!"$ToOsApplication"!]_RcvFnct</SHORT-NAME>
                      <CAN-ENTER-EXCLUSIVE-AREA-REFS>
                        <CAN-ENTER-EXCLUSIVE-AREA-REF DEST="EXCLUSIVE-AREA">/AUTOSAR_ComM/BswModuleDescriptions/ComM/InternalBehavior_Inhibition/SCHM_COMM_EXCLUSIVE_AREA_INHIBITION</CAN-ENTER-EXCLUSIVE-AREA-REF>
                      </CAN-ENTER-EXCLUSIVE-AREA-REFS>
                      <MINIMUM-START-INTERVAL>0.0</MINIMUM-START-INTERVAL>
                      <DATA-RECEIVE-POINTS>
                        <!-- MasterPnc core only -->
                        <BSW-VARIABLE-ACCESS>
                          <SHORT-NAME>BswVarAccess_ComM_Ch_To_Inhibition_From_[!"$FromOsApplication"!]_To_[!"$ToOsApplication"!]_DataGet</SHORT-NAME>
                          <ACCESSED-VARIABLE-REF DEST="VARIABLE-DATA-PROTOTYPE">/AUTOSAR_ComM/BswModuleDescriptions/ComM/ComM_Ch_To_Inhibition_From_[!"$FromOsApplication"!]_To_[!"$ToOsApplication"!]_DataGet</ACCESSED-VARIABLE-REF>
                        </BSW-VARIABLE-ACCESS>
                      </DATA-RECEIVE-POINTS>
                      <IMPLEMENTED-ENTRY-REF DEST="BSW-MODULE-ENTRY">/AUTOSAR_ComM/[!"$bswModuleEntryPackageName"!]/ComM_Ch_To_Inhibition_From_[!"$FromOsApplication"!]_To_[!"$ToOsApplication"!]_RcvFnct</IMPLEMENTED-ENTRY-REF>
                    </BSW-SCHEDULABLE-ENTITY>
      
  [!ENDFOR!] [!/*[!FOR "Idx1" = "1" TO "count(text:split($ChToInhibitionFromOsApp_ToOsApp,' '))"!]*/!]

  [!FOR "Idx1" = "1" TO "count(text:split($InhibitionToChFromOsApp_ToOsApp,' '))"!]
    [!VAR "FromOsApplicationToOsApplication" = "string(text:split($InhibitionToChFromOsApp_ToOsApp,' ')[position() = $Idx1])"!]
    [!VAR "FromOsApplication" = "string(text:split($FromOsApplicationToOsApplication,'->')[position() = 1])"!]
    [!VAR "ToOsApplication" = "string(text:split($FromOsApplicationToOsApplication,'->')[position() = 2])"!]
                    <BSW-CALLED-ENTITY>
                      <SHORT-NAME>BswCalledEnt_ComM_Inhibition_To_Ch_From_[!"$InhibitionOsApplication"!]_To_[!"$ToOsApplication"!]_DataSntFnct</SHORT-NAME>
                      <MINIMUM-START-INTERVAL>0.0</MINIMUM-START-INTERVAL>
                      <DATA-SEND-POINTS>
                        <!-- MasterPnc core only -->
                        <BSW-VARIABLE-ACCESS>
                          <SHORT-NAME>BswVarAccess_ComM_Inhibition_To_Ch_From_[!"$FromOsApplication"!]_To_[!"$ToOsApplication"!]_DataSet</SHORT-NAME>
                          <ACCESSED-VARIABLE-REF DEST="VARIABLE-DATA-PROTOTYPE">/AUTOSAR_ComM/BswModuleDescriptions/ComM/ComM_Inhibition_To_Ch_From_[!"$FromOsApplication"!]_To_[!"$ToOsApplication"!]_DataSet</ACCESSED-VARIABLE-REF>
                        </BSW-VARIABLE-ACCESS>
                      </DATA-SEND-POINTS>
                      <IMPLEMENTED-ENTRY-REF DEST="BSW-MODULE-ENTRY">/AUTOSAR_ComM/BswModuleEntrys/ComM_Inhibition_To_Ch_DataSntFnct</IMPLEMENTED-ENTRY-REF>
                    </BSW-CALLED-ENTITY>
  [!ENDFOR!] [!/*[!FOR "Idx1" = "1" TO "count(text:split($InhibitionToChFromOsApp_ToOsApp,' '))"!]*/!]
  [!IF "$ComMDummyMainfunctionNeeded = 'true'"!]
                    <BSW-SCHEDULABLE-ENTITY>
                      <SHORT-NAME>ComM_DummyInhibitionMainFunction</SHORT-NAME>
                      <CAN-ENTER-EXCLUSIVE-AREA-REFS>
                        <CAN-ENTER-EXCLUSIVE-AREA-REF DEST="EXCLUSIVE-AREA">/AUTOSAR_ComM/BswModuleDescriptions/ComM/InternalBehavior_Inhibition/SCHM_COMM_EXCLUSIVE_AREA_INHIBITION</CAN-ENTER-EXCLUSIVE-AREA-REF>
                      </CAN-ENTER-EXCLUSIVE-AREA-REFS>
                      <MINIMUM-START-INTERVAL>0.0</MINIMUM-START-INTERVAL>
                      <IMPLEMENTED-ENTRY-REF DEST="BSW-MODULE-ENTRY">/AUTOSAR_ComM/[!"$bswModuleEntryPackageName"!]/ComM_DummyInhibitionMainFunction</IMPLEMENTED-ENTRY-REF>
                    </BSW-SCHEDULABLE-ENTITY>
  [!ENDIF!] [!/*[!IF "$ComMDummyMainfunctionNeeded"="'true'"!]*/!]
                  </ENTITYS>
                  <EVENTS>
  [!IF "num:i(count(as:modconf('ComM')[1]/ComMConfigSet/*[1]/ComMUser/*)) > 0"!]    
    [!FOR "Idx1" = "1" TO "count(text:split($UserToInhibitionFromOsApp_ToOsApp,' '))"!]
      [!VAR "FromOsApplicationToOsApplication" = "string(text:split($UserToInhibitionFromOsApp_ToOsApp,' ')[position() = $Idx1])"!]
      [!VAR "FromOsApplication" = "string(text:split($FromOsApplicationToOsApplication,'->')[position() = 1])"!]
      [!VAR "ToOsApplication" = "string(text:split($FromOsApplicationToOsApplication,'->')[position() = 2])"!]            
                    <BSW-DATA-RECEIVED-EVENT>
                        <SHORT-NAME>ComM_User_To_Inhibition_From_[!"$FromOsApplication"!]_To_[!"$ToOsApplication"!]_RecEv</SHORT-NAME>
                        <STARTS-ON-EVENT-REF DEST="BSW-SCHEDULABLE-ENTITY">/AUTOSAR_ComM/BswModuleDescriptions/ComM/InternalBehavior_Inhibition/BswSchEnt_ComM_User_To_Inhibition_From_[!"$FromOsApplication"!]_To_[!"$ToOsApplication"!]_RcvFnct</STARTS-ON-EVENT-REF>
                        <DATA-REF DEST="VARIABLE-DATA-PROTOTYPE">/AUTOSAR_ComM/BswModuleDescriptions/ComM/ComM_User_To_Inhibition_From_[!"$FromOsApplication"!]_To_[!"$ToOsApplication"!]_DataGet</DATA-REF>
                    </BSW-DATA-RECEIVED-EVENT>   
    [!ENDFOR!] [!/*[!FOR "Idx1" = "1" TO "count(text:split($UserToInhibitionFromOsApp_ToOsApp,' '))"!]*/!]
  [!ENDIF!] [!/* [!IF "num:i(count(as:modconf('ComM')[1]/ComMConfigSet/*[1]/ComMUser/*)) > 0"!] */!]                  
  [!FOR "Idx1" = "1" TO "count(text:split($ChToInhibitionFromOsApp_ToOsApp,' '))"!]
    [!VAR "FromOsApplicationToOsApplication" = "string(text:split($ChToInhibitionFromOsApp_ToOsApp,' ')[position() = $Idx1])"!]
    [!VAR "FromOsApplication" = "string(text:split($FromOsApplicationToOsApplication,'->')[position() = 1])"!]
    [!VAR "ToOsApplication" = "string(text:split($FromOsApplicationToOsApplication,'->')[position() = 2])"!]            
                    <BSW-DATA-RECEIVED-EVENT>
                        <SHORT-NAME>ComM_Ch_To_Inhibition_From_[!"$FromOsApplication"!]_To_[!"$ToOsApplication"!]_RecEv</SHORT-NAME>
                        <STARTS-ON-EVENT-REF DEST="BSW-SCHEDULABLE-ENTITY">/AUTOSAR_ComM/BswModuleDescriptions/ComM/InternalBehavior_Inhibition/BswSchEnt_ComM_Ch_To_Inhibition_From_[!"$FromOsApplication"!]_To_[!"$ToOsApplication"!]_RcvFnct</STARTS-ON-EVENT-REF>
                        <DATA-REF DEST="VARIABLE-DATA-PROTOTYPE">/AUTOSAR_ComM/BswModuleDescriptions/ComM/ComM_Ch_To_Inhibition_From_[!"$FromOsApplication"!]_To_[!"$ToOsApplication"!]_DataGet</DATA-REF>
                    </BSW-DATA-RECEIVED-EVENT>   
  [!ENDFOR!] [!/*[!FOR "Idx1" = "1" TO "count(text:split($ChToInhibitionFromOsApp_ToOsApp,' '))"!]*/!]  
                  </EVENTS>
                  <RECEPTION-POLICYS>
  [!IF "num:i(count(as:modconf('ComM')[1]/ComMConfigSet/*[1]/ComMUser/*)) > 0"!]    
    [!FOR "Idx1" = "1" TO "count(text:split($UserToInhibitionFromOsApp_ToOsApp,' '))"!]
      [!VAR "FromOsApplicationToOsApplication" = "string(text:split($UserToInhibitionFromOsApp_ToOsApp,' ')[position() = $Idx1])"!]
      [!VAR "FromOsApplication" = "string(text:split($FromOsApplicationToOsApplication,'->')[position() = 1])"!]
      [!VAR "ToOsApplication" = "string(text:split($FromOsApplicationToOsApplication,'->')[position() = 2])"!]
      [!CALL "GetUserToInhibitionQueueSize","FromOsApplication"="$FromOsApplication"!]      
                    <BSW-QUEUED-DATA-RECEPTION-POLICY>
                      <ENABLE-TAKE-ADDRESS>true</ENABLE-TAKE-ADDRESS>
                      <RECEIVED-DATA-REF DEST="VARIABLE-DATA-PROTOTYPE">/AUTOSAR_ComM/BswModuleDescriptions/ComM/ComM_User_To_Inhibition_From_[!"$FromOsApplication"!]_To_[!"$ToOsApplication"!]_DataGet</RECEIVED-DATA-REF>
                      <QUEUE-LENGTH>[!"num:i($UserToInhibitionQueueSize)"!]</QUEUE-LENGTH>
                    </BSW-QUEUED-DATA-RECEPTION-POLICY>
    [!ENDFOR!] [!/*[!FOR "Idx1" = "1" TO "count(text:split($UserToInhibitionFromOsApp_ToOsApp,' '))"!]*/!]
  [!ENDIF!] [!/* [!IF "num:i(count(as:modconf('ComM')[1]/ComMConfigSet/*[1]/ComMUser/*)) > 0"!] */!]
  
  [!FOR "Idx1" = "1" TO "count(text:split($ChToInhibitionFromOsApp_ToOsApp,' '))"!]
    [!VAR "FromOsApplicationToOsApplication" = "string(text:split($ChToInhibitionFromOsApp_ToOsApp,' ')[position() = $Idx1])"!]
    [!VAR "FromOsApplication" = "string(text:split($FromOsApplicationToOsApplication,'->')[position() = 1])"!]
    [!VAR "ToOsApplication" = "string(text:split($FromOsApplicationToOsApplication,'->')[position() = 2])"!]           
    [!CALL "GetChToInhibitionQueueSize","FromOsApplication"="$FromOsApplication"!]
                    <BSW-QUEUED-DATA-RECEPTION-POLICY>
                      <ENABLE-TAKE-ADDRESS>true</ENABLE-TAKE-ADDRESS>
                      <RECEIVED-DATA-REF DEST="VARIABLE-DATA-PROTOTYPE">/AUTOSAR_ComM/BswModuleDescriptions/ComM/ComM_Ch_To_Inhibition_From_[!"$FromOsApplication"!]_To_[!"$ToOsApplication"!]_DataGet</RECEIVED-DATA-REF>
                      <QUEUE-LENGTH>[!"num:i($ChToInhibitionQueueSize)"!]</QUEUE-LENGTH>
                    </BSW-QUEUED-DATA-RECEPTION-POLICY>
  [!ENDFOR!] [!/*[!FOR "Idx1" = "1" TO "count(text:split($ChToInhibitionFromOsApp_ToOsApp,' '))"!]*/!]  
                  </RECEPTION-POLICYS>                  
                </BSW-INTERNAL-BEHAVIOR>
[!ENDIF!] [!/*[!IF "(as:modconf('ComM')[1]/ComMGeneral/ComMModeLimitationEnabled = 'true') or (as:modconf('ComM')[1]/ComMGeneral/ComMWakeupInhibitionEnabled = 'true')"!]*/!]                


[!IF "num:i(count(as:modconf('ComM')[1]/ComMConfigSet/*[1]/ComMUser/*)) > 0"!]
  [!FOR "Idx1" = "1" TO "count(text:split($FoundUserOsApplications,' '))"!]
    [!VAR "CurrentOsApplication" = "string(text:split($FoundUserOsApplications,' ')[position() = $Idx1])"!]
                <BSW-INTERNAL-BEHAVIOR>
                  <SHORT-NAME>InternalBehavior_User_[!"$CurrentOsApplication"!]</SHORT-NAME>
                  <EXCLUSIVE-AREAS>
                    <EXCLUSIVE-AREA>
                      <SHORT-NAME>SCHM_COMM_EXCLUSIVE_AREA_USER_[!"$CurrentOsApplication"!]</SHORT-NAME>
                    </EXCLUSIVE-AREA>
                  </EXCLUSIVE-AREAS>
                  <ENTITYS>
    [!LOOP "as:modconf('ComM')[1]/ComMConfigSet/*[1]/ComMUser/*"!]
      [!CALL "GetUserOsApplication","UserEcuCPartitionRef"="ComMUserEcucPartitionRef"!]
      [!IF "$UserOsApplication = $CurrentOsApplication"!]
                    <BSW-SCHEDULABLE-ENTITY>
                      <SHORT-NAME>ComM_1_User_[!"$UserOsApplication"!]_ComM_MainFunction_User_[!"ComMUserIdentifier"!]</SHORT-NAME>
                      <CAN-ENTER-EXCLUSIVE-AREA-REFS>
                        <CAN-ENTER-EXCLUSIVE-AREA-REF DEST="EXCLUSIVE-AREA">/AUTOSAR_ComM/BswModuleDescriptions/ComM/InternalBehavior_User_[!"$CurrentOsApplication"!]/SCHM_COMM_EXCLUSIVE_AREA_USER_[!"$CurrentOsApplication"!]</CAN-ENTER-EXCLUSIVE-AREA-REF>
                      </CAN-ENTER-EXCLUSIVE-AREA-REFS>
                      <MINIMUM-START-INTERVAL>0.0</MINIMUM-START-INTERVAL>
                      <IMPLEMENTED-ENTRY-REF DEST="BSW-MODULE-ENTRY">/AUTOSAR_ComM/[!"$bswModuleEntryPackageName"!]/ComM_MainFunction_User_[!"ComMUserIdentifier"!]</IMPLEMENTED-ENTRY-REF>
                    </BSW-SCHEDULABLE-ENTITY>
      [!ENDIF!] [!/*[!IF "$UserOsApplication = $CurrentOsApplication"!]*/!]
    [!ENDLOOP!] [!/*[!LOOP "as:modconf('ComM')[1]/ComMConfigSet/*[1]/ComMUser/*"!]*/!]                  
    [!IF "(as:modconf('ComM')[1]/ComMGeneral/ComMRteUsage = 'true') or (as:modconf('ComM')[1]/ComMGeneral/ComMModeLimitationEnabled = 'true')"!]
      [!FOR "Idx2" = "1" TO "count(text:split($ChToUserFromOsApp_ToOsApp,' '))"!]
        [!VAR "FromOsApplicationToOsApplication" = "string(text:split($ChToUserFromOsApp_ToOsApp,' ')[position() = $Idx2])"!]
        [!VAR "FromOsApplication" = "string(text:split($FromOsApplicationToOsApplication,'->')[position() = 1])"!]
        [!VAR "ToOsApplication" = "string(text:split($FromOsApplicationToOsApplication,'->')[position() = 2])"!]
        [!IF "$CurrentOsApplication = $ToOsApplication"!]
                    <BSW-SCHEDULABLE-ENTITY>
                      <SHORT-NAME>BswSchEnt_ComM_Ch_To_User_From_[!"$FromOsApplication"!]_To_[!"$ToOsApplication"!]_RcvFnct</SHORT-NAME>
                      <CAN-ENTER-EXCLUSIVE-AREA-REFS>
                        <CAN-ENTER-EXCLUSIVE-AREA-REF DEST="EXCLUSIVE-AREA">/AUTOSAR_ComM/BswModuleDescriptions/ComM/InternalBehavior_User_[!"$ToOsApplication"!]/SCHM_COMM_EXCLUSIVE_AREA_USER_[!"$ToOsApplication"!]</CAN-ENTER-EXCLUSIVE-AREA-REF>
                      </CAN-ENTER-EXCLUSIVE-AREA-REFS>
                      <MINIMUM-START-INTERVAL>0.0</MINIMUM-START-INTERVAL>
                      <DATA-RECEIVE-POINTS>
                        <!-- MasterPnc core only -->
                        <BSW-VARIABLE-ACCESS>
                          <SHORT-NAME>BswVarAccess_ComM_Ch_To_User_From_[!"$FromOsApplication"!]_To_[!"$ToOsApplication"!]_DataGet</SHORT-NAME>
                          <ACCESSED-VARIABLE-REF DEST="VARIABLE-DATA-PROTOTYPE">/AUTOSAR_ComM/BswModuleDescriptions/ComM/ComM_Ch_To_User_From_[!"$FromOsApplication"!]_To_[!"$ToOsApplication"!]_DataGet</ACCESSED-VARIABLE-REF>
                        </BSW-VARIABLE-ACCESS>
                      </DATA-RECEIVE-POINTS>
                      <IMPLEMENTED-ENTRY-REF DEST="BSW-MODULE-ENTRY">/AUTOSAR_ComM/[!"$bswModuleEntryPackageName"!]/ComM_Ch_To_User_From_[!"$FromOsApplication"!]_To_[!"$ToOsApplication"!]_RcvFnct</IMPLEMENTED-ENTRY-REF>
                    </BSW-SCHEDULABLE-ENTITY>      
        [!ENDIF!] [!/*[!IF "$CurrentOsApplication = $ToOsApplication"!]*/!]
      [!ENDFOR!] [!/*[!FOR "Idx2" = "1" TO "count(text:split($ChToUserFromOsApp_ToOsApp,' '))"!]*/!]
    [!ENDIF!] [!/*[!IF "(as:modconf('ComM')[1]/ComMGeneral/ComMRteUsage = 'true') or (as:modconf('ComM')[1]/ComMGeneral/ComMModeLimitationEnabled = 'true')"!]*/!]
    
    [!FOR "Idx2" = "1" TO "count(text:split($UserToChFromOsApp_ToOsApp,' '))"!]
      [!VAR "FromOsApplicationToOsApplication" = "string(text:split($UserToChFromOsApp_ToOsApp,' ')[position() = $Idx2])"!]
      [!VAR "FromOsApplication" = "string(text:split($FromOsApplicationToOsApplication,'->')[position() = 1])"!]
      [!VAR "ToOsApplication" = "string(text:split($FromOsApplicationToOsApplication,'->')[position() = 2])"!]
      [!IF "$CurrentOsApplication = $FromOsApplication"!]
                    <BSW-CALLED-ENTITY>
                      <SHORT-NAME>BswCalledEnt_ComM_User_To_Ch_From_[!"$FromOsApplication"!]_To_[!"$ToOsApplication"!]_DataSntFnct</SHORT-NAME>
                      <MINIMUM-START-INTERVAL>0.0</MINIMUM-START-INTERVAL>
                      <DATA-SEND-POINTS>
                        <!-- MasterPnc core only -->
                        <BSW-VARIABLE-ACCESS>
                          <SHORT-NAME>BswVarAccess_ComM_User_To_Ch_From_[!"$FromOsApplication"!]_To_[!"$ToOsApplication"!]_DataSet</SHORT-NAME>
                          <ACCESSED-VARIABLE-REF DEST="VARIABLE-DATA-PROTOTYPE">/AUTOSAR_ComM/BswModuleDescriptions/ComM/ComM_User_To_Ch_From_[!"$FromOsApplication"!]_To_[!"$ToOsApplication"!]_DataSet</ACCESSED-VARIABLE-REF>
                        </BSW-VARIABLE-ACCESS>
                      </DATA-SEND-POINTS>
                      <IMPLEMENTED-ENTRY-REF DEST="BSW-MODULE-ENTRY">/AUTOSAR_ComM/BswModuleEntrys/ComM_User_To_Ch_DataSntFnct</IMPLEMENTED-ENTRY-REF>
                    </BSW-CALLED-ENTITY>
      [!ENDIF!] [!/*[!IF "$CurrentOsApplication = $FromOsApplication"!]*/!]
    [!ENDFOR!] [!/*[!FOR "Idx2" = "1" TO "count(text:split($UserToChFromOsApp_ToOsApp,' '))"!]*/!]    
    [!IF "as:modconf('ComM')[1]/ComMGeneral/ComMPncSupport = 'true'"!]
      [!IF "num:i(count(as:modconf('ComM')[1]/ComMConfigSet/*[1]/ComMUser/*)) > 0"!]
        [!FOR "Idx2" = "1" TO "count(text:split($UserToMasterPncFromOsApp_ToOsApp,' '))"!]
          [!VAR "FromOsApplicationToOsApplication" = "string(text:split($UserToMasterPncFromOsApp_ToOsApp,' ')[position() = $Idx2])"!]
          [!VAR "FromOsApplication" = "string(text:split($FromOsApplicationToOsApplication,'->')[position() = 1])"!]
          [!VAR "ToOsApplication" = "string(text:split($FromOsApplicationToOsApplication,'->')[position() = 2])"!]                   
          [!IF "$CurrentOsApplication = $FromOsApplication"!]
                      <BSW-CALLED-ENTITY>
                        <SHORT-NAME>BswCalledEnt_ComM_User_To_MasterPnc_From_[!"$FromOsApplication"!]_To_[!"$ToOsApplication"!]_DataSntFnct</SHORT-NAME>
                        <MINIMUM-START-INTERVAL>0.0</MINIMUM-START-INTERVAL>
                        <DATA-SEND-POINTS>
                          <!-- MasterPnc core only -->
                          <BSW-VARIABLE-ACCESS>
                            <SHORT-NAME>BswVarAccess_ComM_User_To_MasterPnc_From_[!"$FromOsApplication"!]_To_[!"$ToOsApplication"!]_DataSet</SHORT-NAME>
                            <ACCESSED-VARIABLE-REF DEST="VARIABLE-DATA-PROTOTYPE">/AUTOSAR_ComM/BswModuleDescriptions/ComM/ComM_User_To_MasterPnc_From_[!"$FromOsApplication"!]_To_[!"$ToOsApplication"!]_DataSet</ACCESSED-VARIABLE-REF>
                          </BSW-VARIABLE-ACCESS>
                        </DATA-SEND-POINTS>
                        <IMPLEMENTED-ENTRY-REF DEST="BSW-MODULE-ENTRY">/AUTOSAR_ComM/BswModuleEntrys/ComM_User_To_MasterPnc_DataSntFnct</IMPLEMENTED-ENTRY-REF>
                      </BSW-CALLED-ENTITY>
          [!ENDIF!] [!/*[!IF "$CurrentOsApplication = $FromOsApplication"!]*/!]
        [!ENDFOR!] [!/*[!FOR "Idx2" = "1" TO "count(text:split($UserToMasterPncFromOsApp_ToOsApp,' '))"!]*/!]
      [!ENDIF!] [!/*[!IF "num:i(count(as:modconf('ComM')[1]/ComMConfigSet/*[1]/ComMUser/*)) > 0"!]*/!]
    [!ENDIF!] [!/*[!IF "as:modconf('ComM')[1]/ComMGeneral/ComMPncSupport = 'true'"!]*/!] 
    [!IF "(as:modconf('ComM')[1]/ComMGeneral/ComMModeLimitationEnabled = 'true') or (as:modconf('ComM')[1]/ComMGeneral/ComMWakeupInhibitionEnabled = 'true')"!]	
      [!FOR "Idx2" = "1" TO "count(text:split($UserToInhibitionFromOsApp_ToOsApp,' '))"!]
        [!VAR "FromOsApplicationToOsApplication" = "string(text:split($UserToInhibitionFromOsApp_ToOsApp,' ')[position() = $Idx2])"!]
        [!VAR "FromOsApplication" = "string(text:split($FromOsApplicationToOsApplication,'->')[position() = 1])"!]
        [!VAR "ToOsApplication" = "string(text:split($FromOsApplicationToOsApplication,'->')[position() = 2])"!]            
        [!IF "$CurrentOsApplication = $FromOsApplication"!]
                      <BSW-CALLED-ENTITY>
                      <SHORT-NAME>BswCalledEnt_ComM_User_To_Inhibition_From_[!"$FromOsApplication"!]_To_[!"$ToOsApplication"!]_DataSntFnct</SHORT-NAME>
                      <MINIMUM-START-INTERVAL>0.0</MINIMUM-START-INTERVAL>
                      <DATA-SEND-POINTS>
                        <!-- MasterPnc core only -->
                        <BSW-VARIABLE-ACCESS>
                          <SHORT-NAME>BswVarAccess_ComM_User_To_Inhibition_From_[!"$FromOsApplication"!]_To_[!"$ToOsApplication"!]_DataSet</SHORT-NAME>
                          <ACCESSED-VARIABLE-REF DEST="VARIABLE-DATA-PROTOTYPE">/AUTOSAR_ComM/BswModuleDescriptions/ComM/ComM_User_To_Inhibition_From_[!"$FromOsApplication"!]_To_[!"$ToOsApplication"!]_DataSet</ACCESSED-VARIABLE-REF>
                        </BSW-VARIABLE-ACCESS>
                      </DATA-SEND-POINTS>
                      <IMPLEMENTED-ENTRY-REF DEST="BSW-MODULE-ENTRY">/AUTOSAR_ComM/BswModuleEntrys/ComM_User_To_Inhibition_DataSntFnct</IMPLEMENTED-ENTRY-REF>
                    </BSW-CALLED-ENTITY>
        [!ENDIF!] [!/*[!IF "$CurrentOsApplication = $FromOsApplication"!]*/!]    
      [!ENDFOR!] [!/*[!FOR "Idx2" = "1" TO "count(text:split($UserToInhibitionFromOsApp_ToOsApp,' '))"!]*/!]
	[!ENDIF!] [!/*[!IF "(as:modconf('ComM')[1]/ComMGeneral/ComMModeLimitationEnabled = 'true') or (as:modconf('ComM')[1]/ComMGeneral/ComMWakeupInhibitionEnabled = 'true')"!]*/!]
                  </ENTITYS>
                  <EVENTS>
    [!LOOP "as:modconf('ComM')[1]/ComMConfigSet/*[1]/ComMUser/*"!]
      [!CALL "GetUserOsApplication","UserEcuCPartitionRef"="ComMUserEcucPartitionRef"!]
      [!IF "$UserOsApplication = $CurrentOsApplication"!]                  
                    <BSW-TIMING-EVENT>
                      <SHORT-NAME>TimingEvent_MainFunction_User_[!"ComMUserIdentifier"!]</SHORT-NAME>
                      <STARTS-ON-EVENT-REF DEST="BSW-SCHEDULABLE-ENTITY">/AUTOSAR_ComM/BswModuleDescriptions/ComM/InternalBehavior_User_[!"$CurrentOsApplication"!]/ComM_1_User_[!"$UserOsApplication"!]_ComM_MainFunction_User_[!"ComMUserIdentifier"!]</STARTS-ON-EVENT-REF>
                      <PERIOD>[!"num:min(as:modconf('ComM')[1]/ComMConfigSet/*[1]/ComMChannel/*/ComMMainFunctionPeriod)"!]</PERIOD>
                    </BSW-TIMING-EVENT>
      [!ENDIF!] [!/*[!IF "$UserOsApplication = $CurrentOsApplication"!]*/!]
    [!ENDLOOP!] [!/*[!LOOP "as:modconf('ComM')[1]/ComMConfigSet/*[1]/ComMUser/*"!]*/!]     
    [!IF "(as:modconf('ComM')[1]/ComMGeneral/ComMRteUsage = 'true') or (as:modconf('ComM')[1]/ComMGeneral/ComMModeLimitationEnabled = 'true')"!]    
      [!FOR "Idx2" = "1" TO "count(text:split($ChToUserFromOsApp_ToOsApp,' '))"!]
        [!VAR "FromOsApplicationToOsApplication" = "string(text:split($ChToUserFromOsApp_ToOsApp,' ')[position() = $Idx2])"!]
        [!VAR "FromOsApplication" = "string(text:split($FromOsApplicationToOsApplication,'->')[position() = 1])"!]
        [!VAR "ToOsApplication" = "string(text:split($FromOsApplicationToOsApplication,'->')[position() = 2])"!]
        [!IF "$CurrentOsApplication = $ToOsApplication"!]
                    <BSW-DATA-RECEIVED-EVENT>
                        <SHORT-NAME>ComM_Ch_To_User_From_[!"$FromOsApplication"!]_To_[!"$ToOsApplication"!]_RecEv</SHORT-NAME>
                        <STARTS-ON-EVENT-REF DEST="BSW-SCHEDULABLE-ENTITY">/AUTOSAR_ComM/BswModuleDescriptions/ComM/InternalBehavior_User_[!"$ToOsApplication"!]/BswSchEnt_ComM_Ch_To_User_From_[!"$FromOsApplication"!]_To_[!"$ToOsApplication"!]_RcvFnct</STARTS-ON-EVENT-REF>
                        <DATA-REF DEST="VARIABLE-DATA-PROTOTYPE">/AUTOSAR_ComM/BswModuleDescriptions/ComM/ComM_Ch_To_User_From_[!"$FromOsApplication"!]_To_[!"$ToOsApplication"!]_DataGet</DATA-REF>
                    </BSW-DATA-RECEIVED-EVENT>
        [!ENDIF!] [!/*[!IF "$CurrentOsApplication = $ToOsApplication"!]*/!]
      [!ENDFOR!] [!/*[!FOR "Idx2" = "1" TO "count(text:split($ChToUserFromOsApp_ToOsApp,' '))"!]*/!]                    
    [!ENDIF!] [!/*[!IF "(as:modconf('ComM')[1]/ComMGeneral/ComMRteUsage = 'true') or (as:modconf('ComM')[1]/ComMGeneral/ComMModeLimitationEnabled = 'true')"!]*/!]
                  </EVENTS>
                  <RECEPTION-POLICYS>
    [!IF "(as:modconf('ComM')[1]/ComMGeneral/ComMRteUsage = 'true') or (as:modconf('ComM')[1]/ComMGeneral/ComMModeLimitationEnabled = 'true')"!]
      [!FOR "Idx2" = "1" TO "count(text:split($ChToUserFromOsApp_ToOsApp,' '))"!]
        [!VAR "FromOsApplicationToOsApplication" = "string(text:split($ChToUserFromOsApp_ToOsApp,' ')[position() = $Idx2])"!]
        [!VAR "FromOsApplication" = "string(text:split($FromOsApplicationToOsApplication,'->')[position() = 1])"!]
        [!VAR "ToOsApplication" = "string(text:split($FromOsApplicationToOsApplication,'->')[position() = 2])"!]
        [!IF "$CurrentOsApplication = $ToOsApplication"!]
          [!CALL "GetChannelToUserQueueSize","FromOsApplication"="$FromOsApplication","ToOsApplication"="$ToOsApplication"!]
                    <BSW-QUEUED-DATA-RECEPTION-POLICY>
                      <ENABLE-TAKE-ADDRESS>true</ENABLE-TAKE-ADDRESS>
                      <RECEIVED-DATA-REF DEST="VARIABLE-DATA-PROTOTYPE">/AUTOSAR_ComM/BswModuleDescriptions/ComM/ComM_Ch_To_User_From_[!"$FromOsApplication"!]_To_[!"$ToOsApplication"!]_DataGet</RECEIVED-DATA-REF>
                      <QUEUE-LENGTH>[!"num:i($ChannelToUserQueueSize)"!]</QUEUE-LENGTH>
                    </BSW-QUEUED-DATA-RECEPTION-POLICY>
        [!ENDIF!] [!/*[!IF "$CurrentOsApplication = $ToOsApplication"!]*/!]
      [!ENDFOR!] [!/*[!FOR "Idx2" = "1" TO "count(text:split($ChToUserFromOsApp_ToOsApp,' '))"!]*/!]
    [!ENDIF!] [!/*[!IF "(as:modconf('ComM')[1]/ComMGeneral/ComMRteUsage = 'true') or (as:modconf('ComM')[1]/ComMGeneral/ComMModeLimitationEnabled = 'true')"!]*/!]       
                  </RECEPTION-POLICYS>                  
                </BSW-INTERNAL-BEHAVIOR>
  [!ENDFOR!] [!/*[!FOR "Idx1" = "1" TO "count(text:split($FoundUserOsApplications,' '))"!] */!]
[!ENDIF!] [!/* [!IF "num:i(count(as:modconf('ComM')[1]/ComMConfigSet/*[1]/ComMUser/*)) > 0"!] */!]

[!IF "as:modconf('ComM')[1]/ComMGeneral/ComMPncSupport = 'true'"!]
                <BSW-INTERNAL-BEHAVIOR>
                  <SHORT-NAME>InternalBehavior_MasterPnc</SHORT-NAME>
                  <EXCLUSIVE-AREAS>
                    <EXCLUSIVE-AREA>
                      <SHORT-NAME>SCHM_COMM_EXCLUSIVE_AREA_MASTERPNC</SHORT-NAME>
                    </EXCLUSIVE-AREA>
                  </EXCLUSIVE-AREAS>
                  <ENTITYS>
                    <BSW-SCHEDULABLE-ENTITY>
                      <SHORT-NAME>ComM_MainFunction_MasterPnc</SHORT-NAME>
                      <CAN-ENTER-EXCLUSIVE-AREA-REFS>
                        <CAN-ENTER-EXCLUSIVE-AREA-REF DEST="EXCLUSIVE-AREA">/AUTOSAR_ComM/BswModuleDescriptions/ComM/InternalBehavior_MasterPnc/SCHM_COMM_EXCLUSIVE_AREA_MASTERPNC</CAN-ENTER-EXCLUSIVE-AREA-REF>
                      </CAN-ENTER-EXCLUSIVE-AREA-REFS>
                      <MINIMUM-START-INTERVAL>0.0</MINIMUM-START-INTERVAL>
                      <IMPLEMENTED-ENTRY-REF DEST="BSW-MODULE-ENTRY">/AUTOSAR_ComM/[!"$bswModuleEntryPackageName"!]/ComM_MainFunction_MasterPnc</IMPLEMENTED-ENTRY-REF>
                    </BSW-SCHEDULABLE-ENTITY>

  [!IF "count(text:split($FoundMasterPncPlusSignalsOsApplications,' ')) > 1 "!]
    [!LOOP "node:order(node:refs(as:modconf('ComM')[1]/ComMConfigSet/*[1]/ComMPnc/*/ComMPncComSignal/*[ComMPncComSignalDirection='RX']/ComMPncComSignalRef), 'ComHandleId')"!]
      [!CALL "GetSignalOsApplication","SignalHandle"="ComHandleId","Direction"="'RX'"!]
      [!IF "($SignalOsApplication) != ($MasterPncOsApplication)"!]
                    <BSW-SCHEDULABLE-ENTITY>
                      <SHORT-NAME>BswSchEnt_ComM_SgnMasterPnc_From_[!"$SignalOsApplication"!]_To_[!"$MasterPncOsApplication"!]_RcvFnct_[!"node:name(.)"!]</SHORT-NAME>
                      <CAN-ENTER-EXCLUSIVE-AREA-REFS>
                        <CAN-ENTER-EXCLUSIVE-AREA-REF DEST="EXCLUSIVE-AREA">/AUTOSAR_ComM/BswModuleDescriptions/ComM/InternalBehavior_MasterPnc/SCHM_COMM_EXCLUSIVE_AREA_MASTERPNC</CAN-ENTER-EXCLUSIVE-AREA-REF>
                      </CAN-ENTER-EXCLUSIVE-AREA-REFS>
                      <MINIMUM-START-INTERVAL>0.0</MINIMUM-START-INTERVAL>
                      <DATA-RECEIVE-POINTS>
                        <!-- Master core only -->
                        <BSW-VARIABLE-ACCESS>
                          <SHORT-NAME>BswVarAccess_ComM_SgnMasterPnc_From_[!"$SignalOsApplication"!]_To_[!"$MasterPncOsApplication"!]_DataGet_[!"node:name(.)"!]</SHORT-NAME>
                          <ACCESSED-VARIABLE-REF DEST="VARIABLE-DATA-PROTOTYPE">/AUTOSAR_ComM/BswModuleDescriptions/ComM/ComM_SgnMasterPnc_From_[!"$SignalOsApplication"!]_To_[!"$MasterPncOsApplication"!]_DataGet_[!"node:name(.)"!]</ACCESSED-VARIABLE-REF>
                        </BSW-VARIABLE-ACCESS>
                      </DATA-RECEIVE-POINTS>
                      <IMPLEMENTED-ENTRY-REF DEST="BSW-MODULE-ENTRY">/AUTOSAR_ComM/[!"$bswModuleEntryPackageName"!]/ComM_SgnMasterPnc_From_[!"$SignalOsApplication"!]_To_[!"$MasterPncOsApplication"!]_RcvFnct_[!"node:name(.)"!]</IMPLEMENTED-ENTRY-REF>
                    </BSW-SCHEDULABLE-ENTITY>
      [!ENDIF!]
    [!ENDLOOP!]
  [!ENDIF!] [!/*[!IF "count(text:split($FoundMasterPncPlusSignalsOsApplications,' ')) > 1 "!]*/!]

  [!IF "num:i(count(as:modconf('ComM')[1]/ComMConfigSet/*[1]/ComMUser/*)) > 0"!]
    [!FOR "Idx1" = "1" TO "count(text:split($UserToMasterPncFromOsApp_ToOsApp,' '))"!]
      [!VAR "FromOsApplicationToOsApplication" = "string(text:split($UserToMasterPncFromOsApp_ToOsApp,' ')[position() = $Idx1])"!]
      [!VAR "FromOsApplication" = "string(text:split($FromOsApplicationToOsApplication,'->')[position() = 1])"!]
      [!VAR "ToOsApplication" = "string(text:split($FromOsApplicationToOsApplication,'->')[position() = 2])"!]
                    <BSW-SCHEDULABLE-ENTITY>
                      <SHORT-NAME>BswSchEnt_ComM_User_To_MasterPnc_From_[!"$FromOsApplication"!]_To_[!"$ToOsApplication"!]_RcvFnct</SHORT-NAME>
                      <CAN-ENTER-EXCLUSIVE-AREA-REFS>
                        <CAN-ENTER-EXCLUSIVE-AREA-REF DEST="EXCLUSIVE-AREA">/AUTOSAR_ComM/BswModuleDescriptions/ComM/InternalBehavior_MasterPnc/SCHM_COMM_EXCLUSIVE_AREA_MASTERPNC</CAN-ENTER-EXCLUSIVE-AREA-REF>
                      </CAN-ENTER-EXCLUSIVE-AREA-REFS>
                      <MINIMUM-START-INTERVAL>0.0</MINIMUM-START-INTERVAL>
                      <DATA-RECEIVE-POINTS>
                        <!-- MasterPnc core only -->
                        <BSW-VARIABLE-ACCESS>
                          <SHORT-NAME>BswVarAccess_ComM_User_To_MasterPnc_From_[!"$FromOsApplication"!]_To_[!"$ToOsApplication"!]_DataGet</SHORT-NAME>
                          <ACCESSED-VARIABLE-REF DEST="VARIABLE-DATA-PROTOTYPE">/AUTOSAR_ComM/BswModuleDescriptions/ComM/ComM_User_To_MasterPnc_From_[!"$FromOsApplication"!]_To_[!"$ToOsApplication"!]_DataGet</ACCESSED-VARIABLE-REF>
                        </BSW-VARIABLE-ACCESS>
                      </DATA-RECEIVE-POINTS>
                      <IMPLEMENTED-ENTRY-REF DEST="BSW-MODULE-ENTRY">/AUTOSAR_ComM/[!"$bswModuleEntryPackageName"!]/ComM_User_To_MasterPnc_From_[!"$FromOsApplication"!]_To_[!"$ToOsApplication"!]_RcvFnct</IMPLEMENTED-ENTRY-REF>
                    </BSW-SCHEDULABLE-ENTITY>    
    [!ENDFOR!] [!/*[!FOR "Idx1" = "1" TO "count(text:split($UserToMasterPncFromOsApp_ToOsApp,' '))"!]*/!]  
  [!ENDIF!] [!/*[!IF "num:i(count(as:modconf('ComM')[1]/ComMConfigSet/*[1]/ComMUser/*)) > 0"!]*/!]
  [!FOR "Idx1" = "1" TO "count(text:split($ChToMasterPncFromOsApp_ToOsApp,' '))"!]
    [!VAR "FromOsApplicationToOsApplication" = "string(text:split($ChToMasterPncFromOsApp_ToOsApp,' ')[position() = $Idx1])"!]
    [!VAR "FromOsApplication" = "string(text:split($FromOsApplicationToOsApplication,'->')[position() = 1])"!]
    [!VAR "ToOsApplication" = "string(text:split($FromOsApplicationToOsApplication,'->')[position() = 2])"!]
                    <BSW-SCHEDULABLE-ENTITY>
                      <SHORT-NAME>BswSchEnt_ComM_Ch_To_MasterPnc_From_[!"$FromOsApplication"!]_To_[!"$ToOsApplication"!]_RcvFnct</SHORT-NAME>
                      <CAN-ENTER-EXCLUSIVE-AREA-REFS>
                        <CAN-ENTER-EXCLUSIVE-AREA-REF DEST="EXCLUSIVE-AREA">/AUTOSAR_ComM/BswModuleDescriptions/ComM/InternalBehavior_MasterPnc/SCHM_COMM_EXCLUSIVE_AREA_MASTERPNC</CAN-ENTER-EXCLUSIVE-AREA-REF>
                      </CAN-ENTER-EXCLUSIVE-AREA-REFS>
                      <MINIMUM-START-INTERVAL>0.0</MINIMUM-START-INTERVAL>
                      <DATA-RECEIVE-POINTS>
                        <!-- MasterPnc core only -->
                        <BSW-VARIABLE-ACCESS>
                          <SHORT-NAME>BswVarAccess_ComM_Ch_To_MasterPnc_From_[!"$FromOsApplication"!]_To_[!"$ToOsApplication"!]_DataGet</SHORT-NAME>
                          <ACCESSED-VARIABLE-REF DEST="VARIABLE-DATA-PROTOTYPE">/AUTOSAR_ComM/BswModuleDescriptions/ComM/ComM_Ch_To_MasterPnc_From_[!"$FromOsApplication"!]_To_[!"$ToOsApplication"!]_DataGet</ACCESSED-VARIABLE-REF>
                        </BSW-VARIABLE-ACCESS>
                      </DATA-RECEIVE-POINTS>
                      <IMPLEMENTED-ENTRY-REF DEST="BSW-MODULE-ENTRY">/AUTOSAR_ComM/[!"$bswModuleEntryPackageName"!]/ComM_Ch_To_MasterPnc_From_[!"$FromOsApplication"!]_To_[!"$ToOsApplication"!]_RcvFnct</IMPLEMENTED-ENTRY-REF>
                    </BSW-SCHEDULABLE-ENTITY>   
  [!ENDFOR!] [!/*[!FOR "Idx1" = "1" TO "count(text:split($ChToMasterPncFromOsApp_ToOsApp,' '))"!]*/!]  
  
  

  [!IF "node:exists(as:modconf('ComM')[1]/ComMGeneral/ComMSynchronizedPncShutdownEnabled) and (as:modconf('ComM')[1]/ComMGeneral/ComMSynchronizedPncShutdownEnabled = 'true')"!]
    [!FOR "Idx1" = "1" TO "count(text:split($SynchShutDownChToMasterPncFromOsApp_ToOsApp,' '))"!]
      [!VAR "FromOsApplicationToOsApplication" = "string(text:split($SynchShutDownChToMasterPncFromOsApp_ToOsApp,' ')[position() = $Idx1])"!]
      [!VAR "FromOsApplication" = "string(text:split($FromOsApplicationToOsApplication,'->')[position() = 1])"!]
      [!VAR "ToOsApplication" = "string(text:split($FromOsApplicationToOsApplication,'->')[position() = 2])"!]
                    <BSW-SCHEDULABLE-ENTITY>
                      <SHORT-NAME>BswSchEnt_ComM_SynchShutDownCh_To_MasterPnc_From_[!"$FromOsApplication"!]_To_[!"$ToOsApplication"!]_RcvFnct</SHORT-NAME>
                      <CAN-ENTER-EXCLUSIVE-AREA-REFS>
                        <CAN-ENTER-EXCLUSIVE-AREA-REF DEST="EXCLUSIVE-AREA">/AUTOSAR_ComM/BswModuleDescriptions/ComM/InternalBehavior_MasterPnc/SCHM_COMM_EXCLUSIVE_AREA_MASTERPNC</CAN-ENTER-EXCLUSIVE-AREA-REF>
                      </CAN-ENTER-EXCLUSIVE-AREA-REFS>
                      <MINIMUM-START-INTERVAL>0.0</MINIMUM-START-INTERVAL>
                      <DATA-RECEIVE-POINTS>
                        <!-- MasterPnc core only -->
                        <BSW-VARIABLE-ACCESS>
                          <SHORT-NAME>BswVarAccess_ComM_SynchShutDownCh_To_MasterPnc_From_[!"$FromOsApplication"!]_To_[!"$ToOsApplication"!]_DataGet</SHORT-NAME>
                          <ACCESSED-VARIABLE-REF DEST="VARIABLE-DATA-PROTOTYPE">/AUTOSAR_ComM/BswModuleDescriptions/ComM/ComM_SynchShutDownCh_To_MasterPnc_From_[!"$FromOsApplication"!]_To_[!"$ToOsApplication"!]_DataGet</ACCESSED-VARIABLE-REF>
                        </BSW-VARIABLE-ACCESS>
                      </DATA-RECEIVE-POINTS>
                      <IMPLEMENTED-ENTRY-REF DEST="BSW-MODULE-ENTRY">/AUTOSAR_ComM/[!"$bswModuleEntryPackageName"!]/ComM_SynchShutDownCh_To_MasterPnc_From_[!"$FromOsApplication"!]_To_[!"$ToOsApplication"!]_RcvFnct</IMPLEMENTED-ENTRY-REF>
                    </BSW-SCHEDULABLE-ENTITY>   
    [!ENDFOR!] [!/*[!FOR "Idx1" = "1" TO "count(text:split($SynchShutDownChToMasterPncFromOsApp_ToOsApp,' '))"!]*/!]  
  [!ENDIF!] [!/*[!IF "node:exists(as:modconf('ComM')[1]/ComMGeneral/ComMSynchronizedPncShutdownEnabled) and (as:modconf('ComM')[1]/ComMGeneral/ComMSynchronizedPncShutdownEnabled = 'true')"!]*/!]

  [!IF "node:exists(as:modconf('EcuM')[1]/EcuMGeneral/EcuMCrossCoreComMWakeup) and (node:value(as:modconf('EcuM')[1]/EcuMGeneral/EcuMCrossCoreComMWakeup) = 'true')"!]
    [!FOR "Idx1" = "0" TO "(as:modconf('Os')[1]/OsOS/OsNumberOfCores) - 1"!]
      [!LOOP "node:order(node:refs(as:modconf('EcuM')[1]/EcuMConfiguration/*[1]/EcuMCommonConfiguration/EcuMWakeupSource/*/EcuMComMPNCRef), 'ComMPncId')"!]
                    <BSW-CALLED-ENTITY>
                      <SHORT-NAME>ComM_EcuM_PNCWakeUpIndication_CalledEntity_[!"node:name(.)"!]_Core_[!"$Idx1"!]</SHORT-NAME>
                      <MINIMUM-START-INTERVAL>0.0</MINIMUM-START-INTERVAL>
                      <IMPLEMENTED-ENTRY-REF DEST="BSW-MODULE-ENTRY">/AUTOSAR_ComM/BswModuleEntrys/ComM_EcuM_PNCWakeUpIndication</IMPLEMENTED-ENTRY-REF>
                    </BSW-CALLED-ENTITY>
      [!ENDLOOP!]
    [!ENDFOR!]
  [!ENDIF!] [!/* node:exists(as:modconf('EcuM')[1]/EcuMGeneral/EcuMCrossCoreComMWakeup) and (node:value(as:modconf('EcuM')[1]/EcuMGeneral/EcuMCrossCoreComMWakeup) = 'true') */!]
  [!IF "count(text:split($FoundMasterPncPlusSignalsOsApplications,' ')) > 1 "!]
    [!LOOP "node:order(node:refs(as:modconf('ComM')[1]/ComMConfigSet/*[1]/ComMPnc/*/ComMPncComSignal/*[ComMPncComSignalDirection='TX']/ComMPncComSignalRef), 'ComHandleId')"!]
      [!CALL "GetSignalOsApplication","SignalHandle"="ComHandleId","Direction"="'TX'"!]
      [!IF "($SignalOsApplication) != ($MasterPncOsApplication)"!]
                    <BSW-CALLED-ENTITY>
                      <SHORT-NAME>BswCalledEnt_SgnMasterPnc_From_[!"$MasterPncOsApplication"!]_To_[!"$SignalOsApplication"!]_DataSntFnct_[!"node:name(.)"!]</SHORT-NAME>
                      <MINIMUM-START-INTERVAL>0.0</MINIMUM-START-INTERVAL>
                      <DATA-SEND-POINTS>
                        <!-- MasterPnc core only -->
                        <BSW-VARIABLE-ACCESS>
                          <SHORT-NAME>BswVarAccess_SgnMasterPnc_From_[!"$MasterPncOsApplication"!]_To_[!"$SignalOsApplication"!]_DataSet_[!"node:name(.)"!]</SHORT-NAME>
                          <ACCESSED-VARIABLE-REF DEST="VARIABLE-DATA-PROTOTYPE">/AUTOSAR_ComM/BswModuleDescriptions/ComM/ComM_SgnMasterPnc_From_[!"$MasterPncOsApplication"!]_To_[!"$SignalOsApplication"!]_DataSet_[!"node:name(.)"!]</ACCESSED-VARIABLE-REF>
                        </BSW-VARIABLE-ACCESS>
                      </DATA-SEND-POINTS>
                      <IMPLEMENTED-ENTRY-REF DEST="BSW-MODULE-ENTRY">/AUTOSAR_ComM/BswModuleEntrys/ComM_SgnMasterPnc_DataSntFnct</IMPLEMENTED-ENTRY-REF>
                    </BSW-CALLED-ENTITY>
      [!ENDIF!]
    [!ENDLOOP!]
  [!ENDIF!] [!/* [!IF "count(text:split($FoundMasterPncPlusSignalsOsApplications,' ')) > 1 "!] */!]
  [!FOR "Idx1" = "1" TO "count(text:split($MasterPncToChFromOsApp_ToOsApp,' '))"!]
    [!VAR "FromOsApplicationToOsApplication" = "string(text:split($MasterPncToChFromOsApp_ToOsApp,' ')[position() = $Idx1])"!]
    [!VAR "FromOsApplication" = "string(text:split($FromOsApplicationToOsApplication,'->')[position() = 1])"!]
    [!VAR "ToOsApplication" = "string(text:split($FromOsApplicationToOsApplication,'->')[position() = 2])"!]            
                  <BSW-CALLED-ENTITY>
                    <SHORT-NAME>BswCalledEnt_ComM_MasterPnc_To_Ch_From_[!"$FromOsApplication"!]_To_[!"$ToOsApplication"!]_DataSntFnct</SHORT-NAME>
                    <MINIMUM-START-INTERVAL>0.0</MINIMUM-START-INTERVAL>
                    <DATA-SEND-POINTS>
                      <!-- MasterPnc core only -->
                      <BSW-VARIABLE-ACCESS>
                        <SHORT-NAME>BswVarAccess_ComM_MasterPnc_To_Ch_From_[!"$FromOsApplication"!]_To_[!"$ToOsApplication"!]_DataSet</SHORT-NAME>
                        <ACCESSED-VARIABLE-REF DEST="VARIABLE-DATA-PROTOTYPE">/AUTOSAR_ComM/BswModuleDescriptions/ComM/ComM_MasterPnc_To_Ch_From_[!"$FromOsApplication"!]_To_[!"$ToOsApplication"!]_DataSet</ACCESSED-VARIABLE-REF>
                      </BSW-VARIABLE-ACCESS>
                    </DATA-SEND-POINTS>
                    <IMPLEMENTED-ENTRY-REF DEST="BSW-MODULE-ENTRY">/AUTOSAR_ComM/BswModuleEntrys/ComM_MasterPnc_To_Ch_DataSntFnct</IMPLEMENTED-ENTRY-REF>
                  </BSW-CALLED-ENTITY>
  [!ENDFOR!] [!/*[!FOR "Idx1" = "1" TO "count(text:split($MasterPncToChFromOsApp_ToOsApp,' '))"!]*/!]
                  </ENTITYS>
                  <EVENTS>
                    <BSW-TIMING-EVENT>
                      <SHORT-NAME>TimingEvent_MainFunction_MasterPnc</SHORT-NAME>
                      <STARTS-ON-EVENT-REF DEST="BSW-SCHEDULABLE-ENTITY">/AUTOSAR_ComM/BswModuleDescriptions/ComM/InternalBehavior_MasterPnc/ComM_MainFunction_MasterPnc</STARTS-ON-EVENT-REF>
                      <PERIOD>[!"num:min(as:modconf('ComM')[1]/ComMConfigSet/*[1]/ComMChannel/*/ComMMainFunctionPeriod)"!]</PERIOD>
                    </BSW-TIMING-EVENT>
  [!IF "count(text:split($FoundMasterPncPlusSignalsOsApplications,' ')) > 1 "!]
    [!LOOP "node:order(node:refs(as:modconf('ComM')[1]/ComMConfigSet/*[1]/ComMPnc/*/ComMPncComSignal/*[ComMPncComSignalDirection='RX']/ComMPncComSignalRef), 'ComHandleId')"!]
      [!CALL "GetSignalOsApplication","SignalHandle"="ComHandleId","Direction"="'RX'"!]
      [!IF "($SignalOsApplication) != ($MasterPncOsApplication)"!]
                    <BSW-DATA-RECEIVED-EVENT>
                        <SHORT-NAME>ComM_SgnMasterPnc_From_[!"$SignalOsApplication"!]_To_[!"$MasterPncOsApplication"!]_[!"node:name(.)"!]_RecEv</SHORT-NAME>
                        <STARTS-ON-EVENT-REF DEST="BSW-SCHEDULABLE-ENTITY">/AUTOSAR_ComM/BswModuleDescriptions/ComM/InternalBehavior_MasterPnc/BswSchEnt_ComM_SgnMasterPnc_From_[!"$SignalOsApplication"!]_To_[!"$MasterPncOsApplication"!]_RcvFnct_[!"node:name(.)"!]</STARTS-ON-EVENT-REF>
                        <DATA-REF DEST="VARIABLE-DATA-PROTOTYPE">/AUTOSAR_ComM/BswModuleDescriptions/ComM/ComM_SgnMasterPnc_From_[!"$SignalOsApplication"!]_To_[!"$MasterPncOsApplication"!]_DataGet_[!"node:name(.)"!]</DATA-REF>
                    </BSW-DATA-RECEIVED-EVENT>
      [!ENDIF!]
    [!ENDLOOP!]
  [!ENDIF!]

  [!IF "num:i(count(as:modconf('ComM')[1]/ComMConfigSet/*[1]/ComMUser/*)) > 0"!]
    [!FOR "Idx1" = "1" TO "count(text:split($UserToMasterPncFromOsApp_ToOsApp,' '))"!]
      [!VAR "FromOsApplicationToOsApplication" = "string(text:split($UserToMasterPncFromOsApp_ToOsApp,' ')[position() = $Idx1])"!]
      [!VAR "FromOsApplication" = "string(text:split($FromOsApplicationToOsApplication,'->')[position() = 1])"!]
      [!VAR "ToOsApplication" = "string(text:split($FromOsApplicationToOsApplication,'->')[position() = 2])"!]               
                    <BSW-DATA-RECEIVED-EVENT>
                        <SHORT-NAME>ComM_User_To_MasterPnc_From_[!"$FromOsApplication"!]_To_[!"$ToOsApplication"!]_RecEv</SHORT-NAME>
                        <STARTS-ON-EVENT-REF DEST="BSW-SCHEDULABLE-ENTITY">/AUTOSAR_ComM/BswModuleDescriptions/ComM/InternalBehavior_MasterPnc/BswSchEnt_ComM_User_To_MasterPnc_From_[!"$FromOsApplication"!]_To_[!"$ToOsApplication"!]_RcvFnct</STARTS-ON-EVENT-REF>
                        <DATA-REF DEST="VARIABLE-DATA-PROTOTYPE">/AUTOSAR_ComM/BswModuleDescriptions/ComM/ComM_User_To_MasterPnc_From_[!"$FromOsApplication"!]_To_[!"$ToOsApplication"!]_DataGet</DATA-REF>
                    </BSW-DATA-RECEIVED-EVENT>
    [!ENDFOR!] [!/*[!FOR "Idx1" = "1" TO "count(text:split($UserToMasterPncFromOsApp_ToOsApp,' '))"!]*/!]
  [!ENDIF!] [!/*[!IF "num:i(count(as:modconf('ComM')[1]/ComMConfigSet/*[1]/ComMUser/*)) > 0"!]*/!]
  
  [!FOR "Idx1" = "1" TO "count(text:split($ChToMasterPncFromOsApp_ToOsApp,' '))"!]
    [!VAR "FromOsApplicationToOsApplication" = "string(text:split($ChToMasterPncFromOsApp_ToOsApp,' ')[position() = $Idx1])"!]
    [!VAR "FromOsApplication" = "string(text:split($FromOsApplicationToOsApplication,'->')[position() = 1])"!]
    [!VAR "ToOsApplication" = "string(text:split($FromOsApplicationToOsApplication,'->')[position() = 2])"!] 
                    <BSW-DATA-RECEIVED-EVENT>
                        <SHORT-NAME>ComM_Ch_To_MasterPnc_From_[!"$FromOsApplication"!]_To_[!"$ToOsApplication"!]_RecEv</SHORT-NAME>
                        <STARTS-ON-EVENT-REF DEST="BSW-SCHEDULABLE-ENTITY">/AUTOSAR_ComM/BswModuleDescriptions/ComM/InternalBehavior_MasterPnc/BswSchEnt_ComM_Ch_To_MasterPnc_From_[!"$FromOsApplication"!]_To_[!"$ToOsApplication"!]_RcvFnct</STARTS-ON-EVENT-REF>
                        <DATA-REF DEST="VARIABLE-DATA-PROTOTYPE">/AUTOSAR_ComM/BswModuleDescriptions/ComM/ComM_Ch_To_MasterPnc_From_[!"$FromOsApplication"!]_To_[!"$ToOsApplication"!]_DataGet</DATA-REF>
                    </BSW-DATA-RECEIVED-EVENT>
  [!ENDFOR!] [!/*[!FOR "Idx1" = "1" TO "count(text:split($ChToMasterPncFromOsApp_ToOsApp,' '))"!]*/!]  
  
  [!IF "node:exists(as:modconf('ComM')[1]/ComMGeneral/ComMSynchronizedPncShutdownEnabled) and (as:modconf('ComM')[1]/ComMGeneral/ComMSynchronizedPncShutdownEnabled = 'true')"!]
    [!FOR "Idx1" = "1" TO "count(text:split($SynchShutDownChToMasterPncFromOsApp_ToOsApp,' '))"!]
      [!VAR "FromOsApplicationToOsApplication" = "string(text:split($SynchShutDownChToMasterPncFromOsApp_ToOsApp,' ')[position() = $Idx1])"!]
      [!VAR "FromOsApplication" = "string(text:split($FromOsApplicationToOsApplication,'->')[position() = 1])"!]
      [!VAR "ToOsApplication" = "string(text:split($FromOsApplicationToOsApplication,'->')[position() = 2])"!] 
                    <BSW-DATA-RECEIVED-EVENT>
                        <SHORT-NAME>ComM_SynchShutDownCh_To_MasterPnc_From_[!"$FromOsApplication"!]_To_[!"$ToOsApplication"!]_RecEv</SHORT-NAME>
                        <STARTS-ON-EVENT-REF DEST="BSW-SCHEDULABLE-ENTITY">/AUTOSAR_ComM/BswModuleDescriptions/ComM/InternalBehavior_MasterPnc/BswSchEnt_ComM_SynchShutDownCh_To_MasterPnc_From_[!"$FromOsApplication"!]_To_[!"$ToOsApplication"!]_RcvFnct</STARTS-ON-EVENT-REF>
                        <DATA-REF DEST="VARIABLE-DATA-PROTOTYPE">/AUTOSAR_ComM/BswModuleDescriptions/ComM/ComM_SynchShutDownCh_To_MasterPnc_From_[!"$FromOsApplication"!]_To_[!"$ToOsApplication"!]_DataGet</DATA-REF>
                    </BSW-DATA-RECEIVED-EVENT>
    [!ENDFOR!] [!/*[!FOR "Idx1" = "1" TO "count(text:split($SynchShutDownChToMasterPncFromOsApp_ToOsApp,' '))"!]*/!]
  [!ENDIF!] [!/*[!IF "node:exists(as:modconf('ComM')[1]/ComMGeneral/ComMSynchronizedPncShutdownEnabled) and (as:modconf('ComM')[1]/ComMGeneral/ComMSynchronizedPncShutdownEnabled = 'true')"!]*/!]

  [!IF "node:exists(as:modconf('EcuM')[1]/EcuMGeneral/EcuMCrossCoreComMWakeup) and (node:value(as:modconf('EcuM')[1]/EcuMGeneral/EcuMCrossCoreComMWakeup) = 'true')"!]
    [!FOR "Idx1" = "0" TO "(as:modconf('Os')[1]/OsOS/OsNumberOfCores) - 1"!]
      [!LOOP "node:order(node:refs(as:modconf('EcuM')[1]/EcuMConfiguration/*[1]/EcuMCommonConfiguration/EcuMWakeupSource/*/EcuMComMPNCRef), 'ComMPncId')"!]
                    <BSW-OPERATION-INVOKED-EVENT>
                      <SHORT-NAME>OpInokedEv_ComM_EcuM_PNCWakeUpIndication_[!"node:name(.)"!]_Core_[!"$Idx1"!]</SHORT-NAME>
                      <STARTS-ON-EVENT-REF DEST="BSW-CALLED-ENTITY">/AUTOSAR_ComM/BswModuleDescriptions/ComM/InternalBehavior_MasterPnc/ComM_EcuM_PNCWakeUpIndication_CalledEntity_[!"node:name(.)"!]_Core_[!"$Idx1"!]</STARTS-ON-EVENT-REF>
                      <ENTRY-REF DEST="BSW-MODULE-CLIENT-SERVER-ENTRY">/AUTOSAR_ComM/BswModuleDescriptions/ComM/ProvidedCSEntry_ComM_EcuM_PNCWakeUpIndication_[!"node:name(.)"!]_Core_[!"$Idx1"!]</ENTRY-REF>
                    </BSW-OPERATION-INVOKED-EVENT>
      [!ENDLOOP!]
    [!ENDFOR!]
  [!ENDIF!] [!/* [!IF "node:exists(as:modconf('EcuM')[1]/EcuMGeneral/EcuMCrossCoreComMWakeup) and (node:value(as:modconf('EcuM')[1]/EcuMGeneral/EcuMCrossCoreComMWakeup) = 'true')"!] */!]
                  </EVENTS>
                  <RECEPTION-POLICYS>
  [!IF "count(text:split($FoundMasterPncPlusSignalsOsApplications,' ')) > 1 "!]
    [!LOOP "node:order(node:refs(as:modconf('ComM')[1]/ComMConfigSet/*[1]/ComMPnc/*/ComMPncComSignal/*[ComMPncComSignalDirection='RX']/ComMPncComSignalRef), 'ComHandleId')"!]
      [!CALL "GetSignalOsApplication","SignalHandle"="ComHandleId","Direction"="'RX'"!]
      [!IF "($SignalOsApplication) != ($MasterPncOsApplication)"!]
                    <BSW-QUEUED-DATA-RECEPTION-POLICY>
                      <ENABLE-TAKE-ADDRESS>true</ENABLE-TAKE-ADDRESS>
                      <RECEIVED-DATA-REF DEST="VARIABLE-DATA-PROTOTYPE">/AUTOSAR_ComM/BswModuleDescriptions/ComM/ComM_SgnMasterPnc_From_[!"$SignalOsApplication"!]_To_[!"$MasterPncOsApplication"!]_DataGet_[!"node:name(.)"!]</RECEIVED-DATA-REF>
                      <QUEUE-LENGTH>2</QUEUE-LENGTH>
                    </BSW-QUEUED-DATA-RECEPTION-POLICY>
      [!ENDIF!]
    [!ENDLOOP!]
  [!ENDIF!] [!/*[!IF "count(text:split($FoundMasterPncPlusSignalsOsApplications,' ')) > 1 "!]*/!]
  
  [!IF "num:i(count(as:modconf('ComM')[1]/ComMConfigSet/*[1]/ComMUser/*)) > 0"!]
    [!FOR "Idx1" = "1" TO "count(text:split($UserToMasterPncFromOsApp_ToOsApp,' '))"!]
      [!VAR "FromOsApplicationToOsApplication" = "string(text:split($UserToMasterPncFromOsApp_ToOsApp,' ')[position() = $Idx1])"!]
      [!VAR "FromOsApplication" = "string(text:split($FromOsApplicationToOsApplication,'->')[position() = 1])"!]
      [!VAR "ToOsApplication" = "string(text:split($FromOsApplicationToOsApplication,'->')[position() = 2])"!]
        [!CALL "GetUserToMasterPncQueueSize","FromOsApplication"="$FromOsApplication"!]
                    <BSW-QUEUED-DATA-RECEPTION-POLICY>
                      <ENABLE-TAKE-ADDRESS>true</ENABLE-TAKE-ADDRESS>
                      <RECEIVED-DATA-REF DEST="VARIABLE-DATA-PROTOTYPE">/AUTOSAR_ComM/BswModuleDescriptions/ComM/ComM_User_To_MasterPnc_From_[!"$FromOsApplication"!]_To_[!"$ToOsApplication"!]_DataGet</RECEIVED-DATA-REF>
                      <QUEUE-LENGTH>[!"num:i($UserToMasterPncQueueSize)"!]</QUEUE-LENGTH>
                    </BSW-QUEUED-DATA-RECEPTION-POLICY>
    [!ENDFOR!] [!/*[!FOR "Idx1" = "1" TO "count(text:split($UserToMasterPncFromOsApp_ToOsApp,' '))"!]*/!]
  [!ENDIF!] [!/*[!IF "num:i(count(as:modconf('ComM')[1]/ComMConfigSet/*[1]/ComMUser/*)) > 0"!]*/!]
  [!FOR "Idx1" = "1" TO "count(text:split($ChToMasterPncFromOsApp_ToOsApp,' '))"!]
    [!VAR "FromOsApplicationToOsApplication" = "string(text:split($ChToMasterPncFromOsApp_ToOsApp,' ')[position() = $Idx1])"!]
    [!VAR "FromOsApplication" = "string(text:split($FromOsApplicationToOsApplication,'->')[position() = 1])"!]
    [!VAR "ToOsApplication" = "string(text:split($FromOsApplicationToOsApplication,'->')[position() = 2])"!]
    [!CALL "GetChToMasterPncQueueSize","FromOsApplication"="$FromOsApplication"!]
                    <BSW-QUEUED-DATA-RECEPTION-POLICY>
                      <ENABLE-TAKE-ADDRESS>true</ENABLE-TAKE-ADDRESS>
                      <RECEIVED-DATA-REF DEST="VARIABLE-DATA-PROTOTYPE">/AUTOSAR_ComM/BswModuleDescriptions/ComM/ComM_Ch_To_MasterPnc_From_[!"$FromOsApplication"!]_To_[!"$ToOsApplication"!]_DataGet</RECEIVED-DATA-REF>
                      <QUEUE-LENGTH>[!"num:i($ChToMasterPncQueueSize)"!]</QUEUE-LENGTH>
                    </BSW-QUEUED-DATA-RECEPTION-POLICY>
  [!ENDFOR!] [!/*[!FOR "Idx1" = "1" TO "count(text:split($ChToMasterPncFromOsApp_ToOsApp,' '))"!]*/!]  

  [!IF "node:exists(as:modconf('ComM')[1]/ComMGeneral/ComMSynchronizedPncShutdownEnabled) and (as:modconf('ComM')[1]/ComMGeneral/ComMSynchronizedPncShutdownEnabled = 'true')"!]
    [!FOR "Idx1" = "1" TO "count(text:split($SynchShutDownChToMasterPncFromOsApp_ToOsApp,' '))"!]
      [!VAR "FromOsApplicationToOsApplication" = "string(text:split($SynchShutDownChToMasterPncFromOsApp_ToOsApp,' ')[position() = $Idx1])"!]
      [!VAR "FromOsApplication" = "string(text:split($FromOsApplicationToOsApplication,'->')[position() = 1])"!]
      [!VAR "ToOsApplication" = "string(text:split($FromOsApplicationToOsApplication,'->')[position() = 2])"!]
      [!CALL "GetSynchShutDownChToMasterPnc_QueueSize","FromOsApplication"="$FromOsApplication"!]
                    <BSW-QUEUED-DATA-RECEPTION-POLICY>
                      <ENABLE-TAKE-ADDRESS>true</ENABLE-TAKE-ADDRESS>
                      <RECEIVED-DATA-REF DEST="VARIABLE-DATA-PROTOTYPE">/AUTOSAR_ComM/BswModuleDescriptions/ComM/ComM_SynchShutDownCh_To_MasterPnc_From_[!"$FromOsApplication"!]_To_[!"$ToOsApplication"!]_DataGet</RECEIVED-DATA-REF>
                      <QUEUE-LENGTH>[!"num:i($SynchShutDownChToMasterPncQueueSize)"!]</QUEUE-LENGTH>
                    </BSW-QUEUED-DATA-RECEPTION-POLICY>
    [!ENDFOR!] [!/*[!FOR "Idx1" = "1" TO "count(text:split($SynchShutDownChToMasterPncFromOsApp_ToOsApp,' '))"!]*/!]                    
  [!ENDIF!] [!/*[!IF "node:exists(as:modconf('ComM')[1]/ComMGeneral/ComMSynchronizedPncShutdownEnabled) and (as:modconf('ComM')[1]/ComMGeneral/ComMSynchronizedPncShutdownEnabled = 'true')"!]*/!]
                  </RECEPTION-POLICYS>
                </BSW-INTERNAL-BEHAVIOR>
[!ENDIF!] [!/* [!IF "as:modconf('ComM')[1]/ComMGeneral/ComMPncSupport = 'true'"!] */!]
[!FOR "Idx1" = "1" TO "count(text:split($FoundChannelsOsApplications,' '))"!]
  [!VAR "CurrentOsApplication" = "string(text:split($FoundChannelsOsApplications,' ')[position() = $Idx1])"!]
                <BSW-INTERNAL-BEHAVIOR>
                  <SHORT-NAME>InternalBehavior_Ch_OsApplication_[!"$CurrentOsApplication"!]</SHORT-NAME>
                  <EXCLUSIVE-AREAS>
                    <EXCLUSIVE-AREA>
                      <SHORT-NAME>SCHM_COMM_EXCLUSIVE_AREA_CH_OSAPPLICATION_[!"$CurrentOsApplication"!]</SHORT-NAME>
                    </EXCLUSIVE-AREA>
                  </EXCLUSIVE-AREAS>
                  <ENTITYS>
  [!LOOP "as:modconf('ComM')[1]/ComMConfigSet/*[1]/ComMChannel/*"!]
    [!VAR "EcuCChannelPartitonRef" = "ComMChannelPartitionRef"!]
    [!IF "node:name(as:modconf('Os')[1]/OsApplication/*[node:exists(OsAppEcucPartitionRef) and (OsAppEcucPartitionRef = $EcuCChannelPartitonRef)]) = $CurrentOsApplication"!]
      [!CALL "GetDcmChannelFound","CurrentComMChannelId"="ComMChannelId"!]
      [!CALL "GetChannelOsApplication","ChannelEcuCPartitionRef"="ComMChannelPartitionRef"!]
                    <BSW-SCHEDULABLE-ENTITY>
                      <SHORT-NAME>ComM_1_Ch_OsApplication_[!"$ChannelOsApplication"!]_ComM_MainFunction_[!"ComMChannelId"!]</SHORT-NAME>
                      <CAN-ENTER-EXCLUSIVE-AREA-REFS>
                        <CAN-ENTER-EXCLUSIVE-AREA-REF DEST="EXCLUSIVE-AREA">/AUTOSAR_ComM/BswModuleDescriptions/ComM/InternalBehavior_Ch_OsApplication_[!"$CurrentOsApplication"!]/SCHM_COMM_EXCLUSIVE_AREA_CH_OSAPPLICATION_[!"$CurrentOsApplication"!]</CAN-ENTER-EXCLUSIVE-AREA-REF>
                      </CAN-ENTER-EXCLUSIVE-AREA-REFS>
                      <MINIMUM-START-INTERVAL>0.0</MINIMUM-START-INTERVAL>
                      <CALL-POINTS>
      [!IF "$DcmChannelFound = 'true'"!]
                        <BSW-ASYNCHRONOUS-SERVER-CALL-POINT>
                          <SHORT-NAME>AsynchCallPoint_Dcm_ComM_FullComModeEntered_[!"node:name(.)"!]</SHORT-NAME>
                          <CALLED-ENTRY-REF DEST="BSW-MODULE-CLIENT-SERVER-ENTRY">/AUTOSAR_ComM/BswModuleDescriptions/ComM/RequiredCSEntry_Dcm_ComM_FullComModeEntered_[!"node:name(.)"!]</CALLED-ENTRY-REF>
                        </BSW-ASYNCHRONOUS-SERVER-CALL-POINT>
        [!IF "(ComMBusType = 'COMM_BUS_TYPE_CAN' or ComMBusType = 'COMM_BUS_TYPE_ETH') and (ComMNetworkManagement/ComMNmVariant = 'FULL' or ComMNetworkManagement/ComMNmVariant = 'PASSIVE')"!]
                        <BSW-ASYNCHRONOUS-SERVER-CALL-POINT>
                          <SHORT-NAME>AsynchCallPoint_Dcm_ComM_SilentComModeEntered_[!"node:name(.)"!]</SHORT-NAME>
                          <CALLED-ENTRY-REF DEST="BSW-MODULE-CLIENT-SERVER-ENTRY">/AUTOSAR_ComM/BswModuleDescriptions/ComM/RequiredCSEntry_Dcm_ComM_SilentComModeEntered_[!"node:name(.)"!]</CALLED-ENTRY-REF>
                        </BSW-ASYNCHRONOUS-SERVER-CALL-POINT>
        [!ENDIF!] [!/* [!IF "(ComMBusType = 'COMM_BUS_TYPE_CAN' or ComMBusType = 'COMM_BUS_TYPE_ETH') and (ComMNetworkManagement/ComMNmVariant = 'FULL' or ComMNetworkManagement/ComMNmVariant = 'PASSIVE')"!] */!]
                        <BSW-ASYNCHRONOUS-SERVER-CALL-POINT>
                          <SHORT-NAME>AsynchCallPoint_Dcm_ComM_NoComModeEntered_[!"node:name(.)"!]</SHORT-NAME>
                          <CALLED-ENTRY-REF DEST="BSW-MODULE-CLIENT-SERVER-ENTRY">/AUTOSAR_ComM/BswModuleDescriptions/ComM/RequiredCSEntry_Dcm_ComM_NoComModeEntered_[!"node:name(.)"!]</CALLED-ENTRY-REF>
                        </BSW-ASYNCHRONOUS-SERVER-CALL-POINT>
      [!ENDIF!] [!/* [!IF "$DcmChannelFound = 'true'"!] */!]
                      </CALL-POINTS>
                      <IMPLEMENTED-ENTRY-REF DEST="BSW-MODULE-ENTRY">/AUTOSAR_ComM/[!"$bswModuleEntryPackageName"!]/ComM_MainFunction_[!"ComMChannelId"!]</IMPLEMENTED-ENTRY-REF>
                    </BSW-SCHEDULABLE-ENTITY>
    [!ENDIF!] [!/* [!IF "node:name(as:modconf('Os')[1]/OsApplication/*[node:exists(OsAppEcucPartitionRef) and (OsAppEcucPartitionRef = $EcuCChannelPartitonRef)]) = $CurrentOsApplication"!] */!]
  [!ENDLOOP!] [!/* [!LOOP "as:modconf('ComM')[1]/ComMConfigSet/*[1]/ComMChannel/*"!]!*/!]
  [!FOR "Idx2" = "1" TO "count(text:split($ChToChFromOsApp_ToOsApp,' '))"!]
    [!VAR "FromOsApplicationToOsApplication" = "string(text:split($ChToChFromOsApp_ToOsApp,' ')[position() = $Idx2])"!]
    [!VAR "FromOsApplication" = "string(text:split($FromOsApplicationToOsApplication,'->')[position() = 1])"!]
    [!VAR "ToOsApplication" = "string(text:split($FromOsApplicationToOsApplication,'->')[position() = 2])"!]
    [!IF "$CurrentOsApplication = $ToOsApplication"!]
                    <BSW-SCHEDULABLE-ENTITY>
                      <SHORT-NAME>BswSchEnt_ComM_Ch_To_Ch_From_[!"$FromOsApplication"!]_To_[!"$ToOsApplication"!]_RcvFnct</SHORT-NAME>
                      <CAN-ENTER-EXCLUSIVE-AREA-REFS>
                        <CAN-ENTER-EXCLUSIVE-AREA-REF DEST="EXCLUSIVE-AREA">/AUTOSAR_ComM/BswModuleDescriptions/ComM/InternalBehavior_Ch_OsApplication_[!"$ToOsApplication"!]/SCHM_COMM_EXCLUSIVE_AREA_CH_OSAPPLICATION_[!"$ToOsApplication"!]</CAN-ENTER-EXCLUSIVE-AREA-REF>
                      </CAN-ENTER-EXCLUSIVE-AREA-REFS>
                      <MINIMUM-START-INTERVAL>0.0</MINIMUM-START-INTERVAL>
                      <DATA-RECEIVE-POINTS>
                        <!-- MasterPnc core only -->
                        <BSW-VARIABLE-ACCESS>
                          <SHORT-NAME>BswVarAccess_ComM_Ch_To_Ch_From_[!"$FromOsApplication"!]_To_[!"$ToOsApplication"!]_DataGet</SHORT-NAME>
                          <ACCESSED-VARIABLE-REF DEST="VARIABLE-DATA-PROTOTYPE">/AUTOSAR_ComM/BswModuleDescriptions/ComM/ComM_Ch_To_Ch_From_[!"$FromOsApplication"!]_To_[!"$ToOsApplication"!]_DataGet</ACCESSED-VARIABLE-REF>
                        </BSW-VARIABLE-ACCESS>
                      </DATA-RECEIVE-POINTS>
                      <IMPLEMENTED-ENTRY-REF DEST="BSW-MODULE-ENTRY">/AUTOSAR_ComM/[!"$bswModuleEntryPackageName"!]/ComM_Ch_To_Ch_From_[!"$FromOsApplication"!]_To_[!"$ToOsApplication"!]_RcvFnct</IMPLEMENTED-ENTRY-REF>
                    </BSW-SCHEDULABLE-ENTITY>
    [!ENDIF!] [!/*[!IF "$CurrentOsApplication = $ToOsApplication"!]*/!]
  [!ENDFOR!] [!/*[!FOR "Idx2" = "1" TO "count(text:split($ChToChFromOsApp_ToOsApp,' '))"!]*/!]
  [!IF "as:modconf('ComM')[1]/ComMGeneral/ComMPncSupport = 'true'"!]
    [!FOR "Idx2" = "1" TO "count(text:split($MasterPncToChFromOsApp_ToOsApp,' '))"!]
      [!VAR "FromOsApplicationToOsApplication" = "string(text:split($MasterPncToChFromOsApp_ToOsApp,' ')[position() = $Idx2])"!]
      [!VAR "FromOsApplication" = "string(text:split($FromOsApplicationToOsApplication,'->')[position() = 1])"!]
      [!VAR "ToOsApplication" = "string(text:split($FromOsApplicationToOsApplication,'->')[position() = 2])"!]
      [!IF "$CurrentOsApplication = $ToOsApplication"!]      
                    <BSW-SCHEDULABLE-ENTITY>
                      <SHORT-NAME>BswSchEnt_ComM_MasterPnc_To_Ch_From_[!"$FromOsApplication"!]_To_[!"$ToOsApplication"!]_RcvFnct</SHORT-NAME>
                      <CAN-ENTER-EXCLUSIVE-AREA-REFS>
                        <CAN-ENTER-EXCLUSIVE-AREA-REF DEST="EXCLUSIVE-AREA">/AUTOSAR_ComM/BswModuleDescriptions/ComM/InternalBehavior_Ch_OsApplication_[!"$ToOsApplication"!]/SCHM_COMM_EXCLUSIVE_AREA_CH_OSAPPLICATION_[!"$ToOsApplication"!]</CAN-ENTER-EXCLUSIVE-AREA-REF>
                      </CAN-ENTER-EXCLUSIVE-AREA-REFS>
                      <MINIMUM-START-INTERVAL>0.0</MINIMUM-START-INTERVAL>
                      <DATA-RECEIVE-POINTS>
                        <!-- MasterPnc core only -->
                        <BSW-VARIABLE-ACCESS>
                          <SHORT-NAME>BswVarAccess_ComM_MasterPnc_To_Ch_From_[!"$FromOsApplication"!]_To_[!"$ToOsApplication"!]_DataGet</SHORT-NAME>
                          <ACCESSED-VARIABLE-REF DEST="VARIABLE-DATA-PROTOTYPE">/AUTOSAR_ComM/BswModuleDescriptions/ComM/ComM_MasterPnc_To_Ch_From_[!"$FromOsApplication"!]_To_[!"$ToOsApplication"!]_DataGet</ACCESSED-VARIABLE-REF>
                        </BSW-VARIABLE-ACCESS>
                      </DATA-RECEIVE-POINTS>
                      <IMPLEMENTED-ENTRY-REF DEST="BSW-MODULE-ENTRY">/AUTOSAR_ComM/[!"$bswModuleEntryPackageName"!]/ComM_MasterPnc_To_Ch_From_[!"$FromOsApplication"!]_To_[!"$ToOsApplication"!]_RcvFnct</IMPLEMENTED-ENTRY-REF>
                    </BSW-SCHEDULABLE-ENTITY>
      [!ENDIF!] [!/*[!IF "$CurrentOsApplication = $ToOsApplication"!]*/!]
    [!ENDFOR!] [!/*[!FOR "Idx2" = "1" TO "count(text:split($MasterPncToChFromOsApp_ToOsApp,' '))"!] */!]
  [!ENDIF!] [!/*[!IF "as:modconf('ComM')[1]/ComMGeneral/ComMPncSupport = 'true'"!]*/!]

  [!FOR "Idx2" = "1" TO "count(text:split($UserToChFromOsApp_ToOsApp,' '))"!]
    [!VAR "FromOsApplicationToOsApplication" = "string(text:split($UserToChFromOsApp_ToOsApp,' ')[position() = $Idx2])"!]
    [!VAR "FromOsApplication" = "string(text:split($FromOsApplicationToOsApplication,'->')[position() = 1])"!]
    [!VAR "ToOsApplication" = "string(text:split($FromOsApplicationToOsApplication,'->')[position() = 2])"!]
    [!IF "$CurrentOsApplication = $ToOsApplication"!]
                    <BSW-SCHEDULABLE-ENTITY>
                      <SHORT-NAME>BswSchEnt_ComM_User_To_Ch_From_[!"$FromOsApplication"!]_To_[!"$CurrentOsApplication"!]_RcvFnct</SHORT-NAME>
                      <CAN-ENTER-EXCLUSIVE-AREA-REFS>
                        <CAN-ENTER-EXCLUSIVE-AREA-REF DEST="EXCLUSIVE-AREA">/AUTOSAR_ComM/BswModuleDescriptions/ComM/InternalBehavior_Ch_OsApplication_[!"$CurrentOsApplication"!]/SCHM_COMM_EXCLUSIVE_AREA_CH_OSAPPLICATION_[!"$ToOsApplication"!]</CAN-ENTER-EXCLUSIVE-AREA-REF>
                      </CAN-ENTER-EXCLUSIVE-AREA-REFS>
                      <MINIMUM-START-INTERVAL>0.0</MINIMUM-START-INTERVAL>
                      <DATA-RECEIVE-POINTS>
                        <!-- MasterPnc core only -->
                        <BSW-VARIABLE-ACCESS>
                          <SHORT-NAME>BswVarAccess_ComM_User_To_Ch_From_[!"$FromOsApplication"!]_To_[!"$CurrentOsApplication"!]_DataGet</SHORT-NAME>
                          <ACCESSED-VARIABLE-REF DEST="VARIABLE-DATA-PROTOTYPE">/AUTOSAR_ComM/BswModuleDescriptions/ComM/ComM_User_To_Ch_From_[!"$FromOsApplication"!]_To_[!"$ToOsApplication"!]_DataGet</ACCESSED-VARIABLE-REF>
                        </BSW-VARIABLE-ACCESS>
                      </DATA-RECEIVE-POINTS>
                      <IMPLEMENTED-ENTRY-REF DEST="BSW-MODULE-ENTRY">/AUTOSAR_ComM/[!"$bswModuleEntryPackageName"!]/ComM_User_To_Ch_From_[!"$FromOsApplication"!]_To_[!"$ToOsApplication"!]_RcvFnct</IMPLEMENTED-ENTRY-REF>
                    </BSW-SCHEDULABLE-ENTITY>
    [!ENDIF!] [!/*[!IF "$CurrentOsApplication = $ToOsApplication"!]*/!]
  [!ENDFOR!] [!/*[!FOR "Idx2" = "1" TO "count(text:split($UserToChFromOsApp_ToOsApp,' '))"!]*/!]  
  
  [!IF "(as:modconf('ComM')[1]/ComMGeneral/ComMModeLimitationEnabled = 'true') or (as:modconf('ComM')[1]/ComMGeneral/ComMWakeupInhibitionEnabled = 'true')"!]
    [!FOR "Idx2" = "1" TO "count(text:split($InhibitionToChFromOsApp_ToOsApp,' '))"!]
      [!VAR "FromOsApplicationToOsApplication" = "string(text:split($InhibitionToChFromOsApp_ToOsApp,' ')[position() = $Idx2])"!]
      [!VAR "FromOsApplication" = "string(text:split($FromOsApplicationToOsApplication,'->')[position() = 1])"!]
      [!VAR "ToOsApplication" = "string(text:split($FromOsApplicationToOsApplication,'->')[position() = 2])"!]
      [!IF "$CurrentOsApplication = $ToOsApplication"!]
                    <BSW-SCHEDULABLE-ENTITY>
                      <SHORT-NAME>BswSchEnt_ComM_Inhibition_To_Ch_From_[!"$InhibitionOsApplication"!]_To_[!"$CurrentOsApplication"!]_RcvFnct</SHORT-NAME>
                      <CAN-ENTER-EXCLUSIVE-AREA-REFS>
                        <CAN-ENTER-EXCLUSIVE-AREA-REF DEST="EXCLUSIVE-AREA">/AUTOSAR_ComM/BswModuleDescriptions/ComM/InternalBehavior_Ch_OsApplication_[!"$CurrentOsApplication"!]/SCHM_COMM_EXCLUSIVE_AREA_CH_OSAPPLICATION_[!"$CurrentOsApplication"!]</CAN-ENTER-EXCLUSIVE-AREA-REF>
                      </CAN-ENTER-EXCLUSIVE-AREA-REFS>
                      <MINIMUM-START-INTERVAL>0.0</MINIMUM-START-INTERVAL>
                      <DATA-RECEIVE-POINTS>
                        <!-- MasterPnc core only -->
                        <BSW-VARIABLE-ACCESS>
                          <SHORT-NAME>BswVarAccess_ComM_Inhibition_To_Ch_From_[!"$FromOsApplication"!]_To_[!"$ToOsApplication"!]_DataGet</SHORT-NAME>
                          <ACCESSED-VARIABLE-REF DEST="VARIABLE-DATA-PROTOTYPE">/AUTOSAR_ComM/BswModuleDescriptions/ComM/ComM_Inhibition_To_Ch_From_[!"$FromOsApplication"!]_To_[!"$ToOsApplication"!]_DataGet</ACCESSED-VARIABLE-REF>
                        </BSW-VARIABLE-ACCESS>
                      </DATA-RECEIVE-POINTS>
                      <IMPLEMENTED-ENTRY-REF DEST="BSW-MODULE-ENTRY">/AUTOSAR_ComM/[!"$bswModuleEntryPackageName"!]/ComM_Inhibition_To_Ch_From_[!"$FromOsApplication"!]_To_[!"$ToOsApplication"!]_RcvFnct</IMPLEMENTED-ENTRY-REF>
                    </BSW-SCHEDULABLE-ENTITY>
      [!ENDIF!] [!/*[!IF "$CurrentOsApplication = $ToOsApplication"!]*/!]
    [!ENDFOR!] [!/*[!FOR "Idx2" = "1" TO "count(text:split($InhibitionToChFromOsApp_ToOsApp,' '))"!]*/!]
  [!ENDIF!] [!/*[!IF "(as:modconf('ComM')[1]/ComMGeneral/ComMModeLimitationEnabled = 'true') or (as:modconf('ComM')[1]/ComMGeneral/ComMWakeupInhibitionEnabled = 'true')"!]*/!]                
  
  [!LOOP "as:modconf('ComM')[1]/ComMConfigSet/*[1]/ComMChannel/*"!]
    [!VAR "EcuCChannelPartitonRef" = "ComMChannelPartitionRef"!]
    [!IF "node:name(as:modconf('Os')[1]/OsApplication/*[node:exists(OsAppEcucPartitionRef) and (OsAppEcucPartitionRef = $EcuCChannelPartitonRef)]) = $CurrentOsApplication"!]
      [!CALL "GetDcmChannelFound","CurrentComMChannelId"="ComMChannelId"!]
      [!IF "$DcmChannelFound = 'true'"!]
                    <BSW-CALLED-ENTITY>
                      <SHORT-NAME>ComM_DCM_ActiveDiagnostic_CalledEntity_[!"node:name(.)"!]</SHORT-NAME>
                      <MINIMUM-START-INTERVAL>0.0</MINIMUM-START-INTERVAL>
                      <IMPLEMENTED-ENTRY-REF DEST="BSW-MODULE-ENTRY">/AUTOSAR_ComM/BswModuleEntrys/ComM_DCM_ActiveDiagnostic</IMPLEMENTED-ENTRY-REF>
                    </BSW-CALLED-ENTITY>
                    <BSW-CALLED-ENTITY>
                      <SHORT-NAME>ComM_DCM_InactiveDiagnostic_CalledEntity_[!"node:name(.)"!]</SHORT-NAME>
                      <MINIMUM-START-INTERVAL>0.0</MINIMUM-START-INTERVAL>
                      <IMPLEMENTED-ENTRY-REF DEST="BSW-MODULE-ENTRY">/AUTOSAR_ComM/BswModuleEntrys/ComM_DCM_InactiveDiagnostic</IMPLEMENTED-ENTRY-REF>
                    </BSW-CALLED-ENTITY>
      [!ENDIF!] [!/* [!IF "$DcmChannelFound = 'true'"!] */!]

      [!IF "node:exists(as:modconf('EcuM')[1]/EcuMGeneral/EcuMCrossCoreComMWakeup) and (node:value(as:modconf('EcuM')[1]/EcuMGeneral/EcuMCrossCoreComMWakeup) = 'true')"!]
        [!CALL "GetEcuMChannelFound","CurrentComMChannelId"="ComMChannelId"!]
        [!IF "$EcuMChannelFound = 'true'"!]
          [!FOR "Idx2" = "0" TO "(as:modconf('Os')[1]/OsOS/OsNumberOfCores) - 1"!]
                    <BSW-CALLED-ENTITY>
                      <SHORT-NAME>ComM_EcuM_WakeUpIndication_CalledEntity_[!"node:name(.)"!]_ToCore_[!"$Idx2"!]</SHORT-NAME>
                      <MINIMUM-START-INTERVAL>0.0</MINIMUM-START-INTERVAL>
                      <IMPLEMENTED-ENTRY-REF DEST="BSW-MODULE-ENTRY">/AUTOSAR_ComM/BswModuleEntrys/ComM_EcuM_WakeUpIndication</IMPLEMENTED-ENTRY-REF>
                    </BSW-CALLED-ENTITY>
          [!ENDFOR!]
        [!ENDIF!] [!/* [!IF "$EcuMChannelFound = 'true'"!] */!]
      [!ENDIF!] [!/* [!IF "node:exists(as:modconf('EcuM')[1]/EcuMGeneral/EcuMCrossCoreComMWakeup) and (node:value(as:modconf('EcuM')[1]/EcuMGeneral/EcuMCrossCoreComMWakeup) = 'true')"!] */!]
    [!ENDIF!] [!/* [!IF "node:name(as:modconf('Os')[1]/OsApplication/*[node:exists(OsAppEcucPartitionRef) and (OsAppEcucPartitionRef = $EcuCChannelPartitonRef)]) = $CurrentOsApplication"!] */!]
  [!ENDLOOP!] [!/* [!LOOP "as:modconf('ComM')[1]/ComMConfigSet/*[1]/ComMChannel/*"!]!*/!]
  [!VAR "FromOsApplication"="$CurrentOsApplication"!]
  [!FOR "Idx2" = "1" TO "count(text:split($ChToChFromOsApp_ToOsApp,' '))"!]
    [!VAR "FromOsApplicationToOsApplication" = "string(text:split($ChToChFromOsApp_ToOsApp,' ')[position() = $Idx2])"!]
    [!VAR "FromOsApplication" = "string(text:split($FromOsApplicationToOsApplication,'->')[position() = 1])"!]
    [!VAR "ToOsApplication" = "string(text:split($FromOsApplicationToOsApplication,'->')[position() = 2])"!]
    [!IF "$CurrentOsApplication = $FromOsApplication"!]
                  <BSW-CALLED-ENTITY>
                    <SHORT-NAME>BswCalledEnt_ComM_Ch_To_Ch_From_[!"$FromOsApplication"!]_To_[!"$ToOsApplication"!]_DataSntFnct</SHORT-NAME>
                    <MINIMUM-START-INTERVAL>0.0</MINIMUM-START-INTERVAL>
                    <DATA-SEND-POINTS>
                      <!-- MasterPnc core only -->
                      <BSW-VARIABLE-ACCESS>
                        <SHORT-NAME>BswVarAccess_ComM_Ch_To_Ch_From_[!"$FromOsApplication"!]_To_[!"$ToOsApplication"!]_DataSet</SHORT-NAME>
                        <ACCESSED-VARIABLE-REF DEST="VARIABLE-DATA-PROTOTYPE">/AUTOSAR_ComM/BswModuleDescriptions/ComM/ComM_Ch_To_Ch_From_[!"$FromOsApplication"!]_To_[!"$ToOsApplication"!]_DataSet</ACCESSED-VARIABLE-REF>
                      </BSW-VARIABLE-ACCESS>
                    </DATA-SEND-POINTS>
                    <IMPLEMENTED-ENTRY-REF DEST="BSW-MODULE-ENTRY">/AUTOSAR_ComM/BswModuleEntrys/ComM_Ch_To_Ch_DataSntFnct</IMPLEMENTED-ENTRY-REF>
                  </BSW-CALLED-ENTITY>
    [!ENDIF!] [!/*[!IF "$CurrentOsApplication = $FromOsApplication"!]*/!]
  [!ENDFOR!] [!/*[!FOR "Idx2" = "1" TO "count(text:split($ChToChFromOsApp_ToOsApp,' '))"!]*/!]              

  [!IF "num:i(count(as:modconf('ComM')[1]/ComMConfigSet/*[1]/ComMUser/*)) > 0"!]
    [!IF "(as:modconf('ComM')[1]/ComMGeneral/ComMRteUsage = 'true') or (as:modconf('ComM')[1]/ComMGeneral/ComMModeLimitationEnabled = 'true')"!]
      [!FOR "Idx2" = "1" TO "count(text:split($ChToUserFromOsApp_ToOsApp,' '))"!]
        [!VAR "FromOsApplicationToOsApplication" = "string(text:split($ChToUserFromOsApp_ToOsApp,' ')[position() = $Idx2])"!]
        [!VAR "FromOsApplication" = "string(text:split($FromOsApplicationToOsApplication,'->')[position() = 1])"!]
        [!VAR "ToOsApplication" = "string(text:split($FromOsApplicationToOsApplication,'->')[position() = 2])"!]
        [!IF "$CurrentOsApplication = $FromOsApplication"!]
                    <BSW-CALLED-ENTITY>
                      <SHORT-NAME>BswCalledEnt_ComM_Ch_To_User_From_[!"$FromOsApplication"!]_To_[!"$ToOsApplication"!]_DataSntFnct</SHORT-NAME>
                      <MINIMUM-START-INTERVAL>0.0</MINIMUM-START-INTERVAL>
                      <DATA-SEND-POINTS>
                        <!-- MasterPnc core only -->
                        <BSW-VARIABLE-ACCESS>
                          <SHORT-NAME>BswVarAccess_ComM_Ch_To_User_From_[!"$FromOsApplication"!]_To_[!"$ToOsApplication"!]_DataSet</SHORT-NAME>
                          <ACCESSED-VARIABLE-REF DEST="VARIABLE-DATA-PROTOTYPE">/AUTOSAR_ComM/BswModuleDescriptions/ComM/ComM_Ch_To_User_From_[!"$FromOsApplication"!]_To_[!"$ToOsApplication"!]_DataSet</ACCESSED-VARIABLE-REF>
                        </BSW-VARIABLE-ACCESS>
                      </DATA-SEND-POINTS>
                      <IMPLEMENTED-ENTRY-REF DEST="BSW-MODULE-ENTRY">/AUTOSAR_ComM/BswModuleEntrys/ComM_Ch_To_User_DataSntFnct</IMPLEMENTED-ENTRY-REF>
                    </BSW-CALLED-ENTITY>
        [!ENDIF!] [!/*[!IF "$CurrentOsApplication = $FromOsApplication"!]*/!]
      [!ENDFOR!] [!/*[!FOR "Idx2" = "1" TO "count(text:split($ChToUserFromOsApp_ToOsApp,' '))"!]*/!]
    [!ENDIF!] [!/*[!IF "(as:modconf('ComM')[1]/ComMGeneral/ComMRteUsage = 'true') or (as:modconf('ComM')[1]/ComMGeneral/ComMModeLimitationEnabled = 'true')"!]*/!]
  [!ENDIF!] [!/*[!IF "num:i(count(as:modconf('ComM')[1]/ComMConfigSet/*[1]/ComMUser/*)) > 0"!]*/!]

  [!IF "(as:modconf('ComM')[1]/ComMGeneral/ComMModeLimitationEnabled = 'true') or (as:modconf('ComM')[1]/ComMGeneral/ComMWakeupInhibitionEnabled = 'true')"!]
    [!FOR "Idx2" = "1" TO "count(text:split($ChToInhibitionFromOsApp_ToOsApp,' '))"!]
      [!VAR "FromOsApplicationToOsApplication" = "string(text:split($ChToInhibitionFromOsApp_ToOsApp,' ')[position() = $Idx2])"!]
      [!VAR "FromOsApplication" = "string(text:split($FromOsApplicationToOsApplication,'->')[position() = 1])"!]
      [!VAR "ToOsApplication" = "string(text:split($FromOsApplicationToOsApplication,'->')[position() = 2])"!]            
      [!IF "$CurrentOsApplication = $FromOsApplication"!]
                    <BSW-CALLED-ENTITY>
                      <SHORT-NAME>BswCalledEnt_ComM_Ch_To_Inhibition_From_[!"$FromOsApplication"!]_To_[!"$ToOsApplication"!]_DataSntFnct</SHORT-NAME>
                      <MINIMUM-START-INTERVAL>0.0</MINIMUM-START-INTERVAL>
                      <DATA-SEND-POINTS>
                        <!-- MasterPnc core only -->
                        <BSW-VARIABLE-ACCESS>
                          <SHORT-NAME>BswVarAccess_ComM_Ch_To_Inhibition_From_[!"$FromOsApplication"!]_To_[!"$ToOsApplication"!]_DataSet</SHORT-NAME>
                          <ACCESSED-VARIABLE-REF DEST="VARIABLE-DATA-PROTOTYPE">/AUTOSAR_ComM/BswModuleDescriptions/ComM/ComM_Ch_To_Inhibition_From_[!"$FromOsApplication"!]_To_[!"$ToOsApplication"!]_DataSet</ACCESSED-VARIABLE-REF>
                        </BSW-VARIABLE-ACCESS>
                      </DATA-SEND-POINTS>
                      <IMPLEMENTED-ENTRY-REF DEST="BSW-MODULE-ENTRY">/AUTOSAR_ComM/BswModuleEntrys/ComM_Ch_To_Inhibition_DataSntFnct</IMPLEMENTED-ENTRY-REF>
                    </BSW-CALLED-ENTITY>
      [!ENDIF!] [!/*[!IF "$CurrentOsApplication = $FromOsApplication"!]*/!]    
    [!ENDFOR!] [!/*[!FOR "Idx2" = "1" TO "count(text:split($ChToInhibitionFromOsApp_ToOsApp,' '))"!]*/!]
  [!ENDIF!] [!/*[!IF "(as:modconf('ComM')[1]/ComMGeneral/ComMModeLimitationEnabled = 'true') or (as:modconf('ComM')[1]/ComMGeneral/ComMWakeupInhibitionEnabled = 'true')"!]*/!]
  
  [!IF "as:modconf('ComM')[1]/ComMGeneral/ComMPncSupport = 'true'"!]
    [!FOR "Idx2" = "1" TO "count(text:split($ChToMasterPncFromOsApp_ToOsApp,' '))"!]
      [!VAR "FromOsApplicationToOsApplication" = "string(text:split($ChToMasterPncFromOsApp_ToOsApp,' ')[position() = $Idx2])"!]
      [!VAR "FromOsApplication" = "string(text:split($FromOsApplicationToOsApplication,'->')[position() = 1])"!]
      [!VAR "ToOsApplication" = "string(text:split($FromOsApplicationToOsApplication,'->')[position() = 2])"!]
      [!IF "$CurrentOsApplication = $FromOsApplication"!]
                  <BSW-CALLED-ENTITY>
                    <SHORT-NAME>BswCalledEnt_ComM_Ch_To_MasterPnc_From_[!"$FromOsApplication"!]_To_[!"$ToOsApplication"!]_DataSntFnct</SHORT-NAME>
                    <MINIMUM-START-INTERVAL>0.0</MINIMUM-START-INTERVAL>
                    <DATA-SEND-POINTS>
                      <!-- MasterPnc core only -->
                      <BSW-VARIABLE-ACCESS>
                        <SHORT-NAME>BswVarAccess_ComM_Ch_To_MasterPnc_From_[!"$FromOsApplication"!]_To_[!"$ToOsApplication"!]_DataSet</SHORT-NAME>
                        <ACCESSED-VARIABLE-REF DEST="VARIABLE-DATA-PROTOTYPE">/AUTOSAR_ComM/BswModuleDescriptions/ComM/ComM_Ch_To_MasterPnc_From_[!"$FromOsApplication"!]_To_[!"$ToOsApplication"!]_DataSet</ACCESSED-VARIABLE-REF>
                      </BSW-VARIABLE-ACCESS>
                    </DATA-SEND-POINTS>
                    <IMPLEMENTED-ENTRY-REF DEST="BSW-MODULE-ENTRY">/AUTOSAR_ComM/BswModuleEntrys/ComM_Ch_To_MasterPnc_DataSntFnct</IMPLEMENTED-ENTRY-REF>
                  </BSW-CALLED-ENTITY>
      [!ENDIF!] [!/*[!IF "$CurrentOsApplication = $FromOsApplication"!]*/!]
    [!ENDFOR!] [!/*[!FOR "Idx2" = "1" TO "count(text:split($ChToMasterPncFromOsApp_ToOsApp,' '))"!]*/!]
  [!ENDIF!] [!/*[!IF "as:modconf('ComM')[1]/ComMGeneral/ComMPncSupport = 'true'"!]*/!]
  
  
  
  [!IF "node:exists(as:modconf('ComM')[1]/ComMGeneral/ComMSynchronizedPncShutdownEnabled) and (as:modconf('ComM')[1]/ComMGeneral/ComMSynchronizedPncShutdownEnabled = 'true')"!]
    [!FOR "Idx2" = "1" TO "count(text:split($SynchShutDownChToMasterPncFromOsApp_ToOsApp,' '))"!]
      [!VAR "FromOsApplicationToOsApplication" = "string(text:split($SynchShutDownChToMasterPncFromOsApp_ToOsApp,' ')[position() = $Idx2])"!]
      [!VAR "FromOsApplication" = "string(text:split($FromOsApplicationToOsApplication,'->')[position() = 1])"!]
      [!VAR "ToOsApplication" = "string(text:split($FromOsApplicationToOsApplication,'->')[position() = 2])"!]
      [!IF "$CurrentOsApplication = $FromOsApplication"!]
                  <BSW-CALLED-ENTITY>
                    <SHORT-NAME>BswCalledEnt_ComM_SynchShutDownCh_To_MasterPnc_From_[!"$FromOsApplication"!]_To_[!"$ToOsApplication"!]_DataSntFnct</SHORT-NAME>
                    <MINIMUM-START-INTERVAL>0.0</MINIMUM-START-INTERVAL>
                    <DATA-SEND-POINTS>
                      <!-- MasterPnc core only -->
                      <BSW-VARIABLE-ACCESS>
                        <SHORT-NAME>BswVarAccess_ComM_SynchShutDownCh_To_MasterPnc_From_[!"$FromOsApplication"!]_To_[!"$ToOsApplication"!]_DataSet</SHORT-NAME>
                        <ACCESSED-VARIABLE-REF DEST="VARIABLE-DATA-PROTOTYPE">/AUTOSAR_ComM/BswModuleDescriptions/ComM/ComM_SynchShutDownCh_To_MasterPnc_From_[!"$FromOsApplication"!]_To_[!"$ToOsApplication"!]_DataSet</ACCESSED-VARIABLE-REF>
                      </BSW-VARIABLE-ACCESS>
                    </DATA-SEND-POINTS>
                    <IMPLEMENTED-ENTRY-REF DEST="BSW-MODULE-ENTRY">/AUTOSAR_ComM/BswModuleEntrys/ComM_SynchShutDownCh_To_MasterPnc_DataSntFnct</IMPLEMENTED-ENTRY-REF>
                  </BSW-CALLED-ENTITY>
      [!ENDIF!] [!/*[!IF "$CurrentOsApplication = $FromOsApplication"!]*/!]
    [!ENDFOR!] [!/*[!FOR "Idx2" = "1" TO "count(text:split($SynchShutDownChToMasterPncFromOsApp_ToOsApp,' '))"!]*/!]
  [!ENDIF!][!/*[!IF "node:exists(as:modconf('ComM')[1]/ComMGeneral/ComMSynchronizedPncShutdownEnabled) and (as:modconf('ComM')[1]/ComMGeneral/ComMSynchronizedPncShutdownEnabled = 'true')"!]*/!]
                  </ENTITYS>
                  <EVENTS>
  [!LOOP "as:modconf('ComM')[1]/ComMConfigSet/*[1]/ComMChannel/*"!]
    [!VAR "EcuCChannelPartitonRef" = "ComMChannelPartitionRef"!]
    [!IF "node:name(as:modconf('Os')[1]/OsApplication/*[node:exists(OsAppEcucPartitionRef) and (OsAppEcucPartitionRef = $EcuCChannelPartitonRef)]) = $CurrentOsApplication"!]
      [!CALL "GetDcmChannelFound","CurrentComMChannelId"="ComMChannelId"!]
      [!CALL "GetChannelOsApplication","ChannelEcuCPartitionRef"="ComMChannelPartitionRef"!]
                    <BSW-TIMING-EVENT>
                      <SHORT-NAME>TimingEvent_MainFunction_[!"ComMChannelId"!]</SHORT-NAME>
                      <STARTS-ON-EVENT-REF DEST="BSW-SCHEDULABLE-ENTITY">/AUTOSAR_ComM/BswModuleDescriptions/ComM/InternalBehavior_Ch_OsApplication_[!"$CurrentOsApplication"!]/ComM_1_Ch_OsApplication_[!"$ChannelOsApplication"!]_ComM_MainFunction_[!"ComMChannelId"!]</STARTS-ON-EVENT-REF>
                      <PERIOD>[!"ComMMainFunctionPeriod"!]</PERIOD>
                    </BSW-TIMING-EVENT>
      [!IF "node:exists(as:modconf('EcuM')[1]/EcuMGeneral/EcuMCrossCoreComMWakeup) and (node:value(as:modconf('EcuM')[1]/EcuMGeneral/EcuMCrossCoreComMWakeup) = 'true')"!]
        [!CALL "GetEcuMChannelFound","CurrentComMChannelId"="ComMChannelId"!]
        [!IF "$EcuMChannelFound = 'true'"!]
          [!FOR "Idx2" = "0" TO "(as:modconf('Os')[1]/OsOS/OsNumberOfCores) - 1"!]
                    <BSW-OPERATION-INVOKED-EVENT>
                      <SHORT-NAME>OpInokedEv_ComM_EcuM_WakeUpIndication_[!"node:name(.)"!]_ToCore_[!"$Idx2"!]</SHORT-NAME>
                      <STARTS-ON-EVENT-REF DEST="BSW-CALLED-ENTITY">/AUTOSAR_ComM/BswModuleDescriptions/ComM/InternalBehavior_Ch_OsApplication_[!"$CurrentOsApplication"!]/ComM_EcuM_WakeUpIndication_CalledEntity_[!"node:name(.)"!]_ToCore_[!"$Idx2"!]</STARTS-ON-EVENT-REF>
                      <ENTRY-REF DEST="BSW-MODULE-CLIENT-SERVER-ENTRY">/AUTOSAR_ComM/BswModuleDescriptions/ComM/ProvidedCSEntry_ComM_EcuM_WakeUpIndication_[!"node:name(.)"!]_ToCore_[!"$Idx2"!]</ENTRY-REF>
                    </BSW-OPERATION-INVOKED-EVENT>
          [!ENDFOR!]
        [!ENDIF!] [!/* [!IF "$EcuMChannelFound = 'true'"!] */!]
      [!ENDIF!] [!/* [!IF "node:exists(as:modconf('EcuM')[1]/EcuMGeneral/EcuMCrossCoreComMWakeup) and (node:value(as:modconf('EcuM')[1]/EcuMGeneral/EcuMCrossCoreComMWakeup) = 'true')"!] */!]
      [!IF "$DcmChannelFound = 'true'"!]
                   <BSW-OPERATION-INVOKED-EVENT>
                     <SHORT-NAME>OpInokedEv_ComM_DCM_ActiveDiagnostic_[!"node:name(.)"!]</SHORT-NAME>
                     <STARTS-ON-EVENT-REF DEST="BSW-CALLED-ENTITY">/AUTOSAR_ComM/BswModuleDescriptions/ComM/InternalBehavior_Ch_OsApplication_[!"$CurrentOsApplication"!]/ComM_DCM_ActiveDiagnostic_CalledEntity_[!"node:name(.)"!]</STARTS-ON-EVENT-REF>
                     <ENTRY-REF DEST="BSW-MODULE-CLIENT-SERVER-ENTRY">/AUTOSAR_ComM/BswModuleDescriptions/ComM/ProvidedCSEntry_ComM_DCM_ActiveDiagnostic_[!"node:name(.)"!]</ENTRY-REF>
                   </BSW-OPERATION-INVOKED-EVENT>

                   <BSW-OPERATION-INVOKED-EVENT>
                     <SHORT-NAME>OpInokedEv_ComM_DCM_InactiveDiagnostic_[!"node:name(.)"!]</SHORT-NAME>
                     <STARTS-ON-EVENT-REF DEST="BSW-CALLED-ENTITY">/AUTOSAR_ComM/BswModuleDescriptions/ComM/InternalBehavior_Ch_OsApplication_[!"$CurrentOsApplication"!]/ComM_DCM_InactiveDiagnostic_CalledEntity_[!"node:name(.)"!]</STARTS-ON-EVENT-REF>
                     <ENTRY-REF DEST="BSW-MODULE-CLIENT-SERVER-ENTRY">/AUTOSAR_ComM/BswModuleDescriptions/ComM/ProvidedCSEntry_ComM_DCM_InactiveDiagnostic_[!"node:name(.)"!]</ENTRY-REF>
                   </BSW-OPERATION-INVOKED-EVENT>
      [!ENDIF!] [!/* [!IF "$DcmChannelFound = 'true'"!] */!]
    [!ENDIF!] [!/*[!IF "node:name(as:modconf('Os')[1]/OsApplication/*[node:exists(OsAppEcucPartitionRef) and (OsAppEcucPartitionRef = $EcuCChannelPartitonRef)]) = $CurrentOsApplication"!] */!]
  [!ENDLOOP!] [!/*[!LOOP "as:modconf('ComM')[1]/ComMConfigSet/*[1]/ComMChannel/*"!] */!]

  [!FOR "Idx2" = "1" TO "count(text:split($ChToChFromOsApp_ToOsApp,' '))"!]
    [!VAR "FromOsApplicationToOsApplication" = "string(text:split($ChToChFromOsApp_ToOsApp,' ')[position() = $Idx2])"!]
    [!VAR "FromOsApplication" = "string(text:split($FromOsApplicationToOsApplication,'->')[position() = 1])"!]
    [!VAR "ToOsApplication" = "string(text:split($FromOsApplicationToOsApplication,'->')[position() = 2])"!]
    [!IF "$CurrentOsApplication = $ToOsApplication"!]
                    <BSW-DATA-RECEIVED-EVENT>                
                        <SHORT-NAME>ComM_Ch_To_Ch_From_[!"$FromOsApplication"!]_To_[!"$ToOsApplication"!]_RecEv</SHORT-NAME>
                        <STARTS-ON-EVENT-REF DEST="BSW-SCHEDULABLE-ENTITY">/AUTOSAR_ComM/BswModuleDescriptions/ComM/InternalBehavior_Ch_OsApplication_[!"$ToOsApplication"!]/BswSchEnt_ComM_Ch_To_Ch_From_[!"$FromOsApplication"!]_To_[!"$ToOsApplication"!]_RcvFnct</STARTS-ON-EVENT-REF>
                        <DATA-REF DEST="VARIABLE-DATA-PROTOTYPE">/AUTOSAR_ComM/BswModuleDescriptions/ComM/ComM_Ch_To_Ch_From_[!"$FromOsApplication"!]_To_[!"$ToOsApplication"!]_DataGet</DATA-REF>
                    </BSW-DATA-RECEIVED-EVENT>
    [!ENDIF!] [!/*[!IF "$CurrentOsApplication = $ToOsApplication"!]*/!]
  [!ENDFOR!] [!/*[!FOR "Idx2" = "1" TO "count(text:split($ChToChFromOsApp_ToOsApp,' '))"!]*/!]

  [!IF "as:modconf('ComM')[1]/ComMGeneral/ComMPncSupport = 'true'"!]
    [!FOR "Idx2" = "1" TO "count(text:split($MasterPncToChFromOsApp_ToOsApp,' '))"!]
      [!VAR "FromOsApplicationToOsApplication" = "string(text:split($MasterPncToChFromOsApp_ToOsApp,' ')[position() = $Idx2])"!]
      [!VAR "FromOsApplication" = "string(text:split($FromOsApplicationToOsApplication,'->')[position() = 1])"!]
      [!VAR "ToOsApplication" = "string(text:split($FromOsApplicationToOsApplication,'->')[position() = 2])"!]            
      [!IF "$CurrentOsApplication = $ToOsApplication"!]
                    <BSW-DATA-RECEIVED-EVENT>
                        <SHORT-NAME>ComM_MasterPnc_To_Ch_From_[!"$FromOsApplication"!]_To_[!"$ToOsApplication"!]_RecEv</SHORT-NAME>
                        <STARTS-ON-EVENT-REF DEST="BSW-SCHEDULABLE-ENTITY">/AUTOSAR_ComM/BswModuleDescriptions/ComM/InternalBehavior_Ch_OsApplication_[!"$ToOsApplication"!]/BswSchEnt_ComM_MasterPnc_To_Ch_From_[!"$FromOsApplication"!]_To_[!"$ToOsApplication"!]_RcvFnct</STARTS-ON-EVENT-REF>
                        <DATA-REF DEST="VARIABLE-DATA-PROTOTYPE">/AUTOSAR_ComM/BswModuleDescriptions/ComM/ComM_MasterPnc_To_Ch_From_[!"$FromOsApplication"!]_To_[!"$ToOsApplication"!]_DataGet</DATA-REF>
                    </BSW-DATA-RECEIVED-EVENT>
      [!ENDIF!] [!/*[!IF "$CurrentOsApplication = $ToOsApplication"!] */!]
    [!ENDFOR!] [!/*[!FOR "Idx2" = "1" TO "count(text:split($MasterPncToChFromOsApp_ToOsApp,' '))"!]*/!]
  [!ENDIF!] [!/*[!IF "as:modconf('ComM')[1]/ComMGeneral/ComMPncSupport = 'true'"!]*/!]
  
  [!FOR "Idx2" = "1" TO "count(text:split($UserToChFromOsApp_ToOsApp,' '))"!]
  [!VAR "FromOsApplicationToOsApplication" = "string(text:split($UserToChFromOsApp_ToOsApp,' ')[position() = $Idx2])"!]
  [!VAR "FromOsApplication" = "string(text:split($FromOsApplicationToOsApplication,'->')[position() = 1])"!]
  [!VAR "ToOsApplication" = "string(text:split($FromOsApplicationToOsApplication,'->')[position() = 2])"!]
  [!IF "$CurrentOsApplication = $ToOsApplication"!]
                    <BSW-DATA-RECEIVED-EVENT>
                        <SHORT-NAME>ComM_User_To_Ch_From_[!"$FromOsApplication"!]_To_[!"$ToOsApplication"!]_RecEv</SHORT-NAME>
                        <STARTS-ON-EVENT-REF DEST="BSW-SCHEDULABLE-ENTITY">/AUTOSAR_ComM/BswModuleDescriptions/ComM/InternalBehavior_Ch_OsApplication_[!"$ToOsApplication"!]/BswSchEnt_ComM_User_To_Ch_From_[!"$FromOsApplication"!]_To_[!"$ToOsApplication"!]_RcvFnct</STARTS-ON-EVENT-REF>
                        <DATA-REF DEST="VARIABLE-DATA-PROTOTYPE">/AUTOSAR_ComM/BswModuleDescriptions/ComM/ComM_User_To_Ch_From_[!"$FromOsApplication"!]_To_[!"$ToOsApplication"!]_DataGet</DATA-REF>
                    </BSW-DATA-RECEIVED-EVENT>
    [!ENDIF!] [!/*[!IF "$CurrentOsApplication = $ToOsApplication"!]*/!]
  [!ENDFOR!] [!/*[!FOR "Idx2" = "1" TO "count(text:split($UserToChFromOsApp_ToOsApp,' '))"!]*/!]
  
  [!IF "(as:modconf('ComM')[1]/ComMGeneral/ComMModeLimitationEnabled = 'true') or (as:modconf('ComM')[1]/ComMGeneral/ComMWakeupInhibitionEnabled = 'true')"!]
    [!FOR "Idx2" = "1" TO "count(text:split($InhibitionToChFromOsApp_ToOsApp,' '))"!]
      [!VAR "FromOsApplicationToOsApplication" = "string(text:split($InhibitionToChFromOsApp_ToOsApp,' ')[position() = $Idx2])"!]
      [!VAR "FromOsApplication" = "string(text:split($FromOsApplicationToOsApplication,'->')[position() = 1])"!]
      [!VAR "ToOsApplication" = "string(text:split($FromOsApplicationToOsApplication,'->')[position() = 2])"!]
      [!IF "$CurrentOsApplication = $ToOsApplication"!]
                    <BSW-DATA-RECEIVED-EVENT>
                        <SHORT-NAME>ComM_Inhibition_To_Ch_From_[!"$FromOsApplication"!]_To_[!"$ToOsApplication"!]_RecEv</SHORT-NAME>
                        <STARTS-ON-EVENT-REF DEST="BSW-SCHEDULABLE-ENTITY">/AUTOSAR_ComM/BswModuleDescriptions/ComM/InternalBehavior_Ch_OsApplication_[!"$ToOsApplication"!]/BswSchEnt_ComM_Inhibition_To_Ch_From_[!"$FromOsApplication"!]_To_[!"$ToOsApplication"!]_RcvFnct</STARTS-ON-EVENT-REF>
                        <DATA-REF DEST="VARIABLE-DATA-PROTOTYPE">/AUTOSAR_ComM/BswModuleDescriptions/ComM/ComM_Inhibition_To_Ch_From_[!"$FromOsApplication"!]_To_[!"$ToOsApplication"!]_DataGet</DATA-REF>
                    </BSW-DATA-RECEIVED-EVENT>
      [!ENDIF!] [!/*[!IF "$CurrentOsApplication = $ToOsApplication"!]*/!]
    [!ENDFOR!] [!/*[!FOR "Idx2" = "1" TO "count(text:split($InhibitionToChFromOsApp_ToOsApp,' '))"!]*/!]
  [!ENDIF!] [!/*[!IF "(as:modconf('ComM')[1]/ComMGeneral/ComMModeLimitationEnabled = 'true') or (as:modconf('ComM')[1]/ComMGeneral/ComMWakeupInhibitionEnabled = 'true')"!]*/!]                  
                  </EVENTS>
                  <RECEPTION-POLICYS>
  [!FOR "Idx2" = "1" TO "count(text:split($ChToChFromOsApp_ToOsApp,' '))"!]
    [!VAR "FromOsApplicationToOsApplication" = "string(text:split($ChToChFromOsApp_ToOsApp,' ')[position() = $Idx2])"!]
    [!VAR "FromOsApplication" = "string(text:split($FromOsApplicationToOsApplication,'->')[position() = 1])"!]
    [!VAR "ToOsApplication" = "string(text:split($FromOsApplicationToOsApplication,'->')[position() = 2])"!]
      [!CALL "GetChToChQueueSize","FromOsApplication"="$FromOsApplication","ToOsApplication"="$ToOsApplication"!]
                    <BSW-QUEUED-DATA-RECEPTION-POLICY>
                      <ENABLE-TAKE-ADDRESS>true</ENABLE-TAKE-ADDRESS>
                      <RECEIVED-DATA-REF DEST="VARIABLE-DATA-PROTOTYPE">/AUTOSAR_ComM/BswModuleDescriptions/ComM/ComM_Ch_To_Ch_From_[!"$FromOsApplication"!]_To_[!"$ToOsApplication"!]_DataGet</RECEIVED-DATA-REF>
                      <QUEUE-LENGTH>[!"num:i($ChToChQueueSize)"!]</QUEUE-LENGTH>
                    </BSW-QUEUED-DATA-RECEPTION-POLICY>
  [!ENDFOR!] [!/*[!FOR "Idx2" = "1" TO "count(text:split($ChToChFromOsApp_ToOsApp,' '))"!]*/!]
  
  [!IF "as:modconf('ComM')[1]/ComMGeneral/ComMPncSupport = 'true'"!]
    [!FOR "Idx2" = "1" TO "count(text:split($MasterPncToChFromOsApp_ToOsApp,' '))"!]
      [!VAR "FromOsApplicationToOsApplication" = "string(text:split($MasterPncToChFromOsApp_ToOsApp,' ')[position() = $Idx2])"!]
      [!VAR "FromOsApplication" = "string(text:split($FromOsApplicationToOsApplication,'->')[position() = 1])"!]
      [!VAR "ToOsApplication" = "string(text:split($FromOsApplicationToOsApplication,'->')[position() = 2])"!]            
      [!IF "$CurrentOsApplication = $ToOsApplication"!]    
        [!CALL "GetMasterPncToChQueueSize","ToOsApplication"="$ToOsApplication"!]
                    <BSW-QUEUED-DATA-RECEPTION-POLICY>
                      <ENABLE-TAKE-ADDRESS>true</ENABLE-TAKE-ADDRESS>
                      <RECEIVED-DATA-REF DEST="VARIABLE-DATA-PROTOTYPE">/AUTOSAR_ComM/BswModuleDescriptions/ComM/ComM_MasterPnc_To_Ch_From_[!"$FromOsApplication"!]_To_[!"$ToOsApplication"!]_DataGet</RECEIVED-DATA-REF>
                      <QUEUE-LENGTH>[!"num:i($MasterPncToChQueueSize)"!]</QUEUE-LENGTH>
                    </BSW-QUEUED-DATA-RECEPTION-POLICY>
      [!ENDIF!] [!/*[!IF "$CurrentOsApplication = $ToOsApplication"!]*/!]
    [!ENDFOR!] [!/*[!FOR "Idx2" = "1" TO "count(text:split($MasterPncToChFromOsApp_ToOsApp,' '))"!]*/!]
  [!ENDIF!] [!/*[!IF "as:modconf('ComM')[1]/ComMGeneral/ComMPncSupport = 'true'"!]*/!]
  
  [!FOR "Idx2" = "1" TO "count(text:split($UserToChFromOsApp_ToOsApp,' '))"!]
    [!VAR "FromOsApplicationToOsApplication" = "string(text:split($UserToChFromOsApp_ToOsApp,' ')[position() = $Idx2])"!]
    [!VAR "FromOsApplication" = "string(text:split($FromOsApplicationToOsApplication,'->')[position() = 1])"!]
    [!VAR "ToOsApplication" = "string(text:split($FromOsApplicationToOsApplication,'->')[position() = 2])"!]
    [!IF "$CurrentOsApplication = $ToOsApplication"!]
      [!CALL "GetUserToChannelQueueSize","FromOsApplication"="$FromOsApplication","ToOsApplication"="$ToOsApplication"!]    
                    <BSW-QUEUED-DATA-RECEPTION-POLICY>
                      <ENABLE-TAKE-ADDRESS>true</ENABLE-TAKE-ADDRESS>
                      <RECEIVED-DATA-REF DEST="VARIABLE-DATA-PROTOTYPE">/AUTOSAR_ComM/BswModuleDescriptions/ComM/ComM_User_To_Ch_From_[!"$FromOsApplication"!]_To_[!"$ToOsApplication"!]_DataGet</RECEIVED-DATA-REF>
                      <QUEUE-LENGTH>[!"$UserToChannelQueueSize"!]</QUEUE-LENGTH>
                    </BSW-QUEUED-DATA-RECEPTION-POLICY>
    [!ENDIF!] [!/*[!IF "$CurrentOsApplication = $ToOsApplication"!]*/!]
  [!ENDFOR!] [!/*[!FOR "Idx2" = "1" TO "count(text:split($UserToChFromOsApp_ToOsApp,' '))"!]*/!]
  
  [!IF "(as:modconf('ComM')[1]/ComMGeneral/ComMModeLimitationEnabled = 'true') or (as:modconf('ComM')[1]/ComMGeneral/ComMWakeupInhibitionEnabled = 'true')"!]
    [!FOR "Idx2" = "1" TO "count(text:split($InhibitionToChFromOsApp_ToOsApp,' '))"!]
      [!VAR "FromOsApplicationToOsApplication" = "string(text:split($InhibitionToChFromOsApp_ToOsApp,' ')[position() = $Idx2])"!]
      [!VAR "FromOsApplication" = "string(text:split($FromOsApplicationToOsApplication,'->')[position() = 1])"!]
      [!VAR "ToOsApplication" = "string(text:split($FromOsApplicationToOsApplication,'->')[position() = 2])"!]
      [!IF "$CurrentOsApplication = $ToOsApplication"!]
        [!CALL "GetInhibitionToChQueueSize","ToOsApplication"="$ToOsApplication"!]
                    <BSW-QUEUED-DATA-RECEPTION-POLICY>
                      <ENABLE-TAKE-ADDRESS>true</ENABLE-TAKE-ADDRESS>
                      <RECEIVED-DATA-REF DEST="VARIABLE-DATA-PROTOTYPE">/AUTOSAR_ComM/BswModuleDescriptions/ComM/ComM_Inhibition_To_Ch_From_[!"$FromOsApplication"!]_To_[!"$ToOsApplication"!]_DataGet</RECEIVED-DATA-REF>
                      <QUEUE-LENGTH>[!"num:i($InhibitionToChQueueSize)"!]</QUEUE-LENGTH>
                    </BSW-QUEUED-DATA-RECEPTION-POLICY>  
      [!ENDIF!] [!/*[!IF "$CurrentOsApplication = $ToOsApplication"!]*/!]
    [!ENDFOR!] [!/*[!FOR "Idx2" = "1" TO "count(text:split($InhibitionToChFromOsApp_ToOsApp,' '))"!]*/!]
  [!ENDIF!] [!/*[!IF "(as:modconf('ComM')[1]/ComMGeneral/ComMModeLimitationEnabled = 'true') or (as:modconf('ComM')[1]/ComMGeneral/ComMWakeupInhibitionEnabled = 'true')"!]*/!]
                  </RECEPTION-POLICYS>
                </BSW-INTERNAL-BEHAVIOR>
[!ENDFOR!] [!/* [!FOR "Idx1" = "1" TO "count(text:split($FoundChannelsOsApplications,' '))"!] */!]
[!IF "as:modconf('ComM')[1]/ComMGeneral/ComMPncSupport = 'true'"!]
  [!IF "count(text:split($FoundMasterPncPlusSignalsOsApplications,' ')) > 1 "!]
    [!FOR "Idx1" = "1" TO "count(text:split($FoundMasterPncPlusSignalsOsApplications,' '))"!][!//
      [!VAR "CurrentOsApplication" = "string(text:split($FoundMasterPncPlusSignalsOsApplications,' ')[position() = $Idx1])"!]
      [!IF "($CurrentOsApplication) != ($MasterPncOsApplication)"!]
                <BSW-INTERNAL-BEHAVIOR>
                  <SHORT-NAME>InternalBehavior_SgnSlavePnc_[!"($CurrentOsApplication)"!]</SHORT-NAME>
                  <EXCLUSIVE-AREAS>
                    <EXCLUSIVE-AREA>
                      <SHORT-NAME>SCHM_COMM_EXCLUSIVE_AREA_SgnSlavePnc_[!"($CurrentOsApplication)"!]</SHORT-NAME>
                    </EXCLUSIVE-AREA>
                  </EXCLUSIVE-AREAS>
                  <ENTITYS>
        [!LOOP "node:order(node:refs(as:modconf('ComM')[1]/ComMConfigSet/*[1]/ComMPnc/*/ComMPncComSignal/*[ComMPncComSignalDirection='TX']/ComMPncComSignalRef), 'ComHandleId')"!]
          [!CALL "GetSignalOsApplication","SignalHandle"="ComHandleId","Direction"="'TX'"!]
          [!IF "($SignalOsApplication) = ($CurrentOsApplication)"!]
                    <BSW-SCHEDULABLE-ENTITY>
                      <SHORT-NAME>BswSchEnt_ComM_SgnSlavePnc_From_[!"$MasterPncOsApplication"!]_To_[!"$SignalOsApplication"!]_RcvFnct_[!"node:name(.)"!]</SHORT-NAME>
                      <CAN-ENTER-EXCLUSIVE-AREA-REFS>
                        <CAN-ENTER-EXCLUSIVE-AREA-REF DEST="EXCLUSIVE-AREA">/AUTOSAR_ComM/BswModuleDescriptions/ComM/InternalBehavior_SgnSlavePnc_[!"($SignalOsApplication)"!]/SCHM_COMM_EXCLUSIVE_AREA_SgnSlavePnc_[!"($CurrentOsApplication)"!]</CAN-ENTER-EXCLUSIVE-AREA-REF>
                      </CAN-ENTER-EXCLUSIVE-AREA-REFS>
                      <MINIMUM-START-INTERVAL>0.0</MINIMUM-START-INTERVAL>
                      <DATA-RECEIVE-POINTS>
                        <!-- Slave core only -->
                        <BSW-VARIABLE-ACCESS>
                          <SHORT-NAME>BswVarAccess_ComM_SgnSlavePnc_From_[!"$MasterPncOsApplication"!]_To_[!"$SignalOsApplication"!]_DataGet_[!"node:name(.)"!]</SHORT-NAME>
                          <ACCESSED-VARIABLE-REF DEST="VARIABLE-DATA-PROTOTYPE">/AUTOSAR_ComM/BswModuleDescriptions/ComM/ComM_SgnSlavePnc_From_[!"$MasterPncOsApplication"!]_To_[!"$SignalOsApplication"!]_DataGet_[!"node:name(.)"!]</ACCESSED-VARIABLE-REF>
                        </BSW-VARIABLE-ACCESS>
                      </DATA-RECEIVE-POINTS>
                      <IMPLEMENTED-ENTRY-REF DEST="BSW-MODULE-ENTRY">/AUTOSAR_ComM/[!"$bswModuleEntryPackageName"!]/ComM_SgnSlavePnc_From_[!"$MasterPncOsApplication"!]_To_[!"$SignalOsApplication"!]_RcvFnct_[!"node:name(.)"!]</IMPLEMENTED-ENTRY-REF>
                    </BSW-SCHEDULABLE-ENTITY>
          [!ENDIF!]
        [!ENDLOOP!]

        [!LOOP "node:order(node:refs(as:modconf('ComM')[1]/ComMConfigSet/*[1]/ComMPnc/*/ComMPncComSignal/*[ComMPncComSignalDirection='RX']/ComMPncComSignalRef), 'ComHandleId')"!]
          [!CALL "GetSignalOsApplication","SignalHandle"="ComHandleId","Direction"="'RX'"!]
          [!IF "($SignalOsApplication) = ($CurrentOsApplication)"!]
                    <BSW-CALLED-ENTITY>
                      <SHORT-NAME>BswCalledEnt_SgnSlavePnc_From_[!"$SignalOsApplication"!]_To_[!"$MasterPncOsApplication"!]_DataSntFnct_[!"node:name(.)"!]</SHORT-NAME>
                      <MINIMUM-START-INTERVAL>0.0</MINIMUM-START-INTERVAL>
                      <DATA-SEND-POINTS>
                        <!-- Slave core only -->
                        <BSW-VARIABLE-ACCESS>
                          <SHORT-NAME>BswVarAccess_SgnSlavePnc_OsApplication_[!"($SignalOsApplication)"!]_DataSet_[!"node:name(.)"!]</SHORT-NAME>
                          <ACCESSED-VARIABLE-REF DEST="VARIABLE-DATA-PROTOTYPE">/AUTOSAR_ComM/BswModuleDescriptions/ComM/ComM_SgnSlavePnc_From_[!"$SignalOsApplication"!]_To_[!"$MasterPncOsApplication"!]_DataSet_[!"node:name(.)"!]</ACCESSED-VARIABLE-REF>
                        </BSW-VARIABLE-ACCESS>
                      </DATA-SEND-POINTS>
                      <IMPLEMENTED-ENTRY-REF DEST="BSW-MODULE-ENTRY">/AUTOSAR_ComM/BswModuleEntrys/ComM_COMCbk_[!"node:name(.)"!]</IMPLEMENTED-ENTRY-REF>
                    </BSW-CALLED-ENTITY>
          [!ENDIF!]
        [!ENDLOOP!]
                  </ENTITYS>
                  <EVENTS>
        [!LOOP "node:order(node:refs(as:modconf('ComM')[1]/ComMConfigSet/*[1]/ComMPnc/*/ComMPncComSignal/*[ComMPncComSignalDirection='TX']/ComMPncComSignalRef), 'ComHandleId')"!]
          [!CALL "GetSignalOsApplication","SignalHandle"="ComHandleId","Direction"="'TX'"!]
          [!IF "($SignalOsApplication) = ($CurrentOsApplication)"!]
                    <BSW-DATA-RECEIVED-EVENT>
                        <SHORT-NAME>ComM_SgnSlavePnc_From_[!"$MasterPncOsApplication"!]_To_[!"$SignalOsApplication"!]_[!"node:name(.)"!]_RecEv</SHORT-NAME>
                        <STARTS-ON-EVENT-REF DEST="BSW-SCHEDULABLE-ENTITY">/AUTOSAR_ComM/BswModuleDescriptions/ComM/InternalBehavior_SgnSlavePnc_[!"($SignalOsApplication)"!]/BswSchEnt_ComM_SgnSlavePnc_From_[!"$MasterPncOsApplication"!]_To_[!"$SignalOsApplication"!]_RcvFnct_[!"node:name(.)"!]</STARTS-ON-EVENT-REF>
                        <DATA-REF DEST="VARIABLE-DATA-PROTOTYPE">/AUTOSAR_ComM/BswModuleDescriptions/ComM/ComM_SgnSlavePnc_From_[!"$MasterPncOsApplication"!]_To_[!"$SignalOsApplication"!]_DataGet_[!"node:name(.)"!]</DATA-REF>
                    </BSW-DATA-RECEIVED-EVENT>
          [!ENDIF!]
        [!ENDLOOP!]
                  </EVENTS>
                  <RECEPTION-POLICYS>
        [!LOOP "node:order(node:refs(as:modconf('ComM')[1]/ComMConfigSet/*[1]/ComMPnc/*/ComMPncComSignal/*[ComMPncComSignalDirection='TX']/ComMPncComSignalRef), 'ComHandleId')"!]
          [!CALL "GetSignalOsApplication","SignalHandle"="ComHandleId","Direction"="'TX'"!]
          [!IF "($SignalOsApplication) = ($CurrentOsApplication)"!]
                    <BSW-QUEUED-DATA-RECEPTION-POLICY>
                      <ENABLE-TAKE-ADDRESS>true</ENABLE-TAKE-ADDRESS>
                      <RECEIVED-DATA-REF DEST="VARIABLE-DATA-PROTOTYPE">/AUTOSAR_ComM/BswModuleDescriptions/ComM/ComM_SgnSlavePnc_From_[!"$MasterPncOsApplication"!]_To_[!"$SignalOsApplication"!]_DataGet_[!"node:name(.)"!]</RECEIVED-DATA-REF>
                      <QUEUE-LENGTH>2</QUEUE-LENGTH>
                    </BSW-QUEUED-DATA-RECEPTION-POLICY>
          [!ENDIF!]
        [!ENDLOOP!]
                  </RECEPTION-POLICYS>
                </BSW-INTERNAL-BEHAVIOR>
      [!ENDIF!]
    [!ENDFOR!]
  [!ENDIF!]
[!ENDIF!] [!/*[!IF "as:modconf('ComM')[1]/ComMGeneral/ComMPncSupport = 'true'"!]*/!]


              </INTERNAL-BEHAVIORS>
            </BSW-MODULE-DESCRIPTION>
          </ELEMENTS>
        </AR-PACKAGE>
        <AR-PACKAGE>
          <SHORT-NAME>[!"$bswModuleEntryPackageName"!]</SHORT-NAME>
          <ELEMENTS>
[!LOOP "ComMConfigSet/*[1]/ComMChannel/*"!]
            <BSW-MODULE-ENTRY>
              <SHORT-NAME>ComM_MainFunction_[!"ComMChannelId"!]</SHORT-NAME>
              <SERVICE-ID>96</SERVICE-ID>
              <IS-REENTRANT>false</IS-REENTRANT>
              <IS-SYNCHRONOUS>true</IS-SYNCHRONOUS>
              <CALL-TYPE>SCHEDULED</CALL-TYPE>
              <EXECUTION-CONTEXT>TASK</EXECUTION-CONTEXT>
              <SW-SERVICE-IMPL-POLICY>STANDARD</SW-SERVICE-IMPL-POLICY>
            </BSW-MODULE-ENTRY>
[!ENDLOOP!]

            <BSW-MODULE-ENTRY>
              <SHORT-NAME>ComM_DummyMainFunction</SHORT-NAME>
              <SERVICE-ID>255</SERVICE-ID>
              <IS-REENTRANT>false</IS-REENTRANT>
              <IS-SYNCHRONOUS>true</IS-SYNCHRONOUS>
              <CALL-TYPE>SCHEDULED</CALL-TYPE>
              <EXECUTION-CONTEXT>TASK</EXECUTION-CONTEXT>
              <SW-SERVICE-IMPL-POLICY>STANDARD</SW-SERVICE-IMPL-POLICY>
            </BSW-MODULE-ENTRY>
            <BSW-MODULE-ENTRY>
              <SHORT-NAME>ComM_DummyInhibitionMainFunction</SHORT-NAME>
              <SERVICE-ID>255</SERVICE-ID>
              <IS-REENTRANT>false</IS-REENTRANT>
              <IS-SYNCHRONOUS>true</IS-SYNCHRONOUS>
              <CALL-TYPE>SCHEDULED</CALL-TYPE>
              <EXECUTION-CONTEXT>TASK</EXECUTION-CONTEXT>
              <SW-SERVICE-IMPL-POLICY>STANDARD</SW-SERVICE-IMPL-POLICY>
            </BSW-MODULE-ENTRY>            
[!IF "(as:modconf('ComM')[1]/ComMGeneral/ComMModeLimitationEnabled = 'true') or (as:modconf('ComM')[1]/ComMGeneral/ComMWakeupInhibitionEnabled = 'true')"!]
  [!IF "num:i(count(as:modconf('ComM')[1]/ComMConfigSet/*[1]/ComMUser/*)) > 0"!]    
    [!FOR "Idx1" = "1" TO "count(text:split($UserToInhibitionFromOsApp_ToOsApp,' '))"!]
      [!VAR "FromOsApplicationToOsApplication" = "string(text:split($UserToInhibitionFromOsApp_ToOsApp,' ')[position() = $Idx1])"!]
      [!VAR "FromOsApplication" = "string(text:split($FromOsApplicationToOsApplication,'->')[position() = 1])"!]
      [!VAR "ToOsApplication" = "string(text:split($FromOsApplicationToOsApplication,'->')[position() = 2])"!]            
            <BSW-MODULE-ENTRY>
              <SHORT-NAME>ComM_User_To_Inhibition_From_[!"$FromOsApplication"!]_To_[!"$InhibitionOsApplication"!]_RcvFnct</SHORT-NAME>
              <ADMIN-DATA>
                <SDGS>
                  <SDG GID="EB:DnT">
                    <SD GID="FunctionGroup">Extern</SD>
                    <SD GID="EnableTracing">true</SD>
                  </SDG>
                 </SDGS>
              </ADMIN-DATA>
              <SERVICE-ID>255</SERVICE-ID>
              <IS-REENTRANT>false</IS-REENTRANT>
              <IS-SYNCHRONOUS>true</IS-SYNCHRONOUS>
              <CALL-TYPE>SCHEDULED</CALL-TYPE>
              <EXECUTION-CONTEXT>TASK</EXECUTION-CONTEXT>
              <SW-SERVICE-IMPL-POLICY>STANDARD</SW-SERVICE-IMPL-POLICY>
              <ARGUMENTS>
              </ARGUMENTS>
            </BSW-MODULE-ENTRY>
    [!ENDFOR!] [!/*[!FOR "Idx1" = "1" TO "count(text:split($UserToInhibitionFromOsApp_ToOsApp,' '))"!]*/!]
            <BSW-MODULE-ENTRY>
              <SHORT-NAME>ComM_User_To_Inhibition_DataSntFnct</SHORT-NAME>
              <ADMIN-DATA>
                <SDGS>
                  <SDG GID="EB:DnT">
                    <SD GID="FunctionGroup">Extern</SD>
                    <SD GID="EnableTracing">true</SD>
                  </SDG>
                 </SDGS>
              </ADMIN-DATA>
              <SERVICE-ID>255</SERVICE-ID>
              <IS-REENTRANT>false</IS-REENTRANT>
              <IS-SYNCHRONOUS>true</IS-SYNCHRONOUS>
              <CALL-TYPE>REGULAR</CALL-TYPE>
              <EXECUTION-CONTEXT>TASK</EXECUTION-CONTEXT>
              <SW-SERVICE-IMPL-POLICY>STANDARD</SW-SERVICE-IMPL-POLICY>
              <ARGUMENTS>
              </ARGUMENTS>
            </BSW-MODULE-ENTRY>    
  [!ENDIF!] [!/* [!IF "num:i(count(as:modconf('ComM')[1]/ComMConfigSet/*[1]/ComMUser/*)) > 0"!] */!]
  [!FOR "Idx1" = "1" TO "count(text:split($InhibitionToChFromOsApp_ToOsApp,' '))"!]
    [!VAR "FromOsApplicationToOsApplication" = "string(text:split($InhibitionToChFromOsApp_ToOsApp,' ')[position() = $Idx1])"!]
    [!VAR "FromOsApplication" = "string(text:split($FromOsApplicationToOsApplication,'->')[position() = 1])"!]
    [!VAR "ToOsApplication" = "string(text:split($FromOsApplicationToOsApplication,'->')[position() = 2])"!]  
            <BSW-MODULE-ENTRY>
              <SHORT-NAME>ComM_Inhibition_To_Ch_From_[!"$FromOsApplication"!]_To_[!"$ToOsApplication"!]_RcvFnct</SHORT-NAME>
              <ADMIN-DATA>
                <SDGS>
                  <SDG GID="EB:DnT">
                    <SD GID="FunctionGroup">Extern</SD>
                    <SD GID="EnableTracing">true</SD>
                  </SDG>
                 </SDGS>
              </ADMIN-DATA>
              <SERVICE-ID>255</SERVICE-ID>
              <IS-REENTRANT>false</IS-REENTRANT>
              <IS-SYNCHRONOUS>true</IS-SYNCHRONOUS>
              <CALL-TYPE>SCHEDULED</CALL-TYPE>
              <EXECUTION-CONTEXT>TASK</EXECUTION-CONTEXT>
              <SW-SERVICE-IMPL-POLICY>STANDARD</SW-SERVICE-IMPL-POLICY>
              <ARGUMENTS>
              </ARGUMENTS>
            </BSW-MODULE-ENTRY>
  [!ENDFOR!] [!/* [!FOR "Idx1" = "1" TO "count(text:split($InhibitionToChFromOsApp_ToOsApp,' '))"!] */!]
            <BSW-MODULE-ENTRY>
              <SHORT-NAME>ComM_Inhibition_To_Ch_DataSntFnct</SHORT-NAME>
              <ADMIN-DATA>
                <SDGS>
                  <SDG GID="EB:DnT">
                    <SD GID="FunctionGroup">Extern</SD>
                    <SD GID="EnableTracing">true</SD>
                  </SDG>
                 </SDGS>
              </ADMIN-DATA>
              <SERVICE-ID>255</SERVICE-ID>
              <IS-REENTRANT>false</IS-REENTRANT>
              <IS-SYNCHRONOUS>true</IS-SYNCHRONOUS>
              <CALL-TYPE>REGULAR</CALL-TYPE>
              <EXECUTION-CONTEXT>TASK</EXECUTION-CONTEXT>
              <SW-SERVICE-IMPL-POLICY>STANDARD</SW-SERVICE-IMPL-POLICY>
              <ARGUMENTS>
              </ARGUMENTS>
            </BSW-MODULE-ENTRY>
			
  [!FOR "Idx1" = "1" TO "count(text:split($ChToInhibitionFromOsApp_ToOsApp,' '))"!]
    [!VAR "FromOsApplicationToOsApplication" = "string(text:split($ChToInhibitionFromOsApp_ToOsApp,' ')[position() = $Idx1])"!]
    [!VAR "FromOsApplication" = "string(text:split($FromOsApplicationToOsApplication,'->')[position() = 1])"!]
    [!VAR "ToOsApplication" = "string(text:split($FromOsApplicationToOsApplication,'->')[position() = 2])"!]  
            <BSW-MODULE-ENTRY>
              <SHORT-NAME>ComM_Ch_To_Inhibition_From_[!"$FromOsApplication"!]_To_[!"$ToOsApplication"!]_RcvFnct</SHORT-NAME>
              <ADMIN-DATA>
                <SDGS>
                  <SDG GID="EB:DnT">
                    <SD GID="FunctionGroup">Extern</SD>
                    <SD GID="EnableTracing">true</SD>
                  </SDG>
                 </SDGS>
              </ADMIN-DATA>
              <SERVICE-ID>255</SERVICE-ID>
              <IS-REENTRANT>false</IS-REENTRANT>
              <IS-SYNCHRONOUS>true</IS-SYNCHRONOUS>
              <CALL-TYPE>SCHEDULED</CALL-TYPE>
              <EXECUTION-CONTEXT>TASK</EXECUTION-CONTEXT>
              <SW-SERVICE-IMPL-POLICY>STANDARD</SW-SERVICE-IMPL-POLICY>
              <ARGUMENTS>
              </ARGUMENTS>
            </BSW-MODULE-ENTRY>
  [!ENDFOR!] [!/* [!FOR "Idx1" = "1" TO "count(text:split($ChToInhibitionFromOsApp_ToOsApp,' '))"!] */!]
            <BSW-MODULE-ENTRY>
              <SHORT-NAME>ComM_Ch_To_Inhibition_DataSntFnct</SHORT-NAME>
              <ADMIN-DATA>
                <SDGS>
                  <SDG GID="EB:DnT">
                    <SD GID="FunctionGroup">Extern</SD>
                    <SD GID="EnableTracing">true</SD>
                  </SDG>
                 </SDGS>
              </ADMIN-DATA>
              <SERVICE-ID>255</SERVICE-ID>
              <IS-REENTRANT>false</IS-REENTRANT>
              <IS-SYNCHRONOUS>true</IS-SYNCHRONOUS>
              <CALL-TYPE>REGULAR</CALL-TYPE>
              <EXECUTION-CONTEXT>TASK</EXECUTION-CONTEXT>
              <SW-SERVICE-IMPL-POLICY>STANDARD</SW-SERVICE-IMPL-POLICY>
              <ARGUMENTS>
              </ARGUMENTS>
            </BSW-MODULE-ENTRY>			
[!ENDIF!] [!/*[!IF "(as:modconf('ComM')[1]/ComMGeneral/ComMModeLimitationEnabled = 'true') or (as:modconf('ComM')[1]/ComMGeneral/ComMWakeupInhibitionEnabled = 'true')"!]*/!]

[!IF "as:modconf('ComM')[1]/ComMGeneral/ComMDcmUsage = 'true'"!]
            <BSW-MODULE-ENTRY>
              <SHORT-NAME>ComM_DCM_ActiveDiagnostic</SHORT-NAME>
              <ADMIN-DATA>
                <SDGS>
                  <SDG GID="EB:DnT">
                    <SD GID="FunctionGroup">Extern</SD>
                    <SD GID="EnableTracing">true</SD>
                  </SDG>
                 </SDGS>
              </ADMIN-DATA>
              <SERVICE-ID>31</SERVICE-ID>
              <IS-REENTRANT>true</IS-REENTRANT>
              <IS-SYNCHRONOUS>false</IS-SYNCHRONOUS>
              <CALL-TYPE>REGULAR</CALL-TYPE>
              <EXECUTION-CONTEXT>TASK</EXECUTION-CONTEXT>
              <SW-SERVICE-IMPL-POLICY>STANDARD</SW-SERVICE-IMPL-POLICY>
              <ARGUMENTS>
                <SW-SERVICE-ARG>
                  <SHORT-NAME>Channel</SHORT-NAME>
                  <DIRECTION>IN</DIRECTION>
                  <SW-DATA-DEF-PROPS>
                    <SW-DATA-DEF-PROPS-VARIANTS>
                      <SW-DATA-DEF-PROPS-CONDITIONAL>
                        <IMPLEMENTATION-DATA-TYPE-REF DEST="IMPLEMENTATION-DATA-TYPE">/AUTOSAR_Platform/ImplementationDataTypes/uint8</IMPLEMENTATION-DATA-TYPE-REF>
                      </SW-DATA-DEF-PROPS-CONDITIONAL>
                    </SW-DATA-DEF-PROPS-VARIANTS>
                  </SW-DATA-DEF-PROPS>
                </SW-SERVICE-ARG>
              </ARGUMENTS>
            </BSW-MODULE-ENTRY>
            <BSW-MODULE-ENTRY>
              <SHORT-NAME>ComM_DCM_InactiveDiagnostic</SHORT-NAME>
              <ADMIN-DATA>
                <SDGS>
                  <SDG GID="EB:DnT">
                    <SD GID="FunctionGroup">Extern</SD>
                    <SD GID="EnableTracing">true</SD>
                  </SDG>
                 </SDGS>
              </ADMIN-DATA>
              <SERVICE-ID>32</SERVICE-ID>
              <IS-REENTRANT>true</IS-REENTRANT>
              <IS-SYNCHRONOUS>false</IS-SYNCHRONOUS>
              <CALL-TYPE>REGULAR</CALL-TYPE>
              <EXECUTION-CONTEXT>TASK</EXECUTION-CONTEXT>
              <SW-SERVICE-IMPL-POLICY>STANDARD</SW-SERVICE-IMPL-POLICY>
              <ARGUMENTS>
                <SW-SERVICE-ARG>
                  <SHORT-NAME>Channel</SHORT-NAME>
                  <DIRECTION>IN</DIRECTION>
                  <SW-DATA-DEF-PROPS>
                    <SW-DATA-DEF-PROPS-VARIANTS>
                      <SW-DATA-DEF-PROPS-CONDITIONAL>
                        <IMPLEMENTATION-DATA-TYPE-REF DEST="IMPLEMENTATION-DATA-TYPE">/AUTOSAR_Platform/ImplementationDataTypes/uint8</IMPLEMENTATION-DATA-TYPE-REF>
                      </SW-DATA-DEF-PROPS-CONDITIONAL>
                    </SW-DATA-DEF-PROPS-VARIANTS>
                  </SW-DATA-DEF-PROPS>
                </SW-SERVICE-ARG>
              </ARGUMENTS>
            </BSW-MODULE-ENTRY>
[!ENDIF!] [!/* [!IF "as:modconf('ComM')[1]/ComMGeneral/ComMDcmUsage = 'true'"!] */!]
