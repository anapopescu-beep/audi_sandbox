[part 2 of 3]
[!IF "General/ETS_EnableDET = 'true'"!]
            <!-- !LINKSTO EB.ETS.interface.1, 1 -->
            <CLIENT-SERVER-INTERFACE>
              <SHORT-NAME>DetService</SHORT-NAME>
              <IS-SERVICE>true</IS-SERVICE>
              <OPERATIONS>
                <CLIENT-SERVER-OPERATION>
                  <SHORT-NAME>ReportError</SHORT-NAME>
                  <ARGUMENTS>
                    <ARGUMENT-DATA-PROTOTYPE>
                      <SHORT-NAME>InstanceId</SHORT-NAME>
                      <TYPE-TREF DEST="IMPLEMENTATION-DATA-TYPE">/AUTOSAR_Platform/ImplementationDataTypes/uint8</TYPE-TREF>
                      <DIRECTION>IN</DIRECTION>
                    </ARGUMENT-DATA-PROTOTYPE>
                    <ARGUMENT-DATA-PROTOTYPE>
                      <SHORT-NAME>ApiId</SHORT-NAME>
                      <TYPE-TREF DEST="IMPLEMENTATION-DATA-TYPE">/AUTOSAR_Platform/ImplementationDataTypes/uint8</TYPE-TREF>
                      <DIRECTION>IN</DIRECTION>
                    </ARGUMENT-DATA-PROTOTYPE>
                    <ARGUMENT-DATA-PROTOTYPE>
                      <SHORT-NAME>ErrorId</SHORT-NAME>
                      <TYPE-TREF DEST="IMPLEMENTATION-DATA-TYPE">/AUTOSAR_Platform/ImplementationDataTypes/uint8</TYPE-TREF>
                      <DIRECTION>IN</DIRECTION>
                    </ARGUMENT-DATA-PROTOTYPE>
                  </ARGUMENTS>
                  <POSSIBLE-ERROR-REFS>
                    <POSSIBLE-ERROR-REF DEST="APPLICATION-ERROR">/ETS/PortInterfaces/DetService/E_OK</POSSIBLE-ERROR-REF>
                    <POSSIBLE-ERROR-REF DEST="APPLICATION-ERROR">/ETS/PortInterfaces/DetService/E_NOT_OK</POSSIBLE-ERROR-REF>
                   </POSSIBLE-ERROR-REFS>
                </CLIENT-SERVER-OPERATION>
              </OPERATIONS>
              <POSSIBLE-ERRORS>
                <APPLICATION-ERROR>
                  <SHORT-NAME>E_OK</SHORT-NAME>
                  <ERROR-CODE>0</ERROR-CODE>
                </APPLICATION-ERROR>
                <APPLICATION-ERROR>
                  <SHORT-NAME>E_NOT_OK</SHORT-NAME>
                  <ERROR-CODE>1</ERROR-CODE>
                </APPLICATION-ERROR>
              </POSSIBLE-ERRORS>
            </CLIENT-SERVER-INTERFACE>
[!ENDIF!]
[!IF "EnhancedTestabilityService/TestingClientInteraction/checkByteOrder = 'true'"!]
            <!-- !LINKSTO EB.ETS.interface.22, 1 -->
            <CLIENT-SERVER-INTERFACE>
              <SHORT-NAME>ETS_CheckByteOrder</SHORT-NAME>
              <IS-SERVICE>true</IS-SERVICE>
              <OPERATIONS>
                <!-- !LINKSTO swdd.ETS-0001.2, 1 -->
                <CLIENT-SERVER-OPERATION>
                  <SHORT-NAME>ETS_CheckByteOrder</SHORT-NAME>
                  <ARGUMENTS>
                    <ARGUMENT-DATA-PROTOTYPE>
                      <SHORT-NAME>summandUINT8</SHORT-NAME>
                      <TYPE-TREF DEST="IMPLEMENTATION-DATA-TYPE">/AUTOSAR_Platform/ImplementationDataTypes/uint8</TYPE-TREF>
                      <DIRECTION>IN</DIRECTION>
                      <SERVER-ARGUMENT-IMPL-POLICY>USE-ARGUMENT-TYPE</SERVER-ARGUMENT-IMPL-POLICY>
                    </ARGUMENT-DATA-PROTOTYPE>
                    <ARGUMENT-DATA-PROTOTYPE>
                      <SHORT-NAME>summandUINT16</SHORT-NAME>
                      <TYPE-TREF DEST="IMPLEMENTATION-DATA-TYPE">/AUTOSAR_Platform/ImplementationDataTypes/uint16</TYPE-TREF>
                      <DIRECTION>IN</DIRECTION>
                      <SERVER-ARGUMENT-IMPL-POLICY>USE-ARGUMENT-TYPE</SERVER-ARGUMENT-IMPL-POLICY>
                    </ARGUMENT-DATA-PROTOTYPE>
                    <ARGUMENT-DATA-PROTOTYPE>
                      <SHORT-NAME>sum</SHORT-NAME>
                      <TYPE-TREF DEST="IMPLEMENTATION-DATA-TYPE">/AUTOSAR_Platform/ImplementationDataTypes/uint32</TYPE-TREF>
                      <DIRECTION>OUT</DIRECTION>
                      <SERVER-ARGUMENT-IMPL-POLICY>USE-ARGUMENT-TYPE</SERVER-ARGUMENT-IMPL-POLICY>
                    </ARGUMENT-DATA-PROTOTYPE>
                  </ARGUMENTS>
                </CLIENT-SERVER-OPERATION>
              </OPERATIONS>
            </CLIENT-SERVER-INTERFACE>
[!ENDIF!]
[!IF "EnhancedTestabilityService/TestingClientInteraction/clientServiceActivate = 'true'"!]
            <!-- !LINKSTO EB.ETS.interface.23, 1 -->
            <SENDER-RECEIVER-INTERFACE>
              <SHORT-NAME>ETS_ClientServiceActivate</SHORT-NAME>
              <IS-SERVICE>true</IS-SERVICE>
              <DATA-ELEMENTS>
                <VARIABLE-DATA-PROTOTYPE>
                  <SHORT-NAME>start</SHORT-NAME>
                  <SW-DATA-DEF-PROPS>
                    <SW-DATA-DEF-PROPS-VARIANTS>
                      <SW-DATA-DEF-PROPS-CONDITIONAL>
                        <SW-IMPL-POLICY>QUEUED</SW-IMPL-POLICY>
                      </SW-DATA-DEF-PROPS-CONDITIONAL>
                    </SW-DATA-DEF-PROPS-VARIANTS>
                  </SW-DATA-DEF-PROPS>
                  <TYPE-TREF DEST="IMPLEMENTATION-DATA-TYPE">/AUTOSAR_Platform/ImplementationDataTypes/uint8</TYPE-TREF>
                </VARIABLE-DATA-PROTOTYPE>
              </DATA-ELEMENTS>
            </SENDER-RECEIVER-INTERFACE>
[!ENDIF!]
[!IF "EnhancedTestabilityService/TestingClientInteraction/clientServiceCallEchoUINT8Array = 'true'"!]
            <!-- !LINKSTO EB.ETS.interface.20, 1 -->
            <CLIENT-SERVER-INTERFACE>
              <SHORT-NAME>ETS_ClientServiceCallEchoUINT8Array</SHORT-NAME>
              <IS-SERVICE>true</IS-SERVICE>
              <OPERATIONS>
                <CLIENT-SERVER-OPERATION>
                  <SHORT-NAME>ETS_ClientServiceCallEchoUINT8Array</SHORT-NAME>
                  <ARGUMENTS>
                    <ARGUMENT-DATA-PROTOTYPE>
                      <SHORT-NAME>uINT8ARRAY</SHORT-NAME>
                      <CATEGORY>ARRAY</CATEGORY>
                      <TYPE-TREF DEST="APPLICATION-ARRAY-DATA-TYPE">/ETS/ApplicationDataTypes/ETS_Uint8Array</TYPE-TREF>
                      <DIRECTION>INOUT</DIRECTION>
                    </ARGUMENT-DATA-PROTOTYPE>
                  </ARGUMENTS>
                </CLIENT-SERVER-OPERATION>
              </OPERATIONS>
            </CLIENT-SERVER-INTERFACE>
[!ENDIF!]
[!IF "EnhancedTestabilityService/TestingClientInteraction/clientServiceDeactivate = 'true'"!]
            <!-- !LINKSTO EB.ETS.interface.24, 1 -->
            <SENDER-RECEIVER-INTERFACE>
              <SHORT-NAME>ETS_ClientServiceDeactivate</SHORT-NAME>
              <IS-SERVICE>true</IS-SERVICE>
              <DATA-ELEMENTS>
                <VARIABLE-DATA-PROTOTYPE>
                  <SHORT-NAME>start</SHORT-NAME>
                  <SW-DATA-DEF-PROPS>
                    <SW-DATA-DEF-PROPS-VARIANTS>
                      <SW-DATA-DEF-PROPS-CONDITIONAL>
                        <SW-IMPL-POLICY>QUEUED</SW-IMPL-POLICY>
                      </SW-DATA-DEF-PROPS-CONDITIONAL>
                    </SW-DATA-DEF-PROPS-VARIANTS>
                  </SW-DATA-DEF-PROPS>
                  <TYPE-TREF DEST="IMPLEMENTATION-DATA-TYPE">/AUTOSAR_Platform/ImplementationDataTypes/uint8</TYPE-TREF>
                </VARIABLE-DATA-PROTOTYPE>
              </DATA-ELEMENTS>
            </SENDER-RECEIVER-INTERFACE>
[!ENDIF!]
[!IF "EnhancedTestabilityService/TestingClientInteraction/clientServiceGetLastValueOfEventTCP = 'true'"!]
            <!-- !LINKSTO EB.ETS.interface.3, 1 -->
            <CLIENT-SERVER-INTERFACE>
              <SHORT-NAME>ETS_ClientServiceGetLastValueOfEventTCP</SHORT-NAME>
              <IS-SERVICE>true</IS-SERVICE>
              <OPERATIONS>
                <CLIENT-SERVER-OPERATION>
                  <SHORT-NAME>ETS_ClientServiceGetLastValueOfEventTCP</SHORT-NAME>
                  <ARGUMENTS>
                    <ARGUMENT-DATA-PROTOTYPE>
                      <SHORT-NAME>lastValue</SHORT-NAME>
                      <TYPE-TREF DEST="IMPLEMENTATION-DATA-TYPE">/AUTOSAR_Platform/ImplementationDataTypes/uint8</TYPE-TREF>
                      <DIRECTION>OUT</DIRECTION>
                      <SERVER-ARGUMENT-IMPL-POLICY>USE-ARGUMENT-TYPE</SERVER-ARGUMENT-IMPL-POLICY>
                    </ARGUMENT-DATA-PROTOTYPE>
                  </ARGUMENTS>
                </CLIENT-SERVER-OPERATION>
              </OPERATIONS>
            </CLIENT-SERVER-INTERFACE>
[!ENDIF!]
[!IF "EnhancedTestabilityService/TestingClientInteraction/clientServiceGetLastValueOfEventUDPMulticast = 'true'"!]
            <!-- !LINKSTO EB.ETS.interface.5, 1 -->
            <CLIENT-SERVER-INTERFACE>
              <SHORT-NAME>ETS_ClientServiceGetLastValueOfEventUDPMulticast</SHORT-NAME>
              <IS-SERVICE>true</IS-SERVICE>
              <OPERATIONS>
                <CLIENT-SERVER-OPERATION>
                  <SHORT-NAME>ETS_ClientServiceGetLastValueOfEventUDPMulticast</SHORT-NAME>
                  <ARGUMENTS>
                    <ARGUMENT-DATA-PROTOTYPE>
                      <SHORT-NAME>lastValue</SHORT-NAME>
                      <TYPE-TREF DEST="IMPLEMENTATION-DATA-TYPE">/AUTOSAR_Platform/ImplementationDataTypes/uint8</TYPE-TREF>
                      <DIRECTION>OUT</DIRECTION>
                      <SERVER-ARGUMENT-IMPL-POLICY>USE-ARGUMENT-TYPE</SERVER-ARGUMENT-IMPL-POLICY>
                    </ARGUMENT-DATA-PROTOTYPE>
                  </ARGUMENTS>
                </CLIENT-SERVER-OPERATION>
              </OPERATIONS>
            </CLIENT-SERVER-INTERFACE>
[!ENDIF!]
[!IF "EnhancedTestabilityService/TestingClientInteraction/clientServiceGetLastValueOfEventUDPUnicast = 'true'"!]
            <!-- !LINKSTO EB.ETS.interface.2, 1 -->
            <CLIENT-SERVER-INTERFACE>
              <SHORT-NAME>ETS_ClientServiceGetLastValueOfEventUDPUnicast</SHORT-NAME>
              <IS-SERVICE>true</IS-SERVICE>
              <OPERATIONS>
                <CLIENT-SERVER-OPERATION>
                  <SHORT-NAME>ETS_ClientServiceGetLastValueOfEventUDPUnicast</SHORT-NAME>
                  <ARGUMENTS>
                    <ARGUMENT-DATA-PROTOTYPE>
                      <SHORT-NAME>lastValue</SHORT-NAME>
                      <TYPE-TREF DEST="IMPLEMENTATION-DATA-TYPE">/AUTOSAR_Platform/ImplementationDataTypes/uint8</TYPE-TREF>
                      <DIRECTION>OUT</DIRECTION>
                      <SERVER-ARGUMENT-IMPL-POLICY>USE-ARGUMENT-TYPE</SERVER-ARGUMENT-IMPL-POLICY>
                    </ARGUMENT-DATA-PROTOTYPE>
                  </ARGUMENTS>
                </CLIENT-SERVER-OPERATION>
              </OPERATIONS>
            </CLIENT-SERVER-INTERFACE>
[!ENDIF!]
[!IF "EnhancedTestabilityService/TestingClientInteraction/clientServiceSubscribeEventgroup = 'true'"!]
            <!-- !LINKSTO EB.ETS.interface.4, 1 -->
            <SENDER-RECEIVER-INTERFACE>
              <SHORT-NAME>ETS_ClientServiceSubscribeEventgroup</SHORT-NAME>
              <IS-SERVICE>true</IS-SERVICE>
              <DATA-ELEMENTS>
                <VARIABLE-DATA-PROTOTYPE>
                  <SHORT-NAME>clientServiceSubscribeEventgroup</SHORT-NAME>
                  <CATEGORY>STRUCTURE</CATEGORY>
                  <SW-DATA-DEF-PROPS>
                    <SW-DATA-DEF-PROPS-VARIANTS>
                      <SW-DATA-DEF-PROPS-CONDITIONAL>
                        <SW-IMPL-POLICY>QUEUED</SW-IMPL-POLICY>
                      </SW-DATA-DEF-PROPS-CONDITIONAL>
                    </SW-DATA-DEF-PROPS-VARIANTS>
                  </SW-DATA-DEF-PROPS>
                  <TYPE-TREF DEST="APPLICATION-RECORD-DATA-TYPE">/ETS/ApplicationDataTypes/ETS_TimePeriod</TYPE-TREF>
                </VARIABLE-DATA-PROTOTYPE>
              </DATA-ELEMENTS>
            </SENDER-RECEIVER-INTERFACE>
[!ENDIF!]
[!IF "EnhancedTestabilityService/EchoingDataTypes/echoCommonDatatypes = 'true'"!]
            <!-- !LINKSTO EB.ETS.interface.41, 1 -->
            <CLIENT-SERVER-INTERFACE>
              <SHORT-NAME>ETS_EchoCommonDatatypes</SHORT-NAME>
              <IS-SERVICE>true</IS-SERVICE>
              <OPERATIONS>
                <CLIENT-SERVER-OPERATION>
                  <SHORT-NAME>EchoCommonDatatypes</SHORT-NAME>
                  <ARGUMENTS>
                    <ARGUMENT-DATA-PROTOTYPE>
                      <SHORT-NAME>bOOLEAN_in</SHORT-NAME>
                      <CATEGORY>VALUE</CATEGORY>
                      <TYPE-TREF DEST="IMPLEMENTATION-DATA-TYPE">/AUTOSAR_Platform/ImplementationDataTypes/boolean</TYPE-TREF>
                      <DIRECTION>IN</DIRECTION>
                      <SERVER-ARGUMENT-IMPL-POLICY>USE-ARGUMENT-TYPE</SERVER-ARGUMENT-IMPL-POLICY>
                    </ARGUMENT-DATA-PROTOTYPE>
                    <ARGUMENT-DATA-PROTOTYPE>
                      <SHORT-NAME>uINT8_in</SHORT-NAME>
                      <CATEGORY>VALUE</CATEGORY>
                      <TYPE-TREF DEST="IMPLEMENTATION-DATA-TYPE">/AUTOSAR_Platform/ImplementationDataTypes/uint8</TYPE-TREF>
                      <DIRECTION>IN</DIRECTION>
                      <SERVER-ARGUMENT-IMPL-POLICY>USE-ARGUMENT-TYPE</SERVER-ARGUMENT-IMPL-POLICY>
                    </ARGUMENT-DATA-PROTOTYPE>
                    <ARGUMENT-DATA-PROTOTYPE>
                      <SHORT-NAME>uINT16_in</SHORT-NAME>
                      <CATEGORY>VALUE</CATEGORY>
                      <TYPE-TREF DEST="IMPLEMENTATION-DATA-TYPE">/AUTOSAR_Platform/ImplementationDataTypes/uint16</TYPE-TREF>
                      <DIRECTION>IN</DIRECTION>
                      <SERVER-ARGUMENT-IMPL-POLICY>USE-ARGUMENT-TYPE</SERVER-ARGUMENT-IMPL-POLICY>
                    </ARGUMENT-DATA-PROTOTYPE>
                    <ARGUMENT-DATA-PROTOTYPE>
                      <SHORT-NAME>uINT32_in</SHORT-NAME>
                      <CATEGORY>VALUE</CATEGORY>
                      <TYPE-TREF DEST="IMPLEMENTATION-DATA-TYPE">/AUTOSAR_Platform/ImplementationDataTypes/uint32</TYPE-TREF>
                      <DIRECTION>IN</DIRECTION>
                      <SERVER-ARGUMENT-IMPL-POLICY>USE-ARGUMENT-TYPE</SERVER-ARGUMENT-IMPL-POLICY>
                    </ARGUMENT-DATA-PROTOTYPE>
                    <ARGUMENT-DATA-PROTOTYPE>
                      <SHORT-NAME>iNT8_in</SHORT-NAME>
                      <CATEGORY>VALUE</CATEGORY>
                      <TYPE-TREF DEST="IMPLEMENTATION-DATA-TYPE">/AUTOSAR_Platform/ImplementationDataTypes/sint8</TYPE-TREF>
                      <DIRECTION>IN</DIRECTION>
                      <SERVER-ARGUMENT-IMPL-POLICY>USE-ARGUMENT-TYPE</SERVER-ARGUMENT-IMPL-POLICY>
                    </ARGUMENT-DATA-PROTOTYPE>
                    <ARGUMENT-DATA-PROTOTYPE>
                      <SHORT-NAME>iNT16_in</SHORT-NAME>
                      <CATEGORY>VALUE</CATEGORY>
                      <TYPE-TREF DEST="IMPLEMENTATION-DATA-TYPE">/AUTOSAR_Platform/ImplementationDataTypes/sint16</TYPE-TREF>
                      <DIRECTION>IN</DIRECTION>
                      <SERVER-ARGUMENT-IMPL-POLICY>USE-ARGUMENT-TYPE</SERVER-ARGUMENT-IMPL-POLICY>
                    </ARGUMENT-DATA-PROTOTYPE>
                    <ARGUMENT-DATA-PROTOTYPE>
                      <SHORT-NAME>iNT32_in</SHORT-NAME>
                      <CATEGORY>VALUE</CATEGORY>
                      <TYPE-TREF DEST="IMPLEMENTATION-DATA-TYPE">/AUTOSAR_Platform/ImplementationDataTypes/sint32</TYPE-TREF>
                      <DIRECTION>IN</DIRECTION>
                      <SERVER-ARGUMENT-IMPL-POLICY>USE-ARGUMENT-TYPE</SERVER-ARGUMENT-IMPL-POLICY>
                    </ARGUMENT-DATA-PROTOTYPE>
                    <ARGUMENT-DATA-PROTOTYPE>
                      <SHORT-NAME>fLOAT32_in</SHORT-NAME>
                      <CATEGORY>VALUE</CATEGORY>
                      <TYPE-TREF DEST="IMPLEMENTATION-DATA-TYPE">/AUTOSAR_Platform/ImplementationDataTypes/float32</TYPE-TREF>
                      <DIRECTION>IN</DIRECTION>
                      <SERVER-ARGUMENT-IMPL-POLICY>USE-ARGUMENT-TYPE</SERVER-ARGUMENT-IMPL-POLICY>
                    </ARGUMENT-DATA-PROTOTYPE>
                    <ARGUMENT-DATA-PROTOTYPE >
                      <SHORT-NAME>fLOAT64_in</SHORT-NAME>
                      <TYPE-TREF DEST="IMPLEMENTATION-DATA-TYPE">/AUTOSAR_Platform/ImplementationDataTypes/float64</TYPE-TREF>
                      <DIRECTION>IN</DIRECTION>
                      <SERVER-ARGUMENT-IMPL-POLICY>USE-ARGUMENT-TYPE</SERVER-ARGUMENT-IMPL-POLICY>
                    </ARGUMENT-DATA-PROTOTYPE>
                    <ARGUMENT-DATA-PROTOTYPE>
                      <SHORT-NAME>fLOAT64_out</SHORT-NAME>
                      <TYPE-TREF DEST="IMPLEMENTATION-DATA-TYPE">/AUTOSAR_Platform/ImplementationDataTypes/float64</TYPE-TREF>
                      <DIRECTION>OUT</DIRECTION>
                      <SERVER-ARGUMENT-IMPL-POLICY>USE-ARGUMENT-TYPE</SERVER-ARGUMENT-IMPL-POLICY>
                    </ARGUMENT-DATA-PROTOTYPE>
                    <ARGUMENT-DATA-PROTOTYPE>
                      <SHORT-NAME>fLOAT32_out</SHORT-NAME>
                      <CATEGORY>VALUE</CATEGORY>
                      <TYPE-TREF DEST="IMPLEMENTATION-DATA-TYPE">/AUTOSAR_Platform/ImplementationDataTypes/float32</TYPE-TREF>
                      <DIRECTION>OUT</DIRECTION>
                      <SERVER-ARGUMENT-IMPL-POLICY>USE-ARGUMENT-TYPE</SERVER-ARGUMENT-IMPL-POLICY>
                    </ARGUMENT-DATA-PROTOTYPE>
                    <ARGUMENT-DATA-PROTOTYPE>
                      <SHORT-NAME>iNT32_out</SHORT-NAME>
                      <CATEGORY>VALUE</CATEGORY>
                      <TYPE-TREF DEST="IMPLEMENTATION-DATA-TYPE">/AUTOSAR_Platform/ImplementationDataTypes/sint32</TYPE-TREF>
                      <DIRECTION>OUT</DIRECTION>
                      <SERVER-ARGUMENT-IMPL-POLICY>USE-ARGUMENT-TYPE</SERVER-ARGUMENT-IMPL-POLICY>
                    </ARGUMENT-DATA-PROTOTYPE>
                    <ARGUMENT-DATA-PROTOTYPE>
                      <SHORT-NAME>iNT16_out</SHORT-NAME>
                      <CATEGORY>VALUE</CATEGORY>
                      <TYPE-TREF DEST="IMPLEMENTATION-DATA-TYPE">/AUTOSAR_Platform/ImplementationDataTypes/sint16</TYPE-TREF>
                      <DIRECTION>OUT</DIRECTION>
                      <SERVER-ARGUMENT-IMPL-POLICY>USE-ARGUMENT-TYPE</SERVER-ARGUMENT-IMPL-POLICY>
                    </ARGUMENT-DATA-PROTOTYPE>
                    <ARGUMENT-DATA-PROTOTYPE>
                      <SHORT-NAME>iNT8_out</SHORT-NAME>
                      <CATEGORY>VALUE</CATEGORY>
                      <TYPE-TREF DEST="IMPLEMENTATION-DATA-TYPE">/AUTOSAR_Platform/ImplementationDataTypes/sint8</TYPE-TREF>
                      <DIRECTION>OUT</DIRECTION>
                      <SERVER-ARGUMENT-IMPL-POLICY>USE-ARGUMENT-TYPE</SERVER-ARGUMENT-IMPL-POLICY>
                    </ARGUMENT-DATA-PROTOTYPE>
                    <ARGUMENT-DATA-PROTOTYPE>
                      <SHORT-NAME>uINT32_out</SHORT-NAME>
                      <CATEGORY>VALUE</CATEGORY>
                      <TYPE-TREF DEST="IMPLEMENTATION-DATA-TYPE">/AUTOSAR_Platform/ImplementationDataTypes/uint32</TYPE-TREF>
                      <DIRECTION>OUT</DIRECTION>
                      <SERVER-ARGUMENT-IMPL-POLICY>USE-ARGUMENT-TYPE</SERVER-ARGUMENT-IMPL-POLICY>
                    </ARGUMENT-DATA-PROTOTYPE>
                    <ARGUMENT-DATA-PROTOTYPE>
                      <SHORT-NAME>uINT16_out</SHORT-NAME>
                      <CATEGORY>VALUE</CATEGORY>
                      <TYPE-TREF DEST="IMPLEMENTATION-DATA-TYPE">/AUTOSAR_Platform/ImplementationDataTypes/uint16</TYPE-TREF>
                      <DIRECTION>OUT</DIRECTION>
                      <SERVER-ARGUMENT-IMPL-POLICY>USE-ARGUMENT-TYPE</SERVER-ARGUMENT-IMPL-POLICY>
                    </ARGUMENT-DATA-PROTOTYPE>
                    <ARGUMENT-DATA-PROTOTYPE>
                      <SHORT-NAME>uINT8_out</SHORT-NAME>
                      <CATEGORY>VALUE</CATEGORY>
                      <TYPE-TREF DEST="IMPLEMENTATION-DATA-TYPE">/AUTOSAR_Platform/ImplementationDataTypes/uint8</TYPE-TREF>
                      <DIRECTION>OUT</DIRECTION>
                      <SERVER-ARGUMENT-IMPL-POLICY>USE-ARGUMENT-TYPE</SERVER-ARGUMENT-IMPL-POLICY>
                    </ARGUMENT-DATA-PROTOTYPE>
                    <ARGUMENT-DATA-PROTOTYPE>
                      <SHORT-NAME>bOOLEAN_out</SHORT-NAME>
                      <CATEGORY>VALUE</CATEGORY>
                      <TYPE-TREF DEST="IMPLEMENTATION-DATA-TYPE">/AUTOSAR_Platform/ImplementationDataTypes/boolean</TYPE-TREF>
                      <DIRECTION>OUT</DIRECTION>
                      <SERVER-ARGUMENT-IMPL-POLICY>USE-ARGUMENT-TYPE</SERVER-ARGUMENT-IMPL-POLICY>
                    </ARGUMENT-DATA-PROTOTYPE>
                  </ARGUMENTS>
                </CLIENT-SERVER-OPERATION>
              </OPERATIONS>
            </CLIENT-SERVER-INTERFACE>
[!ENDIF!]
[!IF "EnhancedTestabilityService/EchoingDataTypes/echoUINT8 = 'true'"!]
            <!-- !LINKSTO EB.ETS.interface.50, 1 -->
            <CLIENT-SERVER-INTERFACE>
              <SHORT-NAME>ETS_EchoUINT8</SHORT-NAME>
              <IS-SERVICE>true</IS-SERVICE>
              <OPERATIONS>
                <CLIENT-SERVER-OPERATION>
                  <SHORT-NAME>EchoUINT8</SHORT-NAME>
                  <ARGUMENTS>
                    <ARGUMENT-DATA-PROTOTYPE>
                      <SHORT-NAME>Uint8Value</SHORT-NAME>
                      <CATEGORY>VALUE</CATEGORY>
                      <TYPE-TREF DEST="IMPLEMENTATION-DATA-TYPE">/AUTOSAR_Platform/ImplementationDataTypes/uint8</TYPE-TREF>
                      <DIRECTION>IN</DIRECTION>
                    </ARGUMENT-DATA-PROTOTYPE>
                    <ARGUMENT-DATA-PROTOTYPE>
                      <SHORT-NAME>Uint8ReturnValue</SHORT-NAME>
                      <CATEGORY>VALUE</CATEGORY>
                      <TYPE-TREF DEST="IMPLEMENTATION-DATA-TYPE">/AUTOSAR_Platform/ImplementationDataTypes/uint8</TYPE-TREF>
                      <DIRECTION>OUT</DIRECTION>
                    </ARGUMENT-DATA-PROTOTYPE>
                  </ARGUMENTS>
                </CLIENT-SERVER-OPERATION>
              </OPERATIONS>
            </CLIENT-SERVER-INTERFACE>
[!ENDIF!]
[!IF "EnhancedTestabilityService/TestingClientInteraction/clientServiceActivate = 'true'"!]
            <!-- !LINKSTO EB.ETS.interface.35, 1 -->
            <SENDER-RECEIVER-INTERFACE>
              <SHORT-NAME>ETS_ModeRequest_SD_ClientService</SHORT-NAME>
              <IS-SERVICE>true</IS-SERVICE>
              <DATA-ELEMENTS>
                <VARIABLE-DATA-PROTOTYPE>
                  <SHORT-NAME>requestedMode</SHORT-NAME>
                  <SW-DATA-DEF-PROPS>
                    <SW-DATA-DEF-PROPS-VARIANTS>
                      <SW-DATA-DEF-PROPS-CONDITIONAL></SW-DATA-DEF-PROPS-CONDITIONAL>
                    </SW-DATA-DEF-PROPS-VARIANTS>
                  </SW-DATA-DEF-PROPS>
                  <TYPE-TREF DEST="IMPLEMENTATION-DATA-TYPE">/ETS/ImplementationDataTypes/ETS_SD_ClientServiceModeType</TYPE-TREF>
                  <INIT-VALUE>
                    <NUMERICAL-VALUE-SPECIFICATION>
                      <VALUE>0</VALUE>
                    </NUMERICAL-VALUE-SPECIFICATION>
                  </INIT-VALUE>
                </VARIABLE-DATA-PROTOTYPE>
              </DATA-ELEMENTS>
            </SENDER-RECEIVER-INTERFACE>
[!ENDIF!]
[!IF "EnhancedTestabilityService/TestingClientInteraction/clientServiceSubscribeEventgroup = 'true'"!]
            <!-- !LINKSTO EB.ETS.interface.36, 1 -->
            <SENDER-RECEIVER-INTERFACE>
              <SHORT-NAME>ETS_ModeRequest_SD_ConsumeEventGroup</SHORT-NAME>
              <IS-SERVICE>true</IS-SERVICE>
              <DATA-ELEMENTS>
                <VARIABLE-DATA-PROTOTYPE>
                  <SHORT-NAME>requestedMode</SHORT-NAME>
                  <SW-DATA-DEF-PROPS>
                    <SW-DATA-DEF-PROPS-VARIANTS>
                      <SW-DATA-DEF-PROPS-CONDITIONAL></SW-DATA-DEF-PROPS-CONDITIONAL>
                    </SW-DATA-DEF-PROPS-VARIANTS>
                  </SW-DATA-DEF-PROPS>
                  <TYPE-TREF DEST="IMPLEMENTATION-DATA-TYPE">/ETS/ImplementationDataTypes/ETS_SD_ConsumeEventGroupModeType</TYPE-TREF>
                </VARIABLE-DATA-PROTOTYPE>
              </DATA-ELEMENTS>
            </SENDER-RECEIVER-INTERFACE>
[!ENDIF!]
[!IF "EnhancedTestabilityService/TestingClientInteraction/clientServiceSubscribeEventgroup = 'true'"!]
            <!-- !LINKSTO EB.ETS.interface.37, 1 -->
            <SENDER-RECEIVER-INTERFACE>
              <SHORT-NAME>ETS_ModeRequest_SD_ServerService</SHORT-NAME>
              <IS-SERVICE>true</IS-SERVICE>
              <DATA-ELEMENTS>
                <VARIABLE-DATA-PROTOTYPE>
                  <SHORT-NAME>requestedMode</SHORT-NAME>
                  <SW-DATA-DEF-PROPS>
                    <SW-DATA-DEF-PROPS-VARIANTS>
                      <SW-DATA-DEF-PROPS-CONDITIONAL></SW-DATA-DEF-PROPS-CONDITIONAL>
                    </SW-DATA-DEF-PROPS-VARIANTS>
                  </SW-DATA-DEF-PROPS>
                  <TYPE-TREF DEST="IMPLEMENTATION-DATA-TYPE">/ETS/ImplementationDataTypes/ETS_SD_ServerServiceModeType</TYPE-TREF>
                </VARIABLE-DATA-PROTOTYPE>
              </DATA-ELEMENTS>
            </SENDER-RECEIVER-INTERFACE>
[!ENDIF!]
[!IF "EnhancedTestabilityService/TestingClientInteraction/resetInterface = 'true'"!]
            <!-- !LINKSTO EB.ETS.interface.14, 1 -->
            <TRIGGER-INTERFACE>
              <SHORT-NAME>ETS_ResetInterface</SHORT-NAME>
              <IS-SERVICE>true</IS-SERVICE>
              <TRIGGERS>
                <TRIGGER>
                  <SHORT-NAME>Reset</SHORT-NAME>
                  <SW-IMPL-POLICY>QUEUED</SW-IMPL-POLICY>
                </TRIGGER>
              </TRIGGERS>
            </TRIGGER-INTERFACE>
[!ENDIF!]
[!IF "EnhancedTestabilityService/TestingClientInteraction/suspendInterface = 'true'"!]
            <!-- !LINKSTO EB.ETS.interface.15, 1 -->
            <SENDER-RECEIVER-INTERFACE>
              <SHORT-NAME>ETS_SuspendInterface</SHORT-NAME>
              <IS-SERVICE>true</IS-SERVICE>
              <DATA-ELEMENTS>
                <VARIABLE-DATA-PROTOTYPE>
                  <SHORT-NAME>suspendInterface</SHORT-NAME>
                  <CATEGORY>STRUCTURE</CATEGORY>
                  <SW-DATA-DEF-PROPS>
                    <SW-DATA-DEF-PROPS-VARIANTS>
                      <SW-DATA-DEF-PROPS-CONDITIONAL>
                        <SW-IMPL-POLICY>QUEUED</SW-IMPL-POLICY>
                      </SW-DATA-DEF-PROPS-CONDITIONAL>
                    </SW-DATA-DEF-PROPS-VARIANTS>
                  </SW-DATA-DEF-PROPS>
                  <TYPE-TREF DEST="APPLICATION-RECORD-DATA-TYPE">/ETS/ApplicationDataTypes/ETS_TimePeriod</TYPE-TREF>
                </VARIABLE-DATA-PROTOTYPE>
              </DATA-ELEMENTS>
            </SENDER-RECEIVER-INTERFACE>
[!ENDIF!]
            <MODE-SWITCH-INTERFACE>
              <SHORT-NAME>ETS_SwitchPort_CurrentMode</SHORT-NAME>
              <IS-SERVICE>true</IS-SERVICE>
              <MODE-GROUP>
                <SHORT-NAME>CurrentMode</SHORT-NAME>
                <TYPE-TREF DEST="MODE-DECLARATION-GROUP">/ETS/ModeDeclarationGroups/ETS_CurrentMode</TYPE-TREF>
              </MODE-GROUP>
            </MODE-SWITCH-INTERFACE>
[!IF "EnhancedTestabilityService/TestingEvents/triggerEventUINT8 = 'true'"!]
            <!-- !LINKSTO EB.ETS.interface.29, 1 -->
            <SENDER-RECEIVER-INTERFACE>
              <SHORT-NAME>ETS_TriggerEventUINT8</SHORT-NAME>
              <IS-SERVICE>true</IS-SERVICE>
              <DATA-ELEMENTS>
                <VARIABLE-DATA-PROTOTYPE>
                  <SHORT-NAME>triggerEventUINT8</SHORT-NAME>
                  <SW-DATA-DEF-PROPS>
                    <SW-DATA-DEF-PROPS-VARIANTS>
                      <SW-DATA-DEF-PROPS-CONDITIONAL>
                        <SW-IMPL-POLICY>QUEUED</SW-IMPL-POLICY>
                      </SW-DATA-DEF-PROPS-CONDITIONAL>
                    </SW-DATA-DEF-PROPS-VARIANTS>
                  </SW-DATA-DEF-PROPS>
                  <TYPE-TREF DEST="IMPLEMENTATION-DATA-TYPE">/ETS/ImplementationDataTypes/ETS_TriggerEventType</TYPE-TREF>
                </VARIABLE-DATA-PROTOTYPE>
              </DATA-ELEMENTS>
            </SENDER-RECEIVER-INTERFACE>
[!ENDIF!]
[!IF "EnhancedTestabilityService/TestingEvents/triggerEventUINT8Array = 'true'"!]
            <!-- !LINKSTO EB.ETS.interface.28, 1 -->
            <SENDER-RECEIVER-INTERFACE>
              <SHORT-NAME>ETS_TriggerEventUINT8Array</SHORT-NAME>
              <IS-SERVICE>true</IS-SERVICE>
              <DATA-ELEMENTS>
                <VARIABLE-DATA-PROTOTYPE>
                  <SHORT-NAME>triggerEventUINT8Array</SHORT-NAME>
                  <SW-DATA-DEF-PROPS>
                    <SW-DATA-DEF-PROPS-VARIANTS>
                      <SW-DATA-DEF-PROPS-CONDITIONAL>
                        <SW-IMPL-POLICY>QUEUED</SW-IMPL-POLICY>
                      </SW-DATA-DEF-PROPS-CONDITIONAL>
                    </SW-DATA-DEF-PROPS-VARIANTS>
                  </SW-DATA-DEF-PROPS>
                  <!-- !LINKSTO swdd.ETS-0035.2, 1 -->
                  <TYPE-TREF DEST="IMPLEMENTATION-DATA-TYPE">/ETS/ImplementationDataTypes/ETS_TriggerEventType</TYPE-TREF>
                </VARIABLE-DATA-PROTOTYPE>
              </DATA-ELEMENTS>
            </SENDER-RECEIVER-INTERFACE>
[!ENDIF!]
[!IF "EnhancedTestabilityService/TestingEvents/triggerEventUINT8E2E = 'true'"!]
            <!-- !LINKSTO EB.ETS.interface.27, 1 -->
            <SENDER-RECEIVER-INTERFACE>
              <SHORT-NAME>ETS_TriggerEventUINT8E2E</SHORT-NAME>
              <IS-SERVICE>true</IS-SERVICE>
              <DATA-ELEMENTS>
                <VARIABLE-DATA-PROTOTYPE>
                  <SHORT-NAME>triggerEventUINT8E2E</SHORT-NAME>
                  <SW-DATA-DEF-PROPS>
                    <SW-DATA-DEF-PROPS-VARIANTS>
                      <SW-DATA-DEF-PROPS-CONDITIONAL>
                        <SW-IMPL-POLICY>QUEUED</SW-IMPL-POLICY>
                      </SW-DATA-DEF-PROPS-CONDITIONAL>
                    </SW-DATA-DEF-PROPS-VARIANTS>
                  </SW-DATA-DEF-PROPS>
                  <TYPE-TREF DEST="IMPLEMENTATION-DATA-TYPE">/ETS/ImplementationDataTypes/ETS_TriggerEventType</TYPE-TREF>
                </VARIABLE-DATA-PROTOTYPE>
              </DATA-ELEMENTS>
            </SENDER-RECEIVER-INTERFACE>
[!ENDIF!]
[!IF "EnhancedTestabilityService/TestingEvents/triggerEventUINT8Multicast = 'true'"!]
            <!-- !LINKSTO EB.ETS.interface.25, 1 -->
            <SENDER-RECEIVER-INTERFACE>
              <SHORT-NAME>ETS_TriggerEventUINT8Multicast</SHORT-NAME>
              <IS-SERVICE>true</IS-SERVICE>
              <DATA-ELEMENTS>
                <VARIABLE-DATA-PROTOTYPE>
                  <SHORT-NAME>triggerEventUINT8Multicast</SHORT-NAME>
                  <SW-DATA-DEF-PROPS>
                    <SW-DATA-DEF-PROPS-VARIANTS>
                      <SW-DATA-DEF-PROPS-CONDITIONAL>
                        <SW-IMPL-POLICY>QUEUED</SW-IMPL-POLICY>
                      </SW-DATA-DEF-PROPS-CONDITIONAL>
                    </SW-DATA-DEF-PROPS-VARIANTS>
                  </SW-DATA-DEF-PROPS>
                  <TYPE-TREF DEST="IMPLEMENTATION-DATA-TYPE">/ETS/ImplementationDataTypes/ETS_TriggerEventType</TYPE-TREF>
                </VARIABLE-DATA-PROTOTYPE>
              </DATA-ELEMENTS>
            </SENDER-RECEIVER-INTERFACE>
[!ENDIF!]
[!IF "EnhancedTestabilityService/TestingEvents/triggerEventUINT8Reliable = 'true'"!]
            <!-- !LINKSTO EB.ETS.interface.26, 1 -->
            <SENDER-RECEIVER-INTERFACE>
              <SHORT-NAME>ETS_TriggerEventUINT8Reliable</SHORT-NAME>
              <IS-SERVICE>true</IS-SERVICE>
              <DATA-ELEMENTS>
                <VARIABLE-DATA-PROTOTYPE>
                  <SHORT-NAME>triggerEventUINT8Reliable</SHORT-NAME>
                  <SW-DATA-DEF-PROPS>
                    <SW-DATA-DEF-PROPS-VARIANTS>
                      <SW-DATA-DEF-PROPS-CONDITIONAL>
                        <SW-IMPL-POLICY>QUEUED</SW-IMPL-POLICY>
                      </SW-DATA-DEF-PROPS-CONDITIONAL>
                    </SW-DATA-DEF-PROPS-VARIANTS>
                  </SW-DATA-DEF-PROPS>
                  <TYPE-TREF DEST="IMPLEMENTATION-DATA-TYPE">/ETS/ImplementationDataTypes/ETS_TriggerEventType</TYPE-TREF>
                </VARIABLE-DATA-PROTOTYPE>
              </DATA-ELEMENTS>
            </SENDER-RECEIVER-INTERFACE>
[!ENDIF!]
[!IF "EnhancedTestabilityService/EchoingDataTypes/echoUINT8Array = 'true'"!]
            <IMPLEMENTATION-DATA-TYPE>
              <SHORT-NAME>echoUINT8Array</SHORT-NAME>
              <CATEGORY>ARRAY</CATEGORY>
              <SW-DATA-DEF-PROPS>
                <SW-DATA-DEF-PROPS-VARIANTS>
                  <SW-DATA-DEF-PROPS-CONDITIONAL></SW-DATA-DEF-PROPS-CONDITIONAL>
                </SW-DATA-DEF-PROPS-VARIANTS>
              </SW-DATA-DEF-PROPS>
              <SUB-ELEMENTS>
                <IMPLEMENTATION-DATA-TYPE-ELEMENT>
                  <SHORT-NAME>SE_echoUINT8Array</SHORT-NAME>
                  <CATEGORY>VALUE</CATEGORY>
                  <ADMIN-DATA><SDGS><SDG GID="_conversion"><SDG GID="ARRAY-SIZE-HANDLING"><SD GID="_mixed">ALL-INDICES-SAME-ARRAY-SIZE</SD></SDG><SD GID="_path">ARRAY-SIZE-HANDLING@4/</SD><SD GID="_target">org.artop.aal.autosar421</SD></SDG></SDGS></ADMIN-DATA><ARRAY-SIZE T="2018-12-08T13:19:55+01:00">5</ARRAY-SIZE>
                  
                  <ARRAY-SIZE-SEMANTICS>VARIABLE-SIZE</ARRAY-SIZE-SEMANTICS>
                  <SW-DATA-DEF-PROPS>
                    <SW-DATA-DEF-PROPS-VARIANTS>
                      <SW-DATA-DEF-PROPS-CONDITIONAL>
                        <BASE-TYPE-REF DEST="SW-BASE-TYPE">/AUTOSAR_Platform/BaseTypes/uint8</BASE-TYPE-REF>
                      </SW-DATA-DEF-PROPS-CONDITIONAL>
                    </SW-DATA-DEF-PROPS-VARIANTS>
                  </SW-DATA-DEF-PROPS>
                </IMPLEMENTATION-DATA-TYPE-ELEMENT>
              </SUB-ELEMENTS>
            </IMPLEMENTATION-DATA-TYPE>
[!ENDIF!]
[!IF "EnhancedTestabilityService/EchoingDataTypes/echoUINT64 = 'true'"!]
            <!-- !LINKSTO EB.ETS.interface.49, 1 -->
            <CLIENT-SERVER-INTERFACE>
              <SHORT-NAME>ETS_EchoUINT64</SHORT-NAME>
              <IS-SERVICE>true</IS-SERVICE>
              <OPERATIONS>
                <CLIENT-SERVER-OPERATION>
                  <SHORT-NAME>EchoUINT64</SHORT-NAME>
                  <ARGUMENTS>
                    <ARGUMENT-DATA-PROTOTYPE>
                      <SHORT-NAME>Uint64Value</SHORT-NAME>
                      <CATEGORY>VALUE</CATEGORY>
                      <TYPE-TREF DEST="IMPLEMENTATION-DATA-TYPE">/AUTOSAR_Platform/ImplementationDataTypes/uint64</TYPE-TREF>
                      <DIRECTION>IN</DIRECTION>
                    </ARGUMENT-DATA-PROTOTYPE>
                    <ARGUMENT-DATA-PROTOTYPE>
                      <SHORT-NAME>Uint64ReturnValue</SHORT-NAME>
                      <CATEGORY>VALUE</CATEGORY>
                      <TYPE-TREF DEST="IMPLEMENTATION-DATA-TYPE">/AUTOSAR_Platform/ImplementationDataTypes/uint64</TYPE-TREF>
                      <DIRECTION>OUT</DIRECTION>
                    </ARGUMENT-DATA-PROTOTYPE>
                  </ARGUMENTS>
                </CLIENT-SERVER-OPERATION>
              </OPERATIONS>
            </CLIENT-SERVER-INTERFACE>
[!ENDIF!]
[!IF "EnhancedTestabilityService/EchoingDataTypes/echoInt64 = 'true'"!]
            <!-- !LINKSTO EB.ETS.interface.45, 1 -->
            <CLIENT-SERVER-INTERFACE>
              <SHORT-NAME>ETS_EchoINT64</SHORT-NAME>
              <IS-SERVICE>true</IS-SERVICE>
              <OPERATIONS>
                <CLIENT-SERVER-OPERATION>
                  <SHORT-NAME>EchoINT64</SHORT-NAME>
                  <ARGUMENTS>
                    <ARGUMENT-DATA-PROTOTYPE>
                      <SHORT-NAME>int64Value</SHORT-NAME>
                      <CATEGORY>VALUE</CATEGORY>
                      <TYPE-TREF DEST="IMPLEMENTATION-DATA-TYPE">/AUTOSAR_Platform/ImplementationDataTypes/sint64</TYPE-TREF>
                      <DIRECTION>IN</DIRECTION>
                    </ARGUMENT-DATA-PROTOTYPE>
                    <ARGUMENT-DATA-PROTOTYPE>
                      <SHORT-NAME>int64ReturnValue</SHORT-NAME>
                      <CATEGORY>VALUE</CATEGORY>
                      <TYPE-TREF DEST="IMPLEMENTATION-DATA-TYPE">/AUTOSAR_Platform/ImplementationDataTypes/sint64</TYPE-TREF>
                      <DIRECTION>OUT</DIRECTION>
                    </ARGUMENT-DATA-PROTOTYPE>
                  </ARGUMENTS>
                </CLIENT-SERVER-OPERATION>
              </OPERATIONS>
            </CLIENT-SERVER-INTERFACE>
[!ENDIF!]
[!IF "EnhancedTestabilityService/EchoingDataTypes/echoINT8 = 'true'"!]
            <!-- !LINKSTO EB.ETS.interface.44, 1 -->
            <CLIENT-SERVER-INTERFACE>
              <SHORT-NAME>ETS_EchoINT8</SHORT-NAME>
              <IS-SERVICE>true</IS-SERVICE>
              <OPERATIONS>
                <CLIENT-SERVER-OPERATION>
                  <SHORT-NAME>EchoINT8</SHORT-NAME>
                  <ARGUMENTS>
                    <ARGUMENT-DATA-PROTOTYPE>
                      <SHORT-NAME>Int8Value</SHORT-NAME>
                      <CATEGORY>VALUE</CATEGORY>
                      <TYPE-TREF DEST="IMPLEMENTATION-DATA-TYPE">/AUTOSAR_Platform/ImplementationDataTypes/sint8</TYPE-TREF>
                      <DIRECTION>IN</DIRECTION>
                    </ARGUMENT-DATA-PROTOTYPE>
                    <ARGUMENT-DATA-PROTOTYPE>
                      <SHORT-NAME>Int8ReturnValue</SHORT-NAME>
                      <CATEGORY>VALUE</CATEGORY>
                      <TYPE-TREF DEST="IMPLEMENTATION-DATA-TYPE">/AUTOSAR_Platform/ImplementationDataTypes/sint8</TYPE-TREF>
                      <DIRECTION>OUT</DIRECTION>
                    </ARGUMENT-DATA-PROTOTYPE>
                  </ARGUMENTS>
                </CLIENT-SERVER-OPERATION>
              </OPERATIONS>
            </CLIENT-SERVER-INTERFACE>
[!ENDIF!]
[!IF "EnhancedTestabilityService/EchoingDataTypes/echoFLOAT64 = 'true'"!]
            <!-- !LINKSTO EB.ETS.interface.43, 1 -->
            <CLIENT-SERVER-INTERFACE>
              <SHORT-NAME>ETS_EchoFLOAT64</SHORT-NAME>
              <IS-SERVICE>true</IS-SERVICE>
              <OPERATIONS>
                <CLIENT-SERVER-OPERATION>
                  <SHORT-NAME>EchoFLOAT64</SHORT-NAME>
                  <ARGUMENTS>
                    <ARGUMENT-DATA-PROTOTYPE>
                      <SHORT-NAME>float64Value</SHORT-NAME>
                      <CATEGORY>VALUE</CATEGORY>
                      <TYPE-TREF DEST="IMPLEMENTATION-DATA-TYPE">/AUTOSAR_Platform/ImplementationDataTypes/float64</TYPE-TREF>
                      <DIRECTION>IN</DIRECTION>
                    </ARGUMENT-DATA-PROTOTYPE>
                    <ARGUMENT-DATA-PROTOTYPE>
                      <SHORT-NAME>float64ReturnValue</SHORT-NAME>
                      <CATEGORY>VALUE</CATEGORY>
                      <TYPE-TREF DEST="IMPLEMENTATION-DATA-TYPE">/AUTOSAR_Platform/ImplementationDataTypes/float64</TYPE-TREF>
                      <DIRECTION>OUT</DIRECTION>
                    </ARGUMENT-DATA-PROTOTYPE>
                  </ARGUMENTS>
                </CLIENT-SERVER-OPERATION>
              </OPERATIONS>
            </CLIENT-SERVER-INTERFACE>
[!ENDIF!]
[!IF "EnhancedTestabilityService/EchoingDataTypes/echoENUM = 'true'"!]
            <!-- !LINKSTO EB.ETS.interface.42, 1 -->
            <CLIENT-SERVER-INTERFACE>
              <SHORT-NAME>ETS_EchoENUM</SHORT-NAME>
              <IS-SERVICE>true</IS-SERVICE>
              <OPERATIONS>
                <CLIENT-SERVER-OPERATION>
                  <SHORT-NAME>EchoENUM</SHORT-NAME>
                  <ARGUMENTS>
                    <ARGUMENT-DATA-PROTOTYPE>
                      <SHORT-NAME>ENUMValue</SHORT-NAME>
                      <CATEGORY>VALUE</CATEGORY>
                      <TYPE-TREF DEST="APPLICATION-PRIMITIVE-DATA-TYPE">/ETS/ApplicationDataTypes/ETS_ENUM</TYPE-TREF>
                      <DIRECTION>IN</DIRECTION>
                    </ARGUMENT-DATA-PROTOTYPE>
                    <ARGUMENT-DATA-PROTOTYPE>
                      <SHORT-NAME>ENUMReturnValue</SHORT-NAME>
                      <CATEGORY>VALUE</CATEGORY>
                      <TYPE-TREF DEST="APPLICATION-PRIMITIVE-DATA-TYPE">/ETS/ApplicationDataTypes/ETS_ENUM</TYPE-TREF>
                      <DIRECTION>OUT</DIRECTION>
                    </ARGUMENT-DATA-PROTOTYPE>
                  </ARGUMENTS>
                </CLIENT-SERVER-OPERATION>
              </OPERATIONS>
            </CLIENT-SERVER-INTERFACE>
[!ENDIF!]
[!IF "EnhancedTestabilityService/EchoingDataTypes/echoUINT8Array = 'true'"!]
            <!-- !LINKSTO EB.ETS.interface.51, 1 -->
            <CLIENT-SERVER-INTERFACE>
              <SHORT-NAME>ETS_EchoUINT8Array</SHORT-NAME>
              <IS-SERVICE>true</IS-SERVICE>
              <OPERATIONS>
                <CLIENT-SERVER-OPERATION>
                  <SHORT-NAME>EchoUINT8Array</SHORT-NAME>
                  <ARGUMENTS>
                    <ARGUMENT-DATA-PROTOTYPE>
                      <SHORT-NAME>uint8Array</SHORT-NAME>
                      <CATEGORY>ARRAY</CATEGORY>
                      <TYPE-TREF DEST="APPLICATION-ARRAY-DATA-TYPE">/ETS/ApplicationDataTypes/ETS_Uint8Array</TYPE-TREF>
                      <DIRECTION>INOUT</DIRECTION>
                    </ARGUMENT-DATA-PROTOTYPE>
                  </ARGUMENTS>
                </CLIENT-SERVER-OPERATION>
              </OPERATIONS>
            </CLIENT-SERVER-INTERFACE>
[!ENDIF!]
[!IF "EnhancedTestabilityService/EchoingDataTypes/echoStaticUINT8Array = 'true'"!]
            <!-- !LINKSTO EB.ETS.interface.47, 1 -->
            <CLIENT-SERVER-INTERFACE>
              <SHORT-NAME>ETS_EchoStaticUINT8Array</SHORT-NAME>
              <IS-SERVICE>true</IS-SERVICE>
              <OPERATIONS>
                <CLIENT-SERVER-OPERATION>
                  <SHORT-NAME>EchoStaticUINT8Array</SHORT-NAME>
                  <ARGUMENTS>
                    <ARGUMENT-DATA-PROTOTYPE>
                      <SHORT-NAME>ES_uINT8Array</SHORT-NAME>
                      <CATEGORY>ARRAY</CATEGORY>
                      <TYPE-TREF DEST="APPLICATION-ARRAY-DATA-TYPE">/ETS/ApplicationDataTypes/ETS_StaticUint8Array</TYPE-TREF>
                      <DIRECTION>IN</DIRECTION>
                    </ARGUMENT-DATA-PROTOTYPE>
                    <ARGUMENT-DATA-PROTOTYPE>
                      <SHORT-NAME>ES_uINT8ArrayReturnValue</SHORT-NAME>
                      <CATEGORY>ARRAY</CATEGORY>
                      <TYPE-TREF DEST="APPLICATION-ARRAY-DATA-TYPE">/ETS/ApplicationDataTypes/ETS_StaticUint8Array</TYPE-TREF>
                      <DIRECTION>OUT</DIRECTION>
                    </ARGUMENT-DATA-PROTOTYPE>
                  </ARGUMENTS>
                </CLIENT-SERVER-OPERATION>
              </OPERATIONS>
            </CLIENT-SERVER-INTERFACE>
[!ENDIF!]
[!IF "EnhancedTestabilityService/EchoingDataTypes/echoBitfields = 'true'"!]
            <!-- !LINKSTO EB.ETS.interface.40, 1 -->
            <CLIENT-SERVER-INTERFACE>
              <SHORT-NAME>ETS_EchoBitfields</SHORT-NAME>
              <IS-SERVICE>true</IS-SERVICE>
              <OPERATIONS>
                <CLIENT-SERVER-OPERATION>
                  <SHORT-NAME>EchoBitfields</SHORT-NAME>
                  <ARGUMENTS>
                    <ARGUMENT-DATA-PROTOTYPE>
                      <SHORT-NAME>bitfield8_in</SHORT-NAME>
                      <CATEGORY>VALUE</CATEGORY>
                      <TYPE-TREF DEST="APPLICATION-PRIMITIVE-DATA-TYPE">/ETS/ApplicationDataTypes/ETS_Bitfield_uint8</TYPE-TREF>
                      <DIRECTION>IN</DIRECTION>
                    </ARGUMENT-DATA-PROTOTYPE>
                    <ARGUMENT-DATA-PROTOTYPE>
                      <SHORT-NAME>bitfield16_in</SHORT-NAME>
                      <CATEGORY>VALUE</CATEGORY>
                      <TYPE-TREF DEST="APPLICATION-PRIMITIVE-DATA-TYPE">/ETS/ApplicationDataTypes/ETS_Bitfield_uint16</TYPE-TREF>
                      <DIRECTION>IN</DIRECTION>
                    </ARGUMENT-DATA-PROTOTYPE>
                    <ARGUMENT-DATA-PROTOTYPE>
                      <SHORT-NAME>bitfield32_in</SHORT-NAME>
                      <CATEGORY>VALUE</CATEGORY>
                      <TYPE-TREF DEST="APPLICATION-PRIMITIVE-DATA-TYPE">/ETS/ApplicationDataTypes/ETS_Bitfield_uint32</TYPE-TREF>
                      <DIRECTION>IN</DIRECTION>
                    </ARGUMENT-DATA-PROTOTYPE>
                    <ARGUMENT-DATA-PROTOTYPE>
                      <SHORT-NAME>bitfield8_out</SHORT-NAME>
                      <CATEGORY>VALUE</CATEGORY>
                      <TYPE-TREF DEST="APPLICATION-PRIMITIVE-DATA-TYPE">/ETS/ApplicationDataTypes/ETS_Bitfield_uint8_return</TYPE-TREF>
                      <DIRECTION>OUT</DIRECTION>
                    </ARGUMENT-DATA-PROTOTYPE>
                    <ARGUMENT-DATA-PROTOTYPE>
                      <SHORT-NAME>bitfield16_out</SHORT-NAME>
                      <CATEGORY>VALUE</CATEGORY>
                      <TYPE-TREF DEST="APPLICATION-PRIMITIVE-DATA-TYPE">/ETS/ApplicationDataTypes/ETS_Bitfield_uint16_return</TYPE-TREF>
                      <DIRECTION>OUT</DIRECTION>
                    </ARGUMENT-DATA-PROTOTYPE>
                    <ARGUMENT-DATA-PROTOTYPE>
                      <SHORT-NAME>bitfield32_out</SHORT-NAME>
                      <CATEGORY>VALUE</CATEGORY>
                      <TYPE-TREF DEST="APPLICATION-PRIMITIVE-DATA-TYPE">/ETS/ApplicationDataTypes/ETS_Bitfield_uint32_return</TYPE-TREF>
                      <DIRECTION>OUT</DIRECTION>
                    </ARGUMENT-DATA-PROTOTYPE>
                  </ARGUMENTS>
                </CLIENT-SERVER-OPERATION>
              </OPERATIONS>
            </CLIENT-SERVER-INTERFACE>
[!ENDIF!]
[!IF "EnhancedTestabilityService/EchoingDataTypes/echoTYPEDEF = 'true'"!]
            <!-- !LINKSTO EB.ETS.interface.48, 1 -->
            <CLIENT-SERVER-INTERFACE>
              <SHORT-NAME>ETS_EchoTYPEDEF</SHORT-NAME>
              <IS-SERVICE>true</IS-SERVICE>
              <OPERATIONS>
                <CLIENT-SERVER-OPERATION>
                  <SHORT-NAME>EchoTYPEDEF</SHORT-NAME>
                  <ARGUMENTS>
                    <ARGUMENT-DATA-PROTOTYPE>
                      <SHORT-NAME>typeDefElement</SHORT-NAME>
                      <CATEGORY>VALUE</CATEGORY>
                      <TYPE-TREF DEST="IMPLEMENTATION-DATA-TYPE">/AUTOSAR_Platform/ImplementationDataTypes/uint8</TYPE-TREF>
                      <DIRECTION>IN</DIRECTION>
                    </ARGUMENT-DATA-PROTOTYPE>
                    <ARGUMENT-DATA-PROTOTYPE>
                      <SHORT-NAME>typeDefreturnElement</SHORT-NAME>
                      <CATEGORY>VALUE</CATEGORY>
                      <TYPE-TREF DEST="IMPLEMENTATION-DATA-TYPE">/AUTOSAR_Platform/ImplementationDataTypes/uint8</TYPE-TREF>
                      <DIRECTION>OUT</DIRECTION>
                    </ARGUMENT-DATA-PROTOTYPE>
                  </ARGUMENTS>
                </CLIENT-SERVER-OPERATION>
              </OPERATIONS>
            </CLIENT-SERVER-INTERFACE>
[!ENDIF!]
[!IF "EnhancedTestabilityService/EchoingDataTypes/echoUINT8Array16BitLength = 'true'"!]
            <!-- !LINKSTO EB.ETS.interface.52, 1 -->
            <CLIENT-SERVER-INTERFACE>
              <SHORT-NAME>ETS_EchoUINT8Array16Bitlength</SHORT-NAME>
              <IS-SERVICE>true</IS-SERVICE>
              <OPERATIONS>
                <CLIENT-SERVER-OPERATION>
                  <SHORT-NAME>EchoUINT8Array16Bitlength</SHORT-NAME>
                  <ARGUMENTS>
                    <ARGUMENT-DATA-PROTOTYPE>
                      <SHORT-NAME>uINT8Array</SHORT-NAME>
                      <CATEGORY>ARRAY</CATEGORY>
                      <TYPE-TREF DEST="APPLICATION-ARRAY-DATA-TYPE">/ETS/ApplicationDataTypes/ETS_UINT8Array16Bitlength</TYPE-TREF>
                      <DIRECTION>INOUT</DIRECTION>
                    </ARGUMENT-DATA-PROTOTYPE>
                  </ARGUMENTS>
                </CLIENT-SERVER-OPERATION>
              </OPERATIONS>
            </CLIENT-SERVER-INTERFACE>
[!ENDIF!]
[!IF "EnhancedTestabilityService/EchoingDataTypes/echoUINT8E2E = 'true'"!]
            <!-- !LINKSTO EB.ETS.interface.57, 1 -->
            <CLIENT-SERVER-INTERFACE>
              <SHORT-NAME>ETS_EchoUINT8E2E</SHORT-NAME>
              <IS-SERVICE>true</IS-SERVICE>
              <OPERATIONS>
                <CLIENT-SERVER-OPERATION>
                  <SHORT-NAME>EchoUINT8E2E</SHORT-NAME>
                  <ARGUMENTS>
                    <ARGUMENT-DATA-PROTOTYPE>
                      <SHORT-NAME>cRCId</SHORT-NAME>
                      <CATEGORY>VALUE</CATEGORY>
                      <TYPE-TREF DEST="IMPLEMENTATION-DATA-TYPE">/AUTOSAR_Platform/ImplementationDataTypes/uint32</TYPE-TREF>
                      <DIRECTION>INOUT</DIRECTION>
                    </ARGUMENT-DATA-PROTOTYPE>
                    <ARGUMENT-DATA-PROTOTYPE>
                      <SHORT-NAME>alive</SHORT-NAME>
                      <CATEGORY>VALUE</CATEGORY>
                      <TYPE-TREF DEST="IMPLEMENTATION-DATA-TYPE">/AUTOSAR_Platform/ImplementationDataTypes/uint16</TYPE-TREF>
                      <DIRECTION>INOUT</DIRECTION>
                    </ARGUMENT-DATA-PROTOTYPE>
                    <ARGUMENT-DATA-PROTOTYPE>
                      <SHORT-NAME>cRC</SHORT-NAME>
                      <CATEGORY>VALUE</CATEGORY>
                      <TYPE-TREF DEST="IMPLEMENTATION-DATA-TYPE">/AUTOSAR_Platform/ImplementationDataTypes/uint32</TYPE-TREF>
                      <DIRECTION>INOUT</DIRECTION>
                    </ARGUMENT-DATA-PROTOTYPE>
                    <ARGUMENT-DATA-PROTOTYPE>
                      <SHORT-NAME>uINT8Value</SHORT-NAME>
                      <CATEGORY>VALUE</CATEGORY>
                      <TYPE-TREF DEST="IMPLEMENTATION-DATA-TYPE">/AUTOSAR_Platform/ImplementationDataTypes/uint8</TYPE-TREF>
                      <DIRECTION>INOUT</DIRECTION>
                    </ARGUMENT-DATA-PROTOTYPE>
                  </ARGUMENTS>
                </CLIENT-SERVER-OPERATION>
              </OPERATIONS>
            </CLIENT-SERVER-INTERFACE>
[!ENDIF!]
[!IF "EnhancedTestabilityService/EchoingDataTypes/echoUINT8RELIABLE = 'true'"!]
            <!-- !LINKSTO EB.ETS.interface.59, 1 -->
            <CLIENT-SERVER-INTERFACE>
              <SHORT-NAME>ETS_EchoUINT8RELIABLE</SHORT-NAME>
              <IS-SERVICE>true</IS-SERVICE>
              <OPERATIONS>
                <CLIENT-SERVER-OPERATION>
                  <SHORT-NAME>EchoUINT8RELIABLE</SHORT-NAME>
                  <ARGUMENTS>
                    <ARGUMENT-DATA-PROTOTYPE>
                      <SHORT-NAME>Uint8Value</SHORT-NAME>
                      <CATEGORY>VALUE</CATEGORY>
                      <TYPE-TREF DEST="IMPLEMENTATION-DATA-TYPE">/AUTOSAR_Platform/ImplementationDataTypes/uint8</TYPE-TREF>
                      <DIRECTION>IN</DIRECTION>
                    </ARGUMENT-DATA-PROTOTYPE>
                    <ARGUMENT-DATA-PROTOTYPE>
                      <SHORT-NAME>Uint8ReturnValue</SHORT-NAME>
                      <CATEGORY>VALUE</CATEGORY>
                      <TYPE-TREF DEST="IMPLEMENTATION-DATA-TYPE">/AUTOSAR_Platform/ImplementationDataTypes/uint8</TYPE-TREF>
                      <DIRECTION>OUT</DIRECTION>
                    </ARGUMENT-DATA-PROTOTYPE>
                  </ARGUMENTS>
                </CLIENT-SERVER-OPERATION>
              </OPERATIONS>
            </CLIENT-SERVER-INTERFACE>
[!ENDIF!]
[!IF "EnhancedTestabilityService/EchoingDataTypes/echoSTRUCTSimple = 'true'"!]
            <!-- !LINKSTO EB.ETS.interface.46, 1 -->
            <CLIENT-SERVER-INTERFACE>
              <SHORT-NAME>ETS_EchoSTRUCTSimple</SHORT-NAME>
              <IS-SERVICE>true</IS-SERVICE>
              <OPERATIONS>
                <CLIENT-SERVER-OPERATION>
                  <SHORT-NAME>EchoSTRUCTSimple</SHORT-NAME>
                  <ARGUMENTS>
                    <ARGUMENT-DATA-PROTOTYPE>
                      <SHORT-NAME>structElement</SHORT-NAME>
                      <CATEGORY>ARRAY</CATEGORY>
                      <TYPE-TREF DEST="APPLICATION-ARRAY-DATA-TYPE">/ETS/ApplicationDataTypes/ETS_SimpleStructArray</TYPE-TREF>
                      <DIRECTION>IN</DIRECTION>
                    </ARGUMENT-DATA-PROTOTYPE>
                    <ARGUMENT-DATA-PROTOTYPE>
                      <SHORT-NAME>structReturnElement</SHORT-NAME>
                      <CATEGORY>ARRAY</CATEGORY>
                      <TYPE-TREF DEST="APPLICATION-ARRAY-DATA-TYPE">/ETS/ApplicationDataTypes/ETS_SimpleStructArray</TYPE-TREF>
                      <DIRECTION>OUT</DIRECTION>
                    </ARGUMENT-DATA-PROTOTYPE>
                  </ARGUMENTS>
                </CLIENT-SERVER-OPERATION>
              </OPERATIONS>
            </CLIENT-SERVER-INTERFACE>
[!ENDIF!]
[!IF "EnhancedTestabilityService/EchoingDataTypes/echoUINT8Array8BitLength = 'true'"!]
            <!-- !LINKSTO EB.ETS.interface.58, 1 -->
            <CLIENT-SERVER-INTERFACE>
              <SHORT-NAME>ETS_EchoUINT8Array8BitLength</SHORT-NAME>
              <IS-SERVICE>true</IS-SERVICE>
              <OPERATIONS>
                <CLIENT-SERVER-OPERATION>
                  <SHORT-NAME>EchoUINT8Array8BitLength</SHORT-NAME>
                  <ARGUMENTS>
                    <ARGUMENT-DATA-PROTOTYPE>
                      <SHORT-NAME>uINT8Array_BL</SHORT-NAME>
                      <CATEGORY>ARRAY</CATEGORY>
                      <TYPE-TREF DEST="APPLICATION-ARRAY-DATA-TYPE">/ETS/ApplicationDataTypes/ETS_UINT8Array8Bitlength</TYPE-TREF>
                      <DIRECTION>INOUT</DIRECTION>
                    </ARGUMENT-DATA-PROTOTYPE>
                  </ARGUMENTS>
                </CLIENT-SERVER-OPERATION>
              </OPERATIONS>
            </CLIENT-SERVER-INTERFACE>
[!ENDIF!]
[!IF "EnhancedTestabilityService/EchoingDataTypes/echoUINT8ArrayMinSize = 'true'"!]
            <!-- !LINKSTO EB.ETS.interface.39, 1 -->
            <CLIENT-SERVER-INTERFACE>
              <SHORT-NAME>ETS_EchoUINT8ArrayMinSize</SHORT-NAME>
              <IS-SERVICE>true</IS-SERVICE>
              <OPERATIONS>
                <CLIENT-SERVER-OPERATION>
                  <SHORT-NAME>EchoUINT8ArrayMinSize</SHORT-NAME>
                  <DESC>
                    <L-2 L="FOR-ALL">Shall return at least three elements</L-2>
                  </DESC>
                  <ARGUMENTS>
                    <ARGUMENT-DATA-PROTOTYPE>
                      <SHORT-NAME>uINT8Array_MS</SHORT-NAME>
                      <CATEGORY>ARRAY</CATEGORY>
                      <TYPE-TREF DEST="APPLICATION-ARRAY-DATA-TYPE">/ETS/ApplicationDataTypes/ETS_Uint8Array</TYPE-TREF>
                      <DIRECTION>IN</DIRECTION>
                    </ARGUMENT-DATA-PROTOTYPE>
                    <ARGUMENT-DATA-PROTOTYPE>
                      <SHORT-NAME>uINT8ArrayReturnValue_MS</SHORT-NAME>
                      <CATEGORY>ARRAY</CATEGORY>
                      <TYPE-TREF DEST="APPLICATION-ARRAY-DATA-TYPE">/ETS/ApplicationDataTypes/ETS_Uint8Array</TYPE-TREF>
                      <DIRECTION>OUT</DIRECTION>
                    </ARGUMENT-DATA-PROTOTYPE>
                  </ARGUMENTS>
                </CLIENT-SERVER-OPERATION>
              </OPERATIONS>
            </CLIENT-SERVER-INTERFACE>
[!ENDIF!]
[!IF "EnhancedTestabilityService/EchoingDataTypes/echoUINT8Array2Dim = 'true'"!]
            <!-- !LINKSTO EB.ETS.interface.56, 1 -->
            <CLIENT-SERVER-INTERFACE>
              <SHORT-NAME>ETS_EchoUINT8Array2Dim</SHORT-NAME>
              <IS-SERVICE>true</IS-SERVICE>
              <OPERATIONS>
                <CLIENT-SERVER-OPERATION>
                  <SHORT-NAME>EchoUINT8Array2Dim</SHORT-NAME>
                  <ARGUMENTS>
                    <ARGUMENT-DATA-PROTOTYPE>
                      <SHORT-NAME>uINT8Array_2D</SHORT-NAME>
                      <CATEGORY>ARRAY</CATEGORY>
                      <TYPE-TREF DEST="APPLICATION-ARRAY-DATA-TYPE">/ETS/ApplicationDataTypes/ETS_TwoDimUint8Array</TYPE-TREF>
                      <DIRECTION>IN</DIRECTION>
                    </ARGUMENT-DATA-PROTOTYPE>
                    <ARGUMENT-DATA-PROTOTYPE>
                      <SHORT-NAME>uINT8ArrayReturnValue_2D</SHORT-NAME>
                      <CATEGORY>ARRAY</CATEGORY>
                      <TYPE-TREF DEST="APPLICATION-ARRAY-DATA-TYPE">/ETS/ApplicationDataTypes/ETS_TwoDimUint8Array</TYPE-TREF>
                      <DIRECTION>OUT</DIRECTION>
                    </ARGUMENT-DATA-PROTOTYPE>
                  </ARGUMENTS>
                </CLIENT-SERVER-OPERATION>
              </OPERATIONS>
            </CLIENT-SERVER-INTERFACE>
[!ENDIF!]
[!IF "EnhancedTestabilityService/EchoingDataTypes/echoUNION = 'true'"!]
            <!-- !LINKSTO EB.ETS.interface.55, 1 -->
            <CLIENT-SERVER-INTERFACE>
              <SHORT-NAME>ETS_EchoUNION</SHORT-NAME>
              <IS-SERVICE>true</IS-SERVICE>
              <OPERATIONS>
                <CLIENT-SERVER-OPERATION>
                  <SHORT-NAME>EchoUNION</SHORT-NAME>
                  <ARGUMENTS>
                    <ARGUMENT-DATA-PROTOTYPE>
                      <SHORT-NAME>uINT8Union</SHORT-NAME>
                      <CATEGORY>UNION</CATEGORY>
                      <TYPE-TREF DEST="IMPLEMENTATION-DATA-TYPE">/ETS/ImplementationDataTypes/ETS_UNION</TYPE-TREF>
                      <DIRECTION>IN</DIRECTION>
                    </ARGUMENT-DATA-PROTOTYPE>
                    <ARGUMENT-DATA-PROTOTYPE>
                      <SHORT-NAME>uINT8UnionReturnValue</SHORT-NAME>
                      <CATEGORY>UNION</CATEGORY>
                      <TYPE-TREF DEST="IMPLEMENTATION-DATA-TYPE">/ETS/ImplementationDataTypes/ETS_UNION</TYPE-TREF>
                      <DIRECTION>OUT</DIRECTION>
                    </ARGUMENT-DATA-PROTOTYPE>
                  </ARGUMENTS>
                </CLIENT-SERVER-OPERATION>
              </OPERATIONS>
            </CLIENT-SERVER-INTERFACE>
[!ENDIF!]
[!IF "EnhancedTestabilityService/EchoingDataTypes/echoUTF8FIXED = 'true'"!]
            <!-- !LINKSTO EB.ETS.interface.54, 1 -->
            <CLIENT-SERVER-INTERFACE>
              <SHORT-NAME>ETS_EchoUTF8FIXED</SHORT-NAME>
              <IS-SERVICE>true</IS-SERVICE>
              <OPERATIONS>
                <CLIENT-SERVER-OPERATION>
                  <SHORT-NAME>EchoUTF8FIXED</SHORT-NAME>
                  <ARGUMENTS>
                    <ARGUMENT-DATA-PROTOTYPE>
                      <SHORT-NAME>uINT8Array_FX</SHORT-NAME>
                      <CATEGORY>ARRAY</CATEGORY>
                      <TYPE-TREF DEST="APPLICATION-ARRAY-DATA-TYPE">/ETS/ApplicationDataTypes/ETS_UTF8FixedArray</TYPE-TREF>
                      <DIRECTION>IN</DIRECTION>
                    </ARGUMENT-DATA-PROTOTYPE>
                    <ARGUMENT-DATA-PROTOTYPE>
                      <SHORT-NAME>uINT8ArrayReturnValue</SHORT-NAME>
                      <CATEGORY>ARRAY</CATEGORY>
                      <TYPE-TREF DEST="APPLICATION-ARRAY-DATA-TYPE">/ETS/ApplicationDataTypes/ETS_UTF8FixedArray</TYPE-TREF>
                      <DIRECTION>OUT</DIRECTION>
                    </ARGUMENT-DATA-PROTOTYPE>
                  </ARGUMENTS>
                </CLIENT-SERVER-OPERATION>
              </OPERATIONS>
            </CLIENT-SERVER-INTERFACE>
[!ENDIF!]
[!IF "EnhancedTestabilityService/EchoingDataTypes/echoUTF16FIXED = 'true'"!]
            <!-- !LINKSTO EB.ETS.interface.53, 1 -->
            <CLIENT-SERVER-INTERFACE>
              <SHORT-NAME>ETS_EchoUTF16FIXED</SHORT-NAME>
              <IS-SERVICE>true</IS-SERVICE>
              <OPERATIONS>
                <CLIENT-SERVER-OPERATION>
                  <SHORT-NAME>EchoUTF16FIXED</SHORT-NAME>
                  <ARGUMENTS>
                    <ARGUMENT-DATA-PROTOTYPE>
                      <SHORT-NAME>uINT16Array</SHORT-NAME>
                      <CATEGORY>ARRAY</CATEGORY>
                      <TYPE-TREF DEST="APPLICATION-ARRAY-DATA-TYPE">/ETS/ApplicationDataTypes/ETS_UTF16FixedArray</TYPE-TREF>
                      <DIRECTION>IN</DIRECTION>
                    </ARGUMENT-DATA-PROTOTYPE>
                    <ARGUMENT-DATA-PROTOTYPE>
                      <SHORT-NAME>uINT16ArrayReturnValue</SHORT-NAME>
                      <CATEGORY>ARRAY</CATEGORY>
                      <TYPE-TREF DEST="APPLICATION-ARRAY-DATA-TYPE">/ETS/ApplicationDataTypes/ETS_UTF16FixedArray</TYPE-TREF>
                      <DIRECTION>OUT</DIRECTION>
                    </ARGUMENT-DATA-PROTOTYPE>
                  </ARGUMENTS>
                </CLIENT-SERVER-OPERATION>
              </OPERATIONS>
            </CLIENT-SERVER-INTERFACE>
[!ENDIF!]
[!IF "EnhancedTestabilityService/EventsAndFields/TestEventUINT8 = 'true'"!]
            <!-- !LINKSTO EB.ETS.interface.16, 1 -->
            <!-- !LINKSTO EB.ETS.interface.33, 1 -->
            <SENDER-RECEIVER-INTERFACE>
              <SHORT-NAME>ETS_TestEventUINT8</SHORT-NAME>
              <IS-SERVICE>true</IS-SERVICE>
              <DATA-ELEMENTS>
                <VARIABLE-DATA-PROTOTYPE>
                  <SHORT-NAME>TestEventUINT8</SHORT-NAME>
                  <CATEGORY>STRUCTURE</CATEGORY>
                  <SW-DATA-DEF-PROPS>
                    <SW-DATA-DEF-PROPS-VARIANTS>
                      <SW-DATA-DEF-PROPS-CONDITIONAL>
                        <SW-CALIBRATION-ACCESS>READ-ONLY</SW-CALIBRATION-ACCESS>
                      </SW-DATA-DEF-PROPS-CONDITIONAL>
                    </SW-DATA-DEF-PROPS-VARIANTS>
                  </SW-DATA-DEF-PROPS>
                  <TYPE-TREF DEST="APPLICATION-RECORD-DATA-TYPE">/ETS/ApplicationDataTypes/ETS_Uint8Value</TYPE-TREF>
                </VARIABLE-DATA-PROTOTYPE>
              </DATA-ELEMENTS>
            </SENDER-RECEIVER-INTERFACE>
[!ENDIF!]
[!IF "EnhancedTestabilityService/EventsAndFields/TestEventUINT8Reliable = 'true'"!]
            <!-- !LINKSTO EB.ETS.interface.38, 1 -->
            <!-- !LINKSTO EB.ETS.interface.30, 1 -->
            <SENDER-RECEIVER-INTERFACE>
              <SHORT-NAME>ETS_TestEventUINT8Reliable</SHORT-NAME>
              <IS-SERVICE>true</IS-SERVICE>
              <DATA-ELEMENTS>
                <VARIABLE-DATA-PROTOTYPE>
                  <SHORT-NAME>TestEventUINT8Reliable</SHORT-NAME>
                  <CATEGORY>STRUCTURE</CATEGORY>
                  <SW-DATA-DEF-PROPS>
                    <SW-DATA-DEF-PROPS-VARIANTS>
                      <SW-DATA-DEF-PROPS-CONDITIONAL>
                        <SW-CALIBRATION-ACCESS>READ-ONLY</SW-CALIBRATION-ACCESS>
                      </SW-DATA-DEF-PROPS-CONDITIONAL>
                    </SW-DATA-DEF-PROPS-VARIANTS>
                  </SW-DATA-DEF-PROPS>
                  <TYPE-TREF DEST="APPLICATION-RECORD-DATA-TYPE">/ETS/ApplicationDataTypes/ETS_Uint8Value</TYPE-TREF>
                </VARIABLE-DATA-PROTOTYPE>
              </DATA-ELEMENTS>
            </SENDER-RECEIVER-INTERFACE>
[!ENDIF!]
[!IF "EnhancedTestabilityService/EventsAndFields/TestEventUINT8Array = 'true'"!]
            <!-- !LINKSTO EB.ETS.interface.17, 1 -->
            <!-- !LINKSTO EB.ETS.interface.32, 1 -->
            <SENDER-RECEIVER-INTERFACE>
              <SHORT-NAME>ETS_TestEventUINT8Array</SHORT-NAME>
              <IS-SERVICE>true</IS-SERVICE>
              <DATA-ELEMENTS>
                <VARIABLE-DATA-PROTOTYPE>
                  <SHORT-NAME>TestEventUINT8Array</SHORT-NAME>
                  <CATEGORY>STRUCTURE</CATEGORY>
                  <SW-DATA-DEF-PROPS>
                    <SW-DATA-DEF-PROPS-VARIANTS>
                      <SW-DATA-DEF-PROPS-CONDITIONAL>
                        <SW-CALIBRATION-ACCESS>NOT-ACCESSIBLE</SW-CALIBRATION-ACCESS>
                        <SW-IMPL-POLICY>QUEUED</SW-IMPL-POLICY>
                      </SW-DATA-DEF-PROPS-CONDITIONAL>
                    </SW-DATA-DEF-PROPS-VARIANTS>
                  </SW-DATA-DEF-PROPS>
                  <TYPE-TREF DEST="IMPLEMENTATION-DATA-TYPE">/ETS/ImplementationDataTypes/ETS_Uint8Array</TYPE-TREF>
                </VARIABLE-DATA-PROTOTYPE>
              </DATA-ELEMENTS>
            </SENDER-RECEIVER-INTERFACE>
[!ENDIF!]
[!IF "EnhancedTestabilityService/EventsAndFields/TestEventUINT8E2E = 'true'"!]
            <!-- !LINKSTO EB.ETS.interface.18, 1 -->
            <!-- !LINKSTO EB.ETS.interface.31, 1 -->
            <SENDER-RECEIVER-INTERFACE>
              <SHORT-NAME>ETS_TestEventUINT8E2E</SHORT-NAME>
              <IS-SERVICE>true</IS-SERVICE>
              <DATA-ELEMENTS>
                <VARIABLE-DATA-PROTOTYPE>
                  <SHORT-NAME>TestEventUINT8E2E</SHORT-NAME>
                  <CATEGORY>STRUCTURE</CATEGORY>
                  <SW-DATA-DEF-PROPS>
                    <SW-DATA-DEF-PROPS-VARIANTS>
                      <SW-DATA-DEF-PROPS-CONDITIONAL>
                        <SW-CALIBRATION-ACCESS>READ-ONLY</SW-CALIBRATION-ACCESS>
                      </SW-DATA-DEF-PROPS-CONDITIONAL>
                    </SW-DATA-DEF-PROPS-VARIANTS>
                  </SW-DATA-DEF-PROPS>
                  <TYPE-TREF DEST="APPLICATION-RECORD-DATA-TYPE">/ETS/ApplicationDataTypes/ETS_Uint8Value</TYPE-TREF>
                </VARIABLE-DATA-PROTOTYPE>
              </DATA-ELEMENTS>
            </SENDER-RECEIVER-INTERFACE>
[!ENDIF!]
[!IF "EnhancedTestabilityService/EventsAndFields/TestEventUINT8Multicast = 'true'"!]
            <!-- !LINKSTO EB.ETS.interface.19, 1 -->
            <!-- !LINKSTO EB.ETS.interface.34, 1 -->
            <SENDER-RECEIVER-INTERFACE>
              <SHORT-NAME>ETS_TestEventUINT8Multicast</SHORT-NAME>
              <IS-SERVICE>true</IS-SERVICE>
              <DATA-ELEMENTS>
                <VARIABLE-DATA-PROTOTYPE>
                  <SHORT-NAME>TestEventUINT8Multicast</SHORT-NAME>
                  <CATEGORY>STRUCTURE</CATEGORY>
                  <SW-DATA-DEF-PROPS>
                    <SW-DATA-DEF-PROPS-VARIANTS>
                      <SW-DATA-DEF-PROPS-CONDITIONAL>
                        <SW-CALIBRATION-ACCESS>READ-ONLY</SW-CALIBRATION-ACCESS>
                      </SW-DATA-DEF-PROPS-CONDITIONAL>
                    </SW-DATA-DEF-PROPS-VARIANTS>
                  </SW-DATA-DEF-PROPS>
                  <TYPE-TREF DEST="APPLICATION-RECORD-DATA-TYPE">/ETS/ApplicationDataTypes/ETS_Uint8Value</TYPE-TREF>
                  <INIT-VALUE>
                    <RECORD-VALUE-SPECIFICATION>
                      <FIELDS>
                        <APPLICATION-VALUE-SPECIFICATION>
                          <SHORT-LABEL>uINT8Value</SHORT-LABEL>
                          <CATEGORY>VALUE</CATEGORY>
                          <SW-VALUE-CONT>
                            <UNIT-REF DEST="UNIT">/ETS/Units/ETS_NoUnit</UNIT-REF>
                            <SW-VALUES-PHYS>
                              <V>0</V>
                            </SW-VALUES-PHYS>
                          </SW-VALUE-CONT>
                        </APPLICATION-VALUE-SPECIFICATION>
                      </FIELDS>
                    </RECORD-VALUE-SPECIFICATION>
                  </INIT-VALUE>
                </VARIABLE-DATA-PROTOTYPE>
              </DATA-ELEMENTS>
            </SENDER-RECEIVER-INTERFACE>
[!ENDIF!]
[!IF "EnhancedTestabilityService/EventsAndFields/TestFieldUINT8 = 'true'"!]
            <!-- !LINKSTO EB.ETS.interface.7, 1 -->
            <CLIENT-SERVER-INTERFACE>
              <SHORT-NAME>ETS_TestFieldUINT8</SHORT-NAME>
              <IS-SERVICE>true</IS-SERVICE>
              <OPERATIONS>
                <CLIENT-SERVER-OPERATION>
                  <SHORT-NAME>getFieldTestFieldUINT8</SHORT-NAME>
                  <ARGUMENTS>
                    <ARGUMENT-DATA-PROTOTYPE>
                      <SHORT-NAME>Getter</SHORT-NAME>
                      <CATEGORY>VALUE</CATEGORY>
                      <TYPE-TREF DEST="IMPLEMENTATION-DATA-TYPE">/AUTOSAR_Platform/ImplementationDataTypes/uint8</TYPE-TREF>
                      <DIRECTION>OUT</DIRECTION>
                    </ARGUMENT-DATA-PROTOTYPE>
                  </ARGUMENTS>
                </CLIENT-SERVER-OPERATION>
                <CLIENT-SERVER-OPERATION>
                  <SHORT-NAME>setFieldTestFieldUINT8</SHORT-NAME>
                  <ARGUMENTS>
                    <ARGUMENT-DATA-PROTOTYPE>
                      <SHORT-NAME>Setter</SHORT-NAME>
                      <CATEGORY>VALUE</CATEGORY>
                      <TYPE-TREF DEST="IMPLEMENTATION-DATA-TYPE">/AUTOSAR_Platform/ImplementationDataTypes/uint8</TYPE-TREF>
                      <DIRECTION>INOUT</DIRECTION>
                    </ARGUMENT-DATA-PROTOTYPE>
                  </ARGUMENTS>
                </CLIENT-SERVER-OPERATION>
              </OPERATIONS>
            </CLIENT-SERVER-INTERFACE>
[!ENDIF!]
[!IF "EnhancedTestabilityService/EventsAndFields/TestFieldUINT8Reliable = 'true'"!]
            <!-- !LINKSTO EB.ETS.interface.8, 1 -->
            <CLIENT-SERVER-INTERFACE>
              <SHORT-NAME>ETS_TestFieldUINT8Reliable</SHORT-NAME>
              <IS-SERVICE>true</IS-SERVICE>
              <OPERATIONS>
                <CLIENT-SERVER-OPERATION>
                  <SHORT-NAME>getFieldTestFieldUINT8Reliable</SHORT-NAME>
                  <ARGUMENTS>
                    <ARGUMENT-DATA-PROTOTYPE>
                      <SHORT-NAME>Getter</SHORT-NAME>
                      <CATEGORY>VALUE</CATEGORY>
                      <TYPE-TREF DEST="IMPLEMENTATION-DATA-TYPE">/AUTOSAR_Platform/ImplementationDataTypes/uint8</TYPE-TREF>
                      <DIRECTION>OUT</DIRECTION>
                    </ARGUMENT-DATA-PROTOTYPE>
                  </ARGUMENTS>
                </CLIENT-SERVER-OPERATION>
                <CLIENT-SERVER-OPERATION>
                  <SHORT-NAME>setFieldTestFieldUINT8Reliable</SHORT-NAME>
                  <ARGUMENTS>
                    <ARGUMENT-DATA-PROTOTYPE>
                      <SHORT-NAME>Setter</SHORT-NAME>
                      <CATEGORY>VALUE</CATEGORY>
                      <TYPE-TREF DEST="IMPLEMENTATION-DATA-TYPE">/AUTOSAR_Platform/ImplementationDataTypes/uint8</TYPE-TREF>
                      <DIRECTION>INOUT</DIRECTION>
                    </ARGUMENT-DATA-PROTOTYPE>
                  </ARGUMENTS>
                </CLIENT-SERVER-OPERATION>
              </OPERATIONS>
            </CLIENT-SERVER-INTERFACE>
[!ENDIF!]
[!IF "EnhancedTestabilityService/EventsAndFields/TestFieldUINT8Array = 'true'"!]
            <!-- !LINKSTO EB.ETS.interface.6, 1 -->
            <CLIENT-SERVER-INTERFACE>
              <SHORT-NAME>ETS_TestFieldUINT8Array</SHORT-NAME>
              <IS-SERVICE>true</IS-SERVICE>
              <OPERATIONS>
                <CLIENT-SERVER-OPERATION>
                  <SHORT-NAME>getFieldTestFieldUINT8Array</SHORT-NAME>
                  <ARGUMENTS>
                    <ARGUMENT-DATA-PROTOTYPE>
                      <SHORT-NAME>Getter</SHORT-NAME>
                      <CATEGORY>ARRAY</CATEGORY>
                      <TYPE-TREF DEST="APPLICATION-ARRAY-DATA-TYPE">/ETS/ApplicationDataTypes/ETS_Uint8Array</TYPE-TREF>
                      <DIRECTION>OUT</DIRECTION>
                    </ARGUMENT-DATA-PROTOTYPE>
                  </ARGUMENTS>
                </CLIENT-SERVER-OPERATION>
                <CLIENT-SERVER-OPERATION>
                  <SHORT-NAME>setFieldTestFieldUINT8Array</SHORT-NAME>
                  <ARGUMENTS>
                    <ARGUMENT-DATA-PROTOTYPE>
                      <SHORT-NAME>Setter</SHORT-NAME>
                      <CATEGORY>ARRAY</CATEGORY>
                      <TYPE-TREF DEST="APPLICATION-ARRAY-DATA-TYPE">/ETS/ApplicationDataTypes/ETS_Uint8Array</TYPE-TREF>
                      <DIRECTION>INOUT</DIRECTION>
                    </ARGUMENT-DATA-PROTOTYPE>
                  </ARGUMENTS>
                </CLIENT-SERVER-OPERATION>
              </OPERATIONS>
            </CLIENT-SERVER-INTERFACE>
[!ENDIF!]
[!IF "EnhancedTestabilityService/EventsAndFields/TestFieldUINT8 = 'true'"!]
            <!-- !LINKSTO EB.ETS.interface.12, 1 -->
            <SENDER-RECEIVER-INTERFACE>
              <SHORT-NAME>ETS_NotifyFieldTestFieldUINT8</SHORT-NAME>
              <IS-SERVICE>true</IS-SERVICE>
              <DATA-ELEMENTS>
                <VARIABLE-DATA-PROTOTYPE>
                  <SHORT-NAME>Notifier</SHORT-NAME>
                  <CATEGORY>VALUE</CATEGORY>
                  <SW-DATA-DEF-PROPS>
                    <SW-DATA-DEF-PROPS-VARIANTS>
                      <SW-DATA-DEF-PROPS-CONDITIONAL>
                        <SW-CALIBRATION-ACCESS>READ-ONLY</SW-CALIBRATION-ACCESS>
                      </SW-DATA-DEF-PROPS-CONDITIONAL>
                    </SW-DATA-DEF-PROPS-VARIANTS>
                  </SW-DATA-DEF-PROPS>
                  <TYPE-TREF DEST="IMPLEMENTATION-DATA-TYPE">/AUTOSAR_Platform/ImplementationDataTypes/uint8</TYPE-TREF>
                </VARIABLE-DATA-PROTOTYPE>
              </DATA-ELEMENTS>
            </SENDER-RECEIVER-INTERFACE>
[!ENDIF!]
[!IF "EnhancedTestabilityService/EventsAndFields/TestFieldUINT8Reliable = 'true'"!]
            <!-- !LINKSTO EB.ETS.interface.10, 1 -->
            <SENDER-RECEIVER-INTERFACE>
              <SHORT-NAME>ETS_NotifyFieldTestFieldUINT8Reliable</SHORT-NAME>
              <IS-SERVICE>true</IS-SERVICE>
              <DATA-ELEMENTS>
                <VARIABLE-DATA-PROTOTYPE>
                  <SHORT-NAME>Notifier</SHORT-NAME>
                  <CATEGORY>VALUE</CATEGORY>
                  <SW-DATA-DEF-PROPS>
                    <SW-DATA-DEF-PROPS-VARIANTS>
                      <SW-DATA-DEF-PROPS-CONDITIONAL>
                        <SW-CALIBRATION-ACCESS>READ-ONLY</SW-CALIBRATION-ACCESS>
                      </SW-DATA-DEF-PROPS-CONDITIONAL>
                    </SW-DATA-DEF-PROPS-VARIANTS>
                  </SW-DATA-DEF-PROPS>
                  <TYPE-TREF DEST="IMPLEMENTATION-DATA-TYPE">/AUTOSAR_Platform/ImplementationDataTypes/uint8</TYPE-TREF>
                </VARIABLE-DATA-PROTOTYPE>
              </DATA-ELEMENTS>
            </SENDER-RECEIVER-INTERFACE>
[!ENDIF!]
[!IF "EnhancedTestabilityService/EventsAndFields/TestFieldUINT8Array = 'true'"!]
            <!-- !LINKSTO EB.ETS.interface.11, 1 -->
            <SENDER-RECEIVER-INTERFACE>
              <SHORT-NAME>ETS_NotifyFieldTestFieldUINT8Array</SHORT-NAME>
              <IS-SERVICE>true</IS-SERVICE>
              <DATA-ELEMENTS>
                <VARIABLE-DATA-PROTOTYPE>
                  <SHORT-NAME>Notifier</SHORT-NAME>
                  <CATEGORY>ARRAY</CATEGORY>
                  <SW-DATA-DEF-PROPS>
                    <SW-DATA-DEF-PROPS-VARIANTS>
                      <SW-DATA-DEF-PROPS-CONDITIONAL>
                        <SW-CALIBRATION-ACCESS>NOT-ACCESSIBLE</SW-CALIBRATION-ACCESS>
                        <SW-IMPL-POLICY>QUEUED</SW-IMPL-POLICY>
                      </SW-DATA-DEF-PROPS-CONDITIONAL>
                    </SW-DATA-DEF-PROPS-VARIANTS>
                  </SW-DATA-DEF-PROPS>
                  <TYPE-TREF DEST="IMPLEMENTATION-DATA-TYPE">/ETS/ImplementationDataTypes/ETS_Uint8Array</TYPE-TREF>
                </VARIABLE-DATA-PROTOTYPE>
              </DATA-ELEMENTS>
            </SENDER-RECEIVER-INTERFACE>
[!ENDIF!]
[!IF "EnhancedTestabilityService/EventsAndFields/InterfaceVersion = 'true'"!]
            <!-- !LINKSTO EB.ETS.interface.21, 1 -->
            <CLIENT-SERVER-INTERFACE>
              <SHORT-NAME>ETS_InterfaceVersion</SHORT-NAME>
              <IS-SERVICE>true</IS-SERVICE>
              <OPERATIONS>
                <CLIENT-SERVER-OPERATION>
                  <SHORT-NAME>getFieldInterfaceVersion</SHORT-NAME>
                  <ARGUMENTS>
                    <ARGUMENT-DATA-PROTOTYPE>
                      <SHORT-NAME>Getter</SHORT-NAME>
                      <CATEGORY>STRUCTURE</CATEGORY>
                      <TYPE-TREF DEST="APPLICATION-RECORD-DATA-TYPE">/ETS/ApplicationDataTypes/ETS_VersionType</TYPE-TREF>
                      <DIRECTION>OUT</DIRECTION>
                    </ARGUMENT-DATA-PROTOTYPE>
                  </ARGUMENTS>
                </CLIENT-SERVER-OPERATION>
              </OPERATIONS>
            </CLIENT-SERVER-INTERFACE>
[!ENDIF!]
[!IF "EnhancedTestabilityService/EventsAndFields/InterfaceVersion = 'true'"!]
            <!-- !LINKSTO EB.ETS.interface.9, 1 -->
            <SENDER-RECEIVER-INTERFACE>
              <SHORT-NAME>ETS_NotifyFieldInterfaceVersion</SHORT-NAME>
              <IS-SERVICE>true</IS-SERVICE>
              <DATA-ELEMENTS>
                <VARIABLE-DATA-PROTOTYPE>
                  <SHORT-NAME>Notifier</SHORT-NAME>
                  <CATEGORY>STRUCTURE</CATEGORY>
                  <SW-DATA-DEF-PROPS>
                    <SW-DATA-DEF-PROPS-VARIANTS>
                      <SW-DATA-DEF-PROPS-CONDITIONAL>
                        <SW-CALIBRATION-ACCESS>READ-ONLY</SW-CALIBRATION-ACCESS>
                      </SW-DATA-DEF-PROPS-CONDITIONAL>
                    </SW-DATA-DEF-PROPS-VARIANTS>
                  </SW-DATA-DEF-PROPS>
                  <TYPE-TREF DEST="APPLICATION-RECORD-DATA-TYPE">/ETS/ApplicationDataTypes/ETS_VersionType</TYPE-TREF>
                  <INIT-VALUE>
                    <RECORD-VALUE-SPECIFICATION>
                      <FIELDS>
                        <APPLICATION-VALUE-SPECIFICATION>
                          <SHORT-LABEL>majorEtsVersion</SHORT-LABEL>
                          <CATEGORY>VALUE</CATEGORY>
                          <SW-VALUE-CONT>
                            <UNIT-REF DEST="UNIT">/ETS/Units/ETS_NoUnit</UNIT-REF>
                            <SW-VALUES-PHYS>
                              <V>0</V>
                            </SW-VALUES-PHYS>
                          </SW-VALUE-CONT>
                        </APPLICATION-VALUE-SPECIFICATION>
                        <APPLICATION-VALUE-SPECIFICATION>
                          <SHORT-LABEL>minorEtsVersion</SHORT-LABEL>
                          <CATEGORY>VALUE</CATEGORY>
                          <SW-VALUE-CONT>
                            <UNIT-REF DEST="UNIT">/ETS/Units/ETS_NoUnit</UNIT-REF>
                            <SW-VALUES-PHYS>
                              <V>0</V>
                            </SW-VALUES-PHYS>
                          </SW-VALUE-CONT>
                        </APPLICATION-VALUE-SPECIFICATION>
                      </FIELDS>
                    </RECORD-VALUE-SPECIFICATION>
                  </INIT-VALUE>
                </VARIABLE-DATA-PROTOTYPE>
              </DATA-ELEMENTS>
            </SENDER-RECEIVER-INTERFACE>
[!ENDIF!]
[!LOOP "ProjectSpecificTests/*"!]
  [!IF "node:value(ActivateTest) = 'true'"!]
            <CLIENT-SERVER-INTERFACE>
              <SHORT-NAME>ETS_Pst[!"node:name(.)"!]</SHORT-NAME>
              <IS-SERVICE>true</IS-SERVICE>
              <OPERATIONS>
                <CLIENT-SERVER-OPERATION>
                  <SHORT-NAME>ETS_Cbk_[!"node:name(.)"!]</SHORT-NAME>
                  <ARGUMENTS>
                  </ARGUMENTS>
                </CLIENT-SERVER-OPERATION>
              </OPERATIONS>
            </CLIENT-SERVER-INTERFACE>
  [!ENDIF!]
[!ENDLOOP!]
          </ELEMENTS>
        </AR-PACKAGE>
        <AR-PACKAGE>
          <SHORT-NAME>SwcImplementations</SHORT-NAME>
          <ELEMENTS>
            <APPLICATION-SW-COMPONENT-TYPE>
              <SHORT-NAME>ETS</SHORT-NAME>
              <PORTS>
[!IF "General/ETS_EnableDET = 'true'"!]
                <!-- !LINKSTO EB.ETS.Port.1, 1 -->
                <R-PORT-PROTOTYPE>
                  <SHORT-NAME>Det</SHORT-NAME>
                  <REQUIRED-INTERFACE-TREF DEST="CLIENT-SERVER-INTERFACE">/ETS/PortInterfaces/DetService</REQUIRED-INTERFACE-TREF>
                </R-PORT-PROTOTYPE>
[!ENDIF!]
[!IF "EnhancedTestabilityService/TestingClientInteraction/checkByteOrder = 'true'"!]
                <!-- !LINKSTO EB.ETS.Port.4, 1 -->
                <P-PORT-PROTOTYPE>
                  <SHORT-NAME>ETS_CheckByteOrder</SHORT-NAME>
                  <PROVIDED-INTERFACE-TREF DEST="CLIENT-SERVER-INTERFACE">/ETS/PortInterfaces/ETS_CheckByteOrder</PROVIDED-INTERFACE-TREF>
                </P-PORT-PROTOTYPE>
[!ENDIF!]
[!IF "EnhancedTestabilityService/TestingClientInteraction/clientServiceActivate = 'true'"!]
                <!-- !LINKSTO EB.ETS.Port.30, 1 -->
                <R-PORT-PROTOTYPE>
                  <SHORT-NAME>ETS_ClientServiceActivate</SHORT-NAME>
                  <REQUIRED-INTERFACE-TREF DEST="SENDER-RECEIVER-INTERFACE">/ETS/PortInterfaces/ETS_ClientServiceActivate</REQUIRED-INTERFACE-TREF>
                </R-PORT-PROTOTYPE>
[!ENDIF!]
[!IF "EnhancedTestabilityService/TestingClientInteraction/clientServiceCallEchoUINT8Array = 'true'"!]
                <!-- !LINKSTO EB.ETS.Port.32, 1 -->
                <P-PORT-PROTOTYPE>
                  <SHORT-NAME>ETS_ClientServiceCallEchoUINT8Array</SHORT-NAME>
                  <PROVIDED-INTERFACE-TREF DEST="CLIENT-SERVER-INTERFACE">/ETS/PortInterfaces/ETS_ClientServiceCallEchoUINT8Array</PROVIDED-INTERFACE-TREF>
                </P-PORT-PROTOTYPE>
[!ENDIF!]
[!IF "EnhancedTestabilityService/TestingClientInteraction/clientServiceDeactivate = 'true'"!]
                <!-- !LINKSTO EB.ETS.Port.31, 1 -->
                <R-PORT-PROTOTYPE>
                  <SHORT-NAME>ETS_ClientServiceDeactivate</SHORT-NAME>
                  <REQUIRED-INTERFACE-TREF DEST="SENDER-RECEIVER-INTERFACE">/ETS/PortInterfaces/ETS_ClientServiceDeactivate</REQUIRED-INTERFACE-TREF>
                </R-PORT-PROTOTYPE>
[!ENDIF!]
[!IF "EnhancedTestabilityService/TestingClientInteraction/clientServiceGetLastValueOfEventTCP = 'true'"!]
                <!-- !LINKSTO EB.ETS.Port.34, 1 -->
                <P-PORT-PROTOTYPE>
                  <SHORT-NAME>ETS_ClientServiceGetLastValueOfEventTCP</SHORT-NAME>
                  <PROVIDED-INTERFACE-TREF DEST="CLIENT-SERVER-INTERFACE">/ETS/PortInterfaces/ETS_ClientServiceGetLastValueOfEventTCP</PROVIDED-INTERFACE-TREF>
                </P-PORT-PROTOTYPE>
[!ENDIF!]
[!IF "EnhancedTestabilityService/TestingClientInteraction/clientServiceGetLastValueOfEventUDPMulticast = 'true'"!]
                <!-- !LINKSTO EB.ETS.Port.36, 1 -->
                <P-PORT-PROTOTYPE>
                  <SHORT-NAME>ETS_ClientServiceGetLastValueOfEventUDPMulticast</SHORT-NAME>
                  <PROVIDED-INTERFACE-TREF DEST="CLIENT-SERVER-INTERFACE">/ETS/PortInterfaces/ETS_ClientServiceGetLastValueOfEventUDPMulticast</PROVIDED-INTERFACE-TREF>
                </P-PORT-PROTOTYPE>
[!ENDIF!]
[!IF "EnhancedTestabilityService/TestingClientInteraction/clientServiceGetLastValueOfEventUDPUnicast = 'true'"!]
                <!-- !LINKSTO EB.ETS.Port.35, 1 -->
                <P-PORT-PROTOTYPE>
                  <SHORT-NAME>ETS_ClientServiceGetLastValueOfEventUDPUnicast</SHORT-NAME>
                  <PROVIDED-INTERFACE-TREF DEST="CLIENT-SERVER-INTERFACE">/ETS/PortInterfaces/ETS_ClientServiceGetLastValueOfEventUDPUnicast</PROVIDED-INTERFACE-TREF>
                </P-PORT-PROTOTYPE>
[!ENDIF!]
[!IF "EnhancedTestabilityService/TestingClientInteraction/clientServiceSubscribeEventgroup = 'true'"!]
                <!-- !LINKSTO EB.ETS.Port.33, 1 -->
                <R-PORT-PROTOTYPE>
                  <SHORT-NAME>ETS_ClientServiceSubscribeEventgroup</SHORT-NAME>
                  <REQUIRED-INTERFACE-TREF DEST="SENDER-RECEIVER-INTERFACE">/ETS/PortInterfaces/ETS_ClientServiceSubscribeEventgroup</REQUIRED-INTERFACE-TREF>
                </R-PORT-PROTOTYPE>
[!ENDIF!]
[!IF "EnhancedTestabilityService/EchoingDataTypes/echoCommonDatatypes = 'true'"!]
                <!-- !LINKSTO EB.ETS.Port.5, 1 -->
                <P-PORT-PROTOTYPE>
                  <SHORT-NAME>ETS_EchoCommonDatatypes</SHORT-NAME>
                  <PROVIDED-INTERFACE-TREF DEST="CLIENT-SERVER-INTERFACE">/ETS/PortInterfaces/ETS_EchoCommonDatatypes</PROVIDED-INTERFACE-TREF>
                </P-PORT-PROTOTYPE>
[!ENDIF!]
[!IF "EnhancedTestabilityService/EchoingDataTypes/echoUINT8 = 'true'"!]
                <!-- !LINKSTO EB.ETS.Port.13, 1 -->
                <P-PORT-PROTOTYPE>
                  <SHORT-NAME>ETS_EchoUINT8</SHORT-NAME>
                  <PROVIDED-INTERFACE-TREF DEST="CLIENT-SERVER-INTERFACE">/ETS/PortInterfaces/ETS_EchoUINT8</PROVIDED-INTERFACE-TREF>
                </P-PORT-PROTOTYPE>
[!ENDIF!]
[!IF "EnhancedTestabilityService/TestingClientInteraction/resetInterface = 'true'"!]
                <!-- !LINKSTO EB.ETS.Port.2, 1 -->
                <R-PORT-PROTOTYPE>
                  <SHORT-NAME>ETS_ResetInterface</SHORT-NAME>
                  <REQUIRED-INTERFACE-TREF DEST="TRIGGER-INTERFACE">/ETS/PortInterfaces/ETS_ResetInterface</REQUIRED-INTERFACE-TREF>
                </R-PORT-PROTOTYPE>
[!ENDIF!]
[!IF "EnhancedTestabilityService/TestingClientInteraction/clientServiceActivate = 'true'"!]
                <!-- !LINKSTO EB.ETS.Port.56, 1 -->
                <P-PORT-PROTOTYPE>
                  <SHORT-NAME>ETS_SD_ClientServiceRequest</SHORT-NAME>
                  <PROVIDED-INTERFACE-TREF DEST="SENDER-RECEIVER-INTERFACE">/ETS/PortInterfaces/ETS_ModeRequest_SD_ClientService</PROVIDED-INTERFACE-TREF>
                </P-PORT-PROTOTYPE>
[!ENDIF!]
[!IF "EnhancedTestabilityService/TestingClientInteraction/clientServiceSubscribeEventgroup = 'true'"!]
                <!-- !LINKSTO EB.ETS.Port.57, 1 -->
                <P-PORT-PROTOTYPE>
                  <SHORT-NAME>ETS_SD_ConsumedEventGroupRequest</SHORT-NAME>
                  <PROVIDED-INTERFACE-TREF DEST="SENDER-RECEIVER-INTERFACE">/ETS/PortInterfaces/ETS_ModeRequest_SD_ConsumeEventGroup</PROVIDED-INTERFACE-TREF>
                </P-PORT-PROTOTYPE>
[!ENDIF!]
[!IF "EnhancedTestabilityService/TestingClientInteraction/clientServiceActivate = 'true'"!]
                <!-- !LINKSTO EB.ETS.Port.55, 1 -->
                <P-PORT-PROTOTYPE>
                  <SHORT-NAME>ETS_SD_ServerServiceRequest</SHORT-NAME>
                  <PROVIDED-INTERFACE-TREF DEST="SENDER-RECEIVER-INTERFACE">/ETS/PortInterfaces/ETS_ModeRequest_SD_ServerService</PROVIDED-INTERFACE-TREF>
                </P-PORT-PROTOTYPE>
[!ENDIF!]
[!IF "EnhancedTestabilityService/TestingClientInteraction/suspendInterface = 'true'"!]
                <!-- !LINKSTO EB.ETS.Port.3, 1 -->
                <R-PORT-PROTOTYPE>
                  <SHORT-NAME>ETS_SuspendInterface</SHORT-NAME>
                  <REQUIRED-INTERFACE-TREF DEST="SENDER-RECEIVER-INTERFACE">/ETS/PortInterfaces/ETS_SuspendInterface</REQUIRED-INTERFACE-TREF>
                </R-PORT-PROTOTYPE>
[!ENDIF!]
[!IF "EnhancedTestabilityService/TestingEvents/triggerEventUINT8 = 'true'"!]
                <!-- !LINKSTO EB.ETS.Port.25, 1 -->
                <R-PORT-PROTOTYPE>
                  <SHORT-NAME>ETS_TriggerEventUINT8</SHORT-NAME>
                  <REQUIRED-INTERFACE-TREF DEST="SENDER-RECEIVER-INTERFACE">/ETS/PortInterfaces/ETS_TriggerEventUINT8</REQUIRED-INTERFACE-TREF>
                </R-PORT-PROTOTYPE>
[!ENDIF!]
[!IF "EnhancedTestabilityService/TestingEvents/triggerEventUINT8Array = 'true'"!]
                <!-- !LINKSTO EB.ETS.Port.26, 1 -->
                <R-PORT-PROTOTYPE>
                  <SHORT-NAME>ETS_TriggerEventUINT8Array</SHORT-NAME>
                  <REQUIRED-INTERFACE-TREF DEST="SENDER-RECEIVER-INTERFACE">/ETS/PortInterfaces/ETS_TriggerEventUINT8Array</REQUIRED-INTERFACE-TREF>
                </R-PORT-PROTOTYPE>
[!ENDIF!]
[!IF "EnhancedTestabilityService/TestingEvents/triggerEventUINT8E2E = 'true'"!]
                <!-- !LINKSTO EB.ETS.Port.27, 1 -->
                <R-PORT-PROTOTYPE>
                  <SHORT-NAME>ETS_TriggerEventUINT8E2E</SHORT-NAME>
                  <REQUIRED-INTERFACE-TREF DEST="SENDER-RECEIVER-INTERFACE">/ETS/PortInterfaces/ETS_TriggerEventUINT8E2E</REQUIRED-INTERFACE-TREF>
                </R-PORT-PROTOTYPE>
[!ENDIF!]
[!IF "EnhancedTestabilityService/TestingEvents/triggerEventUINT8Multicast = 'true'"!]
                <!-- !LINKSTO EB.ETS.Port.29, 1 -->
                <R-PORT-PROTOTYPE>
                  <SHORT-NAME>ETS_TriggerEventUINT8Multicast</SHORT-NAME>
                  <REQUIRED-INTERFACE-TREF DEST="SENDER-RECEIVER-INTERFACE">/ETS/PortInterfaces/ETS_TriggerEventUINT8Multicast</REQUIRED-INTERFACE-TREF>
                </R-PORT-PROTOTYPE>
[!ENDIF!]
[!IF "EnhancedTestabilityService/TestingEvents/triggerEventUINT8Reliable = 'true'"!]
                <!-- !LINKSTO EB.ETS.Port.28, 1 -->
                <R-PORT-PROTOTYPE>
                  <SHORT-NAME>ETS_TriggerEventUINT8Reliable</SHORT-NAME>
                  <REQUIRED-INTERFACE-TREF DEST="SENDER-RECEIVER-INTERFACE">/ETS/PortInterfaces/ETS_TriggerEventUINT8Reliable</REQUIRED-INTERFACE-TREF>
                </R-PORT-PROTOTYPE>
[!ENDIF!]
                <R-PORT-PROTOTYPE>
                  <SHORT-NAME>currentMode</SHORT-NAME>
                  <REQUIRED-INTERFACE-TREF DEST="MODE-SWITCH-INTERFACE">/ETS/PortInterfaces/ETS_SwitchPort_CurrentMode</REQUIRED-INTERFACE-TREF>
                </R-PORT-PROTOTYPE>
[!IF "EnhancedTestabilityService/EchoingDataTypes/echoUINT64 = 'true'"!]
                <!-- !LINKSTO EB.ETS.Port.12, 1 -->
                <P-PORT-PROTOTYPE>
                  <SHORT-NAME>ETS_EchoUINT64</SHORT-NAME>
                  <PROVIDED-INTERFACE-TREF DEST="CLIENT-SERVER-INTERFACE">/ETS/PortInterfaces/ETS_EchoUINT64</PROVIDED-INTERFACE-TREF>
                </P-PORT-PROTOTYPE>
[!ENDIF!]
[!IF "EnhancedTestabilityService/EchoingDataTypes/echoInt64 = 'true'"!]
                <!-- !LINKSTO EB.ETS.Port.8, 1 -->
                <P-PORT-PROTOTYPE>
                  <SHORT-NAME>ETS_EchoINT64</SHORT-NAME>
                  <PROVIDED-INTERFACE-TREF DEST="CLIENT-SERVER-INTERFACE">/ETS/PortInterfaces/ETS_EchoINT64</PROVIDED-INTERFACE-TREF>
                </P-PORT-PROTOTYPE>
[!ENDIF!]
[!IF "EnhancedTestabilityService/EchoingDataTypes/echoINT8 = 'true'"!]
                <!-- !LINKSTO EB.ETS.Port.9, 1 -->
                <P-PORT-PROTOTYPE>
                  <SHORT-NAME>ETS_EchoINT8</SHORT-NAME>
                  <PROVIDED-INTERFACE-TREF DEST="CLIENT-SERVER-INTERFACE">/ETS/PortInterfaces/ETS_EchoINT8</PROVIDED-INTERFACE-TREF>
                </P-PORT-PROTOTYPE>
[!ENDIF!]
[!IF "EnhancedTestabilityService/EchoingDataTypes/echoFLOAT64 = 'true'"!]
                <!-- !LINKSTO EB.ETS.Port.7, 1 -->
                <P-PORT-PROTOTYPE>
                  <SHORT-NAME>ETS_EchoFLOAT64</SHORT-NAME>
                  <PROVIDED-INTERFACE-TREF DEST="CLIENT-SERVER-INTERFACE">/ETS/PortInterfaces/ETS_EchoFLOAT64</PROVIDED-INTERFACE-TREF>
                </P-PORT-PROTOTYPE>
[!ENDIF!]
[!IF "EnhancedTestabilityService/EchoingDataTypes/echoENUM = 'true'"!]
                <!-- !LINKSTO EB.ETS.Port.6, 1 -->
                <P-PORT-PROTOTYPE>
                  <SHORT-NAME>ETS_EchoENUM</SHORT-NAME>
                  <PROVIDED-INTERFACE-TREF DEST="CLIENT-SERVER-INTERFACE">/ETS/PortInterfaces/ETS_EchoENUM</PROVIDED-INTERFACE-TREF>
                </P-PORT-PROTOTYPE>
[!ENDIF!]
[!IF "EnhancedTestabilityService/EchoingDataTypes/echoUINT8Array = 'true'"!]
                <!-- !LINKSTO EB.ETS.Port.14, 1 -->
                <P-PORT-PROTOTYPE>
                  <SHORT-NAME>ETS_EchoUINT8Array</SHORT-NAME>
                  <PROVIDED-COM-SPECS>
                    <SERVER-COM-SPEC>
                      <OPERATION-REF DEST="CLIENT-SERVER-OPERATION">/ETS/PortInterfaces/ETS_EchoUINT8Array/EchoUINT8Array</OPERATION-REF>
                      <QUEUE-LENGTH>5</QUEUE-LENGTH>
                    </SERVER-COM-SPEC>
                  </PROVIDED-COM-SPECS>
                  <PROVIDED-INTERFACE-TREF DEST="CLIENT-SERVER-INTERFACE">/ETS/PortInterfaces/ETS_EchoUINT8Array</PROVIDED-INTERFACE-TREF>
                </P-PORT-PROTOTYPE>
[!ENDIF!]
[!IF "EnhancedTestabilityService/TestingClientInteraction/clientServiceCallEchoUINT8Array = 'true'"!]
                <R-PORT-PROTOTYPE>
                  <SHORT-NAME>ETS_EchoUINT8ArrayClient</SHORT-NAME>
                  <REQUIRED-INTERFACE-TREF DEST="CLIENT-SERVER-INTERFACE">/ETS/PortInterfaces/ETS_EchoUINT8Array</REQUIRED-INTERFACE-TREF>
                </R-PORT-PROTOTYPE>
[!ENDIF!]
[!IF "EnhancedTestabilityService/EchoingDataTypes/echoStaticUINT8Array = 'true'"!]
                <!-- !LINKSTO EB.ETS.Port.10, 1 -->
                <P-PORT-PROTOTYPE>
                  <SHORT-NAME>ETS_EchoStaticUINT8Array</SHORT-NAME>
                  <PROVIDED-INTERFACE-TREF DEST="CLIENT-SERVER-INTERFACE">/ETS/PortInterfaces/ETS_EchoStaticUINT8Array</PROVIDED-INTERFACE-TREF>
                </P-PORT-PROTOTYPE>
[!ENDIF!]
[!IF "EnhancedTestabilityService/EchoingDataTypes/echoBitfields = 'true'"!]
                <!-- !LINKSTO EB.ETS.Port.24, 1 -->
                <P-PORT-PROTOTYPE>
                  <SHORT-NAME>ETS_EchoBitfields</SHORT-NAME>
                  <PROVIDED-INTERFACE-TREF DEST="CLIENT-SERVER-INTERFACE">/ETS/PortInterfaces/ETS_EchoBitfields</PROVIDED-INTERFACE-TREF>
                </P-PORT-PROTOTYPE>
[!ENDIF!]
[!IF "EnhancedTestabilityService/EchoingDataTypes/echoTYPEDEF = 'true'"!]
                <!-- !LINKSTO EB.ETS.Port.58, 1 -->
                <P-PORT-PROTOTYPE>
                  <SHORT-NAME>ETS_EchoTYPEDEF</SHORT-NAME>
                  <PROVIDED-INTERFACE-TREF DEST="CLIENT-SERVER-INTERFACE">/ETS/PortInterfaces/ETS_EchoTYPEDEF</PROVIDED-INTERFACE-TREF>
                </P-PORT-PROTOTYPE>
[!ENDIF!]
[!IF "EnhancedTestabilityService/EchoingDataTypes/echoUINT8Array16BitLength = 'true'"!]
                <!-- !LINKSTO EB.ETS.Port.16, 1 -->
                <P-PORT-PROTOTYPE>
                  <SHORT-NAME>ETS_EchoUINT8Array16Bitlength</SHORT-NAME>
                  <PROVIDED-INTERFACE-TREF DEST="CLIENT-SERVER-INTERFACE">/ETS/PortInterfaces/ETS_EchoUINT8Array16Bitlength</PROVIDED-INTERFACE-TREF>
                </P-PORT-PROTOTYPE>
[!ENDIF!]
[!IF "EnhancedTestabilityService/EchoingDataTypes/echoUINT8E2E = 'true'"!]
                <!-- !LINKSTO EB.ETS.Port.19, 1 -->
                <P-PORT-PROTOTYPE>
                  <SHORT-NAME>ETS_EchoUINT8E2E</SHORT-NAME>
                  <PROVIDED-INTERFACE-TREF DEST="CLIENT-SERVER-INTERFACE">/ETS/PortInterfaces/ETS_EchoUINT8E2E</PROVIDED-INTERFACE-TREF>
                </P-PORT-PROTOTYPE>
[!ENDIF!]
[!IF "EnhancedTestabilityService/EchoingDataTypes/echoUINT8RELIABLE = 'true'"!]
                <!-- !LINKSTO EB.ETS.Port.20, 1 -->
                <P-PORT-PROTOTYPE>
                  <SHORT-NAME>ETS_EchoUINT8RELIABLE</SHORT-NAME>
                  <PROVIDED-INTERFACE-TREF DEST="CLIENT-SERVER-INTERFACE">/ETS/PortInterfaces/ETS_EchoUINT8RELIABLE</PROVIDED-INTERFACE-TREF>
                </P-PORT-PROTOTYPE>
[!ENDIF!]
[!IF "EnhancedTestabilityService/EchoingDataTypes/echoSTRUCTSimple = 'true'"!]
                <!-- !LINKSTO EB.ETS.Port.11, 1 -->
                <P-PORT-PROTOTYPE>
                  <SHORT-NAME>ETS_EchoSTRUCTSimple</SHORT-NAME>
                  <PROVIDED-INTERFACE-TREF DEST="CLIENT-SERVER-INTERFACE">/ETS/PortInterfaces/ETS_EchoSTRUCTSimple</PROVIDED-INTERFACE-TREF>
                </P-PORT-PROTOTYPE>
[!ENDIF!]
[!IF "EnhancedTestabilityService/EchoingDataTypes/echoUINT8Array8BitLength = 'true'"!]
                <!-- !LINKSTO EB.ETS.Port.15, 1 -->
                <P-PORT-PROTOTYPE>
                  <SHORT-NAME>ETS_EchoUINT8Array8BitLength</SHORT-NAME>
                  <PROVIDED-INTERFACE-TREF DEST="CLIENT-SERVER-INTERFACE">/ETS/PortInterfaces/ETS_EchoUINT8Array8BitLength</PROVIDED-INTERFACE-TREF>
                </P-PORT-PROTOTYPE>
[!ENDIF!]
[!IF "EnhancedTestabilityService/EchoingDataTypes/echoUINT8Array2Dim = 'true'"!]
                <!-- !LINKSTO EB.ETS.Port.17, 1 -->
                <P-PORT-PROTOTYPE>
                  <SHORT-NAME>ETS_EchoUINT8Array2Dim</SHORT-NAME>
                  <PROVIDED-INTERFACE-TREF DEST="CLIENT-SERVER-INTERFACE">/ETS/PortInterfaces/ETS_EchoUINT8Array2Dim</PROVIDED-INTERFACE-TREF>
                </P-PORT-PROTOTYPE>
[!ENDIF!]
[!IF "EnhancedTestabilityService/EchoingDataTypes/echoUINT8ArrayMinSize = 'true'"!]
                <!-- !LINKSTO EB.ETS.Port.18, 1 -->
                <P-PORT-PROTOTYPE>
                  <SHORT-NAME>ETS_EchoUINT8ArrayMinSize</SHORT-NAME>
                  <PROVIDED-INTERFACE-TREF DEST="CLIENT-SERVER-INTERFACE">/ETS/PortInterfaces/ETS_EchoUINT8ArrayMinSize</PROVIDED-INTERFACE-TREF>
                </P-PORT-PROTOTYPE>
[!ENDIF!]
[!IF "EnhancedTestabilityService/EchoingDataTypes/echoUNION = 'true'"!]
                <!-- !LINKSTO EB.ETS.Port.21, 1 -->
                <P-PORT-PROTOTYPE>
                  <SHORT-NAME>ETS_EchoUNION</SHORT-NAME>
                  <PROVIDED-INTERFACE-TREF DEST="CLIENT-SERVER-INTERFACE">/ETS/PortInterfaces/ETS_EchoUNION</PROVIDED-INTERFACE-TREF>
                </P-PORT-PROTOTYPE>
[!ENDIF!]
[!IF "EnhancedTestabilityService/EchoingDataTypes/echoUTF8FIXED = 'true'"!]
                <!-- !LINKSTO EB.ETS.Port.23, 1 -->
                <P-PORT-PROTOTYPE>
                  <SHORT-NAME>ETS_EchoUTF8FIXED</SHORT-NAME>                 
                  <PROVIDED-INTERFACE-TREF DEST="CLIENT-SERVER-INTERFACE">/ETS/PortInterfaces/ETS_EchoUTF8FIXED</PROVIDED-INTERFACE-TREF>
                </P-PORT-PROTOTYPE>
[!ENDIF!]
[!IF "EnhancedTestabilityService/EchoingDataTypes/echoUTF16FIXED = 'true'"!]
                <!-- !LINKSTO EB.ETS.Port.22, 1 -->
                <P-PORT-PROTOTYPE>
                  <SHORT-NAME>ETS_EchoUTF16FIXED</SHORT-NAME>                 
                  <PROVIDED-INTERFACE-TREF DEST="CLIENT-SERVER-INTERFACE">/ETS/PortInterfaces/ETS_EchoUTF16FIXED</PROVIDED-INTERFACE-TREF>
                </P-PORT-PROTOTYPE>
[!ENDIF!]
[!IF "EnhancedTestabilityService/EventsAndFields/TestEventUINT8 = 'true'"!]
                <!-- !LINKSTO EB.ETS.Port.50, 1 -->
                <P-PORT-PROTOTYPE>
                  <SHORT-NAME>ETS_TestEventUINT8</SHORT-NAME>
                  <PROVIDED-COM-SPECS>
                    <NONQUEUED-SENDER-COM-SPEC>
                      <DATA-ELEMENT-REF DEST="VARIABLE-DATA-PROTOTYPE">/ETS/PortInterfaces/ETS_TestEventUINT8/TestEventUINT8</DATA-ELEMENT-REF>
                      <HANDLE-OUT-OF-RANGE>NONE</HANDLE-OUT-OF-RANGE>
                      <USES-END-TO-END-PROTECTION>false</USES-END-TO-END-PROTECTION>
                      <INIT-VALUE>
                        <RECORD-VALUE-SPECIFICATION>
                          <FIELDS>
                            <NUMERICAL-VALUE-SPECIFICATION>
                              <SHORT-LABEL>ElementConstant</SHORT-LABEL>
                              <VALUE>0</VALUE>
                            </NUMERICAL-VALUE-SPECIFICATION>
                          </FIELDS>
                        </RECORD-VALUE-SPECIFICATION>
                      </INIT-VALUE>
                    </NONQUEUED-SENDER-COM-SPEC>
                  </PROVIDED-COM-SPECS>
                  <PROVIDED-INTERFACE-TREF DEST="SENDER-RECEIVER-INTERFACE">/ETS/PortInterfaces/ETS_TestEventUINT8</PROVIDED-INTERFACE-TREF>
                </P-PORT-PROTOTYPE>
[!ENDIF!]
[!IF "EnhancedTestabilityService/EventsAndFields/TestEventUINT8 = 'true'"!]
                <!-- !LINKSTO EB.ETS.Port.46, 1 -->
                <R-PORT-PROTOTYPE>
                  <SHORT-NAME>ETS_TestEventUINT8Client</SHORT-NAME>
                  <REQUIRED-COM-SPECS>
                    <NONQUEUED-RECEIVER-COM-SPEC>
                      <DATA-ELEMENT-REF DEST="VARIABLE-DATA-PROTOTYPE">/ETS/PortInterfaces/ETS_TestEventUINT8/TestEventUINT8</DATA-ELEMENT-REF>
                      <HANDLE-OUT-OF-RANGE>NONE</HANDLE-OUT-OF-RANGE>
                      <USES-END-TO-END-PROTECTION>0</USES-END-TO-END-PROTECTION>
                      <ALIVE-TIMEOUT>0.0</ALIVE-TIMEOUT>
                      <ENABLE-UPDATE>false</ENABLE-UPDATE>
                      <HANDLE-NEVER-RECEIVED>true</HANDLE-NEVER-RECEIVED>
                      <HANDLE-TIMEOUT-TYPE>NONE</HANDLE-TIMEOUT-TYPE>
                      <INIT-VALUE>
                        <RECORD-VALUE-SPECIFICATION>
                          <FIELDS>
                            <APPLICATION-VALUE-SPECIFICATION>
                              <SHORT-LABEL>uINT8Value</SHORT-LABEL>
                              <CATEGORY>VALUE</CATEGORY>
                              <SW-VALUE-CONT>
                                <UNIT-REF DEST="UNIT">/ETS/Units/ETS_NoUnit</UNIT-REF>
                                <SW-VALUES-PHYS>
                                  <V>0</V>
                                </SW-VALUES-PHYS>
                              </SW-VALUE-CONT>
                            </APPLICATION-VALUE-SPECIFICATION>
                          </FIELDS>
                        </RECORD-VALUE-SPECIFICATION>
                      </INIT-VALUE>
                    </NONQUEUED-RECEIVER-COM-SPEC>
                  </REQUIRED-COM-SPECS>
                  <REQUIRED-INTERFACE-TREF DEST="SENDER-RECEIVER-INTERFACE">/ETS/PortInterfaces/ETS_TestEventUINT8</REQUIRED-INTERFACE-TREF>
                </R-PORT-PROTOTYPE>
[!ENDIF!]
[!IF "EnhancedTestabilityService/EventsAndFields/TestEventUINT8Reliable = 'true'"!]
                <!-- !LINKSTO EB.ETS.Port.54, 1 -->
                <P-PORT-PROTOTYPE>
                  <SHORT-NAME>ETS_TestEventUINT8Reliable</SHORT-NAME>
                  <PROVIDED-COM-SPECS>
                    <NONQUEUED-SENDER-COM-SPEC>
                      <DATA-ELEMENT-REF DEST="VARIABLE-DATA-PROTOTYPE">/ETS/PortInterfaces/ETS_TestEventUINT8Reliable/TestEventUINT8Reliable</DATA-ELEMENT-REF>
                      <HANDLE-OUT-OF-RANGE>NONE</HANDLE-OUT-OF-RANGE>
                      <USES-END-TO-END-PROTECTION>false</USES-END-TO-END-PROTECTION>
                      <INIT-VALUE>
                        <RECORD-VALUE-SPECIFICATION>
                          <FIELDS>
                            <NUMERICAL-VALUE-SPECIFICATION>
                              <SHORT-LABEL>ElementConstant</SHORT-LABEL>
                              <VALUE>0</VALUE>
                            </NUMERICAL-VALUE-SPECIFICATION>
                          </FIELDS>
                        </RECORD-VALUE-SPECIFICATION>
                      </INIT-VALUE>
                    </NONQUEUED-SENDER-COM-SPEC>
                  </PROVIDED-COM-SPECS>
                  <PROVIDED-INTERFACE-TREF DEST="SENDER-RECEIVER-INTERFACE">/ETS/PortInterfaces/ETS_TestEventUINT8Reliable</PROVIDED-INTERFACE-TREF>
                </P-PORT-PROTOTYPE>
[!ENDIF!]
[!IF "EnhancedTestabilityService/EventsAndFields/TestEventUINT8Reliable = 'true'"!]
                <!-- !LINKSTO EB.ETS.Port.47, 1 -->
                <R-PORT-PROTOTYPE>
                  <SHORT-NAME>ETS_TestEventUINT8ReliableClient</SHORT-NAME>
                  <REQUIRED-COM-SPECS>
                    <NONQUEUED-RECEIVER-COM-SPEC>
                      <DATA-ELEMENT-REF DEST="VARIABLE-DATA-PROTOTYPE">/ETS/PortInterfaces/ETS_TestEventUINT8Reliable/TestEventUINT8Reliable</DATA-ELEMENT-REF>
                      <HANDLE-OUT-OF-RANGE>NONE</HANDLE-OUT-OF-RANGE>
                      <USES-END-TO-END-PROTECTION>0</USES-END-TO-END-PROTECTION>
                      <ALIVE-TIMEOUT>0.0</ALIVE-TIMEOUT>
                      <ENABLE-UPDATE>false</ENABLE-UPDATE>
                      <HANDLE-NEVER-RECEIVED>true</HANDLE-NEVER-RECEIVED>
                      <HANDLE-TIMEOUT-TYPE>NONE</HANDLE-TIMEOUT-TYPE>
                      <INIT-VALUE>
                        <RECORD-VALUE-SPECIFICATION>
                          <FIELDS>
                            <APPLICATION-VALUE-SPECIFICATION>
                              <SHORT-LABEL>uINT8Value</SHORT-LABEL>
                              <CATEGORY>VALUE</CATEGORY>
                              <SW-VALUE-CONT>
                                <UNIT-REF DEST="UNIT">/ETS/Units/ETS_NoUnit</UNIT-REF>
                                <SW-VALUES-PHYS>
                                  <V>0</V>
                                </SW-VALUES-PHYS>
                              </SW-VALUE-CONT>
                            </APPLICATION-VALUE-SPECIFICATION>
                          </FIELDS>
                        </RECORD-VALUE-SPECIFICATION>
                      </INIT-VALUE>
                    </NONQUEUED-RECEIVER-COM-SPEC>
                  </REQUIRED-COM-SPECS>
                  <REQUIRED-INTERFACE-TREF DEST="SENDER-RECEIVER-INTERFACE">/ETS/PortInterfaces/ETS_TestEventUINT8Reliable</REQUIRED-INTERFACE-TREF>
                </R-PORT-PROTOTYPE>
[!ENDIF!]
[!IF "EnhancedTestabilityService/EventsAndFields/TestEventUINT8Array = 'true'"!]
                <!-- !LINKSTO EB.ETS.Port.52, 1 -->
                <P-PORT-PROTOTYPE>
                  <SHORT-NAME>ETS_TestEventUINT8Array</SHORT-NAME>
                  <PROVIDED-COM-SPECS>
                    <QUEUED-SENDER-COM-SPEC>
                      <DATA-ELEMENT-REF DEST="VARIABLE-DATA-PROTOTYPE">/ETS/PortInterfaces/ETS_TestEventUINT8Array/TestEventUINT8Array</DATA-ELEMENT-REF>
                      <HANDLE-OUT-OF-RANGE>NONE</HANDLE-OUT-OF-RANGE>
                      <TRANSMISSION-ACKNOWLEDGE>
                        <TIMEOUT>0.0</TIMEOUT>
                      </TRANSMISSION-ACKNOWLEDGE>
                      <USES-END-TO-END-PROTECTION>0</USES-END-TO-END-PROTECTION>
                    </QUEUED-SENDER-COM-SPEC>
                  </PROVIDED-COM-SPECS>
                  <PROVIDED-INTERFACE-TREF DEST="SENDER-RECEIVER-INTERFACE">/ETS/PortInterfaces/ETS_TestEventUINT8Array</PROVIDED-INTERFACE-TREF>
                </P-PORT-PROTOTYPE>
[!ENDIF!]
[!IF "EnhancedTestabilityService/EventsAndFields/TestEventUINT8Array = 'true'"!]
                <!-- !LINKSTO EB.ETS.Port.45, 1 -->
                <R-PORT-PROTOTYPE>
                  <SHORT-NAME>ETS_TestEventUINT8ArrayClient</SHORT-NAME>
                  <REQUIRED-COM-SPECS>
                    <QUEUED-RECEIVER-COM-SPEC>
                      <DATA-ELEMENT-REF DEST="VARIABLE-DATA-PROTOTYPE">/ETS/PortInterfaces/ETS_TestEventUINT8Array/TestEventUINT8Array</DATA-ELEMENT-REF>
                      <HANDLE-OUT-OF-RANGE>NONE</HANDLE-OUT-OF-RANGE>
                      <USES-END-TO-END-PROTECTION>false</USES-END-TO-END-PROTECTION>
                      <QUEUE-LENGTH>1</QUEUE-LENGTH>
                    </QUEUED-RECEIVER-COM-SPEC>
                  </REQUIRED-COM-SPECS>
                  <REQUIRED-INTERFACE-TREF DEST="SENDER-RECEIVER-INTERFACE">/ETS/PortInterfaces/ETS_TestEventUINT8Array</REQUIRED-INTERFACE-TREF>
                </R-PORT-PROTOTYPE>
[!ENDIF!]
[!IF "EnhancedTestabilityService/EventsAndFields/TestEventUINT8E2E = 'true'"!]
                <!-- !LINKSTO EB.ETS.Port.51, 1 -->
                <P-PORT-PROTOTYPE>
                  <SHORT-NAME>ETS_TestEventUINT8E2E</SHORT-NAME>
                  <PROVIDED-COM-SPECS>
                    <NONQUEUED-SENDER-COM-SPEC>
                      <DATA-ELEMENT-REF DEST="VARIABLE-DATA-PROTOTYPE">/ETS/PortInterfaces/ETS_TestEventUINT8E2E/TestEventUINT8E2E</DATA-ELEMENT-REF>
                      <HANDLE-OUT-OF-RANGE>NONE</HANDLE-OUT-OF-RANGE>
                      <USES-END-TO-END-PROTECTION>false</USES-END-TO-END-PROTECTION>
                      <INIT-VALUE>
                        <RECORD-VALUE-SPECIFICATION>
                          <FIELDS>
                            <NUMERICAL-VALUE-SPECIFICATION>
                              <SHORT-LABEL>ElementConstant</SHORT-LABEL>
                              <VALUE>0</VALUE>
                            </NUMERICAL-VALUE-SPECIFICATION>
                          </FIELDS>
                        </RECORD-VALUE-SPECIFICATION>
                      </INIT-VALUE>
                    </NONQUEUED-SENDER-COM-SPEC>
                  </PROVIDED-COM-SPECS>
                  <PROVIDED-INTERFACE-TREF DEST="SENDER-RECEIVER-INTERFACE">/ETS/PortInterfaces/ETS_TestEventUINT8E2E</PROVIDED-INTERFACE-TREF>
                </P-PORT-PROTOTYPE>
[!ENDIF!]
[!IF "EnhancedTestabilityService/EventsAndFields/TestEventUINT8E2E = 'true'"!]
                <!-- !LINKSTO EB.ETS.Port.49, 1 -->
                <R-PORT-PROTOTYPE>
                  <SHORT-NAME>ETS_TestEventUINT8E2EClient</SHORT-NAME>
                  <REQUIRED-COM-SPECS>
                    <NONQUEUED-RECEIVER-COM-SPEC>
                      <DATA-ELEMENT-REF DEST="VARIABLE-DATA-PROTOTYPE">/ETS/PortInterfaces/ETS_TestEventUINT8E2E/TestEventUINT8E2E</DATA-ELEMENT-REF>
                      <HANDLE-OUT-OF-RANGE>NONE</HANDLE-OUT-OF-RANGE>
                      <USES-END-TO-END-PROTECTION>0</USES-END-TO-END-PROTECTION>
                      <ALIVE-TIMEOUT>0.0</ALIVE-TIMEOUT>
                      <ENABLE-UPDATE>false</ENABLE-UPDATE>
                      <HANDLE-NEVER-RECEIVED>true</HANDLE-NEVER-RECEIVED>
                      <HANDLE-TIMEOUT-TYPE>NONE</HANDLE-TIMEOUT-TYPE>
                      <INIT-VALUE>
                        <RECORD-VALUE-SPECIFICATION>
                          <FIELDS>
                            <APPLICATION-VALUE-SPECIFICATION>
                              <SHORT-LABEL>uINT8Value</SHORT-LABEL>
                              <CATEGORY>VALUE</CATEGORY>
                              <SW-VALUE-CONT>
                                <UNIT-REF DEST="UNIT">/ETS/Units/ETS_NoUnit</UNIT-REF>
                                <SW-VALUES-PHYS>
                                  <V>0</V>
                                </SW-VALUES-PHYS>
                              </SW-VALUE-CONT>
                            </APPLICATION-VALUE-SPECIFICATION>
                          </FIELDS>
                        </RECORD-VALUE-SPECIFICATION>
                      </INIT-VALUE>
                    </NONQUEUED-RECEIVER-COM-SPEC>
                  </REQUIRED-COM-SPECS>
                  <REQUIRED-INTERFACE-TREF DEST="SENDER-RECEIVER-INTERFACE">/ETS/PortInterfaces/ETS_TestEventUINT8E2E</REQUIRED-INTERFACE-TREF>
                </R-PORT-PROTOTYPE>
[!ENDIF!]
[!IF "EnhancedTestabilityService/EventsAndFields/TestEventUINT8Multicast = 'true'"!]
                <!-- !LINKSTO EB.ETS.Port.53, 1 -->
                <P-PORT-PROTOTYPE>
                  <SHORT-NAME>ETS_TestEventUINT8Multicast</SHORT-NAME>
                  <PROVIDED-COM-SPECS>
                    <NONQUEUED-SENDER-COM-SPEC>
                      <DATA-ELEMENT-REF DEST="VARIABLE-DATA-PROTOTYPE">/ETS/PortInterfaces/ETS_TestEventUINT8Multicast/TestEventUINT8Multicast</DATA-ELEMENT-REF>
                      <HANDLE-OUT-OF-RANGE>NONE</HANDLE-OUT-OF-RANGE>
                      <USES-END-TO-END-PROTECTION>false</USES-END-TO-END-PROTECTION>
                      <INIT-VALUE>
                        <RECORD-VALUE-SPECIFICATION>
                          <FIELDS>
                            <NUMERICAL-VALUE-SPECIFICATION>
                              <SHORT-LABEL>ElementConstant</SHORT-LABEL>
                              <VALUE>0</VALUE>
                            </NUMERICAL-VALUE-SPECIFICATION>
                          </FIELDS>
                        </RECORD-VALUE-SPECIFICATION>
                      </INIT-VALUE>
                    </NONQUEUED-SENDER-COM-SPEC>
                  </PROVIDED-COM-SPECS>
                  <PROVIDED-INTERFACE-TREF DEST="SENDER-RECEIVER-INTERFACE">/ETS/PortInterfaces/ETS_TestEventUINT8Multicast</PROVIDED-INTERFACE-TREF>
                </P-PORT-PROTOTYPE>
[!ENDIF!]
[!IF "EnhancedTestabilityService/EventsAndFields/TestEventUINT8Multicast = 'true'"!]
                <!-- !LINKSTO EB.ETS.Port.48, 1 -->
                <R-PORT-PROTOTYPE>
                  <SHORT-NAME>ETS_TestEventUINT8MulticastClient</SHORT-NAME>
                  <REQUIRED-COM-SPECS>
                    <NONQUEUED-RECEIVER-COM-SPEC>
                      <DATA-ELEMENT-REF DEST="VARIABLE-DATA-PROTOTYPE">/ETS/PortInterfaces/ETS_TestEventUINT8Multicast/TestEventUINT8Multicast</DATA-ELEMENT-REF>
                      <HANDLE-OUT-OF-RANGE>NONE</HANDLE-OUT-OF-RANGE>
                      <USES-END-TO-END-PROTECTION>0</USES-END-TO-END-PROTECTION>
                      <ALIVE-TIMEOUT>0.0</ALIVE-TIMEOUT>
                      <ENABLE-UPDATE>false</ENABLE-UPDATE>
                      <HANDLE-NEVER-RECEIVED>true</HANDLE-NEVER-RECEIVED>
                      <HANDLE-TIMEOUT-TYPE>NONE</HANDLE-TIMEOUT-TYPE>
                      <INIT-VALUE>
                        <RECORD-VALUE-SPECIFICATION>
                          <FIELDS>
                            <APPLICATION-VALUE-SPECIFICATION>
                              <SHORT-LABEL>uINT8Value</SHORT-LABEL>
                              <CATEGORY>VALUE</CATEGORY>
                              <SW-VALUE-CONT>
                                <UNIT-REF DEST="UNIT">/ETS/Units/ETS_NoUnit</UNIT-REF>
                                <SW-VALUES-PHYS>
                                  <V>0</V>
                                </SW-VALUES-PHYS>
                              </SW-VALUE-CONT>
                            </APPLICATION-VALUE-SPECIFICATION>
                          </FIELDS>
                        </RECORD-VALUE-SPECIFICATION>
                      </INIT-VALUE>
                    </NONQUEUED-RECEIVER-COM-SPEC>
                  </REQUIRED-COM-SPECS>
                  <REQUIRED-INTERFACE-TREF DEST="SENDER-RECEIVER-INTERFACE">/ETS/PortInterfaces/ETS_TestEventUINT8Multicast</REQUIRED-INTERFACE-TREF>
                </R-PORT-PROTOTYPE>
[!ENDIF!]
[!IF "EnhancedTestabilityService/EventsAndFields/TestFieldUINT8 = 'true'"!]
                <!-- !LINKSTO EB.ETS.Port.38, 1 -->
                <P-PORT-PROTOTYPE>
                  <SHORT-NAME>ETS_TestFieldUINT8</SHORT-NAME>
                  <PROVIDED-INTERFACE-TREF DEST="CLIENT-SERVER-INTERFACE">/ETS/PortInterfaces/ETS_TestFieldUINT8</PROVIDED-INTERFACE-TREF>
                </P-PORT-PROTOTYPE>
[!ENDIF!]
[!IF "EnhancedTestabilityService/EventsAndFields/TestFieldUINT8Reliable = 'true'"!]
                <!-- !LINKSTO EB.ETS.Port.40, 1 -->
                <P-PORT-PROTOTYPE>
                  <SHORT-NAME>ETS_TestFieldUINT8Reliable</SHORT-NAME>
                  <PROVIDED-INTERFACE-TREF DEST="CLIENT-SERVER-INTERFACE">/ETS/PortInterfaces/ETS_TestFieldUINT8Reliable</PROVIDED-INTERFACE-TREF>
                </P-PORT-PROTOTYPE>
[!ENDIF!]
[!IF "EnhancedTestabilityService/EventsAndFields/TestFieldUINT8Array = 'true'"!]
                <!-- !LINKSTO EB.ETS.Port.39, 1 -->
                <P-PORT-PROTOTYPE>
                  <SHORT-NAME>ETS_TestFieldUINT8Array</SHORT-NAME>
                  <PROVIDED-INTERFACE-TREF DEST="CLIENT-SERVER-INTERFACE">/ETS/PortInterfaces/ETS_TestFieldUINT8Array</PROVIDED-INTERFACE-TREF>
                </P-PORT-PROTOTYPE>
[!ENDIF!]
[!IF "EnhancedTestabilityService/EventsAndFields/TestFieldUINT8 = 'true'"!]
                <!-- !LINKSTO EB.ETS.Port.44, 1 -->
                <P-PORT-PROTOTYPE>
                  <SHORT-NAME>ETS_NotifyFieldTestFieldUINT8</SHORT-NAME>
                  <PROVIDED-COM-SPECS>
                    <NONQUEUED-SENDER-COM-SPEC>
                      <DATA-ELEMENT-REF DEST="VARIABLE-DATA-PROTOTYPE">/ETS/PortInterfaces/ETS_NotifyFieldTestFieldUINT8/Notifier</DATA-ELEMENT-REF>
                      <HANDLE-OUT-OF-RANGE>NONE</HANDLE-OUT-OF-RANGE>
                      <USES-END-TO-END-PROTECTION>false</USES-END-TO-END-PROTECTION>
                      <INIT-VALUE>
                        <NUMERICAL-VALUE-SPECIFICATION>
                          <VALUE>0</VALUE>
                        </NUMERICAL-VALUE-SPECIFICATION>
                      </INIT-VALUE>
                    </NONQUEUED-SENDER-COM-SPEC>
                  </PROVIDED-COM-SPECS>
                  <PROVIDED-INTERFACE-TREF DEST="SENDER-RECEIVER-INTERFACE">/ETS/PortInterfaces/ETS_NotifyFieldTestFieldUINT8</PROVIDED-INTERFACE-TREF>
                  </P-PORT-PROTOTYPE>
[!ENDIF!]
[!IF "EnhancedTestabilityService/EventsAndFields/TestFieldUINT8Reliable = 'true'"!]
                <!-- !LINKSTO EB.ETS.Port.41, 1 -->
                  <P-PORT-PROTOTYPE>
                  <SHORT-NAME>ETS_NotifyFieldTestFieldUINT8Reliable</SHORT-NAME>
                  <PROVIDED-COM-SPECS>
                    <NONQUEUED-SENDER-COM-SPEC>
                      <DATA-ELEMENT-REF DEST="VARIABLE-DATA-PROTOTYPE">/ETS/PortInterfaces/ETS_NotifyFieldTestFieldUINT8Reliable/Notifier</DATA-ELEMENT-REF>
                      <HANDLE-OUT-OF-RANGE>NONE</HANDLE-OUT-OF-RANGE>
                      <USES-END-TO-END-PROTECTION>false</USES-END-TO-END-PROTECTION>
                      <INIT-VALUE>
                        <NUMERICAL-VALUE-SPECIFICATION>
                          <VALUE>0</VALUE>
                        </NUMERICAL-VALUE-SPECIFICATION>
                      </INIT-VALUE>
                    </NONQUEUED-SENDER-COM-SPEC>
                  </PROVIDED-COM-SPECS>
                  <PROVIDED-INTERFACE-TREF DEST="SENDER-RECEIVER-INTERFACE">/ETS/PortInterfaces/ETS_NotifyFieldTestFieldUINT8Reliable</PROVIDED-INTERFACE-TREF>
                </P-PORT-PROTOTYPE>
[!ENDIF!]
[!IF "EnhancedTestabilityService/EventsAndFields/TestFieldUINT8Array = 'true'"!]
                <!-- !LINKSTO EB.ETS.Port.43, 1 -->
                <P-PORT-PROTOTYPE>
                  <SHORT-NAME>ETS_NotifyFieldTestFieldUINT8Array</SHORT-NAME>
                  <PROVIDED-COM-SPECS>
                    <!--<NONQUEUED-SENDER-COM-SPEC>
                              <DATA-ELEMENT-REF DEST="VARIABLE-DATA-PROTOTYPE">/ETS/PortInterfaces/ETS_NotifyFieldTestFieldUINT8Array/Notifier</DATA-ELEMENT-REF>
                              <HANDLE-OUT-OF-RANGE>NONE</HANDLE-OUT-OF-RANGE>
                              <TRANSMISSION-ACKNOWLEDGE>
                                <TIMEOUT>0.0</TIMEOUT>
                              </TRANSMISSION-ACKNOWLEDGE>
                              <USES-END-TO-END-PROTECTION>0</USES-END-TO-END-PROTECTION>
                              <INIT-VALUE>
                                <RECORD-VALUE-SPECIFICATION>
                                  <SHORT-LABEL>InitValue_FieldNotifierTestFieldUINT8Array</SHORT-LABEL>
                                  <FIELDS>
                                    <NUMERICAL-VALUE-SPECIFICATION>
                                      <SHORT-LABEL>size</SHORT-LABEL>
                                      <VALUE>0</VALUE>
                                    </NUMERICAL-VALUE-SPECIFICATION>
                                    <ARRAY-VALUE-SPECIFICATION>
                                      <SHORT-LABEL>elem</SHORT-LABEL>
                                      <ELEMENTS>
                                        <NUMERICAL-VALUE-SPECIFICATION>
                                          <VALUE>0</VALUE>
                                        </NUMERICAL-VALUE-SPECIFICATION>
                                        <NUMERICAL-VALUE-SPECIFICATION>
                                          <VALUE>0</VALUE>
                                        </NUMERICAL-VALUE-SPECIFICATION>
                                        <NUMERICAL-VALUE-SPECIFICATION>
                                          <VALUE>0</VALUE>
                                        </NUMERICAL-VALUE-SPECIFICATION>
                                        <NUMERICAL-VALUE-SPECIFICATION>
                                          <VALUE>0</VALUE>
                                        </NUMERICAL-VALUE-SPECIFICATION>
                                        <NUMERICAL-VALUE-SPECIFICATION>
                                          <VALUE>0</VALUE>
                                        </NUMERICAL-VALUE-SPECIFICATION>
                                      </ELEMENTS>
                                    </ARRAY-VALUE-SPECIFICATION>
                                  </FIELDS>
                                </RECORD-VALUE-SPECIFICATION>
                              </INIT-VALUE>
                            </NONQUEUED-SENDER-COM-SPEC>-->
                  </PROVIDED-COM-SPECS>
                  <PROVIDED-INTERFACE-TREF DEST="SENDER-RECEIVER-INTERFACE">/ETS/PortInterfaces/ETS_NotifyFieldTestFieldUINT8Array</PROVIDED-INTERFACE-TREF>
                </P-PORT-PROTOTYPE>
[!ENDIF!]
[!IF "EnhancedTestabilityService/EventsAndFields/InterfaceVersion = 'true'"!]
                <!-- !LINKSTO EB.ETS.Port.37, 1 -->
                <P-PORT-PROTOTYPE>
                  <SHORT-NAME>ETS_InterfaceVersion</SHORT-NAME>
                  <PROVIDED-INTERFACE-TREF DEST="CLIENT-SERVER-INTERFACE">/ETS/PortInterfaces/ETS_InterfaceVersion</PROVIDED-INTERFACE-TREF>
                </P-PORT-PROTOTYPE>
[!ENDIF!]
[!IF "EnhancedTestabilityService/EventsAndFields/InterfaceVersion = 'true'"!]
                <!-- !LINKSTO EB.ETS.Port.42, 1 -->
                <P-PORT-PROTOTYPE>
                  <SHORT-NAME>ETS_NotifyFieldsInterfaceVersion</SHORT-NAME>
                  <PROVIDED-COM-SPECS>
                    <NONQUEUED-SENDER-COM-SPEC>
                      <DATA-ELEMENT-REF DEST="VARIABLE-DATA-PROTOTYPE">/ETS/PortInterfaces/ETS_NotifyFieldInterfaceVersion/Notifier</DATA-ELEMENT-REF>
                      <HANDLE-OUT-OF-RANGE>NONE</HANDLE-OUT-OF-RANGE>
                      <USES-END-TO-END-PROTECTION>false</USES-END-TO-END-PROTECTION>
                      <INIT-VALUE>
                        <RECORD-VALUE-SPECIFICATION>
                          <FIELDS>
                            <NUMERICAL-VALUE-SPECIFICATION>
                              <SHORT-LABEL>ElementConstant</SHORT-LABEL>
                              <VALUE>0</VALUE>
                            </NUMERICAL-VALUE-SPECIFICATION>
                            <NUMERICAL-VALUE-SPECIFICATION>
                              <SHORT-LABEL>ElementConstant_1</SHORT-LABEL>
                              <VALUE>0</VALUE>
                            </NUMERICAL-VALUE-SPECIFICATION>
                          </FIELDS>
                        </RECORD-VALUE-SPECIFICATION>
                      </INIT-VALUE>
                    </NONQUEUED-SENDER-COM-SPEC>
                  </PROVIDED-COM-SPECS>
                  <PROVIDED-INTERFACE-TREF DEST="SENDER-RECEIVER-INTERFACE">/ETS/PortInterfaces/ETS_NotifyFieldInterfaceVersion</PROVIDED-INTERFACE-TREF>
                </P-PORT-PROTOTYPE>
[!ENDIF!]
[!LOOP "ProjectSpecificTests/*"!]
  [!IF "node:value(ActivateTest) = 'true'"!]
                <P-PORT-PROTOTYPE>
                  <SHORT-NAME>ETS_Pst[!"node:name(.)"!]</SHORT-NAME>
                  <PROVIDED-INTERFACE-TREF DEST="CLIENT-SERVER-INTERFACE">/ETS/PortInterfaces/ETS_Pst[!"node:name(.)"!]</PROVIDED-INTERFACE-TREF>
                </P-PORT-PROTOTYPE>
  [!ENDIF!]
[!ENDLOOP!]
              </PORTS>
              <INTERNAL-BEHAVIORS>
                <SWC-INTERNAL-BEHAVIOR>
                  <SHORT-NAME>IB_ETS</SHORT-NAME>
                  <DATA-TYPE-MAPPING-REFS>
                    <DATA-TYPE-MAPPING-REF DEST="DATA-TYPE-MAPPING-SET">/ETS/DataTypeMappingSets/ETS_ModeMappings</DATA-TYPE-MAPPING-REF>
                    <DATA-TYPE-MAPPING-REF DEST="DATA-TYPE-MAPPING-SET">/ETS/DataTypeMappingSets/ETS_Types</DATA-TYPE-MAPPING-REF>
                    <DATA-TYPE-MAPPING-REF DEST="DATA-TYPE-MAPPING-SET">/ETS/DataTypeMappingSets/ETS_Arrays</DATA-TYPE-MAPPING-REF>
                    <DATA-TYPE-MAPPING-REF DEST="DATA-TYPE-MAPPING-SET">/ETS/DataTypeMappingSets/ETS_Bitfields</DATA-TYPE-MAPPING-REF>
                    <DATA-TYPE-MAPPING-REF DEST="DATA-TYPE-MAPPING-SET">/ETS/DataTypeMappingSets/ETS_Timings</DATA-TYPE-MAPPING-REF>
                  </DATA-TYPE-MAPPING-REFS>
                  <EXCLUSIVE-AREAS>
                    <EXCLUSIVE-AREA>
                      <SHORT-NAME>ETS_EXCLUSIVE_AREA_0</SHORT-NAME>
                    </EXCLUSIVE-AREA>
                  </EXCLUSIVE-AREAS>
                  <EVENTS>
[!IF "EnhancedTestabilityService/TestingClientInteraction/clientServiceActivate = 'true'"!]
                    <!-- !LINKSTO swdd.EB.ETS.Service_dre.1, 1 -->
                    <DATA-RECEIVED-EVENT>
                      <SHORT-NAME>DRE_ClientServiceActivate</SHORT-NAME>
                      <START-ON-EVENT-REF DEST="RUNNABLE-ENTITY">/ETS/SwcImplementations/ETS/IB_ETS/ClientServiceActivate</START-ON-EVENT-REF>
                      <DATA-IREF>
                        <CONTEXT-R-PORT-REF DEST="R-PORT-PROTOTYPE">/ETS/SwcImplementations/ETS/ETS_ClientServiceActivate</CONTEXT-R-PORT-REF>
                        <TARGET-DATA-ELEMENT-REF DEST="VARIABLE-DATA-PROTOTYPE">/ETS/PortInterfaces/ETS_ClientServiceActivate/start</TARGET-DATA-ELEMENT-REF>
                      </DATA-IREF>
                    </DATA-RECEIVED-EVENT>
[!ENDIF!]
[!IF "EnhancedTestabilityService/TestingClientInteraction/clientServiceDeactivate = 'true'"!]
                    <!-- !LINKSTO swdd.EB.ETS.Service_dre.2, 1 -->
                    <DATA-RECEIVED-EVENT>
                      <SHORT-NAME>DRE_ClientServiceDeactivate</SHORT-NAME>
                      <START-ON-EVENT-REF DEST="RUNNABLE-ENTITY">/ETS/SwcImplementations/ETS/IB_ETS/ClientServiceDeactivate</START-ON-EVENT-REF>
                      <DATA-IREF>
                        <CONTEXT-R-PORT-REF DEST="R-PORT-PROTOTYPE">/ETS/SwcImplementations/ETS/ETS_ClientServiceDeactivate</CONTEXT-R-PORT-REF>
                        <TARGET-DATA-ELEMENT-REF DEST="VARIABLE-DATA-PROTOTYPE">/ETS/PortInterfaces/ETS_ClientServiceDeactivate/start</TARGET-DATA-ELEMENT-REF>
                      </DATA-IREF>
                    </DATA-RECEIVED-EVENT>
[!ENDIF!]
[!IF "EnhancedTestabilityService/TestingClientInteraction/clientServiceSubscribeEventgroup = 'true'"!]
                    <!-- !LINKSTO swdd.EB.ETS.Service_dre.3, 1 -->
                    <DATA-RECEIVED-EVENT>
                      <SHORT-NAME>DRE_ClientServiceSubscribeEventgroup</SHORT-NAME>
                      <START-ON-EVENT-REF DEST="RUNNABLE-ENTITY">/ETS/SwcImplementations/ETS/IB_ETS/ClientServiceSubscribeEventgroup</START-ON-EVENT-REF>
                      <DATA-IREF>
                        <CONTEXT-R-PORT-REF DEST="R-PORT-PROTOTYPE">/ETS/SwcImplementations/ETS/ETS_ClientServiceSubscribeEventgroup</CONTEXT-R-PORT-REF>
                        <TARGET-DATA-ELEMENT-REF DEST="VARIABLE-DATA-PROTOTYPE">/ETS/PortInterfaces/ETS_ClientServiceSubscribeEventgroup/clientServiceSubscribeEventgroup</TARGET-DATA-ELEMENT-REF>
                      </DATA-IREF>
                    </DATA-RECEIVED-EVENT>
[!ENDIF!]
[!IF "EnhancedTestabilityService/TestingClientInteraction/suspendInterface = 'true'"!]
                    <!-- !LINKSTO swdd.EB.ETS.Service_dre.4, 1 -->
                    <DATA-RECEIVED-EVENT>
                      <SHORT-NAME>DRE_SuspendInterface</SHORT-NAME>
                      <START-ON-EVENT-REF DEST="RUNNABLE-ENTITY">/ETS/SwcImplementations/ETS/IB_ETS/SuspendInterface</START-ON-EVENT-REF>
                      <DATA-IREF>
                        <CONTEXT-R-PORT-REF DEST="R-PORT-PROTOTYPE">/ETS/SwcImplementations/ETS/ETS_SuspendInterface</CONTEXT-R-PORT-REF>
                        <TARGET-DATA-ELEMENT-REF DEST="VARIABLE-DATA-PROTOTYPE">/ETS/PortInterfaces/ETS_SuspendInterface/suspendInterface</TARGET-DATA-ELEMENT-REF>
                      </DATA-IREF>
                    </DATA-RECEIVED-EVENT>
[!ENDIF!]
[!IF "EnhancedTestabilityService/TestingEvents/triggerEventUINT8 = 'true'"!]
                    <!-- !LINKSTO swdd.EB.ETS.Service_dre.5, 1 -->
                    <DATA-RECEIVED-EVENT>
                      <SHORT-NAME>DRE_TriggerEventUINT8</SHORT-NAME>
                      <START-ON-EVENT-REF DEST="RUNNABLE-ENTITY">/ETS/SwcImplementations/ETS/IB_ETS/TriggerEventUINT8</START-ON-EVENT-REF>
                      <DATA-IREF>
                        <CONTEXT-R-PORT-REF DEST="R-PORT-PROTOTYPE">/ETS/SwcImplementations/ETS/ETS_TriggerEventUINT8</CONTEXT-R-PORT-REF>
                        <TARGET-DATA-ELEMENT-REF DEST="VARIABLE-DATA-PROTOTYPE">/ETS/PortInterfaces/ETS_TriggerEventUINT8/triggerEventUINT8</TARGET-DATA-ELEMENT-REF>
                      </DATA-IREF>
                    </DATA-RECEIVED-EVENT>
[!ENDIF!]
[!IF "EnhancedTestabilityService/TestingEvents/triggerEventUINT8Array = 'true'"!]
                    <!-- !LINKSTO swdd.EB.ETS.Service_dre.6, 1 -->
                    <DATA-RECEIVED-EVENT>
                      <SHORT-NAME>DRE_TriggerEventUINT8Array</SHORT-NAME>
                      <START-ON-EVENT-REF DEST="RUNNABLE-ENTITY">/ETS/SwcImplementations/ETS/IB_ETS/TriggerEventUINT8Array</START-ON-EVENT-REF>
                      <DATA-IREF>
                        <CONTEXT-R-PORT-REF DEST="R-PORT-PROTOTYPE">/ETS/SwcImplementations/ETS/ETS_TriggerEventUINT8Array</CONTEXT-R-PORT-REF>
                        <TARGET-DATA-ELEMENT-REF DEST="VARIABLE-DATA-PROTOTYPE">/ETS/PortInterfaces/ETS_TriggerEventUINT8Array/triggerEventUINT8Array</TARGET-DATA-ELEMENT-REF>
                      </DATA-IREF>
                    </DATA-RECEIVED-EVENT>
[!ENDIF!]
[!IF "EnhancedTestabilityService/TestingEvents/triggerEventUINT8E2E = 'true'"!]
                    <!-- !LINKSTO swdd.EB.ETS.Service_dre.7, 1 -->
                    <DATA-RECEIVED-EVENT>
                      <SHORT-NAME>DRE_TriggerEventUINT8E2E</SHORT-NAME>
                      <START-ON-EVENT-REF DEST="RUNNABLE-ENTITY">/ETS/SwcImplementations/ETS/IB_ETS/TriggerEventUINT8E2E</START-ON-EVENT-REF>
                      <DATA-IREF>
                        <CONTEXT-R-PORT-REF DEST="R-PORT-PROTOTYPE">/ETS/SwcImplementations/ETS/ETS_TriggerEventUINT8E2E</CONTEXT-R-PORT-REF>
                        <TARGET-DATA-ELEMENT-REF DEST="VARIABLE-DATA-PROTOTYPE">/ETS/PortInterfaces/ETS_TriggerEventUINT8E2E/triggerEventUINT8E2E</TARGET-DATA-ELEMENT-REF>
                      </DATA-IREF>
                    </DATA-RECEIVED-EVENT>
[!ENDIF!]
[!IF "EnhancedTestabilityService/TestingEvents/triggerEventUINT8Multicast = 'true'"!]
                    <!-- !LINKSTO swdd.EB.ETS.Service_dre.8, 1 -->
                    <DATA-RECEIVED-EVENT>
                      <SHORT-NAME>DRE_TriggerEventUINT8Multicast</SHORT-NAME>
                      <START-ON-EVENT-REF DEST="RUNNABLE-ENTITY">/ETS/SwcImplementations/ETS/IB_ETS/TriggerEventUINT8Multicast</START-ON-EVENT-REF>
                      <DATA-IREF>
                        <CONTEXT-R-PORT-REF DEST="R-PORT-PROTOTYPE">/ETS/SwcImplementations/ETS/ETS_TriggerEventUINT8Multicast</CONTEXT-R-PORT-REF>
                        <TARGET-DATA-ELEMENT-REF DEST="VARIABLE-DATA-PROTOTYPE">/ETS/PortInterfaces/ETS_TriggerEventUINT8Multicast/triggerEventUINT8Multicast</TARGET-DATA-ELEMENT-REF>
                      </DATA-IREF>
                    </DATA-RECEIVED-EVENT>
[!ENDIF!]
[!IF "EnhancedTestabilityService/TestingEvents/triggerEventUINT8Reliable = 'true'"!]
                    <!-- !LINKSTO swdd.EB.ETS.Service_dre.9, 1 -->
                    <DATA-RECEIVED-EVENT>
                      <SHORT-NAME>DRE_triggerEventUINT8Reliable</SHORT-NAME>
                      <START-ON-EVENT-REF DEST="RUNNABLE-ENTITY">/ETS/SwcImplementations/ETS/IB_ETS/TriggerEventUINT8Reliable</START-ON-EVENT-REF>
                      <DATA-IREF>
                        <CONTEXT-R-PORT-REF DEST="R-PORT-PROTOTYPE">/ETS/SwcImplementations/ETS/ETS_TriggerEventUINT8Reliable</CONTEXT-R-PORT-REF>
                        <TARGET-DATA-ELEMENT-REF DEST="VARIABLE-DATA-PROTOTYPE">/ETS/PortInterfaces/ETS_TriggerEventUINT8Reliable/triggerEventUINT8Reliable</TARGET-DATA-ELEMENT-REF>
                      </DATA-IREF>
                    </DATA-RECEIVED-EVENT>
[!ENDIF!]
[!IF "EnhancedTestabilityService/TestingClientInteraction/resetInterface = 'true'"!]
                    <!-- !LINKSTO swdd.EB.ETS.Service_ext_trigg.1, 1 -->
                    <EXTERNAL-TRIGGER-OCCURRED-EVENT>
                      <SHORT-NAME>ETOE_ResetInterface</SHORT-NAME>
                      <START-ON-EVENT-REF DEST="RUNNABLE-ENTITY">/ETS/SwcImplementations/ETS/IB_ETS/ResetInterface</START-ON-EVENT-REF>
                      <TRIGGER-IREF>
                        <CONTEXT-R-PORT-REF DEST="R-PORT-PROTOTYPE">/ETS/SwcImplementations/ETS/ETS_ResetInterface</CONTEXT-R-PORT-REF>
                        <TARGET-TRIGGER-REF DEST="TRIGGER">/ETS/PortInterfaces/ETS_ResetInterface/Reset</TARGET-TRIGGER-REF>
                      </TRIGGER-IREF>
                    </EXTERNAL-TRIGGER-OCCURRED-EVENT>
[!ENDIF!]
                    <SWC-MODE-SWITCH-EVENT>
                      <SHORT-NAME>MSE_ETS_OnEntryRun</SHORT-NAME>
                      <START-ON-EVENT-REF DEST="RUNNABLE-ENTITY">/ETS/SwcImplementations/ETS/IB_ETS/Init</START-ON-EVENT-REF>
                      <ACTIVATION>ON-ENTRY</ACTIVATION>
                      <MODE-IREFS>
                        <MODE-IREF>
                          <CONTEXT-PORT-REF DEST="R-PORT-PROTOTYPE">/ETS/SwcImplementations/ETS/currentMode</CONTEXT-PORT-REF>
                          <CONTEXT-MODE-DECLARATION-GROUP-PROTOTYPE-REF DEST="MODE-DECLARATION-GROUP-PROTOTYPE">/ETS/PortInterfaces/ETS_SwitchPort_CurrentMode/CurrentMode</CONTEXT-MODE-DECLARATION-GROUP-PROTOTYPE-REF>
                          <TARGET-MODE-DECLARATION-REF DEST="MODE-DECLARATION">/ETS/ModeDeclarationGroups/ETS_CurrentMode/ETS_INIT_MODE</TARGET-MODE-DECLARATION-REF>
                        </MODE-IREF>
                      </MODE-IREFS>
                    </SWC-MODE-SWITCH-EVENT>
[!IF "EnhancedTestabilityService/TestingClientInteraction/checkByteOrder = 'true'"!]
                    <OPERATION-INVOKED-EVENT>
                      <SHORT-NAME>OIE_ETS_CheckByteOrder_ETS_CheckByteOrder</SHORT-NAME>
                      <START-ON-EVENT-REF DEST="RUNNABLE-ENTITY">/ETS/SwcImplementations/ETS/IB_ETS/CheckByteOrder</START-ON-EVENT-REF>
                      <OPERATION-IREF>
                        <CONTEXT-P-PORT-REF DEST="P-PORT-PROTOTYPE">/ETS/SwcImplementations/ETS/ETS_CheckByteOrder</CONTEXT-P-PORT-REF>
                        <TARGET-PROVIDED-OPERATION-REF DEST="CLIENT-SERVER-OPERATION">/ETS/PortInterfaces/ETS_CheckByteOrder/ETS_CheckByteOrder</TARGET-PROVIDED-OPERATION-REF>
                      </OPERATION-IREF>
                    </OPERATION-INVOKED-EVENT>
[!ENDIF!]
[!IF "EnhancedTestabilityService/TestingClientInteraction/clientServiceCallEchoUINT8Array = 'true'"!]
                    <OPERATION-INVOKED-EVENT>
                      <SHORT-NAME>OIE_ETS_ClientServiceCallEchoUINT8Array_ETS_ClientServiceCallEchoUINT8Array</SHORT-NAME>
                      <START-ON-EVENT-REF DEST="RUNNABLE-ENTITY">/ETS/SwcImplementations/ETS/IB_ETS/ClientServiceCallEchoUINT8Array</START-ON-EVENT-REF>
                      <OPERATION-IREF>
                        <CONTEXT-P-PORT-REF DEST="P-PORT-PROTOTYPE">/ETS/SwcImplementations/ETS/ETS_ClientServiceCallEchoUINT8Array</CONTEXT-P-PORT-REF>
                        <TARGET-PROVIDED-OPERATION-REF DEST="CLIENT-SERVER-OPERATION">/ETS/PortInterfaces/ETS_ClientServiceCallEchoUINT8Array/ETS_ClientServiceCallEchoUINT8Array</TARGET-PROVIDED-OPERATION-REF>
                      </OPERATION-IREF>
                    </OPERATION-INVOKED-EVENT>
[!ENDIF!]
[!IF "EnhancedTestabilityService/TestingClientInteraction/clientServiceGetLastValueOfEventTCP = 'true'"!]
                    <OPERATION-INVOKED-EVENT>
                      <SHORT-NAME>OIE_ETS_ClientServiceGetLastValueOfEventTCP_ETS_ClientServiceGetLastValueOfEventTCP</SHORT-NAME>
                      <START-ON-EVENT-REF DEST="RUNNABLE-ENTITY">/ETS/SwcImplementations/ETS/IB_ETS/ClientServiceGetLastValueOfEventTCP</START-ON-EVENT-REF>
                      <OPERATION-IREF>
                        <CONTEXT-P-PORT-REF DEST="P-PORT-PROTOTYPE">/ETS/SwcImplementations/ETS/ETS_ClientServiceGetLastValueOfEventTCP</CONTEXT-P-PORT-REF>
                        <TARGET-PROVIDED-OPERATION-REF DEST="CLIENT-SERVER-OPERATION">/ETS/PortInterfaces/ETS_ClientServiceGetLastValueOfEventTCP/ETS_ClientServiceGetLastValueOfEventTCP</TARGET-PROVIDED-OPERATION-REF>
                      </OPERATION-IREF>
                    </OPERATION-INVOKED-EVENT>
[!ENDIF!]
[!IF "EnhancedTestabilityService/TestingClientInteraction/clientServiceGetLastValueOfEventUDPMulticast = 'true'"!]
                    <OPERATION-INVOKED-EVENT>
                      <SHORT-NAME>OIE_ETS_ClientServiceGetLastValueOfEventUDPMulticast_ETS_ClientServiceGetLastValueOfEventUDPMulticast</SHORT-NAME>
                      <START-ON-EVENT-REF DEST="RUNNABLE-ENTITY">/ETS/SwcImplementations/ETS/IB_ETS/ClientServiceGetLastValueOfEventUDPMulticast</START-ON-EVENT-REF>
                      <OPERATION-IREF>
                        <CONTEXT-P-PORT-REF DEST="P-PORT-PROTOTYPE">/ETS/SwcImplementations/ETS/ETS_ClientServiceGetLastValueOfEventUDPMulticast</CONTEXT-P-PORT-REF>
                        <TARGET-PROVIDED-OPERATION-REF DEST="CLIENT-SERVER-OPERATION">/ETS/PortInterfaces/ETS_ClientServiceGetLastValueOfEventUDPMulticast/ETS_ClientServiceGetLastValueOfEventUDPMulticast</TARGET-PROVIDED-OPERATION-REF>
                      </OPERATION-IREF>
                    </OPERATION-INVOKED-EVENT>
[!ENDIF!]
[!IF "EnhancedTestabilityService/TestingClientInteraction/clientServiceGetLastValueOfEventUDPUnicast = 'true'"!]
                    <OPERATION-INVOKED-EVENT>
                      <SHORT-NAME>OIE_ETS_ClientServiceGetLastValueOfEventUDPUnicast_ETS_ClientServiceGetLastValueOfEventUDPUnicast</SHORT-NAME>
                      <START-ON-EVENT-REF DEST="RUNNABLE-ENTITY">/ETS/SwcImplementations/ETS/IB_ETS/ClientServiceGetLastValueOfEventUDPUnicast</START-ON-EVENT-REF>
                      <OPERATION-IREF>
                        <CONTEXT-P-PORT-REF DEST="P-PORT-PROTOTYPE">/ETS/SwcImplementations/ETS/ETS_ClientServiceGetLastValueOfEventUDPUnicast</CONTEXT-P-PORT-REF>
                        <TARGET-PROVIDED-OPERATION-REF DEST="CLIENT-SERVER-OPERATION">/ETS/PortInterfaces/ETS_ClientServiceGetLastValueOfEventUDPUnicast/ETS_ClientServiceGetLastValueOfEventUDPUnicast</TARGET-PROVIDED-OPERATION-REF>
                      </OPERATION-IREF>
                    </OPERATION-INVOKED-EVENT>
[!ENDIF!]
[!IF "EnhancedTestabilityService/EchoingDataTypes/echoCommonDatatypes = 'true'"!]
                    <OPERATION-INVOKED-EVENT>
                      <SHORT-NAME>OIE_ETS_EchoCommonDatatypes</SHORT-NAME>
                      <START-ON-EVENT-REF DEST="RUNNABLE-ENTITY">/ETS/SwcImplementations/ETS/IB_ETS/EchoCommonDatatypes</START-ON-EVENT-REF>
                      <OPERATION-IREF>
                        <CONTEXT-P-PORT-REF DEST="P-PORT-PROTOTYPE">/ETS/SwcImplementations/ETS/ETS_EchoCommonDatatypes</CONTEXT-P-PORT-REF>
                        <TARGET-PROVIDED-OPERATION-REF DEST="CLIENT-SERVER-OPERATION">/ETS/PortInterfaces/ETS_EchoCommonDatatypes/EchoCommonDatatypes</TARGET-PROVIDED-OPERATION-REF>
                      </OPERATION-IREF>
                    </OPERATION-INVOKED-EVENT>
[!ENDIF!]
[!IF "EnhancedTestabilityService/EchoingDataTypes/echoUINT8 = 'true'"!]
                    <OPERATION-INVOKED-EVENT>
                      <SHORT-NAME>OIE_ETS_EchoUINT8</SHORT-NAME>
                      <START-ON-EVENT-REF DEST="RUNNABLE-ENTITY">/ETS/SwcImplementations/ETS/IB_ETS/EchoUINT8</START-ON-EVENT-REF>
                      <OPERATION-IREF>
                        <CONTEXT-P-PORT-REF DEST="P-PORT-PROTOTYPE">/ETS/SwcImplementations/ETS/ETS_EchoUINT8</CONTEXT-P-PORT-REF>
                        <TARGET-PROVIDED-OPERATION-REF DEST="CLIENT-SERVER-OPERATION">/ETS/PortInterfaces/ETS_EchoUINT8/EchoUINT8</TARGET-PROVIDED-OPERATION-REF>
                      </OPERATION-IREF>
                    </OPERATION-INVOKED-EVENT>
[!ENDIF!]
                    <!-- !LINKSTO swdd.EB.ETS.Service_TimingEvent.1, 1 -->
                    <!-- !LINKSTO EB.ETS.interface.13, 1 -->
                    <TIMING-EVENT>
                      <SHORT-NAME>TE_ETS_MainFunction</SHORT-NAME>
                      <DISABLED-MODE-IREFS>
                        <DISABLED-MODE-IREF>
                          <CONTEXT-PORT-REF DEST="R-PORT-PROTOTYPE">/ETS/SwcImplementations/ETS/currentMode</CONTEXT-PORT-REF>
                          <CONTEXT-MODE-DECLARATION-GROUP-PROTOTYPE-REF DEST="MODE-DECLARATION-GROUP-PROTOTYPE">/ETS/PortInterfaces/ETS_SwitchPort_CurrentMode/CurrentMode</CONTEXT-MODE-DECLARATION-GROUP-PROTOTYPE-REF>
                          <TARGET-MODE-DECLARATION-REF DEST="MODE-DECLARATION">/ETS/ModeDeclarationGroups/ETS_CurrentMode/ETS_INIT_MODE</TARGET-MODE-DECLARATION-REF>
                        </DISABLED-MODE-IREF>
                        <DISABLED-MODE-IREF>
                          <CONTEXT-PORT-REF DEST="R-PORT-PROTOTYPE">/ETS/SwcImplementations/ETS/currentMode</CONTEXT-PORT-REF>
                          <CONTEXT-MODE-DECLARATION-GROUP-PROTOTYPE-REF DEST="MODE-DECLARATION-GROUP-PROTOTYPE">/ETS/PortInterfaces/ETS_SwitchPort_CurrentMode/CurrentMode</CONTEXT-MODE-DECLARATION-GROUP-PROTOTYPE-REF>
                          <TARGET-MODE-DECLARATION-REF DEST="MODE-DECLARATION">/ETS/ModeDeclarationGroups/ETS_CurrentMode/ETS_STOP_MODE</TARGET-MODE-DECLARATION-REF>
                        </DISABLED-MODE-IREF>
                      </DISABLED-MODE-IREFS>
                      <START-ON-EVENT-REF DEST="RUNNABLE-ENTITY">/ETS/SwcImplementations/ETS/IB_ETS/MainFunction</START-ON-EVENT-REF>
                      <PERIOD>[!"num:f(General/MainFunctionPeriod)"!]</PERIOD>
                    </TIMING-EVENT>
[!IF "EnhancedTestabilityService/EchoingDataTypes/echoUINT64 = 'true'"!]
                    <OPERATION-INVOKED-EVENT>
                      <SHORT-NAME>OIE_ETS_EchoUINT64</SHORT-NAME>
                      <START-ON-EVENT-REF DEST="RUNNABLE-ENTITY">/ETS/SwcImplementations/ETS/IB_ETS/EchoUINT64</START-ON-EVENT-REF>
                      <OPERATION-IREF>
                        <CONTEXT-P-PORT-REF DEST="P-PORT-PROTOTYPE">/ETS/SwcImplementations/ETS/ETS_EchoUINT64</CONTEXT-P-PORT-REF>
                        <TARGET-PROVIDED-OPERATION-REF DEST="CLIENT-SERVER-OPERATION">/ETS/PortInterfaces/ETS_EchoUINT64/EchoUINT64</TARGET-PROVIDED-OPERATION-REF>
                      </OPERATION-IREF>
                    </OPERATION-INVOKED-EVENT>
[!ENDIF!]
[!IF "EnhancedTestabilityService/EchoingDataTypes/echoInt64 = 'true'"!]
                    <OPERATION-INVOKED-EVENT>
                      <SHORT-NAME>OIE_ETS_EchoINT64</SHORT-NAME>
                      <START-ON-EVENT-REF DEST="RUNNABLE-ENTITY">/ETS/SwcImplementations/ETS/IB_ETS/EchoINT64</START-ON-EVENT-REF>
                      <OPERATION-IREF>
                        <CONTEXT-P-PORT-REF DEST="P-PORT-PROTOTYPE">/ETS/SwcImplementations/ETS/ETS_EchoINT64</CONTEXT-P-PORT-REF>
                        <TARGET-PROVIDED-OPERATION-REF DEST="CLIENT-SERVER-OPERATION">/ETS/PortInterfaces/ETS_EchoINT64/EchoINT64</TARGET-PROVIDED-OPERATION-REF>
                      </OPERATION-IREF>
                    </OPERATION-INVOKED-EVENT>
[!ENDIF!]
[!IF "EnhancedTestabilityService/EchoingDataTypes/echoINT8 = 'true'"!]
                    <OPERATION-INVOKED-EVENT>
                      <SHORT-NAME>OIE_ETS_EchoINT8</SHORT-NAME>
                      <START-ON-EVENT-REF DEST="RUNNABLE-ENTITY">/ETS/SwcImplementations/ETS/IB_ETS/EchoINT8</START-ON-EVENT-REF>
                      <OPERATION-IREF>
                        <CONTEXT-P-PORT-REF DEST="P-PORT-PROTOTYPE">/ETS/SwcImplementations/ETS/ETS_EchoINT8</CONTEXT-P-PORT-REF>
                        <TARGET-PROVIDED-OPERATION-REF DEST="CLIENT-SERVER-OPERATION">/ETS/PortInterfaces/ETS_EchoINT8/EchoINT8</TARGET-PROVIDED-OPERATION-REF>
                      </OPERATION-IREF>
                    </OPERATION-INVOKED-EVENT>
[!ENDIF!]
[!IF "EnhancedTestabilityService/EchoingDataTypes/echoFLOAT64 = 'true'"!]
                    <OPERATION-INVOKED-EVENT>
                      <SHORT-NAME>OIE_ETS_EchoFLOAT64</SHORT-NAME>
                      <START-ON-EVENT-REF DEST="RUNNABLE-ENTITY">/ETS/SwcImplementations/ETS/IB_ETS/EchoFLOAT64</START-ON-EVENT-REF>
                      <OPERATION-IREF>
                        <CONTEXT-P-PORT-REF DEST="P-PORT-PROTOTYPE">/ETS/SwcImplementations/ETS/ETS_EchoFLOAT64</CONTEXT-P-PORT-REF>
                        <TARGET-PROVIDED-OPERATION-REF DEST="CLIENT-SERVER-OPERATION">/ETS/PortInterfaces/ETS_EchoFLOAT64/EchoFLOAT64</TARGET-PROVIDED-OPERATION-REF>
                      </OPERATION-IREF>
                    </OPERATION-INVOKED-EVENT>
[!ENDIF!]
[!IF "EnhancedTestabilityService/EchoingDataTypes/echoENUM = 'true'"!]
                    <OPERATION-INVOKED-EVENT>
                      <SHORT-NAME>OIE_ETS_EchoENUM</SHORT-NAME>
                      <START-ON-EVENT-REF DEST="RUNNABLE-ENTITY">/ETS/SwcImplementations/ETS/IB_ETS/EchoENUM</START-ON-EVENT-REF>
                      <OPERATION-IREF>
                        <CONTEXT-P-PORT-REF DEST="P-PORT-PROTOTYPE">/ETS/SwcImplementations/ETS/ETS_EchoENUM</CONTEXT-P-PORT-REF>
                        <TARGET-PROVIDED-OPERATION-REF DEST="CLIENT-SERVER-OPERATION">/ETS/PortInterfaces/ETS_EchoENUM/EchoENUM</TARGET-PROVIDED-OPERATION-REF>
                      </OPERATION-IREF>
                    </OPERATION-INVOKED-EVENT>
[!ENDIF!]
[!IF "EnhancedTestabilityService/EchoingDataTypes/echoUINT8Array = 'true'"!]
                    <OPERATION-INVOKED-EVENT>
                      <SHORT-NAME>OIE_ETS_EchoUINT8Array</SHORT-NAME>
                      <START-ON-EVENT-REF DEST="RUNNABLE-ENTITY">/ETS/SwcImplementations/ETS/IB_ETS/EchoUINT8Array</START-ON-EVENT-REF>
                      <OPERATION-IREF>
                        <CONTEXT-P-PORT-REF DEST="P-PORT-PROTOTYPE">/ETS/SwcImplementations/ETS/ETS_EchoUINT8Array</CONTEXT-P-PORT-REF>
                        <TARGET-PROVIDED-OPERATION-REF DEST="CLIENT-SERVER-OPERATION">/ETS/PortInterfaces/ETS_EchoUINT8Array/EchoUINT8Array</TARGET-PROVIDED-OPERATION-REF>
                      </OPERATION-IREF>
                    </OPERATION-INVOKED-EVENT>
[!ENDIF!]
[!IF "EnhancedTestabilityService/EchoingDataTypes/echoStaticUINT8Array = 'true'"!]
                    <OPERATION-INVOKED-EVENT>
                      <SHORT-NAME>OIE_ETS_EchoStaticUINT8Array</SHORT-NAME>
                      <START-ON-EVENT-REF DEST="RUNNABLE-ENTITY">/ETS/SwcImplementations/ETS/IB_ETS/EchoStaticUINT8Array</START-ON-EVENT-REF>
                      <OPERATION-IREF>
                        <CONTEXT-P-PORT-REF DEST="P-PORT-PROTOTYPE">/ETS/SwcImplementations/ETS/ETS_EchoStaticUINT8Array</CONTEXT-P-PORT-REF>
                        <TARGET-PROVIDED-OPERATION-REF DEST="CLIENT-SERVER-OPERATION">/ETS/PortInterfaces/ETS_EchoStaticUINT8Array/EchoStaticUINT8Array</TARGET-PROVIDED-OPERATION-REF>
                      </OPERATION-IREF>
                    </OPERATION-INVOKED-EVENT>
[!ENDIF!]
[!IF "EnhancedTestabilityService/EchoingDataTypes/echoBitfields = 'true'"!]
                    <OPERATION-INVOKED-EVENT>
                      <SHORT-NAME>OIE_ETS_EchoBitfields</SHORT-NAME>
                      <START-ON-EVENT-REF DEST="RUNNABLE-ENTITY">/ETS/SwcImplementations/ETS/IB_ETS/EchoBitfields</START-ON-EVENT-REF>
                      <OPERATION-IREF>
                        <CONTEXT-P-PORT-REF DEST="P-PORT-PROTOTYPE">/ETS/SwcImplementations/ETS/ETS_EchoBitfields</CONTEXT-P-PORT-REF>
                        <TARGET-PROVIDED-OPERATION-REF DEST="CLIENT-SERVER-OPERATION">/ETS/PortInterfaces/ETS_EchoBitfields/EchoBitfields</TARGET-PROVIDED-OPERATION-REF>
                      </OPERATION-IREF>
                    </OPERATION-INVOKED-EVENT>
[!ENDIF!]
[!IF "EnhancedTestabilityService/EchoingDataTypes/echoTYPEDEF = 'true'"!]
                    <OPERATION-INVOKED-EVENT>
                      <SHORT-NAME>OIE_ETS_EchoTYPEDEF</SHORT-NAME>
                      <START-ON-EVENT-REF DEST="RUNNABLE-ENTITY">/ETS/SwcImplementations/ETS/IB_ETS/EchoTYPEDEF</START-ON-EVENT-REF>
                      <OPERATION-IREF>
                        <CONTEXT-P-PORT-REF DEST="P-PORT-PROTOTYPE">/ETS/SwcImplementations/ETS/ETS_EchoTYPEDEF</CONTEXT-P-PORT-REF>
                        <TARGET-PROVIDED-OPERATION-REF DEST="CLIENT-SERVER-OPERATION">/ETS/PortInterfaces/ETS_EchoTYPEDEF/EchoTYPEDEF</TARGET-PROVIDED-OPERATION-REF>
                      </OPERATION-IREF>
                    </OPERATION-INVOKED-EVENT>
[!ENDIF!]
[!IF "EnhancedTestabilityService/EchoingDataTypes/echoUINT8Array16BitLength = 'true'"!]
                    <OPERATION-INVOKED-EVENT>
                      <SHORT-NAME>OIE_ETS_EchoUINT8Array16Bitlength</SHORT-NAME>
                      <START-ON-EVENT-REF DEST="RUNNABLE-ENTITY">/ETS/SwcImplementations/ETS/IB_ETS/EchoUINT8Array16Bitlength</START-ON-EVENT-REF>
                      <OPERATION-IREF>
                        <CONTEXT-P-PORT-REF DEST="P-PORT-PROTOTYPE">/ETS/SwcImplementations/ETS/ETS_EchoUINT8Array16Bitlength</CONTEXT-P-PORT-REF>
                        <TARGET-PROVIDED-OPERATION-REF DEST="CLIENT-SERVER-OPERATION">/ETS/PortInterfaces/ETS_EchoUINT8Array16Bitlength/EchoUINT8Array16Bitlength</TARGET-PROVIDED-OPERATION-REF>
                      </OPERATION-IREF>
                    </OPERATION-INVOKED-EVENT>
[!ENDIF!]
[!IF "EnhancedTestabilityService/EchoingDataTypes/echoUINT8E2E = 'true'"!]
                    <OPERATION-INVOKED-EVENT>
                      <SHORT-NAME>OIE_ETS_EchoUINT8E2E</SHORT-NAME>
                      <START-ON-EVENT-REF DEST="RUNNABLE-ENTITY">/ETS/SwcImplementations/ETS/IB_ETS/EchoUINT8E2E</START-ON-EVENT-REF>
                      <OPERATION-IREF>
                        <CONTEXT-P-PORT-REF DEST="P-PORT-PROTOTYPE">/ETS/SwcImplementations/ETS/ETS_EchoUINT8E2E</CONTEXT-P-PORT-REF>
                        <TARGET-PROVIDED-OPERATION-REF DEST="CLIENT-SERVER-OPERATION">/ETS/PortInterfaces/ETS_EchoUINT8E2E/EchoUINT8E2E</TARGET-PROVIDED-OPERATION-REF>
                      </OPERATION-IREF>
                    </OPERATION-INVOKED-EVENT>
[!ENDIF!]
[!IF "EnhancedTestabilityService/EchoingDataTypes/echoUINT8RELIABLE = 'true'"!]
                    <OPERATION-INVOKED-EVENT>
                      <SHORT-NAME>OIE_ETS_EchoUINT8RELIABLE</SHORT-NAME>
                      <START-ON-EVENT-REF DEST="RUNNABLE-ENTITY">/ETS/SwcImplementations/ETS/IB_ETS/EchoUINT8RELIABLE</START-ON-EVENT-REF>
                      <OPERATION-IREF>
                        <CONTEXT-P-PORT-REF DEST="P-PORT-PROTOTYPE">/ETS/SwcImplementations/ETS/ETS_EchoUINT8RELIABLE</CONTEXT-P-PORT-REF>
                        <TARGET-PROVIDED-OPERATION-REF DEST="CLIENT-SERVER-OPERATION">/ETS/PortInterfaces/ETS_EchoUINT8RELIABLE/EchoUINT8RELIABLE</TARGET-PROVIDED-OPERATION-REF>
                      </OPERATION-IREF>
                    </OPERATION-INVOKED-EVENT>
[!ENDIF!]
[!IF "EnhancedTestabilityService/EchoingDataTypes/echoSTRUCTSimple = 'true'"!]
                    <OPERATION-INVOKED-EVENT>
                      <SHORT-NAME>OIE_ETS_EchoSTRUCTSimple</SHORT-NAME>
                      <START-ON-EVENT-REF DEST="RUNNABLE-ENTITY">/ETS/SwcImplementations/ETS/IB_ETS/EchoSTRUCTSimple</START-ON-EVENT-REF>
                      <OPERATION-IREF>
                        <CONTEXT-P-PORT-REF DEST="P-PORT-PROTOTYPE">/ETS/SwcImplementations/ETS/ETS_EchoSTRUCTSimple</CONTEXT-P-PORT-REF>
                        <TARGET-PROVIDED-OPERATION-REF DEST="CLIENT-SERVER-OPERATION">/ETS/PortInterfaces/ETS_EchoSTRUCTSimple/EchoSTRUCTSimple</TARGET-PROVIDED-OPERATION-REF>
                      </OPERATION-IREF>
                    </OPERATION-INVOKED-EVENT>
[!ENDIF!]
[!IF "EnhancedTestabilityService/EchoingDataTypes/echoUINT8Array8BitLength = 'true'"!]
                    <OPERATION-INVOKED-EVENT>
                      <SHORT-NAME>OIE_ETS_EchoUINT8Array8BitLength</SHORT-NAME>
                      <START-ON-EVENT-REF DEST="RUNNABLE-ENTITY">/ETS/SwcImplementations/ETS/IB_ETS/EchoUINT8Array8BitLength</START-ON-EVENT-REF>
                      <OPERATION-IREF>
                        <CONTEXT-P-PORT-REF DEST="P-PORT-PROTOTYPE">/ETS/SwcImplementations/ETS/ETS_EchoUINT8Array8BitLength</CONTEXT-P-PORT-REF>
                        <TARGET-PROVIDED-OPERATION-REF DEST="CLIENT-SERVER-OPERATION">/ETS/PortInterfaces/ETS_EchoUINT8Array8BitLength/EchoUINT8Array8BitLength</TARGET-PROVIDED-OPERATION-REF>
                      </OPERATION-IREF>
                    </OPERATION-INVOKED-EVENT>
[!ENDIF!]
[!IF "EnhancedTestabilityService/EchoingDataTypes/echoUINT8ArrayMinSize = 'true'"!]
                    <OPERATION-INVOKED-EVENT>
                      <SHORT-NAME>OIE_ETS_EchoUINT8ArrayMinSize</SHORT-NAME>
                      <START-ON-EVENT-REF DEST="RUNNABLE-ENTITY">/ETS/SwcImplementations/ETS/IB_ETS/EchoUINT8ArrayMinSize</START-ON-EVENT-REF>
                      <OPERATION-IREF>
                        <CONTEXT-P-PORT-REF DEST="P-PORT-PROTOTYPE">/ETS/SwcImplementations/ETS/ETS_EchoUINT8ArrayMinSize</CONTEXT-P-PORT-REF>
                        <TARGET-PROVIDED-OPERATION-REF DEST="CLIENT-SERVER-OPERATION">/ETS/PortInterfaces/ETS_EchoUINT8ArrayMinSize/EchoUINT8ArrayMinSize</TARGET-PROVIDED-OPERATION-REF>
                      </OPERATION-IREF>
                    </OPERATION-INVOKED-EVENT>
[!ENDIF!]
[!IF "EnhancedTestabilityService/EchoingDataTypes/echoUINT8Array2Dim = 'true'"!]
                    <OPERATION-INVOKED-EVENT>
                      <SHORT-NAME>OIE_ETS_EchoUINT8Array2Dim</SHORT-NAME>
                      <START-ON-EVENT-REF DEST="RUNNABLE-ENTITY">/ETS/SwcImplementations/ETS/IB_ETS/EchoUINT8Array2Dim</START-ON-EVENT-REF>
                      <OPERATION-IREF>
                        <CONTEXT-P-PORT-REF DEST="P-PORT-PROTOTYPE">/ETS/SwcImplementations/ETS/ETS_EchoUINT8Array2Dim</CONTEXT-P-PORT-REF>
                        <TARGET-PROVIDED-OPERATION-REF DEST="CLIENT-SERVER-OPERATION">/ETS/PortInterfaces/ETS_EchoUINT8Array2Dim/EchoUINT8Array2Dim</TARGET-PROVIDED-OPERATION-REF>
                      </OPERATION-IREF>
                    </OPERATION-INVOKED-EVENT>
[!ENDIF!]
[!IF "EnhancedTestabilityService/EchoingDataTypes/echoUNION = 'true'"!]
                    <OPERATION-INVOKED-EVENT>
                      <SHORT-NAME>OIE_ETS_EchoUNION</SHORT-NAME>
                      <START-ON-EVENT-REF DEST="RUNNABLE-ENTITY">/ETS/SwcImplementations/ETS/IB_ETS/EchoUNION</START-ON-EVENT-REF>
                      <OPERATION-IREF>
                        <CONTEXT-P-PORT-REF DEST="P-PORT-PROTOTYPE">/ETS/SwcImplementations/ETS/ETS_EchoUNION</CONTEXT-P-PORT-REF>
                        <TARGET-PROVIDED-OPERATION-REF DEST="CLIENT-SERVER-OPERATION">/ETS/PortInterfaces/ETS_EchoUNION/EchoUNION</TARGET-PROVIDED-OPERATION-REF>
                      </OPERATION-IREF>
                    </OPERATION-INVOKED-EVENT>
[!ENDIF!]
[!IF "EnhancedTestabilityService/EchoingDataTypes/echoUTF8FIXED = 'true'"!]
                    <OPERATION-INVOKED-EVENT>
                      <SHORT-NAME>OIE_ETS_EchoUTF8FIXED</SHORT-NAME>
                      <START-ON-EVENT-REF DEST="RUNNABLE-ENTITY">/ETS/SwcImplementations/ETS/IB_ETS/EchoUTF8FIXED</START-ON-EVENT-REF>
                      <OPERATION-IREF>
                        <CONTEXT-P-PORT-REF DEST="P-PORT-PROTOTYPE">/ETS/SwcImplementations/ETS/ETS_EchoUTF8FIXED</CONTEXT-P-PORT-REF>
                        <TARGET-PROVIDED-OPERATION-REF DEST="CLIENT-SERVER-OPERATION">/ETS/PortInterfaces/ETS_EchoUTF8FIXED/EchoUTF8FIXED</TARGET-PROVIDED-OPERATION-REF>
                      </OPERATION-IREF>
                    </OPERATION-INVOKED-EVENT>
[!ENDIF!]
[!IF "EnhancedTestabilityService/EchoingDataTypes/echoUTF16FIXED = 'true'"!]
                    <OPERATION-INVOKED-EVENT>
                      <SHORT-NAME>OIE_ETS_EchoUTF16FIXED</SHORT-NAME>
                      <START-ON-EVENT-REF DEST="RUNNABLE-ENTITY">/ETS/SwcImplementations/ETS/IB_ETS/EchoUTF16FIXED</START-ON-EVENT-REF>
                      <OPERATION-IREF>
                        <CONTEXT-P-PORT-REF DEST="P-PORT-PROTOTYPE">/ETS/SwcImplementations/ETS/ETS_EchoUTF16FIXED</CONTEXT-P-PORT-REF>
                        <TARGET-PROVIDED-OPERATION-REF DEST="CLIENT-SERVER-OPERATION">/ETS/PortInterfaces/ETS_EchoUTF16FIXED/EchoUTF16FIXED</TARGET-PROVIDED-OPERATION-REF>
                      </OPERATION-IREF>
                    </OPERATION-INVOKED-EVENT>
[!ENDIF!]
[!IF "EnhancedTestabilityService/EventsAndFields/TestEventUINT8 = 'true'"!]
                    <DATA-RECEIVED-EVENT>
                      <SHORT-NAME>DRE_ETS_TestEventUINT8</SHORT-NAME>
                      <START-ON-EVENT-REF DEST="RUNNABLE-ENTITY">/ETS/SwcImplementations/ETS/IB_ETS/TestEventUINT8</START-ON-EVENT-REF>
                      <DATA-IREF>
                        <CONTEXT-R-PORT-REF DEST="R-PORT-PROTOTYPE">/ETS/SwcImplementations/ETS/ETS_TestEventUINT8Client</CONTEXT-R-PORT-REF>
                        <TARGET-DATA-ELEMENT-REF DEST="VARIABLE-DATA-PROTOTYPE">/ETS/PortInterfaces/ETS_TestEventUINT8/TestEventUINT8</TARGET-DATA-ELEMENT-REF>
                      </DATA-IREF>
                    </DATA-RECEIVED-EVENT>
[!ENDIF!]
[!IF "EnhancedTestabilityService/EventsAndFields/TestEventUINT8Reliable = 'true'"!]
                    <DATA-RECEIVED-EVENT>
                      <SHORT-NAME>DRE_ETS_TestEventUINT8Reliable</SHORT-NAME>
                      <START-ON-EVENT-REF DEST="RUNNABLE-ENTITY">/ETS/SwcImplementations/ETS/IB_ETS/TestEventUINT8Reliable</START-ON-EVENT-REF>
                      <DATA-IREF>
                        <CONTEXT-R-PORT-REF DEST="R-PORT-PROTOTYPE">/ETS/SwcImplementations/ETS/ETS_TestEventUINT8ReliableClient</CONTEXT-R-PORT-REF>
                        <TARGET-DATA-ELEMENT-REF DEST="VARIABLE-DATA-PROTOTYPE">/ETS/PortInterfaces/ETS_TestEventUINT8Reliable/TestEventUINT8Reliable</TARGET-DATA-ELEMENT-REF>
                      </DATA-IREF>
                    </DATA-RECEIVED-EVENT>
[!ENDIF!]
[!IF "EnhancedTestabilityService/EventsAndFields/TestEventUINT8Array = 'true'"!]
                    <DATA-RECEIVED-EVENT>
                      <SHORT-NAME>DRE_ETS_TestEventUINT8Array</SHORT-NAME>
                      <START-ON-EVENT-REF DEST="RUNNABLE-ENTITY">/ETS/SwcImplementations/ETS/IB_ETS/TestEventUINT8Array</START-ON-EVENT-REF>
                      <DATA-IREF>
                        <CONTEXT-R-PORT-REF DEST="R-PORT-PROTOTYPE">/ETS/SwcImplementations/ETS/ETS_TestEventUINT8ArrayClient</CONTEXT-R-PORT-REF>
                        <TARGET-DATA-ELEMENT-REF DEST="VARIABLE-DATA-PROTOTYPE">/ETS/PortInterfaces/ETS_TestEventUINT8Array/TestEventUINT8Array</TARGET-DATA-ELEMENT-REF>
                      </DATA-IREF>
                    </DATA-RECEIVED-EVENT>
[!ENDIF!]
[!IF "EnhancedTestabilityService/EventsAndFields/TestEventUINT8E2E = 'true'"!]
                    <DATA-RECEIVED-EVENT>
                      <SHORT-NAME>DRE_ETS_TestEventUINT8E2E</SHORT-NAME>
                      <START-ON-EVENT-REF DEST="RUNNABLE-ENTITY">/ETS/SwcImplementations/ETS/IB_ETS/TestEventUINT8E2E</START-ON-EVENT-REF>
                      <DATA-IREF>
                        <CONTEXT-R-PORT-REF DEST="R-PORT-PROTOTYPE">/ETS/SwcImplementations/ETS/ETS_TestEventUINT8E2EClient</CONTEXT-R-PORT-REF>
                        <TARGET-DATA-ELEMENT-REF DEST="VARIABLE-DATA-PROTOTYPE">/ETS/PortInterfaces/ETS_TestEventUINT8E2E/TestEventUINT8E2E</TARGET-DATA-ELEMENT-REF>
                      </DATA-IREF>                     
                    </DATA-RECEIVED-EVENT>
[!ENDIF!]
[!IF "EnhancedTestabilityService/EventsAndFields/TestEventUINT8Multicast = 'true'"!]
                    <DATA-RECEIVED-EVENT>
                      <SHORT-NAME>DRE_ETS_TestEventUINT8Multicast</SHORT-NAME>
                      <START-ON-EVENT-REF DEST="RUNNABLE-ENTITY">/ETS/SwcImplementations/ETS/IB_ETS/TestEventUINT8Multicast</START-ON-EVENT-REF>
                      <DATA-IREF>
                        <CONTEXT-R-PORT-REF DEST="R-PORT-PROTOTYPE">/ETS/SwcImplementations/ETS/ETS_TestEventUINT8MulticastClient</CONTEXT-R-PORT-REF>
                        <TARGET-DATA-ELEMENT-REF DEST="VARIABLE-DATA-PROTOTYPE">/ETS/PortInterfaces/ETS_TestEventUINT8Multicast/TestEventUINT8Multicast</TARGET-DATA-ELEMENT-REF>
                      </DATA-IREF>
                    </DATA-RECEIVED-EVENT>
[!ENDIF!]
[!IF "EnhancedTestabilityService/EventsAndFields/TestFieldUINT8 = 'true'"!]
                    <OPERATION-INVOKED-EVENT>
                      <SHORT-NAME>OIE_ETS_GetFieldTestFieldUINT8</SHORT-NAME>
                      <START-ON-EVENT-REF DEST="RUNNABLE-ENTITY">/ETS/SwcImplementations/ETS/IB_ETS/GetFieldTestFieldUINT8</START-ON-EVENT-REF>
                      <OPERATION-IREF>
                        <CONTEXT-P-PORT-REF DEST="P-PORT-PROTOTYPE">/ETS/SwcImplementations/ETS/ETS_TestFieldUINT8</CONTEXT-P-PORT-REF>
                        <TARGET-PROVIDED-OPERATION-REF DEST="CLIENT-SERVER-OPERATION">/ETS/PortInterfaces/ETS_TestFieldUINT8/getFieldTestFieldUINT8</TARGET-PROVIDED-OPERATION-REF>
                      </OPERATION-IREF>
                    </OPERATION-INVOKED-EVENT>
[!ENDIF!]
[!IF "EnhancedTestabilityService/EventsAndFields/TestFieldUINT8Reliable = 'true'"!]
                    <OPERATION-INVOKED-EVENT>
                      <SHORT-NAME>OIE_ETS_GetFieldTestFieldUINT8Reliable</SHORT-NAME>
                      <START-ON-EVENT-REF DEST="RUNNABLE-ENTITY">/ETS/SwcImplementations/ETS/IB_ETS/GetFieldTestFieldUINT8Reliable</START-ON-EVENT-REF>
                      <OPERATION-IREF>
                        <CONTEXT-P-PORT-REF DEST="P-PORT-PROTOTYPE">/ETS/SwcImplementations/ETS/ETS_TestFieldUINT8Reliable</CONTEXT-P-PORT-REF>
                        <TARGET-PROVIDED-OPERATION-REF DEST="CLIENT-SERVER-OPERATION">/ETS/PortInterfaces/ETS_TestFieldUINT8Reliable/getFieldTestFieldUINT8Reliable</TARGET-PROVIDED-OPERATION-REF>
                      </OPERATION-IREF>
                    </OPERATION-INVOKED-EVENT>
[!ENDIF!]
[!IF "EnhancedTestabilityService/EventsAndFields/TestFieldUINT8Array = 'true'"!]
                    <OPERATION-INVOKED-EVENT>
                      <SHORT-NAME>OIE_ETS_GetFieldTestFieldUINT8Array</SHORT-NAME>
                      <START-ON-EVENT-REF DEST="RUNNABLE-ENTITY">/ETS/SwcImplementations/ETS/IB_ETS/GetFieldTestFieldUINT8Array</START-ON-EVENT-REF>
                      <OPERATION-IREF>
                        <CONTEXT-P-PORT-REF DEST="P-PORT-PROTOTYPE">/ETS/SwcImplementations/ETS/ETS_TestFieldUINT8Array</CONTEXT-P-PORT-REF>
                        <TARGET-PROVIDED-OPERATION-REF DEST="CLIENT-SERVER-OPERATION">/ETS/PortInterfaces/ETS_TestFieldUINT8Array/getFieldTestFieldUINT8Array</TARGET-PROVIDED-OPERATION-REF>
                      </OPERATION-IREF>
                    </OPERATION-INVOKED-EVENT>
[!ENDIF!]
[!IF "EnhancedTestabilityService/EventsAndFields/TestFieldUINT8 = 'true'"!]
                    <OPERATION-INVOKED-EVENT>
                      <SHORT-NAME>OIE_ETS_SetFieldTestFieldUINT8</SHORT-NAME>
                      <START-ON-EVENT-REF DEST="RUNNABLE-ENTITY">/ETS/SwcImplementations/ETS/IB_ETS/SetFieldTestFieldUINT8</START-ON-EVENT-REF>
                      <OPERATION-IREF>
                        <CONTEXT-P-PORT-REF DEST="P-PORT-PROTOTYPE">/ETS/SwcImplementations/ETS/ETS_TestFieldUINT8</CONTEXT-P-PORT-REF>
                        <TARGET-PROVIDED-OPERATION-REF DEST="CLIENT-SERVER-OPERATION">/ETS/PortInterfaces/ETS_TestFieldUINT8/setFieldTestFieldUINT8</TARGET-PROVIDED-OPERATION-REF>
                      </OPERATION-IREF>
                    </OPERATION-INVOKED-EVENT>
[!ENDIF!]
[!IF "EnhancedTestabilityService/EventsAndFields/TestFieldUINT8Reliable = 'true'"!]
                    <OPERATION-INVOKED-EVENT>
                      <SHORT-NAME>OIE_ETS_SetFieldTestFieldUINT8Reliable</SHORT-NAME>
                      <START-ON-EVENT-REF DEST="RUNNABLE-ENTITY">/ETS/SwcImplementations/ETS/IB_ETS/SetFieldTestFieldUINT8Reliable</START-ON-EVENT-REF>
                      <OPERATION-IREF>
                        <CONTEXT-P-PORT-REF DEST="P-PORT-PROTOTYPE">/ETS/SwcImplementations/ETS/ETS_TestFieldUINT8Reliable</CONTEXT-P-PORT-REF>
                        <TARGET-PROVIDED-OPERATION-REF DEST="CLIENT-SERVER-OPERATION">/ETS/PortInterfaces/ETS_TestFieldUINT8Reliable/setFieldTestFieldUINT8Reliable</TARGET-PROVIDED-OPERATION-REF>
                      </OPERATION-IREF>
                    </OPERATION-INVOKED-EVENT>
[!ENDIF!]
[!IF "EnhancedTestabilityService/EventsAndFields/TestFieldUINT8Array = 'true'"!]
                    <OPERATION-INVOKED-EVENT>
                      <SHORT-NAME>OIE_ETS_SetFieldTestFieldUINT8Array</SHORT-NAME>
                      <START-ON-EVENT-REF DEST="RUNNABLE-ENTITY">/ETS/SwcImplementations/ETS/IB_ETS/SetFieldTestFieldUINT8Array</START-ON-EVENT-REF>
                      <OPERATION-IREF>
                        <CONTEXT-P-PORT-REF DEST="P-PORT-PROTOTYPE">/ETS/SwcImplementations/ETS/ETS_TestFieldUINT8Array</CONTEXT-P-PORT-REF>
                        <TARGET-PROVIDED-OPERATION-REF DEST="CLIENT-SERVER-OPERATION">/ETS/PortInterfaces/ETS_TestFieldUINT8Array/setFieldTestFieldUINT8Array</TARGET-PROVIDED-OPERATION-REF>
                      </OPERATION-IREF>
                    </OPERATION-INVOKED-EVENT>
[!ENDIF!]
[!IF "EnhancedTestabilityService/EventsAndFields/InterfaceVersion = 'true'"!]
                    <OPERATION-INVOKED-EVENT>
                      <SHORT-NAME>OIE_ETS_GetFieldInterfaceVersion</SHORT-NAME>
                      <START-ON-EVENT-REF DEST="RUNNABLE-ENTITY">/ETS/SwcImplementations/ETS/IB_ETS/GetFieldInterfaceVersion</START-ON-EVENT-REF>
                      <OPERATION-IREF>
                        <CONTEXT-P-PORT-REF DEST="P-PORT-PROTOTYPE">/ETS/SwcImplementations/ETS/ETS_InterfaceVersion</CONTEXT-P-PORT-REF>
                        <TARGET-PROVIDED-OPERATION-REF DEST="CLIENT-SERVER-OPERATION">/ETS/PortInterfaces/ETS_InterfaceVersion/getFieldInterfaceVersion</TARGET-PROVIDED-OPERATION-REF>
                      </OPERATION-IREF>
                    </OPERATION-INVOKED-EVENT>
[!ENDIF!]
[!LOOP "ProjectSpecificTests/*"!]
  [!IF "node:value(ActivateTest) = 'true'"!]
                    <OPERATION-INVOKED-EVENT>
                      <SHORT-NAME>OIE_ETS_Pst[!"node:name(.)"!]</SHORT-NAME>
                      <START-ON-EVENT-REF DEST="RUNNABLE-ENTITY">/ETS/SwcImplementations/ETS/IB_ETS/Pst[!"node:name(.)"!]</START-ON-EVENT-REF>
                      <OPERATION-IREF>
                        <CONTEXT-P-PORT-REF DEST="P-PORT-PROTOTYPE">/ETS/SwcImplementations/ETS/ETS_Pst[!"node:name(.)"!]</CONTEXT-P-PORT-REF>
                        <TARGET-PROVIDED-OPERATION-REF DEST="CLIENT-SERVER-OPERATION">/ETS/PortInterfaces/ETS_Pst[!"node:name(.)"!]/ETS_Cbk_[!"node:name(.)"!]</TARGET-PROVIDED-OPERATION-REF>
                      </OPERATION-IREF>
                    </OPERATION-INVOKED-EVENT>
  [!ENDIF!]
[!ENDLOOP!]
                    </EVENTS>
                    <HANDLE-TERMINATION-AND-RESTART>NO-SUPPORT</HANDLE-TERMINATION-AND-RESTART>
                    <RUNNABLES>
[!IF "EnhancedTestabilityService/TestingClientInteraction/checkByteOrder = 'true'"!]
                    <RUNNABLE-ENTITY>
                      <SHORT-NAME>CheckByteOrder</SHORT-NAME>
                      <MINIMUM-START-INTERVAL>0.0</MINIMUM-START-INTERVAL>
                      <CAN-BE-INVOKED-CONCURRENTLY>false</CAN-BE-INVOKED-CONCURRENTLY>
                      <SYMBOL>ETS_CheckByteOrder</SYMBOL>
                    </RUNNABLE-ENTITY>
[!ENDIF!]
