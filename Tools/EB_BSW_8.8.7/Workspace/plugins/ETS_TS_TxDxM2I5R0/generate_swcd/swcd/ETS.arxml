[part 3 of 3]
[!IF "EnhancedTestabilityService/TestingClientInteraction/clientServiceActivate = 'true'"!]
                    <RUNNABLE-ENTITY>
                      <SHORT-NAME>ClientServiceActivate</SHORT-NAME>
                      <MINIMUM-START-INTERVAL>0.0</MINIMUM-START-INTERVAL>
                      <CAN-BE-INVOKED-CONCURRENTLY>false</CAN-BE-INVOKED-CONCURRENTLY>
                      <DATA-RECEIVE-POINT-BY-ARGUMENTS>
                        <VARIABLE-ACCESS>
                          <SHORT-NAME>drparg_clientServiceActivate</SHORT-NAME>
                          <ACCESSED-VARIABLE>
                            <AUTOSAR-VARIABLE-IREF>
                              <PORT-PROTOTYPE-REF DEST="R-PORT-PROTOTYPE">/ETS/SwcImplementations/ETS/ETS_ClientServiceActivate</PORT-PROTOTYPE-REF>
                              <TARGET-DATA-PROTOTYPE-REF DEST="VARIABLE-DATA-PROTOTYPE">/ETS/PortInterfaces/ETS_ClientServiceActivate/start</TARGET-DATA-PROTOTYPE-REF>
                            </AUTOSAR-VARIABLE-IREF>
                          </ACCESSED-VARIABLE>
                        </VARIABLE-ACCESS>
                      </DATA-RECEIVE-POINT-BY-ARGUMENTS>
                      <SYMBOL>ETS_ClientServiceActivate</SYMBOL>
                    </RUNNABLE-ENTITY>
[!ENDIF!]
[!IF "EnhancedTestabilityService/TestingClientInteraction/clientServiceCallEchoUINT8Array = 'true'"!]
                    <RUNNABLE-ENTITY>
                      <SHORT-NAME>ClientServiceCallEchoUINT8Array</SHORT-NAME>
                      <MINIMUM-START-INTERVAL>0.0</MINIMUM-START-INTERVAL>
                      <CAN-BE-INVOKED-CONCURRENTLY>true</CAN-BE-INVOKED-CONCURRENTLY>
                      <SERVER-CALL-POINTS>
                        <SYNCHRONOUS-SERVER-CALL-POINT>
                          <SHORT-NAME>scp_echoUINT8Array</SHORT-NAME>
                          <OPERATION-IREF>
                            <CONTEXT-R-PORT-REF DEST="R-PORT-PROTOTYPE">/ETS/SwcImplementations/ETS/ETS_EchoUINT8ArrayClient</CONTEXT-R-PORT-REF>
                            <TARGET-REQUIRED-OPERATION-REF DEST="CLIENT-SERVER-OPERATION">/ETS/PortInterfaces/ETS_EchoUINT8Array/EchoUINT8Array</TARGET-REQUIRED-OPERATION-REF>
                          </OPERATION-IREF>
                          <TIMEOUT>0.0</TIMEOUT>
                        </SYNCHRONOUS-SERVER-CALL-POINT>
                      </SERVER-CALL-POINTS>
                      <SYMBOL>ETS_ClientServiceCallEchoUINT8Array</SYMBOL>
                    </RUNNABLE-ENTITY>
[!ENDIF!]
[!IF "EnhancedTestabilityService/TestingClientInteraction/clientServiceDeactivate = 'true'"!]
                    <RUNNABLE-ENTITY>
                      <SHORT-NAME>ClientServiceDeactivate</SHORT-NAME>
                      <MINIMUM-START-INTERVAL>0.0</MINIMUM-START-INTERVAL>
                      <CAN-BE-INVOKED-CONCURRENTLY>false</CAN-BE-INVOKED-CONCURRENTLY>
                      <DATA-RECEIVE-POINT-BY-ARGUMENTS>
                        <VARIABLE-ACCESS>
                          <SHORT-NAME>drparg_start</SHORT-NAME>
                          <ACCESSED-VARIABLE>
                            <AUTOSAR-VARIABLE-IREF>
                              <PORT-PROTOTYPE-REF DEST="R-PORT-PROTOTYPE">/ETS/SwcImplementations/ETS/ETS_ClientServiceDeactivate</PORT-PROTOTYPE-REF>
                              <TARGET-DATA-PROTOTYPE-REF DEST="VARIABLE-DATA-PROTOTYPE">/ETS/PortInterfaces/ETS_ClientServiceDeactivate/start</TARGET-DATA-PROTOTYPE-REF>
                            </AUTOSAR-VARIABLE-IREF>
                          </ACCESSED-VARIABLE>
                        </VARIABLE-ACCESS>
                      </DATA-RECEIVE-POINT-BY-ARGUMENTS>
                      <SYMBOL>ETS_ClientServiceDeactivate</SYMBOL>
                    </RUNNABLE-ENTITY>
[!ENDIF!]
[!IF "EnhancedTestabilityService/TestingClientInteraction/clientServiceGetLastValueOfEventTCP = 'true'"!]
                    <RUNNABLE-ENTITY>
                      <SHORT-NAME>ClientServiceGetLastValueOfEventTCP</SHORT-NAME>
                      <MINIMUM-START-INTERVAL>0.0</MINIMUM-START-INTERVAL>
                      <CAN-BE-INVOKED-CONCURRENTLY>false</CAN-BE-INVOKED-CONCURRENTLY>
                      <SYMBOL>ETS_ClientServiceGetLastValueOfEventTCP</SYMBOL>
                    </RUNNABLE-ENTITY>
[!ENDIF!]
[!IF "EnhancedTestabilityService/TestingClientInteraction/clientServiceGetLastValueOfEventUDPMulticast = 'true'"!]
                    <RUNNABLE-ENTITY>
                      <SHORT-NAME>ClientServiceGetLastValueOfEventUDPMulticast</SHORT-NAME>
                      <MINIMUM-START-INTERVAL>0.0</MINIMUM-START-INTERVAL>
                      <CAN-BE-INVOKED-CONCURRENTLY>false</CAN-BE-INVOKED-CONCURRENTLY>
                      <SYMBOL>ETS_ClientServiceGetLastValueOfEventUDPMulticast</SYMBOL>
                    </RUNNABLE-ENTITY>
[!ENDIF!]
[!IF "EnhancedTestabilityService/TestingClientInteraction/clientServiceGetLastValueOfEventUDPUnicast = 'true'"!]
                    <RUNNABLE-ENTITY>
                      <SHORT-NAME>ClientServiceGetLastValueOfEventUDPUnicast</SHORT-NAME>
                      <MINIMUM-START-INTERVAL>0.0</MINIMUM-START-INTERVAL>
                      <CAN-BE-INVOKED-CONCURRENTLY>false</CAN-BE-INVOKED-CONCURRENTLY>
                      <SYMBOL>ETS_ClientServiceGetLastValueOfEventUDPUnicast</SYMBOL>
                    </RUNNABLE-ENTITY>
[!ENDIF!]
[!IF "EnhancedTestabilityService/TestingClientInteraction/clientServiceSubscribeEventgroup = 'true'"!]
                    <RUNNABLE-ENTITY>
                      <SHORT-NAME>ClientServiceSubscribeEventgroup</SHORT-NAME>
                      <MINIMUM-START-INTERVAL>0.0</MINIMUM-START-INTERVAL>
                      <CAN-BE-INVOKED-CONCURRENTLY>false</CAN-BE-INVOKED-CONCURRENTLY>
                      <DATA-RECEIVE-POINT-BY-ARGUMENTS>
                        <VARIABLE-ACCESS>
                          <SHORT-NAME>drparg_clientServiceSubscrib</SHORT-NAME>
                          <ACCESSED-VARIABLE>
                            <AUTOSAR-VARIABLE-IREF>
                              <PORT-PROTOTYPE-REF DEST="R-PORT-PROTOTYPE">/ETS/SwcImplementations/ETS/ETS_ClientServiceSubscribeEventgroup</PORT-PROTOTYPE-REF>
                              <TARGET-DATA-PROTOTYPE-REF DEST="VARIABLE-DATA-PROTOTYPE">/ETS/PortInterfaces/ETS_ClientServiceSubscribeEventgroup/clientServiceSubscribeEventgroup</TARGET-DATA-PROTOTYPE-REF>
                            </AUTOSAR-VARIABLE-IREF>
                          </ACCESSED-VARIABLE>
                        </VARIABLE-ACCESS>
                      </DATA-RECEIVE-POINT-BY-ARGUMENTS>
                      <SYMBOL>ETS_ClientServiceSubscribeEventgroup</SYMBOL>
                    </RUNNABLE-ENTITY>
[!ENDIF!]
[!IF "EnhancedTestabilityService/EchoingDataTypes/echoCommonDatatypes = 'true'"!]
                    <RUNNABLE-ENTITY>
                      <SHORT-NAME>EchoCommonDatatypes</SHORT-NAME>
                      <MINIMUM-START-INTERVAL>0.0</MINIMUM-START-INTERVAL>
                      <CAN-BE-INVOKED-CONCURRENTLY>false</CAN-BE-INVOKED-CONCURRENTLY>
                      <SYMBOL>ETS_EchoCommonDatatypes</SYMBOL>
                    </RUNNABLE-ENTITY>
[!ENDIF!]
[!IF "EnhancedTestabilityService/EchoingDataTypes/echoUINT8 = 'true'"!]
                    <RUNNABLE-ENTITY>
                      <SHORT-NAME>EchoUINT8</SHORT-NAME>
                      <MINIMUM-START-INTERVAL>0.0</MINIMUM-START-INTERVAL>
                      <CAN-BE-INVOKED-CONCURRENTLY>false</CAN-BE-INVOKED-CONCURRENTLY>
                      <SYMBOL>ETS_EchoUINT8</SYMBOL>
                    </RUNNABLE-ENTITY>
[!ENDIF!]
                    <RUNNABLE-ENTITY>
                      <SHORT-NAME>Init</SHORT-NAME>
                      <MINIMUM-START-INTERVAL>0.0</MINIMUM-START-INTERVAL>
                      <CAN-BE-INVOKED-CONCURRENTLY>false</CAN-BE-INVOKED-CONCURRENTLY>
                      <DATA-SEND-POINTS>
[!IF "EnhancedTestabilityService/TestingClientInteraction/clientServiceActivate = 'true'"!]
                        <VARIABLE-ACCESS>
                          <SHORT-NAME>dsp_requestedMode</SHORT-NAME>
                          <ACCESSED-VARIABLE>
                            <AUTOSAR-VARIABLE-IREF>
                              <PORT-PROTOTYPE-REF DEST="P-PORT-PROTOTYPE">/ETS/SwcImplementations/ETS/ETS_SD_ClientServiceRequest</PORT-PROTOTYPE-REF>
                              <TARGET-DATA-PROTOTYPE-REF DEST="VARIABLE-DATA-PROTOTYPE">/ETS/PortInterfaces/ETS_ModeRequest_SD_ClientService/requestedMode</TARGET-DATA-PROTOTYPE-REF>
                            </AUTOSAR-VARIABLE-IREF>
                          </ACCESSED-VARIABLE>
                        </VARIABLE-ACCESS>
[!ENDIF!]
[!IF "EnhancedTestabilityService/TestingClientInteraction/clientServiceSubscribeEventgroup = 'true'"!]
                        <VARIABLE-ACCESS>
                          <SHORT-NAME>dsp_requestedMode1</SHORT-NAME>
                          <ACCESSED-VARIABLE>
                            <AUTOSAR-VARIABLE-IREF>
                              <PORT-PROTOTYPE-REF DEST="P-PORT-PROTOTYPE">/ETS/SwcImplementations/ETS/ETS_SD_ConsumedEventGroupRequest</PORT-PROTOTYPE-REF>
                              <TARGET-DATA-PROTOTYPE-REF DEST="VARIABLE-DATA-PROTOTYPE">/ETS/PortInterfaces/ETS_ModeRequest_SD_ConsumeEventGroup/requestedMode</TARGET-DATA-PROTOTYPE-REF>
                            </AUTOSAR-VARIABLE-IREF>
                          </ACCESSED-VARIABLE>
                        </VARIABLE-ACCESS>
[!ENDIF!]
[!IF "EnhancedTestabilityService/TestingClientInteraction/clientServiceActivate = 'true'"!]
                        <VARIABLE-ACCESS>
                          <SHORT-NAME>dsp_requestedMode2</SHORT-NAME>
                          <ACCESSED-VARIABLE>
                            <AUTOSAR-VARIABLE-IREF>
                              <PORT-PROTOTYPE-REF DEST="P-PORT-PROTOTYPE">/ETS/SwcImplementations/ETS/ETS_SD_ServerServiceRequest</PORT-PROTOTYPE-REF>
                              <TARGET-DATA-PROTOTYPE-REF DEST="VARIABLE-DATA-PROTOTYPE">/ETS/PortInterfaces/ETS_ModeRequest_SD_ServerService/requestedMode</TARGET-DATA-PROTOTYPE-REF>
                            </AUTOSAR-VARIABLE-IREF>
                          </ACCESSED-VARIABLE>
                        </VARIABLE-ACCESS>
[!ENDIF!]
                      </DATA-SEND-POINTS>
[!IF "General/ETS_EnableDET = 'true'"!]
                      <SERVER-CALL-POINTS>
                        <SYNCHRONOUS-SERVER-CALL-POINT>
                          <SHORT-NAME>SSCP_DetService_Det_ReportError</SHORT-NAME>
                          <OPERATION-IREF>
                            <CONTEXT-R-PORT-REF DEST="R-PORT-PROTOTYPE">/ETS/SwcImplementations/ETS/Det</CONTEXT-R-PORT-REF>
                            <TARGET-REQUIRED-OPERATION-REF DEST="CLIENT-SERVER-OPERATION">/ETS/PortInterfaces/DetService/ReportError</TARGET-REQUIRED-OPERATION-REF>
                          </OPERATION-IREF>
                          <TIMEOUT>0.0</TIMEOUT>
                        </SYNCHRONOUS-SERVER-CALL-POINT>
                      </SERVER-CALL-POINTS>
[!ENDIF!]
                      <SYMBOL>ETS_Init</SYMBOL>
                    </RUNNABLE-ENTITY>
                    <RUNNABLE-ENTITY>
                      <SHORT-NAME>MainFunction</SHORT-NAME>
                      <CAN-ENTER-EXCLUSIVE-AREA-REFS>
                        <CAN-ENTER-EXCLUSIVE-AREA-REF DEST="EXCLUSIVE-AREA">/ETS/SwcImplementations/ETS/IB_ETS/ETS_EXCLUSIVE_AREA_0</CAN-ENTER-EXCLUSIVE-AREA-REF>
                      </CAN-ENTER-EXCLUSIVE-AREA-REFS>
                      <MINIMUM-START-INTERVAL>0.0</MINIMUM-START-INTERVAL>
                      <CAN-BE-INVOKED-CONCURRENTLY>false</CAN-BE-INVOKED-CONCURRENTLY>
                      <DATA-SEND-POINTS>
[!IF "EnhancedTestabilityService/EventsAndFields/TestEventUINT8 = 'true'"!]
                        <VARIABLE-ACCESS>
                          <SHORT-NAME>DSP_TestEventUINT8</SHORT-NAME>
                          <ACCESSED-VARIABLE>
                            <AUTOSAR-VARIABLE-IREF>
                              <PORT-PROTOTYPE-REF DEST="P-PORT-PROTOTYPE">/ETS/SwcImplementations/ETS/ETS_TestEventUINT8</PORT-PROTOTYPE-REF>
                              <TARGET-DATA-PROTOTYPE-REF DEST="VARIABLE-DATA-PROTOTYPE">/ETS/PortInterfaces/ETS_TestEventUINT8/TestEventUINT8</TARGET-DATA-PROTOTYPE-REF>
                            </AUTOSAR-VARIABLE-IREF>
                          </ACCESSED-VARIABLE>
                        </VARIABLE-ACCESS>
[!ENDIF!]
[!IF "EnhancedTestabilityService/EventsAndFields/TestEventUINT8Reliable = 'true'"!]
                        <VARIABLE-ACCESS>
                          <SHORT-NAME>DSP_TestEventUINT8Reliable</SHORT-NAME>
                          <ACCESSED-VARIABLE>
                            <AUTOSAR-VARIABLE-IREF>
                              <PORT-PROTOTYPE-REF DEST="P-PORT-PROTOTYPE">/ETS/SwcImplementations/ETS/ETS_TestEventUINT8Reliable</PORT-PROTOTYPE-REF>
                              <TARGET-DATA-PROTOTYPE-REF DEST="VARIABLE-DATA-PROTOTYPE">/ETS/PortInterfaces/ETS_TestEventUINT8Reliable/TestEventUINT8Reliable</TARGET-DATA-PROTOTYPE-REF>
                            </AUTOSAR-VARIABLE-IREF>
                          </ACCESSED-VARIABLE>
                        </VARIABLE-ACCESS>
[!ENDIF!]
[!IF "EnhancedTestabilityService/EventsAndFields/TestEventUINT8Array = 'true'"!]
                        <VARIABLE-ACCESS>
                          <SHORT-NAME>DSP_TestEventUINT8Array</SHORT-NAME>
                          <ACCESSED-VARIABLE>
                            <AUTOSAR-VARIABLE-IREF>
                              <PORT-PROTOTYPE-REF DEST="P-PORT-PROTOTYPE">/ETS/SwcImplementations/ETS/ETS_TestEventUINT8Array</PORT-PROTOTYPE-REF>
                              <TARGET-DATA-PROTOTYPE-REF DEST="VARIABLE-DATA-PROTOTYPE">/ETS/PortInterfaces/ETS_TestEventUINT8Array/TestEventUINT8Array</TARGET-DATA-PROTOTYPE-REF>
                            </AUTOSAR-VARIABLE-IREF>
                          </ACCESSED-VARIABLE>
                        </VARIABLE-ACCESS>
[!ENDIF!]
[!IF "EnhancedTestabilityService/EventsAndFields/TestEventUINT8E2E = 'true'"!]
                        <VARIABLE-ACCESS>
                          <SHORT-NAME>DSP_TestEventUINT8E2E</SHORT-NAME>
                          <ACCESSED-VARIABLE>
                            <AUTOSAR-VARIABLE-IREF>
                              <PORT-PROTOTYPE-REF DEST="P-PORT-PROTOTYPE">/ETS/SwcImplementations/ETS/ETS_TestEventUINT8E2E</PORT-PROTOTYPE-REF>
                              <TARGET-DATA-PROTOTYPE-REF DEST="VARIABLE-DATA-PROTOTYPE">/ETS/PortInterfaces/ETS_TestEventUINT8E2E/TestEventUINT8E2E</TARGET-DATA-PROTOTYPE-REF>
                            </AUTOSAR-VARIABLE-IREF>
                          </ACCESSED-VARIABLE>
                        </VARIABLE-ACCESS>
[!ENDIF!]
[!IF "EnhancedTestabilityService/EventsAndFields/TestEventUINT8Multicast = 'true'"!]
                        <VARIABLE-ACCESS>
                          <SHORT-NAME>DSP_TestEventUINT8Multicast</SHORT-NAME>
                          <ACCESSED-VARIABLE>
                            <AUTOSAR-VARIABLE-IREF>
                              <PORT-PROTOTYPE-REF DEST="P-PORT-PROTOTYPE">/ETS/SwcImplementations/ETS/ETS_TestEventUINT8Multicast</PORT-PROTOTYPE-REF>
                              <TARGET-DATA-PROTOTYPE-REF DEST="VARIABLE-DATA-PROTOTYPE">/ETS/PortInterfaces/ETS_TestEventUINT8Multicast/TestEventUINT8Multicast</TARGET-DATA-PROTOTYPE-REF>
                            </AUTOSAR-VARIABLE-IREF>
                          </ACCESSED-VARIABLE>
                        </VARIABLE-ACCESS>
[!ENDIF!]
[!IF "EnhancedTestabilityService/EventsAndFields/InterfaceVersion = 'true'"!]
                        <VARIABLE-ACCESS>
                          <SHORT-NAME>DSP_Notifier1</SHORT-NAME>
                          <ACCESSED-VARIABLE>
                            <AUTOSAR-VARIABLE-IREF>
                              <PORT-PROTOTYPE-REF DEST="P-PORT-PROTOTYPE">/ETS/SwcImplementations/ETS/ETS_NotifyFieldsInterfaceVersion</PORT-PROTOTYPE-REF>
                              <TARGET-DATA-PROTOTYPE-REF DEST="VARIABLE-DATA-PROTOTYPE">/ETS/PortInterfaces/ETS_NotifyFieldInterfaceVersion/Notifier</TARGET-DATA-PROTOTYPE-REF>
                            </AUTOSAR-VARIABLE-IREF>
                          </ACCESSED-VARIABLE>
                        </VARIABLE-ACCESS>
[!ENDIF!]
[!IF "EnhancedTestabilityService/EventsAndFields/TestFieldUINT8 = 'true'"!]
                        <VARIABLE-ACCESS>
                          <SHORT-NAME>DSP_Notifier2</SHORT-NAME>
                          <ACCESSED-VARIABLE>
                            <AUTOSAR-VARIABLE-IREF>
                              <PORT-PROTOTYPE-REF DEST="P-PORT-PROTOTYPE">/ETS/SwcImplementations/ETS/ETS_NotifyFieldTestFieldUINT8</PORT-PROTOTYPE-REF>
                              <TARGET-DATA-PROTOTYPE-REF DEST="VARIABLE-DATA-PROTOTYPE">/ETS/PortInterfaces/ETS_NotifyFieldTestFieldUINT8/Notifier</TARGET-DATA-PROTOTYPE-REF>
                            </AUTOSAR-VARIABLE-IREF>
                          </ACCESSED-VARIABLE>
                        </VARIABLE-ACCESS>
[!ENDIF!]
[!IF "EnhancedTestabilityService/TestingClientInteraction/clientServiceActivate = 'true'"!]
                        <VARIABLE-ACCESS>
                          <SHORT-NAME>DSP_ClientService</SHORT-NAME>
                          <ACCESSED-VARIABLE>
                            <AUTOSAR-VARIABLE-IREF>
                              <PORT-PROTOTYPE-REF DEST="P-PORT-PROTOTYPE">/ETS/SwcImplementations/ETS/ETS_SD_ClientServiceRequest</PORT-PROTOTYPE-REF>
                              <TARGET-DATA-PROTOTYPE-REF DEST="VARIABLE-DATA-PROTOTYPE">/ETS/PortInterfaces/ETS_ModeRequest_SD_ClientService/requestedMode</TARGET-DATA-PROTOTYPE-REF>
                            </AUTOSAR-VARIABLE-IREF>
                          </ACCESSED-VARIABLE>
                        </VARIABLE-ACCESS>
[!ENDIF!]
[!IF "EnhancedTestabilityService/TestingClientInteraction/clientServiceActivate = 'true'"!]
                        <VARIABLE-ACCESS>
                          <SHORT-NAME>DSP_ClientService0</SHORT-NAME>
                          <ACCESSED-VARIABLE>
                            <AUTOSAR-VARIABLE-IREF>
                              <PORT-PROTOTYPE-REF DEST="P-PORT-PROTOTYPE">/ETS/SwcImplementations/ETS/ETS_SD_ServerServiceRequest</PORT-PROTOTYPE-REF>
                              <TARGET-DATA-PROTOTYPE-REF DEST="VARIABLE-DATA-PROTOTYPE">/ETS/PortInterfaces/ETS_ModeRequest_SD_ServerService/requestedMode</TARGET-DATA-PROTOTYPE-REF>
                            </AUTOSAR-VARIABLE-IREF>
                          </ACCESSED-VARIABLE>
                        </VARIABLE-ACCESS>
[!ENDIF!]
[!IF "EnhancedTestabilityService/TestingClientInteraction/clientServiceSubscribeEventgroup = 'true'"!]
                        <VARIABLE-ACCESS>
                          <SHORT-NAME>DSP_ClientService00</SHORT-NAME>
                          <ACCESSED-VARIABLE>
                            <AUTOSAR-VARIABLE-IREF>
                              <PORT-PROTOTYPE-REF DEST="P-PORT-PROTOTYPE">/ETS/SwcImplementations/ETS/ETS_SD_ConsumedEventGroupRequest</PORT-PROTOTYPE-REF>
                              <TARGET-DATA-PROTOTYPE-REF DEST="VARIABLE-DATA-PROTOTYPE">/ETS/PortInterfaces/ETS_ModeRequest_SD_ConsumeEventGroup/requestedMode</TARGET-DATA-PROTOTYPE-REF>
                            </AUTOSAR-VARIABLE-IREF>
                          </ACCESSED-VARIABLE>
                        </VARIABLE-ACCESS>
[!ENDIF!]
                      </DATA-SEND-POINTS>
                      <SERVER-CALL-POINTS>
[!IF "General/ETS_EnableDET = 'true'"!]
                        <SYNCHRONOUS-SERVER-CALL-POINT>
                          <SHORT-NAME>SSCP_DetService_Det_ReportError</SHORT-NAME>
                          <OPERATION-IREF>
                            <CONTEXT-R-PORT-REF DEST="R-PORT-PROTOTYPE">/ETS/SwcImplementations/ETS/Det</CONTEXT-R-PORT-REF>
                            <TARGET-REQUIRED-OPERATION-REF DEST="CLIENT-SERVER-OPERATION">/ETS/PortInterfaces/DetService/ReportError</TARGET-REQUIRED-OPERATION-REF>
                          </OPERATION-IREF>
                          <TIMEOUT>0.0</TIMEOUT>
                        </SYNCHRONOUS-SERVER-CALL-POINT>
[!ENDIF!]
                        </SERVER-CALL-POINTS>
                      <SYMBOL>ETS_MainFunction</SYMBOL>
                    </RUNNABLE-ENTITY>
[!IF "EnhancedTestabilityService/TestingClientInteraction/resetInterface = 'true'"!]
                    <RUNNABLE-ENTITY>
                      <SHORT-NAME>ResetInterface</SHORT-NAME>
                      <MINIMUM-START-INTERVAL>0.0</MINIMUM-START-INTERVAL>
                      <CAN-BE-INVOKED-CONCURRENTLY>false</CAN-BE-INVOKED-CONCURRENTLY>
                      <SYMBOL>ETS_ResetInterface</SYMBOL>
                    </RUNNABLE-ENTITY>
[!ENDIF!]
[!IF "EnhancedTestabilityService/TestingClientInteraction/suspendInterface = 'true'"!]
                    <RUNNABLE-ENTITY>
                      <SHORT-NAME>SuspendInterface</SHORT-NAME>
                      <MINIMUM-START-INTERVAL>0.0</MINIMUM-START-INTERVAL>
                      <CAN-BE-INVOKED-CONCURRENTLY>false</CAN-BE-INVOKED-CONCURRENTLY>
                      <DATA-RECEIVE-POINT-BY-ARGUMENTS>
                        <VARIABLE-ACCESS>
                          <SHORT-NAME>dsp_requestedMode</SHORT-NAME>
                          <ACCESSED-VARIABLE>
                            <AUTOSAR-VARIABLE-IREF>
                              <PORT-PROTOTYPE-REF DEST="R-PORT-PROTOTYPE">/ETS/SwcImplementations/ETS/ETS_SuspendInterface</PORT-PROTOTYPE-REF>
                              <TARGET-DATA-PROTOTYPE-REF DEST="VARIABLE-DATA-PROTOTYPE">/ETS/PortInterfaces/ETS_SuspendInterface/suspendInterface</TARGET-DATA-PROTOTYPE-REF>
                            </AUTOSAR-VARIABLE-IREF>
                          </ACCESSED-VARIABLE>
                        </VARIABLE-ACCESS>
                      </DATA-RECEIVE-POINT-BY-ARGUMENTS>
                      <SYMBOL>ETS_SuspendInterface</SYMBOL>
                    </RUNNABLE-ENTITY>
[!ENDIF!]
[!IF "EnhancedTestabilityService/TestingEvents/triggerEventUINT8 = 'true'"!]
                    <RUNNABLE-ENTITY>
                      <SHORT-NAME>TriggerEventUINT8</SHORT-NAME>
                      <MINIMUM-START-INTERVAL>0.0</MINIMUM-START-INTERVAL>
                      <CAN-BE-INVOKED-CONCURRENTLY>false</CAN-BE-INVOKED-CONCURRENTLY>
                      <DATA-RECEIVE-POINT-BY-ARGUMENTS>
                        <VARIABLE-ACCESS>
                          <SHORT-NAME>drparg_triggerEventUINT8</SHORT-NAME>
                          <ACCESSED-VARIABLE>
                            <AUTOSAR-VARIABLE-IREF>
                              <PORT-PROTOTYPE-REF DEST="R-PORT-PROTOTYPE">/ETS/SwcImplementations/ETS/ETS_TriggerEventUINT8</PORT-PROTOTYPE-REF>
                              <TARGET-DATA-PROTOTYPE-REF DEST="VARIABLE-DATA-PROTOTYPE">/ETS/PortInterfaces/ETS_TriggerEventUINT8/triggerEventUINT8</TARGET-DATA-PROTOTYPE-REF>
                            </AUTOSAR-VARIABLE-IREF>
                          </ACCESSED-VARIABLE>
                        </VARIABLE-ACCESS>
                      </DATA-RECEIVE-POINT-BY-ARGUMENTS>
                      <SYMBOL>ETS_TriggerEventUINT8</SYMBOL>
                    </RUNNABLE-ENTITY>
[!ENDIF!]
[!IF "EnhancedTestabilityService/TestingEvents/triggerEventUINT8Array = 'true'"!]
                    <RUNNABLE-ENTITY>
                      <SHORT-NAME>TriggerEventUINT8Array</SHORT-NAME>
                      <MINIMUM-START-INTERVAL>0.0</MINIMUM-START-INTERVAL>
                      <CAN-BE-INVOKED-CONCURRENTLY>false</CAN-BE-INVOKED-CONCURRENTLY>
                      <DATA-RECEIVE-POINT-BY-ARGUMENTS>
                        <VARIABLE-ACCESS>
                          <SHORT-NAME>drparg_triggerEventUINT8Array</SHORT-NAME>
                          <ACCESSED-VARIABLE>
                            <AUTOSAR-VARIABLE-IREF>
                              <PORT-PROTOTYPE-REF DEST="R-PORT-PROTOTYPE">/ETS/SwcImplementations/ETS/ETS_TriggerEventUINT8Array</PORT-PROTOTYPE-REF>
                              <TARGET-DATA-PROTOTYPE-REF DEST="VARIABLE-DATA-PROTOTYPE">/ETS/PortInterfaces/ETS_TriggerEventUINT8Array/triggerEventUINT8Array</TARGET-DATA-PROTOTYPE-REF>
                            </AUTOSAR-VARIABLE-IREF>
                          </ACCESSED-VARIABLE>
                        </VARIABLE-ACCESS>
                      </DATA-RECEIVE-POINT-BY-ARGUMENTS>
                      <SYMBOL>ETS_TriggerEventUINT8Array</SYMBOL>
                    </RUNNABLE-ENTITY>
[!ENDIF!]
[!IF "EnhancedTestabilityService/TestingEvents/triggerEventUINT8E2E = 'true'"!]
                    <RUNNABLE-ENTITY>
                      <SHORT-NAME>TriggerEventUINT8E2E</SHORT-NAME>
                      <MINIMUM-START-INTERVAL>0.0</MINIMUM-START-INTERVAL>
                      <CAN-BE-INVOKED-CONCURRENTLY>false</CAN-BE-INVOKED-CONCURRENTLY>
                      <DATA-RECEIVE-POINT-BY-ARGUMENTS>
                        <VARIABLE-ACCESS>
                          <SHORT-NAME>drparg_triggerEventUINT8E2E</SHORT-NAME>
                          <ACCESSED-VARIABLE>
                            <AUTOSAR-VARIABLE-IREF>
                              <PORT-PROTOTYPE-REF DEST="R-PORT-PROTOTYPE">/ETS/SwcImplementations/ETS/ETS_TriggerEventUINT8E2E</PORT-PROTOTYPE-REF>
                              <TARGET-DATA-PROTOTYPE-REF DEST="VARIABLE-DATA-PROTOTYPE">/ETS/PortInterfaces/ETS_TriggerEventUINT8E2E/triggerEventUINT8E2E</TARGET-DATA-PROTOTYPE-REF>
                            </AUTOSAR-VARIABLE-IREF>
                          </ACCESSED-VARIABLE>
                        </VARIABLE-ACCESS>
                      </DATA-RECEIVE-POINT-BY-ARGUMENTS>
                      <SYMBOL>ETS_TriggerEventUINT8E2E</SYMBOL>
                    </RUNNABLE-ENTITY>
[!ENDIF!]
[!IF "EnhancedTestabilityService/TestingEvents/triggerEventUINT8Multicast = 'true'"!]
                    <RUNNABLE-ENTITY>
                      <SHORT-NAME>TriggerEventUINT8Multicast</SHORT-NAME>
                      <MINIMUM-START-INTERVAL>0.0</MINIMUM-START-INTERVAL>
                      <CAN-BE-INVOKED-CONCURRENTLY>false</CAN-BE-INVOKED-CONCURRENTLY>
                      <DATA-RECEIVE-POINT-BY-ARGUMENTS>
                        <VARIABLE-ACCESS>
                          <SHORT-NAME>drparg_triggerEventUINT8Multicast</SHORT-NAME>
                          <ACCESSED-VARIABLE>
                            <AUTOSAR-VARIABLE-IREF>
                              <PORT-PROTOTYPE-REF DEST="R-PORT-PROTOTYPE">/ETS/SwcImplementations/ETS/ETS_TriggerEventUINT8Multicast</PORT-PROTOTYPE-REF>
                              <TARGET-DATA-PROTOTYPE-REF DEST="VARIABLE-DATA-PROTOTYPE">/ETS/PortInterfaces/ETS_TriggerEventUINT8Multicast/triggerEventUINT8Multicast</TARGET-DATA-PROTOTYPE-REF>
                            </AUTOSAR-VARIABLE-IREF>
                          </ACCESSED-VARIABLE>
                        </VARIABLE-ACCESS>
                      </DATA-RECEIVE-POINT-BY-ARGUMENTS>
                      <SYMBOL>ETS_TriggerEventUINT8Multicast</SYMBOL>
                    </RUNNABLE-ENTITY>
[!ENDIF!]
[!IF "EnhancedTestabilityService/TestingEvents/triggerEventUINT8Reliable = 'true'"!]
                    <RUNNABLE-ENTITY>
                      <SHORT-NAME>TriggerEventUINT8Reliable</SHORT-NAME>
                      <MINIMUM-START-INTERVAL>0.0</MINIMUM-START-INTERVAL>
                      <CAN-BE-INVOKED-CONCURRENTLY>false</CAN-BE-INVOKED-CONCURRENTLY>
                      <DATA-RECEIVE-POINT-BY-ARGUMENTS>
                        <VARIABLE-ACCESS>
                          <SHORT-NAME>drparg_triggerEventUINT8Reliable</SHORT-NAME>
                          <ACCESSED-VARIABLE>
                            <AUTOSAR-VARIABLE-IREF>
                              <PORT-PROTOTYPE-REF DEST="R-PORT-PROTOTYPE">/ETS/SwcImplementations/ETS/ETS_TriggerEventUINT8Reliable</PORT-PROTOTYPE-REF>
                              <TARGET-DATA-PROTOTYPE-REF DEST="VARIABLE-DATA-PROTOTYPE">/ETS/PortInterfaces/ETS_TriggerEventUINT8Reliable/triggerEventUINT8Reliable</TARGET-DATA-PROTOTYPE-REF>
                            </AUTOSAR-VARIABLE-IREF>
                          </ACCESSED-VARIABLE>
                        </VARIABLE-ACCESS>
                      </DATA-RECEIVE-POINT-BY-ARGUMENTS>
                      <SYMBOL>ETS_TriggerEventUINT8Reliable</SYMBOL>
                    </RUNNABLE-ENTITY>
[!ENDIF!]
[!IF "EnhancedTestabilityService/EchoingDataTypes/echoUINT64 = 'true'"!]
                    <RUNNABLE-ENTITY>
                      <SHORT-NAME>EchoUINT64</SHORT-NAME>
                      <MINIMUM-START-INTERVAL>0.0</MINIMUM-START-INTERVAL>
                      <CAN-BE-INVOKED-CONCURRENTLY>false</CAN-BE-INVOKED-CONCURRENTLY>
                      <SYMBOL>ETS_EchoUINT64</SYMBOL>
                    </RUNNABLE-ENTITY>
[!ENDIF!]
[!IF "EnhancedTestabilityService/EchoingDataTypes/echoInt64 = 'true'"!]
                    <RUNNABLE-ENTITY>
                      <SHORT-NAME>EchoINT64</SHORT-NAME>
                      <MINIMUM-START-INTERVAL>0.0</MINIMUM-START-INTERVAL>
                      <CAN-BE-INVOKED-CONCURRENTLY>false</CAN-BE-INVOKED-CONCURRENTLY>
                      <SYMBOL>ETS_EchoINT64</SYMBOL>
                    </RUNNABLE-ENTITY>
[!ENDIF!]
[!IF "EnhancedTestabilityService/EchoingDataTypes/echoINT8 = 'true'"!]
                    <RUNNABLE-ENTITY>
                      <SHORT-NAME>EchoINT8</SHORT-NAME>
                      <MINIMUM-START-INTERVAL>0.0</MINIMUM-START-INTERVAL>
                      <CAN-BE-INVOKED-CONCURRENTLY>false</CAN-BE-INVOKED-CONCURRENTLY>
                      <SYMBOL>ETS_EchoINT8</SYMBOL>
                    </RUNNABLE-ENTITY>
[!ENDIF!]
[!IF "EnhancedTestabilityService/EchoingDataTypes/echoFLOAT64 = 'true'"!]
                    <RUNNABLE-ENTITY>
                      <SHORT-NAME>EchoFLOAT64</SHORT-NAME>
                      <MINIMUM-START-INTERVAL>0.0</MINIMUM-START-INTERVAL>
                      <CAN-BE-INVOKED-CONCURRENTLY>false</CAN-BE-INVOKED-CONCURRENTLY>
                      <SYMBOL>ETS_EchoFLOAT64</SYMBOL>
                    </RUNNABLE-ENTITY>
[!ENDIF!]
[!IF "EnhancedTestabilityService/EchoingDataTypes/echoENUM = 'true'"!]
                    <RUNNABLE-ENTITY>
                      <SHORT-NAME>EchoENUM</SHORT-NAME>
                      <MINIMUM-START-INTERVAL>0.0</MINIMUM-START-INTERVAL>
                      <CAN-BE-INVOKED-CONCURRENTLY>false</CAN-BE-INVOKED-CONCURRENTLY>
                      <SYMBOL>ETS_EchoENUM</SYMBOL>
                    </RUNNABLE-ENTITY>
[!ENDIF!]
[!IF "EnhancedTestabilityService/EchoingDataTypes/echoUINT8Array = 'true'"!]
                    <RUNNABLE-ENTITY>
                      <SHORT-NAME>EchoUINT8Array</SHORT-NAME>
                      <MINIMUM-START-INTERVAL>0.0</MINIMUM-START-INTERVAL>
                      <CAN-BE-INVOKED-CONCURRENTLY>false</CAN-BE-INVOKED-CONCURRENTLY>
                      <SYMBOL>ETS_EchoUINT8Array</SYMBOL>
                    </RUNNABLE-ENTITY>
[!ENDIF!]
[!IF "EnhancedTestabilityService/EchoingDataTypes/echoStaticUINT8Array = 'true'"!]
                    <RUNNABLE-ENTITY>
                      <SHORT-NAME>EchoStaticUINT8Array</SHORT-NAME>
                      <MINIMUM-START-INTERVAL>0.0</MINIMUM-START-INTERVAL>
                      <CAN-BE-INVOKED-CONCURRENTLY>true</CAN-BE-INVOKED-CONCURRENTLY>
                      <SYMBOL>ETS_EchoStaticUINT8Array</SYMBOL>
                    </RUNNABLE-ENTITY>
[!ENDIF!]
[!IF "EnhancedTestabilityService/EchoingDataTypes/echoBitfields = 'true'"!]
                    <RUNNABLE-ENTITY>
                      <SHORT-NAME>EchoBitfields</SHORT-NAME>
                      <MINIMUM-START-INTERVAL>0.0</MINIMUM-START-INTERVAL>
                      <CAN-BE-INVOKED-CONCURRENTLY>true</CAN-BE-INVOKED-CONCURRENTLY>
                      <SYMBOL>ETS_EchoBitfields</SYMBOL>
                    </RUNNABLE-ENTITY>
[!ENDIF!]
[!IF "EnhancedTestabilityService/EchoingDataTypes/echoTYPEDEF = 'true'"!]
                    <RUNNABLE-ENTITY>
                      <SHORT-NAME>EchoTYPEDEF</SHORT-NAME>
                      <MINIMUM-START-INTERVAL>0.0</MINIMUM-START-INTERVAL>
                      <CAN-BE-INVOKED-CONCURRENTLY>true</CAN-BE-INVOKED-CONCURRENTLY>
                      <SYMBOL>ETS_EchoTYPEDEF</SYMBOL>
                    </RUNNABLE-ENTITY>
[!ENDIF!]
[!IF "EnhancedTestabilityService/EchoingDataTypes/echoUINT8Array16BitLength = 'true'"!]
                    <RUNNABLE-ENTITY>
                      <SHORT-NAME>EchoUINT8Array16Bitlength</SHORT-NAME>
                      <MINIMUM-START-INTERVAL>0.0</MINIMUM-START-INTERVAL>
                      <CAN-BE-INVOKED-CONCURRENTLY>true</CAN-BE-INVOKED-CONCURRENTLY>
                      <SYMBOL>ETS_EchoUINT8Array16Bitlength</SYMBOL>
                    </RUNNABLE-ENTITY>
[!ENDIF!]
[!IF "EnhancedTestabilityService/EchoingDataTypes/echoUINT8E2E = 'true'"!]
                    <RUNNABLE-ENTITY>
                      <SHORT-NAME>EchoUINT8E2E</SHORT-NAME>
                      <MINIMUM-START-INTERVAL>0.0</MINIMUM-START-INTERVAL>
                      <CAN-BE-INVOKED-CONCURRENTLY>true</CAN-BE-INVOKED-CONCURRENTLY>
                      <SYMBOL>ETS_EchoUINT8E2E</SYMBOL>
                    </RUNNABLE-ENTITY>
[!ENDIF!]
[!IF "EnhancedTestabilityService/EchoingDataTypes/echoUINT8RELIABLE = 'true'"!]
                    <RUNNABLE-ENTITY>
                      <SHORT-NAME>EchoUINT8RELIABLE</SHORT-NAME>
                      <MINIMUM-START-INTERVAL>0.0</MINIMUM-START-INTERVAL>
                      <CAN-BE-INVOKED-CONCURRENTLY>true</CAN-BE-INVOKED-CONCURRENTLY>
                      <SYMBOL>ETS_EchoUINT8RELIABLE</SYMBOL>
                    </RUNNABLE-ENTITY>
[!ENDIF!]
[!IF "EnhancedTestabilityService/EchoingDataTypes/echoSTRUCTSimple = 'true'"!]
                    <RUNNABLE-ENTITY>
                      <SHORT-NAME>EchoSTRUCTSimple</SHORT-NAME>
                      <MINIMUM-START-INTERVAL>0.0</MINIMUM-START-INTERVAL>
                      <CAN-BE-INVOKED-CONCURRENTLY>true</CAN-BE-INVOKED-CONCURRENTLY>
                      <SYMBOL>ETS_EchoSTRUCTSimple</SYMBOL>
                    </RUNNABLE-ENTITY>
[!ENDIF!]
[!IF "EnhancedTestabilityService/EchoingDataTypes/echoUINT8Array8BitLength = 'true'"!]
                    <RUNNABLE-ENTITY>
                      <SHORT-NAME>EchoUINT8Array8BitLength</SHORT-NAME>
                      <MINIMUM-START-INTERVAL>0.0</MINIMUM-START-INTERVAL>
                      <CAN-BE-INVOKED-CONCURRENTLY>false</CAN-BE-INVOKED-CONCURRENTLY>
                      <SYMBOL>ETS_EchoUINT8Array8BitLength</SYMBOL>
                    </RUNNABLE-ENTITY>
[!ENDIF!]
[!IF "EnhancedTestabilityService/EchoingDataTypes/echoUINT8ArrayMinSize = 'true'"!]
                    <RUNNABLE-ENTITY>
                      <SHORT-NAME>EchoUINT8ArrayMinSize</SHORT-NAME>
                      <MINIMUM-START-INTERVAL>0.0</MINIMUM-START-INTERVAL>
                      <CAN-BE-INVOKED-CONCURRENTLY>true</CAN-BE-INVOKED-CONCURRENTLY>
                      <SYMBOL>ETS_EchoUINT8ArrayMinSize</SYMBOL>
                    </RUNNABLE-ENTITY>
[!ENDIF!]
[!IF "EnhancedTestabilityService/EchoingDataTypes/echoUINT8Array2Dim = 'true'"!]
                    <RUNNABLE-ENTITY>
                      <SHORT-NAME>EchoUINT8Array2Dim</SHORT-NAME>
                      <MINIMUM-START-INTERVAL>0.0</MINIMUM-START-INTERVAL>
                      <CAN-BE-INVOKED-CONCURRENTLY>true</CAN-BE-INVOKED-CONCURRENTLY>
                      <SYMBOL>ETS_EchoUINT8Array2Dim</SYMBOL>
                    </RUNNABLE-ENTITY>
[!ENDIF!]
[!IF "EnhancedTestabilityService/EchoingDataTypes/echoUNION = 'true'"!]
                    <RUNNABLE-ENTITY>
                      <SHORT-NAME>EchoUNION</SHORT-NAME>
                      <MINIMUM-START-INTERVAL>0.0</MINIMUM-START-INTERVAL>
                      <CAN-BE-INVOKED-CONCURRENTLY>true</CAN-BE-INVOKED-CONCURRENTLY>
                      <SYMBOL>ETS_EchoUNION</SYMBOL>
                    </RUNNABLE-ENTITY>
[!ENDIF!]
[!IF "EnhancedTestabilityService/EchoingDataTypes/echoUTF8FIXED = 'true'"!]
                    <RUNNABLE-ENTITY>
                      <SHORT-NAME>EchoUTF8FIXED</SHORT-NAME>
                      <MINIMUM-START-INTERVAL>0.0</MINIMUM-START-INTERVAL>
                      <CAN-BE-INVOKED-CONCURRENTLY>true</CAN-BE-INVOKED-CONCURRENTLY>
                      <SYMBOL>ETS_EchoUTF8FIXED</SYMBOL>
                    </RUNNABLE-ENTITY>
[!ENDIF!]
[!IF "EnhancedTestabilityService/EchoingDataTypes/echoUTF16FIXED = 'true'"!]
                    <RUNNABLE-ENTITY>
                      <SHORT-NAME>EchoUTF16FIXED</SHORT-NAME>
                      <MINIMUM-START-INTERVAL>0.0</MINIMUM-START-INTERVAL>
                      <CAN-BE-INVOKED-CONCURRENTLY>true</CAN-BE-INVOKED-CONCURRENTLY>
                      <SYMBOL>ETS_EchoUTF16FIXED</SYMBOL>
                    </RUNNABLE-ENTITY>
[!ENDIF!]
[!IF "EnhancedTestabilityService/EventsAndFields/TestEventUINT8 = 'true'"!]
                    <RUNNABLE-ENTITY>
                      <SHORT-NAME>TestEventUINT8</SHORT-NAME>
                      <MINIMUM-START-INTERVAL>0.0</MINIMUM-START-INTERVAL>
                      <CAN-BE-INVOKED-CONCURRENTLY>true</CAN-BE-INVOKED-CONCURRENTLY>
                      <DATA-RECEIVE-POINT-BY-ARGUMENTS>
                        <VARIABLE-ACCESS>
                          <SHORT-NAME>drparg_TestEventUINT8</SHORT-NAME>
                          <ACCESSED-VARIABLE>
                            <AUTOSAR-VARIABLE-IREF>
                              <PORT-PROTOTYPE-REF DEST="R-PORT-PROTOTYPE">/ETS/SwcImplementations/ETS/ETS_TestEventUINT8Client</PORT-PROTOTYPE-REF>
                              <TARGET-DATA-PROTOTYPE-REF DEST="VARIABLE-DATA-PROTOTYPE">/ETS/PortInterfaces/ETS_TestEventUINT8/TestEventUINT8</TARGET-DATA-PROTOTYPE-REF>
                            </AUTOSAR-VARIABLE-IREF>
                          </ACCESSED-VARIABLE>
                        </VARIABLE-ACCESS>
                      </DATA-RECEIVE-POINT-BY-ARGUMENTS>
                      <SYMBOL>ETS_TestEventUINT8</SYMBOL>
                    </RUNNABLE-ENTITY>
[!ENDIF!]
[!IF "EnhancedTestabilityService/EventsAndFields/TestEventUINT8Reliable = 'true'"!]
                    <RUNNABLE-ENTITY>
                      <SHORT-NAME>TestEventUINT8Reliable</SHORT-NAME>
                      <MINIMUM-START-INTERVAL>0.0</MINIMUM-START-INTERVAL>
                      <CAN-BE-INVOKED-CONCURRENTLY>true</CAN-BE-INVOKED-CONCURRENTLY>
                      <DATA-RECEIVE-POINT-BY-ARGUMENTS>
                        <VARIABLE-ACCESS>
                          <SHORT-NAME>drparg_TestEventUINT8Reliable</SHORT-NAME>
                          <ACCESSED-VARIABLE>
                            <AUTOSAR-VARIABLE-IREF>
                              <PORT-PROTOTYPE-REF DEST="R-PORT-PROTOTYPE">/ETS/SwcImplementations/ETS/ETS_TestEventUINT8ReliableClient</PORT-PROTOTYPE-REF>
                              <TARGET-DATA-PROTOTYPE-REF DEST="VARIABLE-DATA-PROTOTYPE">/ETS/PortInterfaces/ETS_TestEventUINT8Reliable/TestEventUINT8Reliable</TARGET-DATA-PROTOTYPE-REF>
                            </AUTOSAR-VARIABLE-IREF>
                          </ACCESSED-VARIABLE>
                        </VARIABLE-ACCESS>
                      </DATA-RECEIVE-POINT-BY-ARGUMENTS>
                      <SYMBOL>ETS_TestEventUINT8Reliable</SYMBOL>
                    </RUNNABLE-ENTITY>
[!ENDIF!]
[!IF "EnhancedTestabilityService/EventsAndFields/TestEventUINT8Array = 'true'"!]
                    <RUNNABLE-ENTITY>
                      <SHORT-NAME>TestEventUINT8Array</SHORT-NAME>
                      <MINIMUM-START-INTERVAL>0.0</MINIMUM-START-INTERVAL>
                      <CAN-BE-INVOKED-CONCURRENTLY>true</CAN-BE-INVOKED-CONCURRENTLY>
                      <DATA-RECEIVE-POINT-BY-ARGUMENTS>
                        <VARIABLE-ACCESS>
                          <SHORT-NAME>drparg_TestEventUINT8Array</SHORT-NAME>
                            <ACCESSED-VARIABLE>
                              <AUTOSAR-VARIABLE-IREF>
                                <PORT-PROTOTYPE-REF DEST="R-PORT-PROTOTYPE">/ETS/SwcImplementations/ETS/ETS_TestEventUINT8ArrayClient</PORT-PROTOTYPE-REF>
                                <TARGET-DATA-PROTOTYPE-REF DEST="VARIABLE-DATA-PROTOTYPE">/ETS/PortInterfaces/ETS_TestEventUINT8Array/TestEventUINT8Array</TARGET-DATA-PROTOTYPE-REF>
                              </AUTOSAR-VARIABLE-IREF>
                            </ACCESSED-VARIABLE>
                          </VARIABLE-ACCESS>
                        </DATA-RECEIVE-POINT-BY-ARGUMENTS>
                        <SYMBOL>ETS_TestEventUINT8Array</SYMBOL>
                      </RUNNABLE-ENTITY>
[!ENDIF!]
[!IF "EnhancedTestabilityService/EventsAndFields/TestEventUINT8E2E = 'true'"!]
                      <RUNNABLE-ENTITY>
                        <SHORT-NAME>TestEventUINT8E2E</SHORT-NAME>
                        <MINIMUM-START-INTERVAL>0.0</MINIMUM-START-INTERVAL>
                        <CAN-BE-INVOKED-CONCURRENTLY>true</CAN-BE-INVOKED-CONCURRENTLY>
                        <DATA-RECEIVE-POINT-BY-ARGUMENTS>
                          <VARIABLE-ACCESS>
                            <SHORT-NAME>drparg_TestEventUINT8E2E</SHORT-NAME>
                            <ACCESSED-VARIABLE>
                              <AUTOSAR-VARIABLE-IREF>
                                <PORT-PROTOTYPE-REF DEST="R-PORT-PROTOTYPE">/ETS/SwcImplementations/ETS/ETS_TestEventUINT8E2EClient</PORT-PROTOTYPE-REF>
                                <TARGET-DATA-PROTOTYPE-REF DEST="VARIABLE-DATA-PROTOTYPE">/ETS/PortInterfaces/ETS_TestEventUINT8E2E/TestEventUINT8E2E</TARGET-DATA-PROTOTYPE-REF>
                              </AUTOSAR-VARIABLE-IREF>
                            </ACCESSED-VARIABLE>
                          </VARIABLE-ACCESS>
                        </DATA-RECEIVE-POINT-BY-ARGUMENTS>
                        <SYMBOL>ETS_TestEventUINT8E2E</SYMBOL>
                      </RUNNABLE-ENTITY>
[!ENDIF!]
[!IF "EnhancedTestabilityService/EventsAndFields/TestEventUINT8Multicast = 'true'"!]
                      <RUNNABLE-ENTITY>
                        <SHORT-NAME>TestEventUINT8Multicast</SHORT-NAME>
                        <MINIMUM-START-INTERVAL>0.0</MINIMUM-START-INTERVAL>
                        <CAN-BE-INVOKED-CONCURRENTLY>true</CAN-BE-INVOKED-CONCURRENTLY>
                        <DATA-RECEIVE-POINT-BY-ARGUMENTS>
                          <VARIABLE-ACCESS>
                            <SHORT-NAME>drparg_TestEventUINT8Multicast</SHORT-NAME>
                            <ACCESSED-VARIABLE>
                              <AUTOSAR-VARIABLE-IREF>
                                <PORT-PROTOTYPE-REF DEST="R-PORT-PROTOTYPE">/ETS/SwcImplementations/ETS/ETS_TestEventUINT8MulticastClient</PORT-PROTOTYPE-REF>
                                <TARGET-DATA-PROTOTYPE-REF DEST="VARIABLE-DATA-PROTOTYPE">/ETS/PortInterfaces/ETS_TestEventUINT8Multicast/TestEventUINT8Multicast</TARGET-DATA-PROTOTYPE-REF>
                              </AUTOSAR-VARIABLE-IREF>
                            </ACCESSED-VARIABLE>
                           </VARIABLE-ACCESS>
                        </DATA-RECEIVE-POINT-BY-ARGUMENTS>
                        <SYMBOL>ETS_TestEventUINT8Multicast</SYMBOL>
                      </RUNNABLE-ENTITY>
[!ENDIF!]
[!IF "EnhancedTestabilityService/EventsAndFields/TestFieldUINT8 = 'true'"!]
                      <RUNNABLE-ENTITY>
                        <SHORT-NAME>GetFieldTestFieldUINT8</SHORT-NAME>
                        <MINIMUM-START-INTERVAL>0.0</MINIMUM-START-INTERVAL>
                        <CAN-BE-INVOKED-CONCURRENTLY>true</CAN-BE-INVOKED-CONCURRENTLY>
                        <SYMBOL>ETS_GetFieldTestFieldUINT8</SYMBOL>
                      </RUNNABLE-ENTITY>
[!ENDIF!]
[!IF "EnhancedTestabilityService/EventsAndFields/TestFieldUINT8Reliable = 'true'"!]
                      <RUNNABLE-ENTITY>
                        <SHORT-NAME>GetFieldTestFieldUINT8Reliable</SHORT-NAME>
                        <MINIMUM-START-INTERVAL>0.0</MINIMUM-START-INTERVAL>
                        <CAN-BE-INVOKED-CONCURRENTLY>true</CAN-BE-INVOKED-CONCURRENTLY>
                        <SYMBOL>ETS_GetFieldTestFieldUINT8Reliable</SYMBOL>
                      </RUNNABLE-ENTITY>
[!ENDIF!]
[!IF "EnhancedTestabilityService/EventsAndFields/TestFieldUINT8Array = 'true'"!]
                      <RUNNABLE-ENTITY>
                        <SHORT-NAME>GetFieldTestFieldUINT8Array</SHORT-NAME>
                        <MINIMUM-START-INTERVAL>0.0</MINIMUM-START-INTERVAL>
                        <CAN-BE-INVOKED-CONCURRENTLY>true</CAN-BE-INVOKED-CONCURRENTLY>
                        <SYMBOL>ETS_GetFieldTestFieldUINT8Array</SYMBOL>
                      </RUNNABLE-ENTITY>
[!ENDIF!]
[!IF "EnhancedTestabilityService/EventsAndFields/TestFieldUINT8 = 'true'"!]
                      <RUNNABLE-ENTITY>
                        <SHORT-NAME>SetFieldTestFieldUINT8</SHORT-NAME>
                        <MINIMUM-START-INTERVAL>0.0</MINIMUM-START-INTERVAL>
                        <CAN-BE-INVOKED-CONCURRENTLY>true</CAN-BE-INVOKED-CONCURRENTLY>
                        <DATA-SEND-POINTS>
                          <VARIABLE-ACCESS>
                            <SHORT-NAME>dsp_Notifier</SHORT-NAME>
                            <ACCESSED-VARIABLE>
                              <AUTOSAR-VARIABLE-IREF>
                                <PORT-PROTOTYPE-REF DEST="P-PORT-PROTOTYPE">/ETS/SwcImplementations/ETS/ETS_NotifyFieldTestFieldUINT8</PORT-PROTOTYPE-REF>
                                <TARGET-DATA-PROTOTYPE-REF DEST="VARIABLE-DATA-PROTOTYPE">/ETS/PortInterfaces/ETS_NotifyFieldTestFieldUINT8/Notifier</TARGET-DATA-PROTOTYPE-REF>
                              </AUTOSAR-VARIABLE-IREF>
                            </ACCESSED-VARIABLE>
                          </VARIABLE-ACCESS>
                        </DATA-SEND-POINTS>
                        <SYMBOL>ETS_SetFieldTestFieldUINT8</SYMBOL>
                      </RUNNABLE-ENTITY>
[!ENDIF!]
[!IF "EnhancedTestabilityService/EventsAndFields/TestFieldUINT8Reliable = 'true'"!]
                      <RUNNABLE-ENTITY>
                        <SHORT-NAME>SetFieldTestFieldUINT8Reliable</SHORT-NAME>
                        <MINIMUM-START-INTERVAL>0.0</MINIMUM-START-INTERVAL>
                        <CAN-BE-INVOKED-CONCURRENTLY>true</CAN-BE-INVOKED-CONCURRENTLY>
                        <DATA-SEND-POINTS>
                          <VARIABLE-ACCESS>
                            <SHORT-NAME>dsp_Notifier</SHORT-NAME>
                            <ACCESSED-VARIABLE>
                              <AUTOSAR-VARIABLE-IREF>
                                <PORT-PROTOTYPE-REF DEST="P-PORT-PROTOTYPE">/ETS/SwcImplementations/ETS/ETS_NotifyFieldTestFieldUINT8Reliable</PORT-PROTOTYPE-REF>
                                <TARGET-DATA-PROTOTYPE-REF DEST="VARIABLE-DATA-PROTOTYPE">/ETS/PortInterfaces/ETS_NotifyFieldTestFieldUINT8Reliable/Notifier</TARGET-DATA-PROTOTYPE-REF>
                              </AUTOSAR-VARIABLE-IREF>
                            </ACCESSED-VARIABLE>
                          </VARIABLE-ACCESS>
                        </DATA-SEND-POINTS>
                        <SYMBOL>ETS_SetFieldTestFieldUINT8Reliable</SYMBOL>
                      </RUNNABLE-ENTITY>
[!ENDIF!]
[!IF "EnhancedTestabilityService/EventsAndFields/TestFieldUINT8Array = 'true'"!]
                      <RUNNABLE-ENTITY>
                        <SHORT-NAME>SetFieldTestFieldUINT8Array</SHORT-NAME>
                        <MINIMUM-START-INTERVAL>0.0</MINIMUM-START-INTERVAL>
                        <CAN-BE-INVOKED-CONCURRENTLY>true</CAN-BE-INVOKED-CONCURRENTLY>
                        <DATA-SEND-POINTS>
                          <VARIABLE-ACCESS>
                            <SHORT-NAME>dsp_Notifier</SHORT-NAME>
                            <ACCESSED-VARIABLE>
                              <AUTOSAR-VARIABLE-IREF>
                                <PORT-PROTOTYPE-REF DEST="P-PORT-PROTOTYPE">/ETS/SwcImplementations/ETS/ETS_NotifyFieldTestFieldUINT8Array</PORT-PROTOTYPE-REF>
                                <TARGET-DATA-PROTOTYPE-REF DEST="VARIABLE-DATA-PROTOTYPE">/ETS/PortInterfaces/ETS_NotifyFieldTestFieldUINT8Array/Notifier</TARGET-DATA-PROTOTYPE-REF>
                              </AUTOSAR-VARIABLE-IREF>
                            </ACCESSED-VARIABLE>
                          </VARIABLE-ACCESS>
                        </DATA-SEND-POINTS>
                        <SYMBOL>ETS_SetFieldTestFieldUINT8Array</SYMBOL>
                      </RUNNABLE-ENTITY>
[!ENDIF!]
[!IF "EnhancedTestabilityService/EventsAndFields/InterfaceVersion = 'true'"!]
                      <RUNNABLE-ENTITY>
                        <SHORT-NAME>GetFieldInterfaceVersion</SHORT-NAME>
                        <MINIMUM-START-INTERVAL>0.0</MINIMUM-START-INTERVAL>
                        <CAN-BE-INVOKED-CONCURRENTLY>true</CAN-BE-INVOKED-CONCURRENTLY>
                        <SYMBOL>ETS_GetFieldInterfaceVersion</SYMBOL>
                      </RUNNABLE-ENTITY>
[!ENDIF!]
[!LOOP "ProjectSpecificTests/*"!]
  [!IF "node:value(ActivateTest) = 'true'"!]
                      <RUNNABLE-ENTITY>
                        <SHORT-NAME>Pst[!"node:name(.)"!]</SHORT-NAME>
                        <MINIMUM-START-INTERVAL>0.0</MINIMUM-START-INTERVAL>
                        <CAN-BE-INVOKED-CONCURRENTLY>false</CAN-BE-INVOKED-CONCURRENTLY>
                        <SYMBOL>ETS_Pst[!"node:name(.)"!]</SYMBOL>
                      </RUNNABLE-ENTITY>
  [!ENDIF!]
[!ENDLOOP!]
                    </RUNNABLES>
                    <SUPPORTS-MULTIPLE-INSTANTIATION>false</SUPPORTS-MULTIPLE-INSTANTIATION>
                  </SWC-INTERNAL-BEHAVIOR>
                </INTERNAL-BEHAVIORS>
              </APPLICATION-SW-COMPONENT-TYPE>
              <SWC-IMPLEMENTATION>
                <SHORT-NAME>ETS_Impl</SHORT-NAME>
                <CODE-DESCRIPTORS>
                  <CODE>
                    <SHORT-NAME>CodeDescriptor</SHORT-NAME>
                    <ARTIFACT-DESCRIPTORS>
                      <AUTOSAR-ENGINEERING-OBJECT>
                        <SHORT-LABEL>EngObject</SHORT-LABEL>
                        <CATEGORY>SWSRC</CATEGORY>
                      </AUTOSAR-ENGINEERING-OBJECT>
                    </ARTIFACT-DESCRIPTORS>
                  </CODE>
                </CODE-DESCRIPTORS>
                <PROGRAMMING-LANGUAGE>C</PROGRAMMING-LANGUAGE>
                  <RESOURCE-CONSUMPTION>
                  <SHORT-NAME>ResourceConsumption</SHORT-NAME>
                  <MEMORY-SECTIONS>
                    <MEMORY-SECTION>
                      <SHORT-NAME>CODE</SHORT-NAME>
                      <SW-ADDRMETHOD-REF DEST="SW-ADDR-METHOD">/AUTOSAR_MemMap/SwAddrMethods/CODE</SW-ADDRMETHOD-REF>
                    </MEMORY-SECTION>
                    <MEMORY-SECTION>
                      <SHORT-NAME>CONFIG_DATA_UNSPECIFIED</SHORT-NAME>
                      <ALIGNMENT>UNSPECIFIED</ALIGNMENT>
                      <SW-ADDRMETHOD-REF DEST="SW-ADDR-METHOD">/AUTOSAR_MemMap/SwAddrMethods/CONFIG_DATA</SW-ADDRMETHOD-REF>
                    </MEMORY-SECTION>
                    <MEMORY-SECTION>
                      <SHORT-NAME>VAR_UNSPECIFIED</SHORT-NAME>
                      <ALIGNMENT>UNSPECIFIED</ALIGNMENT>
                      <SW-ADDRMETHOD-REF DEST="SW-ADDR-METHOD">/AUTOSAR_MemMap/SwAddrMethods/VAR_CLEARED</SW-ADDRMETHOD-REF>
                    </MEMORY-SECTION>
                  </MEMORY-SECTIONS>
                </RESOURCE-CONSUMPTION>
                <SW-VERSION>2.5.0</SW-VERSION>
                <VENDOR-ID>1</VENDOR-ID>
                <BEHAVIOR-REF DEST="SWC-INTERNAL-BEHAVIOR">/ETS/SwcImplementations/ETS/IB_ETS</BEHAVIOR-REF>
              </SWC-IMPLEMENTATION>
            </ELEMENTS>
        </AR-PACKAGE>
        <AR-PACKAGE>
          <SHORT-NAME>ApplicationDataTypes</SHORT-NAME>
          <ELEMENTS>
            <APPLICATION-PRIMITIVE-DATA-TYPE>
              <SHORT-NAME>ETS_ENUM</SHORT-NAME>
              <CATEGORY>VALUE</CATEGORY>
              <SW-DATA-DEF-PROPS>
                <SW-DATA-DEF-PROPS-VARIANTS>
                  <SW-DATA-DEF-PROPS-CONDITIONAL>
                    <SW-CALIBRATION-ACCESS>NOT-ACCESSIBLE</SW-CALIBRATION-ACCESS>
                    <COMPU-METHOD-REF DEST="COMPU-METHOD">/ETS/CompuMethods/CM_ETS_ENUM</COMPU-METHOD-REF>
                  </SW-DATA-DEF-PROPS-CONDITIONAL>
                </SW-DATA-DEF-PROPS-VARIANTS>
              </SW-DATA-DEF-PROPS>
            </APPLICATION-PRIMITIVE-DATA-TYPE>
            <APPLICATION-PRIMITIVE-DATA-TYPE>
              <SHORT-NAME>ETS_UINT8</SHORT-NAME>
              <CATEGORY>VALUE</CATEGORY>
              <SW-DATA-DEF-PROPS>
                <SW-DATA-DEF-PROPS-VARIANTS>
                  <SW-DATA-DEF-PROPS-CONDITIONAL>
                    <SW-CALIBRATION-ACCESS>NOT-ACCESSIBLE</SW-CALIBRATION-ACCESS>
                    <COMPU-METHOD-REF DEST="COMPU-METHOD">/ETS/CompuMethods/ETS_UINT8</COMPU-METHOD-REF>
                    <DATA-CONSTR-REF DEST="DATA-CONSTR">/ETS/DataConstraints/ETS_UINT8</DATA-CONSTR-REF>
                    <SW-INTENDED-RESOLUTION>1.0</SW-INTENDED-RESOLUTION>
                  </SW-DATA-DEF-PROPS-CONDITIONAL>
                </SW-DATA-DEF-PROPS-VARIANTS>
              </SW-DATA-DEF-PROPS>
            </APPLICATION-PRIMITIVE-DATA-TYPE>
            <APPLICATION-PRIMITIVE-DATA-TYPE>
              <SHORT-NAME>ETS_UINT16</SHORT-NAME>
              <CATEGORY>VALUE</CATEGORY>
              <SW-DATA-DEF-PROPS>
                <SW-DATA-DEF-PROPS-VARIANTS>
                  <SW-DATA-DEF-PROPS-CONDITIONAL>
                    <SW-CALIBRATION-ACCESS>NOT-ACCESSIBLE</SW-CALIBRATION-ACCESS>
                    <COMPU-METHOD-REF DEST="COMPU-METHOD">/ETS/CompuMethods/ETS_UINT16</COMPU-METHOD-REF>
                    <DATA-CONSTR-REF DEST="DATA-CONSTR">/ETS/DataConstraints/ETS_UINT16</DATA-CONSTR-REF>
                    <SW-INTENDED-RESOLUTION>1.0</SW-INTENDED-RESOLUTION>
                  </SW-DATA-DEF-PROPS-CONDITIONAL>
                </SW-DATA-DEF-PROPS-VARIANTS>
              </SW-DATA-DEF-PROPS>
            </APPLICATION-PRIMITIVE-DATA-TYPE>
            <APPLICATION-PRIMITIVE-DATA-TYPE>
              <SHORT-NAME>ETS_FLOAT32</SHORT-NAME>
              <CATEGORY>VALUE</CATEGORY>
              <SW-DATA-DEF-PROPS>
                <SW-DATA-DEF-PROPS-VARIANTS>
                  <SW-DATA-DEF-PROPS-CONDITIONAL>
                    <SW-CALIBRATION-ACCESS>NOT-ACCESSIBLE</SW-CALIBRATION-ACCESS>
                    <COMPU-METHOD-REF DEST="COMPU-METHOD">/ETS/CompuMethods/ETS_FLOAT32</COMPU-METHOD-REF>
                    <DATA-CONSTR-REF DEST="DATA-CONSTR">/ETS/DataConstraints/ETS_FLOAT32</DATA-CONSTR-REF>
                    <SW-INTENDED-RESOLUTION>1.0</SW-INTENDED-RESOLUTION>
                  </SW-DATA-DEF-PROPS-CONDITIONAL>
                </SW-DATA-DEF-PROPS-VARIANTS>
              </SW-DATA-DEF-PROPS>
            </APPLICATION-PRIMITIVE-DATA-TYPE>
            <APPLICATION-ARRAY-DATA-TYPE>
              <SHORT-NAME>ETS_Uint8Array</SHORT-NAME>
              <CATEGORY>ARRAY</CATEGORY>
              <SW-DATA-DEF-PROPS>
                <SW-DATA-DEF-PROPS-VARIANTS>
                  <SW-DATA-DEF-PROPS-CONDITIONAL>
                    <SW-CALIBRATION-ACCESS>NOT-ACCESSIBLE</SW-CALIBRATION-ACCESS>
                  </SW-DATA-DEF-PROPS-CONDITIONAL>
                </SW-DATA-DEF-PROPS-VARIANTS>
              </SW-DATA-DEF-PROPS>
              <DYNAMIC-ARRAY-SIZE-PROFILE>VSA_LINEAR</DYNAMIC-ARRAY-SIZE-PROFILE>
              <ELEMENT>
                <SHORT-NAME>elem_Uint8Array</SHORT-NAME>
                <CATEGORY>VALUE</CATEGORY>
                <TYPE-TREF DEST="APPLICATION-PRIMITIVE-DATA-TYPE">/ETS/ApplicationDataTypes/ETS_UINT8</TYPE-TREF>
                <ARRAY-SIZE-HANDLING>ALL-INDICES-SAME-ARRAY-SIZE</ARRAY-SIZE-HANDLING>
                <ARRAY-SIZE-SEMANTICS>VARIABLE-SIZE</ARRAY-SIZE-SEMANTICS>
                <MAX-NUMBER-OF-ELEMENTS>5</MAX-NUMBER-OF-ELEMENTS>
              </ELEMENT>
            </APPLICATION-ARRAY-DATA-TYPE>
            <APPLICATION-ARRAY-DATA-TYPE>
              <SHORT-NAME>ETS_UINT8Array16Bitlength</SHORT-NAME>
              <CATEGORY>ARRAY</CATEGORY>
              <SW-DATA-DEF-PROPS>
                <SW-DATA-DEF-PROPS-VARIANTS>
                  <SW-DATA-DEF-PROPS-CONDITIONAL>
                    <SW-CALIBRATION-ACCESS>NOT-ACCESSIBLE</SW-CALIBRATION-ACCESS>
                  </SW-DATA-DEF-PROPS-CONDITIONAL>
                </SW-DATA-DEF-PROPS-VARIANTS>
              </SW-DATA-DEF-PROPS>
              <DYNAMIC-ARRAY-SIZE-PROFILE>VSA_LINEAR</DYNAMIC-ARRAY-SIZE-PROFILE>
              <ELEMENT>
                <SHORT-NAME>elem_UINT8Array16Bitlength</SHORT-NAME>
                <CATEGORY>VALUE</CATEGORY>
                <TYPE-TREF DEST="APPLICATION-PRIMITIVE-DATA-TYPE">/ETS/ApplicationDataTypes/ETS_UINT8</TYPE-TREF>
                <ARRAY-SIZE-HANDLING>ALL-INDICES-SAME-ARRAY-SIZE</ARRAY-SIZE-HANDLING>
                <ARRAY-SIZE-SEMANTICS>VARIABLE-SIZE</ARRAY-SIZE-SEMANTICS>
                <MAX-NUMBER-OF-ELEMENTS>5</MAX-NUMBER-OF-ELEMENTS>
              </ELEMENT>
            </APPLICATION-ARRAY-DATA-TYPE>
			<APPLICATION-ARRAY-DATA-TYPE>
              <SHORT-NAME>ETS_UINT8Array8Bitlength</SHORT-NAME>
              <CATEGORY>ARRAY</CATEGORY>
              <SW-DATA-DEF-PROPS>
                <SW-DATA-DEF-PROPS-VARIANTS>
                  <SW-DATA-DEF-PROPS-CONDITIONAL>
                    <SW-CALIBRATION-ACCESS>NOT-ACCESSIBLE</SW-CALIBRATION-ACCESS>
                  </SW-DATA-DEF-PROPS-CONDITIONAL>
                </SW-DATA-DEF-PROPS-VARIANTS>
              </SW-DATA-DEF-PROPS>
              <DYNAMIC-ARRAY-SIZE-PROFILE>VSA_LINEAR</DYNAMIC-ARRAY-SIZE-PROFILE>
              <ELEMENT>
                <SHORT-NAME>elem_Uint8Array</SHORT-NAME>
                <CATEGORY>VALUE</CATEGORY>
                <TYPE-TREF DEST="APPLICATION-PRIMITIVE-DATA-TYPE">/ETS/ApplicationDataTypes/ETS_UINT8</TYPE-TREF>
                <ARRAY-SIZE-HANDLING>ALL-INDICES-SAME-ARRAY-SIZE</ARRAY-SIZE-HANDLING>
                <ARRAY-SIZE-SEMANTICS>VARIABLE-SIZE</ARRAY-SIZE-SEMANTICS>
                <MAX-NUMBER-OF-ELEMENTS>5</MAX-NUMBER-OF-ELEMENTS>
              </ELEMENT>
            </APPLICATION-ARRAY-DATA-TYPE>
            <APPLICATION-ARRAY-DATA-TYPE>
              <SHORT-NAME>ETS_StaticUint8Array</SHORT-NAME>
              <CATEGORY>ARRAY</CATEGORY>
              <SW-DATA-DEF-PROPS>
                <SW-DATA-DEF-PROPS-VARIANTS>
                  <SW-DATA-DEF-PROPS-CONDITIONAL>
                    <SW-CALIBRATION-ACCESS>NOT-ACCESSIBLE</SW-CALIBRATION-ACCESS>
                  </SW-DATA-DEF-PROPS-CONDITIONAL>
                </SW-DATA-DEF-PROPS-VARIANTS>
              </SW-DATA-DEF-PROPS>
              <ELEMENT>
                <SHORT-NAME>elem_StaticUint8Array</SHORT-NAME>
                <CATEGORY>VALUE</CATEGORY>
                <TYPE-TREF DEST="APPLICATION-PRIMITIVE-DATA-TYPE">/ETS/ApplicationDataTypes/ETS_UINT8</TYPE-TREF>
                <ARRAY-SIZE-SEMANTICS>FIXED-SIZE</ARRAY-SIZE-SEMANTICS>
                <MAX-NUMBER-OF-ELEMENTS>5</MAX-NUMBER-OF-ELEMENTS>
              </ELEMENT>
            </APPLICATION-ARRAY-DATA-TYPE>
            <APPLICATION-PRIMITIVE-DATA-TYPE>
              <SHORT-NAME>ETS_Bitfield_uint16</SHORT-NAME>
              <CATEGORY>VALUE</CATEGORY>
              <SW-DATA-DEF-PROPS>
                <SW-DATA-DEF-PROPS-VARIANTS>
                  <SW-DATA-DEF-PROPS-CONDITIONAL>
                    <SW-CALIBRATION-ACCESS>NOT-ACCESSIBLE</SW-CALIBRATION-ACCESS>
                    <COMPU-METHOD-REF DEST="COMPU-METHOD">/ETS/CompuMethods/ETS_Bitfield_uint16</COMPU-METHOD-REF>
                  </SW-DATA-DEF-PROPS-CONDITIONAL>
                </SW-DATA-DEF-PROPS-VARIANTS>
              </SW-DATA-DEF-PROPS>
            </APPLICATION-PRIMITIVE-DATA-TYPE>
            <APPLICATION-PRIMITIVE-DATA-TYPE>
              <SHORT-NAME>ETS_Bitfield_uint16_return</SHORT-NAME>
              <CATEGORY>VALUE</CATEGORY>
              <SW-DATA-DEF-PROPS>
                <SW-DATA-DEF-PROPS-VARIANTS>
                  <SW-DATA-DEF-PROPS-CONDITIONAL>
                    <SW-CALIBRATION-ACCESS>NOT-ACCESSIBLE</SW-CALIBRATION-ACCESS>
                    <COMPU-METHOD-REF DEST="COMPU-METHOD">/ETS/CompuMethods/ETS_Bitfield_uint16_return</COMPU-METHOD-REF>
                  </SW-DATA-DEF-PROPS-CONDITIONAL>
                </SW-DATA-DEF-PROPS-VARIANTS>
              </SW-DATA-DEF-PROPS>
            </APPLICATION-PRIMITIVE-DATA-TYPE>
            <APPLICATION-PRIMITIVE-DATA-TYPE>
              <SHORT-NAME>ETS_Bitfield_uint32</SHORT-NAME>
              <CATEGORY>VALUE</CATEGORY>
              <SW-DATA-DEF-PROPS>
                <SW-DATA-DEF-PROPS-VARIANTS>
                  <SW-DATA-DEF-PROPS-CONDITIONAL>
                    <SW-CALIBRATION-ACCESS>NOT-ACCESSIBLE</SW-CALIBRATION-ACCESS>
                    <COMPU-METHOD-REF DEST="COMPU-METHOD">/ETS/CompuMethods/ETS_Bitfield_uint32</COMPU-METHOD-REF>
                  </SW-DATA-DEF-PROPS-CONDITIONAL>
                </SW-DATA-DEF-PROPS-VARIANTS>
              </SW-DATA-DEF-PROPS>
            </APPLICATION-PRIMITIVE-DATA-TYPE>
            <APPLICATION-PRIMITIVE-DATA-TYPE>
              <SHORT-NAME>ETS_Bitfield_uint32_return</SHORT-NAME>
              <CATEGORY>VALUE</CATEGORY>
              <SW-DATA-DEF-PROPS>
                <SW-DATA-DEF-PROPS-VARIANTS>
                  <SW-DATA-DEF-PROPS-CONDITIONAL>
                    <SW-CALIBRATION-ACCESS>NOT-ACCESSIBLE</SW-CALIBRATION-ACCESS>
                    <COMPU-METHOD-REF DEST="COMPU-METHOD">/ETS/CompuMethods/ETS_Bitfield_uint32_return</COMPU-METHOD-REF>
                  </SW-DATA-DEF-PROPS-CONDITIONAL>
                </SW-DATA-DEF-PROPS-VARIANTS>
              </SW-DATA-DEF-PROPS>
            </APPLICATION-PRIMITIVE-DATA-TYPE>
            <APPLICATION-PRIMITIVE-DATA-TYPE>
              <SHORT-NAME>ETS_Bitfield_uint8</SHORT-NAME>
              <CATEGORY>VALUE</CATEGORY>
              <SW-DATA-DEF-PROPS>
                <SW-DATA-DEF-PROPS-VARIANTS>
                  <SW-DATA-DEF-PROPS-CONDITIONAL>
                    <SW-CALIBRATION-ACCESS>NOT-ACCESSIBLE</SW-CALIBRATION-ACCESS>
                    <COMPU-METHOD-REF DEST="COMPU-METHOD">/ETS/CompuMethods/ETS_Bitfield_uint8</COMPU-METHOD-REF>
                  </SW-DATA-DEF-PROPS-CONDITIONAL>
                </SW-DATA-DEF-PROPS-VARIANTS>
              </SW-DATA-DEF-PROPS>
            </APPLICATION-PRIMITIVE-DATA-TYPE>
            <APPLICATION-PRIMITIVE-DATA-TYPE>
              <SHORT-NAME>ETS_Bitfield_uint8_return</SHORT-NAME>
              <CATEGORY>VALUE</CATEGORY>
              <SW-DATA-DEF-PROPS>
                <SW-DATA-DEF-PROPS-VARIANTS>
                  <SW-DATA-DEF-PROPS-CONDITIONAL>
                    <SW-CALIBRATION-ACCESS>NOT-ACCESSIBLE</SW-CALIBRATION-ACCESS>
                    <COMPU-METHOD-REF DEST="COMPU-METHOD">/ETS/CompuMethods/ETS_Bitfield_uint8_return</COMPU-METHOD-REF>
                  </SW-DATA-DEF-PROPS-CONDITIONAL>
                </SW-DATA-DEF-PROPS-VARIANTS>
              </SW-DATA-DEF-PROPS>
            </APPLICATION-PRIMITIVE-DATA-TYPE>
            <APPLICATION-RECORD-DATA-TYPE>
              <SHORT-NAME>ETS_SimpleStruct</SHORT-NAME>
              <CATEGORY>STRUCTURE</CATEGORY>
              <SW-DATA-DEF-PROPS>
                <SW-DATA-DEF-PROPS-VARIANTS>
                  <SW-DATA-DEF-PROPS-CONDITIONAL>
                    <SW-CALIBRATION-ACCESS>NOT-ACCESSIBLE</SW-CALIBRATION-ACCESS>
                  </SW-DATA-DEF-PROPS-CONDITIONAL>
                </SW-DATA-DEF-PROPS-VARIANTS>
              </SW-DATA-DEF-PROPS>
              <ELEMENTS>
                <APPLICATION-RECORD-ELEMENT>
                  <SHORT-NAME>floatStructureSimple</SHORT-NAME>
                  <TYPE-TREF DEST="APPLICATION-PRIMITIVE-DATA-TYPE">/ETS/ApplicationDataTypes/ETS_FLOAT32</TYPE-TREF>
                </APPLICATION-RECORD-ELEMENT>
                <APPLICATION-RECORD-ELEMENT>
                  <SHORT-NAME>uint8StructureSimple</SHORT-NAME>
                  <TYPE-TREF DEST="APPLICATION-PRIMITIVE-DATA-TYPE">/ETS/ApplicationDataTypes/ETS_UINT8</TYPE-TREF>
                </APPLICATION-RECORD-ELEMENT>
              </ELEMENTS>
            </APPLICATION-RECORD-DATA-TYPE>
            <APPLICATION-ARRAY-DATA-TYPE>
              <SHORT-NAME>ETS_SimpleStructArray</SHORT-NAME>
              <CATEGORY>ARRAY</CATEGORY>
              <SW-DATA-DEF-PROPS>
                <SW-DATA-DEF-PROPS-VARIANTS>
                  <SW-DATA-DEF-PROPS-CONDITIONAL>
                    <SW-CALIBRATION-ACCESS>NOT-ACCESSIBLE</SW-CALIBRATION-ACCESS>
                  </SW-DATA-DEF-PROPS-CONDITIONAL>
                </SW-DATA-DEF-PROPS-VARIANTS>
              </SW-DATA-DEF-PROPS>
              <ELEMENT>
                <SHORT-NAME>elem_SimpleStructArray</SHORT-NAME>
                <CATEGORY>STRUCTURE</CATEGORY>
                <TYPE-TREF DEST="APPLICATION-RECORD-DATA-TYPE">/ETS/ApplicationDataTypes/ETS_SimpleStruct</TYPE-TREF>
                <ARRAY-SIZE-SEMANTICS>FIXED-SIZE</ARRAY-SIZE-SEMANTICS>
                <MAX-NUMBER-OF-ELEMENTS>2</MAX-NUMBER-OF-ELEMENTS>
              </ELEMENT>
            </APPLICATION-ARRAY-DATA-TYPE>
            <APPLICATION-ARRAY-DATA-TYPE>
              <SHORT-NAME>ETS_TwoDimUint8Array_Dim2</SHORT-NAME>
              <CATEGORY>ARRAY</CATEGORY>
              <SW-DATA-DEF-PROPS>
                <SW-DATA-DEF-PROPS-VARIANTS>
                  <SW-DATA-DEF-PROPS-CONDITIONAL>
                    <SW-CALIBRATION-ACCESS>NOT-ACCESSIBLE</SW-CALIBRATION-ACCESS>
                  </SW-DATA-DEF-PROPS-CONDITIONAL>
                </SW-DATA-DEF-PROPS-VARIANTS>
              </SW-DATA-DEF-PROPS>
              <DYNAMIC-ARRAY-SIZE-PROFILE>VSA_LINEAR</DYNAMIC-ARRAY-SIZE-PROFILE>
              <ELEMENT>
                <SHORT-NAME>elem_TwoDimUint8Array_Dim2</SHORT-NAME>
                <CATEGORY>VALUE</CATEGORY>
                <TYPE-TREF DEST="APPLICATION-PRIMITIVE-DATA-TYPE">/ETS/ApplicationDataTypes/ETS_UINT8</TYPE-TREF>
                <ARRAY-SIZE-HANDLING>ALL-INDICES-SAME-ARRAY-SIZE</ARRAY-SIZE-HANDLING>
                <ARRAY-SIZE-SEMANTICS>VARIABLE-SIZE</ARRAY-SIZE-SEMANTICS>
                <MAX-NUMBER-OF-ELEMENTS>5</MAX-NUMBER-OF-ELEMENTS>
              </ELEMENT>
            </APPLICATION-ARRAY-DATA-TYPE>
            <APPLICATION-ARRAY-DATA-TYPE>
              <SHORT-NAME>ETS_TwoDimUint8Array</SHORT-NAME>
              <CATEGORY>ARRAY</CATEGORY>
              <SW-DATA-DEF-PROPS>
                <SW-DATA-DEF-PROPS-VARIANTS>
                  <SW-DATA-DEF-PROPS-CONDITIONAL>
                    <SW-CALIBRATION-ACCESS>NOT-ACCESSIBLE</SW-CALIBRATION-ACCESS>
                  </SW-DATA-DEF-PROPS-CONDITIONAL>
                </SW-DATA-DEF-PROPS-VARIANTS>
              </SW-DATA-DEF-PROPS>
              <DYNAMIC-ARRAY-SIZE-PROFILE>VSA_FULLY_FLEXIBLE</DYNAMIC-ARRAY-SIZE-PROFILE>
              <ELEMENT>
                <SHORT-NAME>elem_TwoDimUint8Array</SHORT-NAME>
                <CATEGORY>ARRAY</CATEGORY>
                <TYPE-TREF DEST="APPLICATION-ARRAY-DATA-TYPE">/ETS/ApplicationDataTypes/ETS_TwoDimUint8Array_Dim2</TYPE-TREF>
                <ARRAY-SIZE-HANDLING>ALL-INDICES-DIFFERENT-ARRAY-SIZE</ARRAY-SIZE-HANDLING>
                <ARRAY-SIZE-SEMANTICS>VARIABLE-SIZE</ARRAY-SIZE-SEMANTICS>
                <MAX-NUMBER-OF-ELEMENTS>5</MAX-NUMBER-OF-ELEMENTS>
              </ELEMENT>
            </APPLICATION-ARRAY-DATA-TYPE>
            <APPLICATION-RECORD-DATA-TYPE>
              <SHORT-NAME>ETS_TimePeriod</SHORT-NAME>
              <CATEGORY>STRUCTURE</CATEGORY>
              <SW-DATA-DEF-PROPS>
                <SW-DATA-DEF-PROPS-VARIANTS>
                  <SW-DATA-DEF-PROPS-CONDITIONAL>
                    <SW-CALIBRATION-ACCESS>NOT-ACCESSIBLE</SW-CALIBRATION-ACCESS>
                  </SW-DATA-DEF-PROPS-CONDITIONAL>
                </SW-DATA-DEF-PROPS-VARIANTS>
              </SW-DATA-DEF-PROPS>
              <ELEMENTS>
                <APPLICATION-RECORD-ELEMENT>
                  <SHORT-NAME>start</SHORT-NAME>
                  <TYPE-TREF DEST="APPLICATION-PRIMITIVE-DATA-TYPE">/ETS/ApplicationDataTypes/ETS_UINT8</TYPE-TREF>
                </APPLICATION-RECORD-ELEMENT>
                <APPLICATION-RECORD-ELEMENT>
                  <SHORT-NAME>duration</SHORT-NAME>
                  <TYPE-TREF DEST="APPLICATION-PRIMITIVE-DATA-TYPE">/ETS/ApplicationDataTypes/ETS_UINT8</TYPE-TREF>
                </APPLICATION-RECORD-ELEMENT>
              </ELEMENTS>
            </APPLICATION-RECORD-DATA-TYPE>
            <APPLICATION-ARRAY-DATA-TYPE>
              <SHORT-NAME>ETS_UTF8FixedArray</SHORT-NAME>
              <CATEGORY>ARRAY</CATEGORY>
              <SW-DATA-DEF-PROPS>
                <SW-DATA-DEF-PROPS-VARIANTS>
                  <SW-DATA-DEF-PROPS-CONDITIONAL>
                    <SW-CALIBRATION-ACCESS>NOT-ACCESSIBLE</SW-CALIBRATION-ACCESS>
                  </SW-DATA-DEF-PROPS-CONDITIONAL>
                </SW-DATA-DEF-PROPS-VARIANTS>
              </SW-DATA-DEF-PROPS>
              <ELEMENT>
                <SHORT-NAME>elem_UTF8FixedArray</SHORT-NAME>
                <CATEGORY>VALUE</CATEGORY>
                <TYPE-TREF DEST="APPLICATION-PRIMITIVE-DATA-TYPE">/ETS/ApplicationDataTypes/ETS_UINT8</TYPE-TREF>
                <ARRAY-SIZE-SEMANTICS>FIXED-SIZE</ARRAY-SIZE-SEMANTICS>
                <MAX-NUMBER-OF-ELEMENTS>64</MAX-NUMBER-OF-ELEMENTS>
              </ELEMENT>
            </APPLICATION-ARRAY-DATA-TYPE>
            <APPLICATION-ARRAY-DATA-TYPE>
              <SHORT-NAME>ETS_UTF16FixedArray</SHORT-NAME>
              <CATEGORY>ARRAY</CATEGORY>
              <SW-DATA-DEF-PROPS>
                <SW-DATA-DEF-PROPS-VARIANTS>
                  <SW-DATA-DEF-PROPS-CONDITIONAL>
                    <SW-CALIBRATION-ACCESS>NOT-ACCESSIBLE</SW-CALIBRATION-ACCESS>
                  </SW-DATA-DEF-PROPS-CONDITIONAL>
                </SW-DATA-DEF-PROPS-VARIANTS>
              </SW-DATA-DEF-PROPS>
              <ELEMENT>
                <SHORT-NAME>elem_UTF16FixedArray</SHORT-NAME>
                <CATEGORY>VALUE</CATEGORY>
                <TYPE-TREF DEST="APPLICATION-PRIMITIVE-DATA-TYPE">/ETS/ApplicationDataTypes/ETS_UINT16</TYPE-TREF>
                <ARRAY-SIZE-SEMANTICS>FIXED-SIZE</ARRAY-SIZE-SEMANTICS>
                <MAX-NUMBER-OF-ELEMENTS>64</MAX-NUMBER-OF-ELEMENTS>
              </ELEMENT>
            </APPLICATION-ARRAY-DATA-TYPE>
            <APPLICATION-RECORD-DATA-TYPE>
              <SHORT-NAME>ETS_Uint8Value</SHORT-NAME>
              <CATEGORY>STRUCTURE</CATEGORY>
              <SW-DATA-DEF-PROPS>
                <SW-DATA-DEF-PROPS-VARIANTS>
                  <SW-DATA-DEF-PROPS-CONDITIONAL>
                    <SW-CALIBRATION-ACCESS>NOT-ACCESSIBLE</SW-CALIBRATION-ACCESS>
                  </SW-DATA-DEF-PROPS-CONDITIONAL>
                </SW-DATA-DEF-PROPS-VARIANTS>
              </SW-DATA-DEF-PROPS>
              <ELEMENTS>
                <APPLICATION-RECORD-ELEMENT>
                  <SHORT-NAME>uINT8Value</SHORT-NAME>
                  <TYPE-TREF DEST="APPLICATION-PRIMITIVE-DATA-TYPE">/ETS/ApplicationDataTypes/ETS_UINT8</TYPE-TREF>
                </APPLICATION-RECORD-ELEMENT>
              </ELEMENTS>
            </APPLICATION-RECORD-DATA-TYPE>
            <APPLICATION-PRIMITIVE-DATA-TYPE>
              <SHORT-NAME>Coding_Version_Major</SHORT-NAME>
              <CATEGORY>VALUE</CATEGORY>
              <SW-DATA-DEF-PROPS>
                <SW-DATA-DEF-PROPS-VARIANTS>
                  <SW-DATA-DEF-PROPS-CONDITIONAL>
                    <SW-CALIBRATION-ACCESS>NOT-ACCESSIBLE</SW-CALIBRATION-ACCESS>
                    <COMPU-METHOD-REF DEST="COMPU-METHOD">/ETS/CompuMethods/Coding_Version_Major</COMPU-METHOD-REF>
                    <DATA-CONSTR-REF DEST="DATA-CONSTR">/ETS/DataConstraints/Coding_Version_Major</DATA-CONSTR-REF>
                    <SW-INTENDED-RESOLUTION>1.0</SW-INTENDED-RESOLUTION>
                  </SW-DATA-DEF-PROPS-CONDITIONAL>
                </SW-DATA-DEF-PROPS-VARIANTS>
              </SW-DATA-DEF-PROPS>
            </APPLICATION-PRIMITIVE-DATA-TYPE>
            <APPLICATION-PRIMITIVE-DATA-TYPE>
              <SHORT-NAME>Coding_Version_Minor</SHORT-NAME>
              <CATEGORY>VALUE</CATEGORY>
              <SW-DATA-DEF-PROPS>
                <SW-DATA-DEF-PROPS-VARIANTS>
                  <SW-DATA-DEF-PROPS-CONDITIONAL>
                    <SW-CALIBRATION-ACCESS>NOT-ACCESSIBLE</SW-CALIBRATION-ACCESS>
                    <COMPU-METHOD-REF DEST="COMPU-METHOD">/ETS/CompuMethods/Coding_Version_Minor</COMPU-METHOD-REF>
                    <DATA-CONSTR-REF DEST="DATA-CONSTR">/ETS/DataConstraints/Coding_Version_Minor</DATA-CONSTR-REF>
                    <SW-INTENDED-RESOLUTION>1.0</SW-INTENDED-RESOLUTION>
                  </SW-DATA-DEF-PROPS-CONDITIONAL>
                </SW-DATA-DEF-PROPS-VARIANTS>
              </SW-DATA-DEF-PROPS>
            </APPLICATION-PRIMITIVE-DATA-TYPE>
            <APPLICATION-RECORD-DATA-TYPE>
              <SHORT-NAME>ETS_VersionType</SHORT-NAME>
              <CATEGORY>STRUCTURE</CATEGORY>
              <SW-DATA-DEF-PROPS>
                <SW-DATA-DEF-PROPS-VARIANTS>
                  <SW-DATA-DEF-PROPS-CONDITIONAL>
                    <SW-CALIBRATION-ACCESS>NOT-ACCESSIBLE</SW-CALIBRATION-ACCESS>
                  </SW-DATA-DEF-PROPS-CONDITIONAL>
                </SW-DATA-DEF-PROPS-VARIANTS>
              </SW-DATA-DEF-PROPS>
              <ELEMENTS>
                <APPLICATION-RECORD-ELEMENT>
                  <SHORT-NAME>majorEtsVersion</SHORT-NAME>
                  <TYPE-TREF DEST="APPLICATION-PRIMITIVE-DATA-TYPE">/ETS/ApplicationDataTypes/Coding_Version_Major</TYPE-TREF>
                </APPLICATION-RECORD-ELEMENT>
                <APPLICATION-RECORD-ELEMENT>
                  <SHORT-NAME>minorEtsVersion</SHORT-NAME>
                  <TYPE-TREF DEST="APPLICATION-PRIMITIVE-DATA-TYPE">/ETS/ApplicationDataTypes/Coding_Version_Minor</TYPE-TREF>
                </APPLICATION-RECORD-ELEMENT>
              </ELEMENTS>
            </APPLICATION-RECORD-DATA-TYPE>
          </ELEMENTS>
        </AR-PACKAGE>
        <AR-PACKAGE>
          <SHORT-NAME>Dimensions</SHORT-NAME>
          <ELEMENTS>
            <PHYSICAL-DIMENSION>
              <SHORT-NAME>ETS_PD_NoUnit</SHORT-NAME>
            </PHYSICAL-DIMENSION>
          </ELEMENTS>
        </AR-PACKAGE>
        <AR-PACKAGE>
          <SHORT-NAME>Units</SHORT-NAME>
          <ELEMENTS>
            <UNIT>
              <SHORT-NAME>ETS_NoUnit</SHORT-NAME>
              <PHYSICAL-DIMENSION-REF DEST="PHYSICAL-DIMENSION">/ETS/Dimensions/ETS_PD_NoUnit</PHYSICAL-DIMENSION-REF>
            </UNIT>
          </ELEMENTS>
        </AR-PACKAGE>
      </AR-PACKAGES>
    </AR-PACKAGE>
  </AR-PACKAGES>
</AUTOSAR>
