[part 1 of 3]
<?xml version="1.0" encoding="UTF-8"?>
[!AUTOSPACING!]
<AUTOSAR xmlns="http://autosar.org/schema/r4.0" xmlns:xsi="http://www.w3.org/2001/XMLSchema-instance" xsi:schemaLocation="http://autosar.org/schema/r4.0 autosar_4-2-2.xsd">
  <AR-PACKAGES>
    <AR-PACKAGE>
      <SHORT-NAME>ETS</SHORT-NAME>
      <AR-PACKAGES>
        <AR-PACKAGE>
          <SHORT-NAME>CompuMethods</SHORT-NAME>
          <ELEMENTS>
            <COMPU-METHOD>
              <SHORT-NAME>CM_ETS_SD_ClientServiceModeType</SHORT-NAME>
              <CATEGORY>TEXTTABLE</CATEGORY>
              <COMPU-INTERNAL-TO-PHYS>
                <COMPU-SCALES>
                  <COMPU-SCALE>
                    <SHORT-LABEL>ETS_SD_CLIENT_SERVICE_RELEASED</SHORT-LABEL>
                    <LOWER-LIMIT INTERVAL-TYPE="CLOSED">0</LOWER-LIMIT>
                    <UPPER-LIMIT INTERVAL-TYPE="CLOSED">0</UPPER-LIMIT>
                    <COMPU-CONST>
                      <VT>ETS_SD_CLIENT_SERVICE_RELEASED</VT>
                    </COMPU-CONST>
                  </COMPU-SCALE>
                  <COMPU-SCALE>
                    <SHORT-LABEL>ETS_SD_CLIENT_SERVICE_REQUESTED</SHORT-LABEL>
                    <LOWER-LIMIT INTERVAL-TYPE="CLOSED">1</LOWER-LIMIT>
                    <UPPER-LIMIT INTERVAL-TYPE="CLOSED">1</UPPER-LIMIT>
                    <COMPU-CONST>
                      <VT>ETS_SD_CLIENT_SERVICE_REQUESTED</VT>
                    </COMPU-CONST>
                  </COMPU-SCALE>
                </COMPU-SCALES>
                <COMPU-DEFAULT-VALUE>
                  <VT>ETS_SD_CLIENT_SERVICE_RELEASED</VT>
                </COMPU-DEFAULT-VALUE>
              </COMPU-INTERNAL-TO-PHYS>
            </COMPU-METHOD>
            <COMPU-METHOD>
              <SHORT-NAME>CM_ETS_SD_ConsumeEventGroupModeType</SHORT-NAME>
              <CATEGORY>TEXTTABLE</CATEGORY>
              <COMPU-INTERNAL-TO-PHYS>
                <COMPU-SCALES>
                  <COMPU-SCALE>
                    <SHORT-LABEL>ETS_SD_CONSUMED_EVENTGROUP_RELEASED</SHORT-LABEL>
                    <LOWER-LIMIT INTERVAL-TYPE="CLOSED">0</LOWER-LIMIT>
                    <UPPER-LIMIT INTERVAL-TYPE="CLOSED">0</UPPER-LIMIT>
                    <COMPU-CONST>
                      <VT>ETS_SD_CONSUMED_EVENTGROUP_RELEASED</VT>
                    </COMPU-CONST>
                  </COMPU-SCALE>
                  <COMPU-SCALE>
                    <SHORT-LABEL>ETS_SD_CONSUMED_EVENTGROUP_REQUESTED</SHORT-LABEL>
                    <LOWER-LIMIT INTERVAL-TYPE="CLOSED">1</LOWER-LIMIT>
                    <UPPER-LIMIT INTERVAL-TYPE="CLOSED">1</UPPER-LIMIT>
                    <COMPU-CONST>
                      <VT>ETS_SD_CONSUMED_EVENTGROUP_REQUESTED</VT>
                    </COMPU-CONST>
                  </COMPU-SCALE>
                </COMPU-SCALES>
                <COMPU-DEFAULT-VALUE>
                  <VT>ETS_SD_CONSUMED_EVENTGROUP_RELEASED</VT>
                </COMPU-DEFAULT-VALUE>
              </COMPU-INTERNAL-TO-PHYS>
            </COMPU-METHOD>
            <COMPU-METHOD>
              <SHORT-NAME>CM_ETS_SD_ServerServiceModeType</SHORT-NAME>
              <CATEGORY>TEXTTABLE</CATEGORY>
              <COMPU-INTERNAL-TO-PHYS>
                <COMPU-SCALES>
                  <COMPU-SCALE>
                    <SHORT-LABEL>ETS_SD_SERVER_SERVICE_DOWN</SHORT-LABEL>
                    <LOWER-LIMIT INTERVAL-TYPE="CLOSED">0</LOWER-LIMIT>
                    <UPPER-LIMIT INTERVAL-TYPE="CLOSED">0</UPPER-LIMIT>
                    <COMPU-CONST>
                      <VT>ETS_SD_SERVER_SERVICE_DOWN</VT>
                    </COMPU-CONST>
                  </COMPU-SCALE>
                  <COMPU-SCALE>
                    <SHORT-LABEL>ETS_SD_SERVER_SERVICE_AVAILABLE</SHORT-LABEL>
                    <LOWER-LIMIT INTERVAL-TYPE="CLOSED">1</LOWER-LIMIT>
                    <UPPER-LIMIT INTERVAL-TYPE="CLOSED">1</UPPER-LIMIT>
                    <COMPU-CONST>
                      <VT>ETS_SD_SERVER_SERVICE_AVAILABLE</VT>
                    </COMPU-CONST>
                  </COMPU-SCALE>
                </COMPU-SCALES>
                <COMPU-DEFAULT-VALUE>
                  <VT>ETS_SD_SERVER_SERVICE_DOWN</VT>
                </COMPU-DEFAULT-VALUE>
              </COMPU-INTERNAL-TO-PHYS>
            </COMPU-METHOD>
            <COMPU-METHOD>
              <SHORT-NAME>CM_ETS_ENUM</SHORT-NAME>
              <CATEGORY>TEXTTABLE</CATEGORY>
              <COMPU-INTERNAL-TO-PHYS>
                <COMPU-SCALES>
                  <COMPU-SCALE>
                    <SHORT-LABEL>Default</SHORT-LABEL>
                    <LOWER-LIMIT INTERVAL-TYPE="CLOSED">255</LOWER-LIMIT>
                    <UPPER-LIMIT INTERVAL-TYPE="CLOSED">255</UPPER-LIMIT>
                    <COMPU-CONST>
                      <VT>Default</VT>
                    </COMPU-CONST>
                  </COMPU-SCALE>
                  <COMPU-SCALE>
                    <SHORT-LABEL>One</SHORT-LABEL>
                    <LOWER-LIMIT INTERVAL-TYPE="CLOSED">1</LOWER-LIMIT>
                    <UPPER-LIMIT INTERVAL-TYPE="CLOSED">1</UPPER-LIMIT>
                    <COMPU-CONST>
                      <VT>One</VT>
                    </COMPU-CONST>
                  </COMPU-SCALE>
                  <COMPU-SCALE>
                    <SHORT-LABEL>Two</SHORT-LABEL>
                    <LOWER-LIMIT INTERVAL-TYPE="CLOSED">2</LOWER-LIMIT>
                    <UPPER-LIMIT INTERVAL-TYPE="CLOSED">2</UPPER-LIMIT>
                    <COMPU-CONST>
                      <VT>Two</VT>
                    </COMPU-CONST>
                  </COMPU-SCALE>
                  <COMPU-SCALE>
                    <SHORT-LABEL>Tree</SHORT-LABEL>
                    <LOWER-LIMIT INTERVAL-TYPE="CLOSED">3</LOWER-LIMIT>
                    <UPPER-LIMIT INTERVAL-TYPE="CLOSED">3</UPPER-LIMIT>
                    <COMPU-CONST>
                      <VT>Tree</VT>
                    </COMPU-CONST>
                  </COMPU-SCALE>
                </COMPU-SCALES>
              </COMPU-INTERNAL-TO-PHYS>
            </COMPU-METHOD>
            <COMPU-METHOD>
              <SHORT-NAME>ETS_UINT8</SHORT-NAME>
              <CATEGORY>IDENTICAL</CATEGORY>
              <UNIT-REF DEST="UNIT">/ETS/Units/ETS_NoUnit</UNIT-REF>
            </COMPU-METHOD>
            <COMPU-METHOD>
              <SHORT-NAME>ETS_UINT16</SHORT-NAME>
              <CATEGORY>IDENTICAL</CATEGORY>
              <UNIT-REF DEST="UNIT">/ETS/Units/ETS_NoUnit</UNIT-REF>
            </COMPU-METHOD>
            <COMPU-METHOD>
              <SHORT-NAME>ETS_FLOAT32</SHORT-NAME>
              <CATEGORY>IDENTICAL</CATEGORY>
              <UNIT-REF DEST="UNIT">/ETS/Units/ETS_NoUnit</UNIT-REF>
            </COMPU-METHOD>
            <COMPU-METHOD>
              <SHORT-NAME>ETS_Bitfield_uint16</SHORT-NAME>
               <CATEGORY>BITFIELD_TEXTTABLE</CATEGORY>
               <UNIT-REF DEST="UNIT">/ETS/Units/ETS_NoUnit</UNIT-REF>
               <COMPU-INTERNAL-TO-PHYS>
                <COMPU-SCALES>
                  <COMPU-SCALE>
                    <SHORT-LABEL>Function4_on</SHORT-LABEL>
                    <SYMBOL>bf16_in_Function4_on</SYMBOL>
                    <MASK>16</MASK>
                    <LOWER-LIMIT INTERVAL-TYPE="CLOSED">16</LOWER-LIMIT>
                    <UPPER-LIMIT INTERVAL-TYPE="CLOSED">16</UPPER-LIMIT>
                    <COMPU-CONST>
                      <VT>Function4_on</VT>
                      </COMPU-CONST>
                  </COMPU-SCALE>
                  <COMPU-SCALE>
                    <SHORT-LABEL>Function4_off</SHORT-LABEL>
                    <SYMBOL>bf16_in_Function4_off</SYMBOL>
                    <MASK>16</MASK>
                    <LOWER-LIMIT INTERVAL-TYPE="CLOSED">0</LOWER-LIMIT>
                    <UPPER-LIMIT INTERVAL-TYPE="CLOSED">0</UPPER-LIMIT>
                    <COMPU-CONST>
                      <VT>Function4_off</VT>
                    </COMPU-CONST>
                  </COMPU-SCALE>
                  <COMPU-SCALE>
                    <SHORT-LABEL>Function3_on</SHORT-LABEL>
                    <SYMBOL>bf16_in_Function3_on</SYMBOL>
                    <MASK>8</MASK>
                    <LOWER-LIMIT INTERVAL-TYPE="CLOSED">8</LOWER-LIMIT>
                    <UPPER-LIMIT INTERVAL-TYPE="CLOSED">8</UPPER-LIMIT>
                    <COMPU-CONST>
                      <VT>Function3_on</VT>
                    </COMPU-CONST>
                  </COMPU-SCALE>
                  <COMPU-SCALE>
                    <SHORT-LABEL>Function3_off</SHORT-LABEL>
                    <SYMBOL>bf16_in_Function3_off</SYMBOL>
                    <MASK>8</MASK>
                    <LOWER-LIMIT INTERVAL-TYPE="CLOSED">0</LOWER-LIMIT>
                    <UPPER-LIMIT INTERVAL-TYPE="CLOSED">0</UPPER-LIMIT>
                    <COMPU-CONST>
                      <VT>Function3_off</VT>
                    </COMPU-CONST>
                  </COMPU-SCALE>
                  <COMPU-SCALE>
                    <SHORT-LABEL>Function6_on</SHORT-LABEL>
                    <SYMBOL>bf16_in_Function6_on</SYMBOL>
                    <MASK>64</MASK>
                    <LOWER-LIMIT INTERVAL-TYPE="CLOSED">64</LOWER-LIMIT>
                    <UPPER-LIMIT INTERVAL-TYPE="CLOSED">64</UPPER-LIMIT>
                    <COMPU-CONST>
                      <VT>Function6_on</VT>
                    </COMPU-CONST>
                  </COMPU-SCALE>
                  <COMPU-SCALE>
                    <SHORT-LABEL>Function6_off</SHORT-LABEL>
                    <SYMBOL>bf16_in_Function6_off</SYMBOL>
                    <MASK>64</MASK>
                    <LOWER-LIMIT INTERVAL-TYPE="CLOSED">0</LOWER-LIMIT>
                    <UPPER-LIMIT INTERVAL-TYPE="CLOSED">0</UPPER-LIMIT>
                    <COMPU-CONST>
                      <VT>Function6_off</VT>
                    </COMPU-CONST>
                  </COMPU-SCALE>
                  <COMPU-SCALE>
                    <SHORT-LABEL>Function1_on</SHORT-LABEL>
                    <SYMBOL>bf16_in_Function1_on</SYMBOL>
                    <MASK>2</MASK>
                    <LOWER-LIMIT INTERVAL-TYPE="CLOSED">2</LOWER-LIMIT>
                    <UPPER-LIMIT INTERVAL-TYPE="CLOSED">2</UPPER-LIMIT>
                    <COMPU-CONST>
                      <VT>Function1_on</VT>
                    </COMPU-CONST>
                  </COMPU-SCALE>
                  <COMPU-SCALE>
                    <SHORT-LABEL>Function1_off</SHORT-LABEL>
                    <SYMBOL>bf16_in_Function1_off</SYMBOL>
                    <MASK>2</MASK>
                    <LOWER-LIMIT INTERVAL-TYPE="CLOSED">0</LOWER-LIMIT>
                    <UPPER-LIMIT INTERVAL-TYPE="CLOSED">0</UPPER-LIMIT>
                    <COMPU-CONST>
                      <VT>Function1_off</VT>
                    </COMPU-CONST>
                  </COMPU-SCALE>
                  <COMPU-SCALE>
                    <SHORT-LABEL>Function5_on</SHORT-LABEL>
                    <SYMBOL>bf16_in_Function5_on</SYMBOL>
                    <MASK>32</MASK>
                    <LOWER-LIMIT INTERVAL-TYPE="CLOSED">32</LOWER-LIMIT>
                    <UPPER-LIMIT INTERVAL-TYPE="CLOSED">32</UPPER-LIMIT>
                    <COMPU-CONST>
                      <VT>Function5_on</VT>
                    </COMPU-CONST>
                  </COMPU-SCALE>
                  <COMPU-SCALE>
                    <SHORT-LABEL>Function5_off</SHORT-LABEL>
                    <SYMBOL>bf16_in_Function5_off</SYMBOL>
                    <MASK>32</MASK>
                    <LOWER-LIMIT INTERVAL-TYPE="CLOSED">0</LOWER-LIMIT>
                    <UPPER-LIMIT INTERVAL-TYPE="CLOSED">0</UPPER-LIMIT>
                    <COMPU-CONST>
                      <VT>Function5_off</VT>
                    </COMPU-CONST>
                  </COMPU-SCALE>
                  <COMPU-SCALE>
                    <SHORT-LABEL>Function9_on</SHORT-LABEL>
                    <SYMBOL>bf16_in_Function9_on</SYMBOL>
                    <MASK>512</MASK>
                    <LOWER-LIMIT INTERVAL-TYPE="CLOSED">512</LOWER-LIMIT>
                    <UPPER-LIMIT INTERVAL-TYPE="CLOSED">512</UPPER-LIMIT>
                    <COMPU-CONST>
                      <VT>Function9_on</VT>
                    </COMPU-CONST>
                  </COMPU-SCALE>
                  <COMPU-SCALE>
                    <SHORT-LABEL>Function9_off</SHORT-LABEL>
                    <SYMBOL>bf16_in_Function9_off</SYMBOL>
                    <MASK>512</MASK>
                    <LOWER-LIMIT INTERVAL-TYPE="CLOSED">0</LOWER-LIMIT>
                    <UPPER-LIMIT INTERVAL-TYPE="CLOSED">0</UPPER-LIMIT>
                    <COMPU-CONST>
                      <VT>Function9_off</VT>
                    </COMPU-CONST>
                  </COMPU-SCALE>
                <COMPU-SCALE>
                  <SHORT-LABEL>Function12_on</SHORT-LABEL>
                  <SYMBOL>bf16_in_Function12_on</SYMBOL>
                  <MASK>4096</MASK>
                  <LOWER-LIMIT INTERVAL-TYPE="CLOSED">4096</LOWER-LIMIT>
                  <UPPER-LIMIT INTERVAL-TYPE="CLOSED">4096</UPPER-LIMIT>
                  <COMPU-CONST>
                    <VT>Function12_on</VT>
                  </COMPU-CONST>
                </COMPU-SCALE>
                <COMPU-SCALE>
                  <SHORT-LABEL>Function12_off</SHORT-LABEL>
                  <SYMBOL>bf16_in_Function12_off</SYMBOL>
                  <MASK>4096</MASK>
                  <LOWER-LIMIT INTERVAL-TYPE="CLOSED">0</LOWER-LIMIT>
                  <UPPER-LIMIT INTERVAL-TYPE="CLOSED">0</UPPER-LIMIT>
                  <COMPU-CONST>
                    <VT>Function12_off</VT>
                  </COMPU-CONST>
                </COMPU-SCALE>
                <COMPU-SCALE>
                  <SHORT-LABEL>Function2_on</SHORT-LABEL>
                  <SYMBOL>bf16_in_Function2_on</SYMBOL>
                  <MASK>4</MASK>
                  <LOWER-LIMIT INTERVAL-TYPE="CLOSED">4</LOWER-LIMIT>
                  <UPPER-LIMIT INTERVAL-TYPE="CLOSED">4</UPPER-LIMIT>
                  <COMPU-CONST>
                    <VT>Function2_on</VT>
                  </COMPU-CONST>
                </COMPU-SCALE>
                <COMPU-SCALE>
                  <SHORT-LABEL>Function2_off</SHORT-LABEL>
                  <SYMBOL>bf16_in_Function2_off</SYMBOL>
                  <MASK>4</MASK>
                  <LOWER-LIMIT INTERVAL-TYPE="CLOSED">0</LOWER-LIMIT>
                  <UPPER-LIMIT INTERVAL-TYPE="CLOSED">0</UPPER-LIMIT>
                  <COMPU-CONST>
                    <VT>Function2_off</VT>
                  </COMPU-CONST>
                </COMPU-SCALE>
                <COMPU-SCALE>
                  <SHORT-LABEL>Function0_on</SHORT-LABEL>
                  <SYMBOL>bf16_in_Function0_on</SYMBOL>
                  <MASK>1</MASK>
                  <LOWER-LIMIT INTERVAL-TYPE="CLOSED">1</LOWER-LIMIT>
                  <UPPER-LIMIT INTERVAL-TYPE="CLOSED">1</UPPER-LIMIT>
                  <COMPU-CONST>
                    <VT>Function0_on</VT>
                  </COMPU-CONST>
                </COMPU-SCALE>
                <COMPU-SCALE>
                  <SHORT-LABEL>Function0_off</SHORT-LABEL>
                  <SYMBOL>bf16_in_Function0_off</SYMBOL>
                  <MASK>1</MASK>
                  <LOWER-LIMIT INTERVAL-TYPE="CLOSED">0</LOWER-LIMIT>
                  <UPPER-LIMIT INTERVAL-TYPE="CLOSED">0</UPPER-LIMIT>
                  <COMPU-CONST>
                    <VT>Function0_off</VT>
                  </COMPU-CONST>
                </COMPU-SCALE>
                <COMPU-SCALE>
                  <SHORT-LABEL>Function8_off</SHORT-LABEL>
                  <SYMBOL>bf16_in_Function8_off</SYMBOL>
                  <MASK>256</MASK>
                  <LOWER-LIMIT INTERVAL-TYPE="CLOSED">0</LOWER-LIMIT>
                  <UPPER-LIMIT INTERVAL-TYPE="CLOSED">0</UPPER-LIMIT>
                  <COMPU-CONST>
                    <VT>Function8_off</VT>
                  </COMPU-CONST>
                </COMPU-SCALE>
                <COMPU-SCALE>
                  <SHORT-LABEL>Function8_on</SHORT-LABEL>
                  <SYMBOL>bf16_in_Function8_on</SYMBOL>
                  <MASK>256</MASK>
                  <LOWER-LIMIT INTERVAL-TYPE="CLOSED">256</LOWER-LIMIT>
                  <UPPER-LIMIT INTERVAL-TYPE="CLOSED">256</UPPER-LIMIT>
                  <COMPU-CONST>
                    <VT>Function8_on</VT>
                  </COMPU-CONST>
                </COMPU-SCALE>
                <COMPU-SCALE>
                  <SHORT-LABEL>Function14_off</SHORT-LABEL>
                  <SYMBOL>bf16_in_Function14_off</SYMBOL>
                  <MASK>16384</MASK>
                  <LOWER-LIMIT INTERVAL-TYPE="CLOSED">0</LOWER-LIMIT>
                  <UPPER-LIMIT INTERVAL-TYPE="CLOSED">0</UPPER-LIMIT>
                  <COMPU-CONST>
                    <VT>Function14_off</VT>
                  </COMPU-CONST>
                </COMPU-SCALE>
                <COMPU-SCALE>
                  <SHORT-LABEL>Function14_on</SHORT-LABEL>
                  <SYMBOL>bf16_in_Function14_on</SYMBOL>
                  <MASK>16384</MASK>
                  <LOWER-LIMIT INTERVAL-TYPE="CLOSED">16384</LOWER-LIMIT>
                  <UPPER-LIMIT INTERVAL-TYPE="CLOSED">16384</UPPER-LIMIT>
                  <COMPU-CONST>
                    <VT>Function14_on</VT>
                  </COMPU-CONST>
                </COMPU-SCALE>
                <COMPU-SCALE>
                  <SHORT-LABEL>Function11_off</SHORT-LABEL>
                  <SYMBOL>bf16_in_Function11_off</SYMBOL>
                  <MASK>2048</MASK>
                  <LOWER-LIMIT INTERVAL-TYPE="CLOSED">0</LOWER-LIMIT>
                  <UPPER-LIMIT INTERVAL-TYPE="CLOSED">0</UPPER-LIMIT>
                  <COMPU-CONST>
                    <VT>Function11_off</VT>
                  </COMPU-CONST>
                </COMPU-SCALE>
                <COMPU-SCALE>
                  <SHORT-LABEL>Function11_on</SHORT-LABEL>
                  <SYMBOL>bf16_in_Function11_on</SYMBOL>
                  <MASK>2048</MASK>
                  <LOWER-LIMIT INTERVAL-TYPE="CLOSED">2048</LOWER-LIMIT>
                  <UPPER-LIMIT INTERVAL-TYPE="CLOSED">2048</UPPER-LIMIT>
                  <COMPU-CONST>
                    <VT>Function11_on</VT>
                  </COMPU-CONST>
                </COMPU-SCALE>
                <COMPU-SCALE>
                  <SHORT-LABEL>Function15_off</SHORT-LABEL>
                  <SYMBOL>bf16_in_Function15_off</SYMBOL>
                  <MASK>32768</MASK>
                  <LOWER-LIMIT INTERVAL-TYPE="CLOSED">0</LOWER-LIMIT>
                  <UPPER-LIMIT INTERVAL-TYPE="CLOSED">0</UPPER-LIMIT>
                  <COMPU-CONST>
                    <VT>Function15_off</VT>
                  </COMPU-CONST>
                </COMPU-SCALE>
                <COMPU-SCALE>
                  <SHORT-LABEL>Function15_on</SHORT-LABEL>
                  <SYMBOL>bf16_in_Function15_on</SYMBOL>
                  <MASK>32768</MASK>
                  <LOWER-LIMIT INTERVAL-TYPE="CLOSED">32768</LOWER-LIMIT>
                  <UPPER-LIMIT INTERVAL-TYPE="CLOSED">32768</UPPER-LIMIT>
                  <COMPU-CONST>
                    <VT>Function15_on</VT>
                  </COMPU-CONST>
                </COMPU-SCALE>
                <COMPU-SCALE>
                  <SHORT-LABEL>Function7_on</SHORT-LABEL>
                  <SYMBOL>bf16_in_Function7_on</SYMBOL>
                  <MASK>128</MASK>
                  <LOWER-LIMIT INTERVAL-TYPE="CLOSED">128</LOWER-LIMIT>
                  <UPPER-LIMIT INTERVAL-TYPE="CLOSED">128</UPPER-LIMIT>
                  <COMPU-CONST>
                    <VT>Function7_on</VT>
                  </COMPU-CONST>
                </COMPU-SCALE>
                <COMPU-SCALE>
                  <SHORT-LABEL>Function7_off</SHORT-LABEL>
                  <SYMBOL>bf16_in_Function7_off</SYMBOL>
                  <MASK>128</MASK>
                  <LOWER-LIMIT INTERVAL-TYPE="CLOSED">0</LOWER-LIMIT>
                  <UPPER-LIMIT INTERVAL-TYPE="CLOSED">0</UPPER-LIMIT>
                  <COMPU-CONST>
                    <VT>Function7_off</VT>
                  </COMPU-CONST>
                </COMPU-SCALE>
                <COMPU-SCALE>
                  <SHORT-LABEL>Function10_on</SHORT-LABEL>
                  <SYMBOL>bf16_in_Function10_on</SYMBOL>
                  <MASK>1024</MASK>
                  <LOWER-LIMIT INTERVAL-TYPE="CLOSED">1024</LOWER-LIMIT>
                  <UPPER-LIMIT INTERVAL-TYPE="CLOSED">1024</UPPER-LIMIT>
                  <COMPU-CONST>
                    <VT>Function10_on</VT>
                  </COMPU-CONST>
                </COMPU-SCALE>
                <COMPU-SCALE>
                  <SHORT-LABEL>Function10_off</SHORT-LABEL>
                  <SYMBOL>bf16_in_Function10_off</SYMBOL>
                  <MASK>1024</MASK>
                  <LOWER-LIMIT INTERVAL-TYPE="CLOSED">0</LOWER-LIMIT>
                  <UPPER-LIMIT INTERVAL-TYPE="CLOSED">0</UPPER-LIMIT>
                  <COMPU-CONST>
                    <VT>Function10_off</VT>
                  </COMPU-CONST>
                </COMPU-SCALE>
                <COMPU-SCALE>
                  <SHORT-LABEL>Function13_off</SHORT-LABEL>
                  <SYMBOL>bf16_in_Function13_off</SYMBOL>
                  <MASK>8192</MASK>
                  <LOWER-LIMIT INTERVAL-TYPE="CLOSED">0</LOWER-LIMIT>
                  <UPPER-LIMIT INTERVAL-TYPE="CLOSED">0</UPPER-LIMIT>
                  <COMPU-CONST>
                    <VT>Function13_off</VT>
                  </COMPU-CONST>
                </COMPU-SCALE>
                <COMPU-SCALE>
                  <SHORT-LABEL>Function13_on</SHORT-LABEL>
                  <SYMBOL>bf16_in_Function13_on</SYMBOL>
                  <MASK>8192</MASK>
                  <LOWER-LIMIT INTERVAL-TYPE="CLOSED">8192</LOWER-LIMIT>
                  <UPPER-LIMIT INTERVAL-TYPE="CLOSED">8192</UPPER-LIMIT>
                  <COMPU-CONST>
                    <VT>Function13_on</VT>
                  </COMPU-CONST>
                </COMPU-SCALE>
              </COMPU-SCALES>
            </COMPU-INTERNAL-TO-PHYS>
            </COMPU-METHOD>
            <COMPU-METHOD>
              <SHORT-NAME>ETS_Bitfield_uint16_return</SHORT-NAME>
              <CATEGORY>BITFIELD_TEXTTABLE</CATEGORY>
              <UNIT-REF DEST="UNIT">/ETS/Units/ETS_NoUnit</UNIT-REF>
              <COMPU-INTERNAL-TO-PHYS>
                <COMPU-SCALES>
                  <COMPU-SCALE>
                    <SHORT-LABEL>Function10_on</SHORT-LABEL>
                    <SYMBOL>bf16_out_Function10_on</SYMBOL>
                    <MASK>32</MASK>
                    <LOWER-LIMIT INTERVAL-TYPE="CLOSED">32</LOWER-LIMIT>
                    <UPPER-LIMIT INTERVAL-TYPE="CLOSED">32</UPPER-LIMIT>
                    <COMPU-CONST>
                      <VT>Function10_on</VT>
                    </COMPU-CONST>
                  </COMPU-SCALE>
                  <COMPU-SCALE>
                    <SHORT-LABEL>Function10_off</SHORT-LABEL>
                    <SYMBOL>bf16_out_Function10_off</SYMBOL>
                    <MASK>32</MASK>
                    <LOWER-LIMIT INTERVAL-TYPE="CLOSED">0</LOWER-LIMIT>
                    <UPPER-LIMIT INTERVAL-TYPE="CLOSED">0</UPPER-LIMIT>
                    <COMPU-CONST>
                      <VT>Function10_off</VT>
                    </COMPU-CONST>
                  </COMPU-SCALE>
                  <COMPU-SCALE>
                    <SHORT-LABEL>Function8_off</SHORT-LABEL>
                    <SYMBOL>bf16_out_Function8_off</SYMBOL>
                    <MASK>128</MASK>
                    <LOWER-LIMIT INTERVAL-TYPE="CLOSED">0</LOWER-LIMIT>
                    <UPPER-LIMIT INTERVAL-TYPE="CLOSED">0</UPPER-LIMIT>
                    <COMPU-CONST>
                      <VT>Function8_off</VT>
                    </COMPU-CONST>
                  </COMPU-SCALE>
                  <COMPU-SCALE>
                    <SHORT-LABEL>Function8_on</SHORT-LABEL>
                    <SYMBOL>bf16_out_Function8_on</SYMBOL>
                    <MASK>128</MASK>
                    <LOWER-LIMIT INTERVAL-TYPE="CLOSED">128</LOWER-LIMIT>
                    <UPPER-LIMIT INTERVAL-TYPE="CLOSED">128</UPPER-LIMIT>
                    <COMPU-CONST>
                      <VT>Function8_on</VT>
                    </COMPU-CONST>
                  </COMPU-SCALE>
                  <COMPU-SCALE>
                    <SHORT-LABEL>Function4_off</SHORT-LABEL>
                    <SYMBOL>bf16_out_Function4_off</SYMBOL>
                    <MASK>2048</MASK>
                    <LOWER-LIMIT INTERVAL-TYPE="CLOSED">0</LOWER-LIMIT>
                    <UPPER-LIMIT INTERVAL-TYPE="CLOSED">0</UPPER-LIMIT>
                    <COMPU-CONST>
                      <VT>Function4_off</VT>
                    </COMPU-CONST>
                  </COMPU-SCALE>
                  <COMPU-SCALE>
                    <SHORT-LABEL>Function4_on</SHORT-LABEL>
                    <SYMBOL>bf16_out_Function4_on</SYMBOL>
                    <MASK>2048</MASK>
                    <LOWER-LIMIT INTERVAL-TYPE="CLOSED">2048</LOWER-LIMIT>
                    <UPPER-LIMIT INTERVAL-TYPE="CLOSED">2048</UPPER-LIMIT>
                    <COMPU-CONST>
                      <VT>Function4_on</VT>
                    </COMPU-CONST>
                  </COMPU-SCALE>
                  <COMPU-SCALE>
                    <SHORT-LABEL>Function5_off</SHORT-LABEL>
                    <SYMBOL>bf16_out_Function5_off</SYMBOL>
                    <MASK>1024</MASK>
                    <LOWER-LIMIT INTERVAL-TYPE="CLOSED">0</LOWER-LIMIT>
                    <UPPER-LIMIT INTERVAL-TYPE="CLOSED">0</UPPER-LIMIT>
                    <COMPU-CONST>
                      <VT>Function5_off</VT>
                    </COMPU-CONST>
                  </COMPU-SCALE>
                  <COMPU-SCALE>
                    <SHORT-LABEL>Function5_on</SHORT-LABEL>
                    <SYMBOL>bf16_out_Function5_on</SYMBOL>
                    <MASK>1024</MASK>
                    <LOWER-LIMIT INTERVAL-TYPE="CLOSED">1024</LOWER-LIMIT>
                    <UPPER-LIMIT INTERVAL-TYPE="CLOSED">1024</UPPER-LIMIT>
                    <COMPU-CONST>
                      <VT>Function5_on</VT>
                    </COMPU-CONST>
                  </COMPU-SCALE>
                  <COMPU-SCALE>
                    <SHORT-LABEL>Function0_off</SHORT-LABEL>
                    <SYMBOL>bf16_out_Function0_off</SYMBOL>
                    <MASK>32768</MASK>
                    <LOWER-LIMIT INTERVAL-TYPE="CLOSED">0</LOWER-LIMIT>
                    <UPPER-LIMIT INTERVAL-TYPE="CLOSED">0</UPPER-LIMIT>
                    <COMPU-CONST>
                      <VT>Function0_off</VT>
                    </COMPU-CONST>
                  </COMPU-SCALE>
                  <COMPU-SCALE>
                    <SHORT-LABEL>Function0_on</SHORT-LABEL>
                    <SYMBOL>bf16_out_Function0_on</SYMBOL>
                    <MASK>32768</MASK>
                    <LOWER-LIMIT INTERVAL-TYPE="CLOSED">32768</LOWER-LIMIT>
                    <UPPER-LIMIT INTERVAL-TYPE="CLOSED">32768</UPPER-LIMIT>
                    <COMPU-CONST>
                      <VT>Function0_on</VT>
                    </COMPU-CONST>
                  </COMPU-SCALE>
                  <COMPU-SCALE>
                    <SHORT-LABEL>Function14_on</SHORT-LABEL>
                    <SYMBOL>bf16_out_Function14_on</SYMBOL>
                    <MASK>2</MASK>
                    <LOWER-LIMIT INTERVAL-TYPE="CLOSED">2</LOWER-LIMIT>
                    <UPPER-LIMIT INTERVAL-TYPE="CLOSED">2</UPPER-LIMIT>
                    <COMPU-CONST>
                      <VT>Function14_on</VT>
                    </COMPU-CONST>
                  </COMPU-SCALE>
                  <COMPU-SCALE>
                    <SHORT-LABEL>Function14_off</SHORT-LABEL>
                    <SYMBOL>bf16_out_Function14_off</SYMBOL>
                    <MASK>2</MASK>
                    <LOWER-LIMIT INTERVAL-TYPE="CLOSED">0</LOWER-LIMIT>
                    <UPPER-LIMIT INTERVAL-TYPE="CLOSED">0</UPPER-LIMIT>
                    <COMPU-CONST>
                      <VT>Function14_off</VT>
                    </COMPU-CONST>
                  </COMPU-SCALE>
                  <COMPU-SCALE>
                    <SHORT-LABEL>Function11_on</SHORT-LABEL>
                    <SYMBOL>bf16_out_Function11_on</SYMBOL>
                    <MASK>16</MASK>
                    <LOWER-LIMIT INTERVAL-TYPE="CLOSED">16</LOWER-LIMIT>
                    <UPPER-LIMIT INTERVAL-TYPE="CLOSED">16</UPPER-LIMIT>
                    <COMPU-CONST>
                      <VT>Function11_on</VT>
                    </COMPU-CONST>
                  </COMPU-SCALE>
                  <COMPU-SCALE>
                    <SHORT-LABEL>Function11_off</SHORT-LABEL>
                    <SYMBOL>bf16_out_Function11_off</SYMBOL>
                    <MASK>16</MASK>
                    <LOWER-LIMIT INTERVAL-TYPE="CLOSED">0</LOWER-LIMIT>
                    <UPPER-LIMIT INTERVAL-TYPE="CLOSED">0</UPPER-LIMIT>
                    <COMPU-CONST>
                      <VT>Function11_off</VT>
                    </COMPU-CONST>
                  </COMPU-SCALE>
                  <COMPU-SCALE>
                    <SHORT-LABEL>Function3_on</SHORT-LABEL>
                    <SYMBOL>bf16_out_Function3_on</SYMBOL>
                    <MASK>4096</MASK>
                    <LOWER-LIMIT INTERVAL-TYPE="CLOSED">4096</LOWER-LIMIT>
                    <UPPER-LIMIT INTERVAL-TYPE="CLOSED">4096</UPPER-LIMIT>
                    <COMPU-CONST>
                      <VT>Function3_on</VT>
                    </COMPU-CONST>
                  </COMPU-SCALE>
                  <COMPU-SCALE>
                    <SHORT-LABEL>Function3_off</SHORT-LABEL>
                    <SYMBOL>bf16_out_Function3_off</SYMBOL>
                    <MASK>4096</MASK>
                    <LOWER-LIMIT INTERVAL-TYPE="CLOSED">0</LOWER-LIMIT>
                    <UPPER-LIMIT INTERVAL-TYPE="CLOSED">0</UPPER-LIMIT>
                    <COMPU-CONST>
                      <VT>Function3_off</VT>
                    </COMPU-CONST>
                  </COMPU-SCALE>
                  <COMPU-SCALE>
                    <SHORT-LABEL>Function12_on</SHORT-LABEL>
                    <SYMBOL>bf16_out_Function12_on</SYMBOL>
                    <MASK>8</MASK>
                    <LOWER-LIMIT INTERVAL-TYPE="CLOSED">8</LOWER-LIMIT>
                    <UPPER-LIMIT INTERVAL-TYPE="CLOSED">8</UPPER-LIMIT>
                    <COMPU-CONST>
                      <VT>Function12_on</VT>
                    </COMPU-CONST>
                  </COMPU-SCALE>
                  <COMPU-SCALE>
                    <SHORT-LABEL>Function12_off</SHORT-LABEL>
                    <SYMBOL>bf16_out_Function12_off</SYMBOL>
                    <MASK>8</MASK>
                    <LOWER-LIMIT INTERVAL-TYPE="CLOSED">0</LOWER-LIMIT>
                    <UPPER-LIMIT INTERVAL-TYPE="CLOSED">0</UPPER-LIMIT>
                    <COMPU-CONST>
                      <VT>Function12_off</VT>
                    </COMPU-CONST>
                  </COMPU-SCALE>
                  <COMPU-SCALE>
                    <SHORT-LABEL>Function13_off</SHORT-LABEL>
                    <SYMBOL>bf16_out_Function13_off</SYMBOL>
                    <MASK>4</MASK>
                    <LOWER-LIMIT INTERVAL-TYPE="CLOSED">0</LOWER-LIMIT>
                    <UPPER-LIMIT INTERVAL-TYPE="CLOSED">0</UPPER-LIMIT>
                    <COMPU-CONST>
                      <VT>Function13_off</VT>
                    </COMPU-CONST>
                  </COMPU-SCALE>
                  <COMPU-SCALE>
                    <SHORT-LABEL>Function13_on</SHORT-LABEL>
                    <SYMBOL>bf16_out_Function13_on</SYMBOL>
                    <MASK>4</MASK>
                    <LOWER-LIMIT INTERVAL-TYPE="CLOSED">4</LOWER-LIMIT>
                    <UPPER-LIMIT INTERVAL-TYPE="CLOSED">4</UPPER-LIMIT>
                    <COMPU-CONST>
                      <VT>Function13_on</VT>
                    </COMPU-CONST>
                  </COMPU-SCALE>
                  <COMPU-SCALE>
                    <SHORT-LABEL>Function1_on</SHORT-LABEL>
                    <SYMBOL>bf16_out_Function1_on</SYMBOL>
                    <MASK>16384</MASK>
                    <LOWER-LIMIT INTERVAL-TYPE="CLOSED">16384</LOWER-LIMIT>
                    <UPPER-LIMIT INTERVAL-TYPE="CLOSED">16384</UPPER-LIMIT>
                    <COMPU-CONST>
                      <VT>Function1_on</VT>
                    </COMPU-CONST>
                  </COMPU-SCALE>
                  <COMPU-SCALE>
                    <SHORT-LABEL>Function1_off</SHORT-LABEL>
                    <SYMBOL>bf16_out_Function1_off</SYMBOL>
                    <MASK>16384</MASK>
                    <LOWER-LIMIT INTERVAL-TYPE="CLOSED">0</LOWER-LIMIT>
                    <UPPER-LIMIT INTERVAL-TYPE="CLOSED">0</UPPER-LIMIT>
                    <COMPU-CONST>
                      <VT>Function1_off</VT>
                    </COMPU-CONST>
                  </COMPU-SCALE>
                  <COMPU-SCALE>
                    <SHORT-LABEL>Function15_on</SHORT-LABEL>
                    <SYMBOL>bf16_out_Function15_on</SYMBOL>
                    <MASK>1</MASK>
                    <LOWER-LIMIT INTERVAL-TYPE="CLOSED">1</LOWER-LIMIT>
                    <UPPER-LIMIT INTERVAL-TYPE="CLOSED">1</UPPER-LIMIT>
                    <COMPU-CONST>
                      <VT>Function15_on</VT>
                    </COMPU-CONST>
                  </COMPU-SCALE>
                  <COMPU-SCALE>
                    <SHORT-LABEL>Function15_off</SHORT-LABEL>
                    <SYMBOL>bf16_out_Function15_off</SYMBOL>
                    <MASK>1</MASK>
                    <LOWER-LIMIT INTERVAL-TYPE="CLOSED">0</LOWER-LIMIT>
                    <UPPER-LIMIT INTERVAL-TYPE="CLOSED">0</UPPER-LIMIT>
                    <COMPU-CONST>
                      <VT>Function15_off</VT>
                    </COMPU-CONST>
                  </COMPU-SCALE>
                  <COMPU-SCALE>
                    <SHORT-LABEL>Function6_on</SHORT-LABEL>
                    <SYMBOL>bf16_out_Function6_on</SYMBOL>
                    <MASK>512</MASK>
                    <LOWER-LIMIT INTERVAL-TYPE="CLOSED">512</LOWER-LIMIT>
                    <UPPER-LIMIT INTERVAL-TYPE="CLOSED">512</UPPER-LIMIT>
                    <COMPU-CONST>
                      <VT>Function6_on</VT>
                    </COMPU-CONST>
                  </COMPU-SCALE>
                  <COMPU-SCALE>
                    <SHORT-LABEL>Function6_off</SHORT-LABEL>
                    <SYMBOL>bf16_out_Function6_off</SYMBOL>
                    <MASK>512</MASK>
                    <LOWER-LIMIT INTERVAL-TYPE="CLOSED">0</LOWER-LIMIT>
                    <UPPER-LIMIT INTERVAL-TYPE="CLOSED">0</UPPER-LIMIT>
                    <COMPU-CONST>
                      <VT>Function6_off</VT>
                    </COMPU-CONST>
                  </COMPU-SCALE>
                  <COMPU-SCALE>
                    <SHORT-LABEL>Function7_on</SHORT-LABEL>
                    <SYMBOL>bf16_out_Function7_on</SYMBOL>
                    <MASK>256</MASK>
                    <LOWER-LIMIT INTERVAL-TYPE="CLOSED">256</LOWER-LIMIT>
                    <UPPER-LIMIT INTERVAL-TYPE="CLOSED">256</UPPER-LIMIT>
                    <COMPU-CONST>
                      <VT>Function7_on</VT>
                    </COMPU-CONST>
                  </COMPU-SCALE>
                  <COMPU-SCALE>
                    <SHORT-LABEL>Function7_off</SHORT-LABEL>
                    <SYMBOL>bf16_out_Function7_off</SYMBOL>
                    <MASK>256</MASK>
                    <LOWER-LIMIT INTERVAL-TYPE="CLOSED">0</LOWER-LIMIT>
                    <UPPER-LIMIT INTERVAL-TYPE="CLOSED">0</UPPER-LIMIT>
                    <COMPU-CONST>
                      <VT>Function7_off</VT>
                    </COMPU-CONST>
                  </COMPU-SCALE>
                  <COMPU-SCALE>
                    <SHORT-LABEL>Function9_on</SHORT-LABEL>
                    <SYMBOL>bf16_out_Function9_on</SYMBOL>
                    <MASK>64</MASK>
                    <LOWER-LIMIT INTERVAL-TYPE="CLOSED">64</LOWER-LIMIT>
                    <UPPER-LIMIT INTERVAL-TYPE="CLOSED">64</UPPER-LIMIT>
                    <COMPU-CONST>
                      <VT>Function9_on</VT>
                    </COMPU-CONST>
                  </COMPU-SCALE>
                  <COMPU-SCALE>
                    <SHORT-LABEL>Function9_off</SHORT-LABEL>
                    <SYMBOL>bf16_out_Function9_off</SYMBOL>
                    <MASK>64</MASK>
                    <LOWER-LIMIT INTERVAL-TYPE="CLOSED">0</LOWER-LIMIT>
                    <UPPER-LIMIT INTERVAL-TYPE="CLOSED">0</UPPER-LIMIT>
                    <COMPU-CONST>
                      <VT>Function9_off</VT>
                    </COMPU-CONST>
                  </COMPU-SCALE>
                  <COMPU-SCALE>
                    <SHORT-LABEL>Function2_off</SHORT-LABEL>
                    <SYMBOL>bf16_out_Function2_off</SYMBOL>
                    <MASK>8192</MASK>
                    <LOWER-LIMIT INTERVAL-TYPE="CLOSED">0</LOWER-LIMIT>
                    <UPPER-LIMIT INTERVAL-TYPE="CLOSED">0</UPPER-LIMIT>
                    <COMPU-CONST>
                      <VT>Function2_off</VT>
                    </COMPU-CONST>
                  </COMPU-SCALE>
                  <COMPU-SCALE>
                    <SHORT-LABEL>Function2_on</SHORT-LABEL>
                    <SYMBOL>bf16_out_Function2_on</SYMBOL>
                    <MASK>8192</MASK>
                    <LOWER-LIMIT INTERVAL-TYPE="CLOSED">8192</LOWER-LIMIT>
                    <UPPER-LIMIT INTERVAL-TYPE="CLOSED">8192</UPPER-LIMIT>
                    <COMPU-CONST>
                      <VT>Function2_on</VT>
                    </COMPU-CONST>
                  </COMPU-SCALE>
                </COMPU-SCALES>
              </COMPU-INTERNAL-TO-PHYS>
            </COMPU-METHOD>
            <COMPU-METHOD>
              <SHORT-NAME>ETS_Bitfield_uint32</SHORT-NAME>
              <CATEGORY>BITFIELD_TEXTTABLE</CATEGORY>
              <UNIT-REF DEST="UNIT">/ETS/Units/ETS_NoUnit</UNIT-REF>
              <COMPU-INTERNAL-TO-PHYS>
                <COMPU-SCALES>
                  <COMPU-SCALE>
                    <SHORT-LABEL>Function18_on</SHORT-LABEL>
                    <SYMBOL>bf32_in_Function18_on</SYMBOL>
                    <MASK>262144</MASK>
                    <LOWER-LIMIT INTERVAL-TYPE="CLOSED">262144</LOWER-LIMIT>
                    <UPPER-LIMIT INTERVAL-TYPE="CLOSED">262144</UPPER-LIMIT>
                    <COMPU-CONST>
                      <VT>Function18_on</VT>
                    </COMPU-CONST>
                  </COMPU-SCALE>
                  <COMPU-SCALE>
                    <SHORT-LABEL>Function18_off</SHORT-LABEL>
                    <SYMBOL>bf32_in_Function18_off</SYMBOL>
                    <MASK>262144</MASK>
                    <LOWER-LIMIT INTERVAL-TYPE="CLOSED">0</LOWER-LIMIT>
                    <UPPER-LIMIT INTERVAL-TYPE="CLOSED">0</UPPER-LIMIT>
                    <COMPU-CONST>
                      <VT>Function18_off</VT>
                    </COMPU-CONST>
                  </COMPU-SCALE>
                  <COMPU-SCALE>
                    <SHORT-LABEL>Function13_on</SHORT-LABEL>
                    <SYMBOL>bf32_in_Function13_on</SYMBOL>
                    <MASK>8192</MASK>
                    <LOWER-LIMIT INTERVAL-TYPE="CLOSED">8192</LOWER-LIMIT>
                    <UPPER-LIMIT INTERVAL-TYPE="CLOSED">8192</UPPER-LIMIT>
                    <COMPU-CONST>
                      <VT>Function13_on</VT>
                    </COMPU-CONST>
                  </COMPU-SCALE>
                  <COMPU-SCALE>
                    <SHORT-LABEL>Function13_off</SHORT-LABEL>
                    <SYMBOL>bf32_in_Function13_off</SYMBOL>
                    <MASK>8192</MASK>
                    <LOWER-LIMIT INTERVAL-TYPE="CLOSED">0</LOWER-LIMIT>
                    <UPPER-LIMIT INTERVAL-TYPE="CLOSED">0</UPPER-LIMIT>
                    <COMPU-CONST>
                      <VT>Function13_off</VT>
                    </COMPU-CONST>
                  </COMPU-SCALE>
                  <COMPU-SCALE>
                    <SHORT-LABEL>Function27_off</SHORT-LABEL>
                    <SYMBOL>bf32_in_Function27_off</SYMBOL>
                    <MASK>134217728</MASK>
                    <LOWER-LIMIT INTERVAL-TYPE="CLOSED">0</LOWER-LIMIT>
                    <UPPER-LIMIT INTERVAL-TYPE="CLOSED">0</UPPER-LIMIT>
                    <COMPU-CONST>
                      <VT>Function27_off</VT>
                    </COMPU-CONST>
                  </COMPU-SCALE>
                  <COMPU-SCALE>
                    <SHORT-LABEL>Function27_on</SHORT-LABEL>
                    <SYMBOL>bf32_in_Function27_on</SYMBOL>
                    <MASK>134217728</MASK>
                    <LOWER-LIMIT INTERVAL-TYPE="CLOSED">134217728</LOWER-LIMIT>
                    <UPPER-LIMIT INTERVAL-TYPE="CLOSED">134217728</UPPER-LIMIT>
                    <COMPU-CONST>
                      <VT>Function27_on</VT>
                    </COMPU-CONST>
                  </COMPU-SCALE>
                  <COMPU-SCALE>
                    <SHORT-LABEL>Function0_on</SHORT-LABEL>
                    <SYMBOL>bf32_in_Function0_on</SYMBOL>
                    <MASK>1</MASK>
                    <LOWER-LIMIT INTERVAL-TYPE="CLOSED">1</LOWER-LIMIT>
                    <UPPER-LIMIT INTERVAL-TYPE="CLOSED">1</UPPER-LIMIT>
                    <COMPU-CONST>
                      <VT>Function0_on</VT>
                    </COMPU-CONST>
                  </COMPU-SCALE>
                  <COMPU-SCALE>
                    <SHORT-LABEL>Function0_off</SHORT-LABEL>
                    <SYMBOL>bf32_in_Function0_off</SYMBOL>
                    <MASK>1</MASK>
                    <LOWER-LIMIT INTERVAL-TYPE="CLOSED">0</LOWER-LIMIT>
                    <UPPER-LIMIT INTERVAL-TYPE="CLOSED">0</UPPER-LIMIT>
                    <COMPU-CONST>
                      <VT>Function0_off</VT>
                    </COMPU-CONST>
                  </COMPU-SCALE>
                  <COMPU-SCALE>
                    <SHORT-LABEL>Function21_on</SHORT-LABEL>
                    <SYMBOL>bf32_in_Function21_on</SYMBOL>
                    <MASK>2097152</MASK>
                    <LOWER-LIMIT INTERVAL-TYPE="CLOSED">2097152</LOWER-LIMIT>
                    <UPPER-LIMIT INTERVAL-TYPE="CLOSED">2097152</UPPER-LIMIT>
                    <COMPU-CONST>
                      <VT>Function21_on</VT>
                    </COMPU-CONST>
                  </COMPU-SCALE>
                  <COMPU-SCALE>
                    <SHORT-LABEL>Function21_off</SHORT-LABEL>
                    <SYMBOL>bf32_in_Function21_off</SYMBOL>
                    <MASK>2097152</MASK>
                    <LOWER-LIMIT INTERVAL-TYPE="CLOSED">0</LOWER-LIMIT>
                    <UPPER-LIMIT INTERVAL-TYPE="CLOSED">0</UPPER-LIMIT>
                    <COMPU-CONST>
                      <VT>Function21_off</VT>
                    </COMPU-CONST>
                  </COMPU-SCALE>
                  <COMPU-SCALE>
                    <SHORT-LABEL>Function16_on</SHORT-LABEL>
                    <SYMBOL>bf32_in_Function16_on</SYMBOL>
                    <MASK>65536</MASK>
                    <LOWER-LIMIT INTERVAL-TYPE="CLOSED">65536</LOWER-LIMIT>
                    <UPPER-LIMIT INTERVAL-TYPE="CLOSED">65536</UPPER-LIMIT>
                    <COMPU-CONST>
                      <VT>Function16_on</VT>
                    </COMPU-CONST>
                  </COMPU-SCALE>
                  <COMPU-SCALE>
                    <SHORT-LABEL>Function16_off</SHORT-LABEL>
                    <SYMBOL>bf32_in_Function16_off</SYMBOL>
                    <MASK>65536</MASK>
                    <LOWER-LIMIT INTERVAL-TYPE="CLOSED">0</LOWER-LIMIT>
                    <UPPER-LIMIT INTERVAL-TYPE="CLOSED">0</UPPER-LIMIT>
                    <COMPU-CONST>
                      <VT>Function16_off</VT>
                    </COMPU-CONST>
                  </COMPU-SCALE>
                  <COMPU-SCALE>
                    <SHORT-LABEL>Function23_off</SHORT-LABEL>
                    <SYMBOL>bf32_in_Function23_off</SYMBOL>
                    <MASK>8388608</MASK>
                    <LOWER-LIMIT INTERVAL-TYPE="CLOSED">0</LOWER-LIMIT>
                    <UPPER-LIMIT INTERVAL-TYPE="CLOSED">0</UPPER-LIMIT>
                    <COMPU-CONST>
                      <VT>Function23_off</VT>
                    </COMPU-CONST>
                  </COMPU-SCALE>
                  <COMPU-SCALE>
                    <SHORT-LABEL>Function23_on</SHORT-LABEL>
                    <SYMBOL>bf32_in_Function23_on</SYMBOL>
                    <MASK>8388608</MASK>
                    <LOWER-LIMIT INTERVAL-TYPE="CLOSED">8388608</LOWER-LIMIT>
                    <UPPER-LIMIT INTERVAL-TYPE="CLOSED">8388608</UPPER-LIMIT>
                    <COMPU-CONST>
                      <VT>Function23_on</VT>
                    </COMPU-CONST>
                  </COMPU-SCALE>
                  <COMPU-SCALE>
                    <SHORT-LABEL>Function1_on</SHORT-LABEL>
                    <SYMBOL>bf32_in_Function1_on</SYMBOL>
                    <MASK>2</MASK>
                    <LOWER-LIMIT INTERVAL-TYPE="CLOSED">2</LOWER-LIMIT>
                    <UPPER-LIMIT INTERVAL-TYPE="CLOSED">2</UPPER-LIMIT>
                    <COMPU-CONST>
                      <VT>Function1_on</VT>
                    </COMPU-CONST>
                  </COMPU-SCALE>
                  <COMPU-SCALE>
                    <SHORT-LABEL>Function1_off</SHORT-LABEL>
                    <SYMBOL>bf32_in_Function1_off</SYMBOL>
                    <MASK>2</MASK>
                    <LOWER-LIMIT INTERVAL-TYPE="CLOSED">0</LOWER-LIMIT>
                    <UPPER-LIMIT INTERVAL-TYPE="CLOSED">0</UPPER-LIMIT>
                    <COMPU-CONST>
                      <VT>Function1_off</VT>
                    </COMPU-CONST>
                  </COMPU-SCALE>
                  <COMPU-SCALE>
                    <SHORT-LABEL>Function5_on</SHORT-LABEL>
                    <SYMBOL>bf32_in_Function5_on</SYMBOL>
                    <MASK>32</MASK>
                    <LOWER-LIMIT INTERVAL-TYPE="CLOSED">32</LOWER-LIMIT>
                    <UPPER-LIMIT INTERVAL-TYPE="CLOSED">32</UPPER-LIMIT>
                    <COMPU-CONST>
                      <VT>Function5_on</VT>
                    </COMPU-CONST>
                  </COMPU-SCALE>
                  <COMPU-SCALE>
                    <SHORT-LABEL>Function5_off</SHORT-LABEL>
                    <SYMBOL>bf32_in_Function5_off</SYMBOL>
                    <MASK>32</MASK>
                    <LOWER-LIMIT INTERVAL-TYPE="CLOSED">0</LOWER-LIMIT>
                    <UPPER-LIMIT INTERVAL-TYPE="CLOSED">0</UPPER-LIMIT>
                    <COMPU-CONST>
                      <VT>Function5_off</VT>
                    </COMPU-CONST>
                  </COMPU-SCALE>
                  <COMPU-SCALE>
                    <SHORT-LABEL>Function28_off</SHORT-LABEL>
                    <SYMBOL>bf32_in_Function28_off</SYMBOL>
                    <MASK>268435456</MASK>
                    <LOWER-LIMIT INTERVAL-TYPE="CLOSED">0</LOWER-LIMIT>
                    <UPPER-LIMIT INTERVAL-TYPE="CLOSED">0</UPPER-LIMIT>
                    <COMPU-CONST>
                      <VT>Function28_off</VT>
                    </COMPU-CONST>
                  </COMPU-SCALE>
                  <COMPU-SCALE>
                    <SHORT-LABEL>Function28_on</SHORT-LABEL>
                    <SYMBOL>bf32_in_Function28_on</SYMBOL>
                    <MASK>268435456</MASK>
                    <LOWER-LIMIT INTERVAL-TYPE="CLOSED">268435456</LOWER-LIMIT>
                    <UPPER-LIMIT INTERVAL-TYPE="CLOSED">268435456</UPPER-LIMIT>
                    <COMPU-CONST>
                      <VT>Function28_on</VT>
                    </COMPU-CONST>
                  </COMPU-SCALE>
                  <COMPU-SCALE>
                    <SHORT-LABEL>Function9_off</SHORT-LABEL>
                    <SYMBOL>bf32_in_Function9_off</SYMBOL>
                    <MASK>512</MASK>
                    <LOWER-LIMIT INTERVAL-TYPE="CLOSED">0</LOWER-LIMIT>
                    <UPPER-LIMIT INTERVAL-TYPE="CLOSED">0</UPPER-LIMIT>
                    <COMPU-CONST>
                      <VT>Function9_off</VT>
                    </COMPU-CONST>
                  </COMPU-SCALE>
                  <COMPU-SCALE>
                    <SHORT-LABEL>Function9_on</SHORT-LABEL>
                    <SYMBOL>bf32_in_Function9_on</SYMBOL>
                    <MASK>512</MASK>
                    <LOWER-LIMIT INTERVAL-TYPE="CLOSED">512</LOWER-LIMIT>
                    <UPPER-LIMIT INTERVAL-TYPE="CLOSED">512</UPPER-LIMIT>
                    <COMPU-CONST>
                      <VT>Function9_on</VT>
                    </COMPU-CONST>
                  </COMPU-SCALE>
                  <COMPU-SCALE>
                    <SHORT-LABEL>Function26_on</SHORT-LABEL>
                    <SYMBOL>bf32_in_Function26_on</SYMBOL>
                    <MASK>67108864</MASK>
                    <LOWER-LIMIT INTERVAL-TYPE="CLOSED">67108864</LOWER-LIMIT>
                    <UPPER-LIMIT INTERVAL-TYPE="CLOSED">67108864</UPPER-LIMIT>
                    <COMPU-CONST>
                      <VT>Function26_on</VT>
                    </COMPU-CONST>
                  </COMPU-SCALE>
                  <COMPU-SCALE>
                    <SHORT-LABEL>Function26_off</SHORT-LABEL>
                    <SYMBOL>bf32_in_Function26_off</SYMBOL>
                    <MASK>67108864</MASK>
                    <LOWER-LIMIT INTERVAL-TYPE="CLOSED">0</LOWER-LIMIT>
                    <UPPER-LIMIT INTERVAL-TYPE="CLOSED">0</UPPER-LIMIT>
                    <COMPU-CONST>
                      <VT>Function26_off</VT>
                    </COMPU-CONST>
                  </COMPU-SCALE>
                  <COMPU-SCALE>
                    <SHORT-LABEL>Function31_on</SHORT-LABEL>
                    <SYMBOL>bf32_in_Function31_on</SYMBOL>
                    <MASK>2147483648</MASK>
                    <LOWER-LIMIT INTERVAL-TYPE="CLOSED">2147483648</LOWER-LIMIT>
                    <UPPER-LIMIT INTERVAL-TYPE="CLOSED">2147483648</UPPER-LIMIT>
                    <COMPU-CONST>
                      <VT>Function31_on</VT>
                    </COMPU-CONST>
                  </COMPU-SCALE>
                  <COMPU-SCALE>
                    <SHORT-LABEL>Function31_off</SHORT-LABEL>
                    <SYMBOL>bf32_in_Function31_off</SYMBOL>
                    <MASK>2147483648</MASK>
                    <LOWER-LIMIT INTERVAL-TYPE="CLOSED">0</LOWER-LIMIT>
                    <UPPER-LIMIT INTERVAL-TYPE="CLOSED">0</UPPER-LIMIT>
                    <COMPU-CONST>
                      <VT>Function31_off</VT>
                    </COMPU-CONST>
                  </COMPU-SCALE>
                  <COMPU-SCALE>
                    <SHORT-LABEL>Function24_on</SHORT-LABEL>
                    <SYMBOL>bf32_in_Function24_on</SYMBOL>
                    <MASK>16777216</MASK>
                    <LOWER-LIMIT INTERVAL-TYPE="CLOSED">16777216</LOWER-LIMIT>
                    <UPPER-LIMIT INTERVAL-TYPE="CLOSED">16777216</UPPER-LIMIT>
                    <COMPU-CONST>
                      <VT>Function24_on</VT>
                    </COMPU-CONST>
                  </COMPU-SCALE>
                  <COMPU-SCALE>
                    <SHORT-LABEL>Function24_off</SHORT-LABEL>
                    <SYMBOL>bf32_in_Function24_off</SYMBOL>
                    <MASK>16777216</MASK>
                    <LOWER-LIMIT INTERVAL-TYPE="CLOSED">0</LOWER-LIMIT>
                    <UPPER-LIMIT INTERVAL-TYPE="CLOSED">0</UPPER-LIMIT>
                    <COMPU-CONST>
                      <VT>Function24_off</VT>
                    </COMPU-CONST>
                  </COMPU-SCALE>
                  <COMPU-SCALE>
                    <SHORT-LABEL>Function10_off</SHORT-LABEL>
                    <SYMBOL>bf32_in_Function10_off</SYMBOL>
                    <MASK>1024</MASK>
                    <LOWER-LIMIT INTERVAL-TYPE="CLOSED">0</LOWER-LIMIT>
                    <UPPER-LIMIT INTERVAL-TYPE="CLOSED">0</UPPER-LIMIT>
                    <COMPU-CONST>
                      <VT>Function10_off</VT>
                    </COMPU-CONST>
                  </COMPU-SCALE>
                  <COMPU-SCALE>
                    <SHORT-LABEL>Function10_on</SHORT-LABEL>
                    <SYMBOL>bf32_in_Function10_on</SYMBOL>
                    <MASK>1024</MASK>
                    <LOWER-LIMIT INTERVAL-TYPE="CLOSED">1024</LOWER-LIMIT>
                    <UPPER-LIMIT INTERVAL-TYPE="CLOSED">1024</UPPER-LIMIT>
                    <COMPU-CONST>
                      <VT>Function10_on</VT>
                    </COMPU-CONST>
                  </COMPU-SCALE>
                  <COMPU-SCALE>
                    <SHORT-LABEL>Function12_off</SHORT-LABEL>
                    <SYMBOL>bf32_in_Function12_off</SYMBOL>
                    <MASK>4096</MASK>
                    <LOWER-LIMIT INTERVAL-TYPE="CLOSED">0</LOWER-LIMIT>
                    <UPPER-LIMIT INTERVAL-TYPE="CLOSED">0</UPPER-LIMIT>
                    <COMPU-CONST>
                      <VT>Function12_off</VT>
                    </COMPU-CONST>
                  </COMPU-SCALE>
                  <COMPU-SCALE>
                    <SHORT-LABEL>Function12_on</SHORT-LABEL>
                    <SYMBOL>bf32_in_Function12_on</SYMBOL>
                    <MASK>4096</MASK>
                    <LOWER-LIMIT INTERVAL-TYPE="CLOSED">4096</LOWER-LIMIT>
                    <UPPER-LIMIT INTERVAL-TYPE="CLOSED">4096</UPPER-LIMIT>
                    <COMPU-CONST>
                      <VT>Function12_on</VT>
                    </COMPU-CONST>
                  </COMPU-SCALE>
                  <COMPU-SCALE>
                    <SHORT-LABEL>Function20_on</SHORT-LABEL>
                    <SYMBOL>bf32_in_Function20_on</SYMBOL>
                    <MASK>1048576</MASK>
                    <LOWER-LIMIT INTERVAL-TYPE="CLOSED">1048576</LOWER-LIMIT>
                    <UPPER-LIMIT INTERVAL-TYPE="CLOSED">1048576</UPPER-LIMIT>
                    <COMPU-CONST>
                      <VT>Function20_on</VT>
                    </COMPU-CONST>
                  </COMPU-SCALE>
                  <COMPU-SCALE>
                    <SHORT-LABEL>Function20_off</SHORT-LABEL>
                    <SYMBOL>bf32_in_Function20_off</SYMBOL>
                    <MASK>1048576</MASK>
                    <LOWER-LIMIT INTERVAL-TYPE="CLOSED">0</LOWER-LIMIT>
                    <UPPER-LIMIT INTERVAL-TYPE="CLOSED">0</UPPER-LIMIT>
                    <COMPU-CONST>
                      <VT>Function20_off</VT>
                    </COMPU-CONST>
                  </COMPU-SCALE>
                  <COMPU-SCALE>
                    <SHORT-LABEL>Function17_off</SHORT-LABEL>
                    <SYMBOL>bf32_in_Function17_off</SYMBOL>
                    <MASK>131072</MASK>
                    <LOWER-LIMIT INTERVAL-TYPE="CLOSED">0</LOWER-LIMIT>
                    <UPPER-LIMIT INTERVAL-TYPE="CLOSED">0</UPPER-LIMIT>
                    <COMPU-CONST>
                      <VT>Function17_off</VT>
                    </COMPU-CONST>
                  </COMPU-SCALE>
                  <COMPU-SCALE>
                    <SHORT-LABEL>Function17_on</SHORT-LABEL>
                    <SYMBOL>bf32_in_Function17_on</SYMBOL>
                    <MASK>131072</MASK>
                    <LOWER-LIMIT INTERVAL-TYPE="CLOSED">131072</LOWER-LIMIT>
                    <UPPER-LIMIT INTERVAL-TYPE="CLOSED">131072</UPPER-LIMIT>
                    <COMPU-CONST>
                      <VT>Function17_on</VT>
                    </COMPU-CONST>
                  </COMPU-SCALE>
                  <COMPU-SCALE>
                    <SHORT-LABEL>Function29_off</SHORT-LABEL>
                    <SYMBOL>bf32_in_Function29_off</SYMBOL>
                    <MASK>536870912</MASK>
                    <LOWER-LIMIT INTERVAL-TYPE="CLOSED">0</LOWER-LIMIT>
                    <UPPER-LIMIT INTERVAL-TYPE="CLOSED">0</UPPER-LIMIT>
                    <COMPU-CONST>
                      <VT>Function29_off</VT>
                    </COMPU-CONST>
                  </COMPU-SCALE>
                  <COMPU-SCALE>
                    <SHORT-LABEL>Function29_on</SHORT-LABEL>
                    <SYMBOL>bf32_in_Function29_on</SYMBOL>
                    <MASK>536870912</MASK>
                    <LOWER-LIMIT INTERVAL-TYPE="CLOSED">536870912</LOWER-LIMIT>
                    <UPPER-LIMIT INTERVAL-TYPE="CLOSED">536870912</UPPER-LIMIT>
                    <COMPU-CONST>
                      <VT>Function29_on</VT>
                    </COMPU-CONST>
                  </COMPU-SCALE>
                  <COMPU-SCALE>
                    <SHORT-LABEL>Function11_on</SHORT-LABEL>
                    <SYMBOL>bf32_in_Function11_on</SYMBOL>
                    <MASK>2048</MASK>
                    <LOWER-LIMIT INTERVAL-TYPE="CLOSED">2048</LOWER-LIMIT>
                    <UPPER-LIMIT INTERVAL-TYPE="CLOSED">2048</UPPER-LIMIT>
                    <COMPU-CONST>
                      <VT>Function11_on</VT>
                    </COMPU-CONST>
                  </COMPU-SCALE>
                  <COMPU-SCALE>
                    <SHORT-LABEL>Function11_off</SHORT-LABEL>
                    <SYMBOL>bf32_in_Function11_off</SYMBOL>
                    <MASK>2048</MASK>
                    <LOWER-LIMIT INTERVAL-TYPE="CLOSED">0</LOWER-LIMIT>
                    <UPPER-LIMIT INTERVAL-TYPE="CLOSED">0</UPPER-LIMIT>
                    <COMPU-CONST>
                      <VT>Function11_off</VT>
                    </COMPU-CONST>
                  </COMPU-SCALE>
                  <COMPU-SCALE>
                    <SHORT-LABEL>Function19_on</SHORT-LABEL>
                    <SYMBOL>bf32_in_Function19_on</SYMBOL>
                    <MASK>524288</MASK>
                    <LOWER-LIMIT INTERVAL-TYPE="CLOSED">524288</LOWER-LIMIT>
                    <UPPER-LIMIT INTERVAL-TYPE="CLOSED">524288</UPPER-LIMIT>
                    <COMPU-CONST>
                      <VT>Function19_on</VT>
                    </COMPU-CONST>
                  </COMPU-SCALE>
                  <COMPU-SCALE>
                    <SHORT-LABEL>Function19_off</SHORT-LABEL>
                    <SYMBOL>bf32_in_Function19_off</SYMBOL>
                    <MASK>524288</MASK>
                    <LOWER-LIMIT INTERVAL-TYPE="CLOSED">0</LOWER-LIMIT>
                    <UPPER-LIMIT INTERVAL-TYPE="CLOSED">0</UPPER-LIMIT>
                    <COMPU-CONST>
                      <VT>Function19_off</VT>
                    </COMPU-CONST>
                  </COMPU-SCALE>
                  <COMPU-SCALE>
                    <SHORT-LABEL>Function14_on</SHORT-LABEL>
                    <SYMBOL>bf32_in_Function14_on</SYMBOL>
                    <MASK>16384</MASK>
                    <LOWER-LIMIT INTERVAL-TYPE="CLOSED">16384</LOWER-LIMIT>
                    <UPPER-LIMIT INTERVAL-TYPE="CLOSED">16384</UPPER-LIMIT>
                    <COMPU-CONST>
                      <VT>Function14_on</VT>
                    </COMPU-CONST>
                  </COMPU-SCALE>
                  <COMPU-SCALE>
                    <SHORT-LABEL>Function14_off</SHORT-LABEL>
                    <SYMBOL>bf32_in_Function14_off</SYMBOL>
                    <MASK>16384</MASK>
                    <LOWER-LIMIT INTERVAL-TYPE="CLOSED">0</LOWER-LIMIT>
                    <UPPER-LIMIT INTERVAL-TYPE="CLOSED">0</UPPER-LIMIT>
                    <COMPU-CONST>
                      <VT>Function14_off</VT>
                    </COMPU-CONST>
                  </COMPU-SCALE>
                  <COMPU-SCALE>
                    <SHORT-LABEL>Function2_on</SHORT-LABEL>
                    <SYMBOL>bf32_in_Function2_on</SYMBOL>
                    <MASK>4</MASK>
                    <LOWER-LIMIT INTERVAL-TYPE="CLOSED">4</LOWER-LIMIT>
                    <UPPER-LIMIT INTERVAL-TYPE="CLOSED">4</UPPER-LIMIT>
                    <COMPU-CONST>
                      <VT>Function2_on</VT>
                    </COMPU-CONST>
                  </COMPU-SCALE>
                  <COMPU-SCALE>
                    <SHORT-LABEL>Function2_off</SHORT-LABEL>
                    <SYMBOL>bf32_in_Function2_off</SYMBOL>
                    <MASK>4</MASK>
                    <LOWER-LIMIT INTERVAL-TYPE="CLOSED">0</LOWER-LIMIT>
                    <UPPER-LIMIT INTERVAL-TYPE="CLOSED">0</UPPER-LIMIT>
                    <COMPU-CONST>
                      <VT>Function2_off</VT>
                    </COMPU-CONST>
                  </COMPU-SCALE>
                  <COMPU-SCALE>
                    <SHORT-LABEL>Function15_off</SHORT-LABEL>
                    <SYMBOL>bf32_in_Function15_off</SYMBOL>
                    <MASK>32768</MASK>
                    <LOWER-LIMIT INTERVAL-TYPE="CLOSED">0</LOWER-LIMIT>
                    <UPPER-LIMIT INTERVAL-TYPE="CLOSED">0</UPPER-LIMIT>
                    <COMPU-CONST>
                      <VT>Function15_off</VT>
                    </COMPU-CONST>
                  </COMPU-SCALE>
                  <COMPU-SCALE>
                    <SHORT-LABEL>Function15_on</SHORT-LABEL>
                    <SYMBOL>bf32_in_Function15_on</SYMBOL>
                    <MASK>32768</MASK>
                    <LOWER-LIMIT INTERVAL-TYPE="CLOSED">32768</LOWER-LIMIT>
                    <UPPER-LIMIT INTERVAL-TYPE="CLOSED">32768</UPPER-LIMIT>
                    <COMPU-CONST>
                      <VT>Function15_on</VT>
                    </COMPU-CONST>
                  </COMPU-SCALE>
                  <COMPU-SCALE>
                    <SHORT-LABEL>Function8_off</SHORT-LABEL>
                    <SYMBOL>bf32_in_Function8_off</SYMBOL>
                    <MASK>256</MASK>
                    <LOWER-LIMIT INTERVAL-TYPE="CLOSED">0</LOWER-LIMIT>
                    <UPPER-LIMIT INTERVAL-TYPE="CLOSED">0</UPPER-LIMIT>
                    <COMPU-CONST>
                      <VT>Function8_off</VT>
                    </COMPU-CONST>
                  </COMPU-SCALE>
                  <COMPU-SCALE>
                    <SHORT-LABEL>Function8_on</SHORT-LABEL>
                    <SYMBOL>bf32_in_Function8_on</SYMBOL>
                    <MASK>256</MASK>
                    <LOWER-LIMIT INTERVAL-TYPE="CLOSED">256</LOWER-LIMIT>
                    <UPPER-LIMIT INTERVAL-TYPE="CLOSED">256</UPPER-LIMIT>
                    <COMPU-CONST>
                      <VT>Function8_on</VT>
                    </COMPU-CONST>
                  </COMPU-SCALE>
                  <COMPU-SCALE>
                    <SHORT-LABEL>Function3_on</SHORT-LABEL>
                    <SYMBOL>bf32_in_Function3_on</SYMBOL>
                    <MASK>8</MASK>
                    <LOWER-LIMIT INTERVAL-TYPE="CLOSED">8</LOWER-LIMIT>
                    <UPPER-LIMIT INTERVAL-TYPE="CLOSED">8</UPPER-LIMIT>
                    <COMPU-CONST>
                      <VT>Function3_on</VT>
                    </COMPU-CONST>
                  </COMPU-SCALE>
                  <COMPU-SCALE>
                    <SHORT-LABEL>Function3_off</SHORT-LABEL>
                    <SYMBOL>bf32_in_Function3_off</SYMBOL>
                    <MASK>8</MASK>
                    <LOWER-LIMIT INTERVAL-TYPE="CLOSED">0</LOWER-LIMIT>
                    <UPPER-LIMIT INTERVAL-TYPE="CLOSED">0</UPPER-LIMIT>
                    <COMPU-CONST>
                      <VT>Function3_off</VT>
                    </COMPU-CONST>
                  </COMPU-SCALE>
                  <COMPU-SCALE>
                    <SHORT-LABEL>Function30_off</SHORT-LABEL>
                    <SYMBOL>bf32_in_Function30_off</SYMBOL>
                    <MASK>1073741824</MASK>
                    <LOWER-LIMIT INTERVAL-TYPE="CLOSED">0</LOWER-LIMIT>
                    <UPPER-LIMIT INTERVAL-TYPE="CLOSED">0</UPPER-LIMIT>
                    <COMPU-CONST>
                      <VT>Function30_off</VT>
                    </COMPU-CONST>
                  </COMPU-SCALE>
                  <COMPU-SCALE>
                    <SHORT-LABEL>Function30_on</SHORT-LABEL>
                    <SYMBOL>bf32_in_Function30_on</SYMBOL>
                    <MASK>1073741824</MASK>
                    <LOWER-LIMIT INTERVAL-TYPE="CLOSED">1073741824</LOWER-LIMIT>
                    <UPPER-LIMIT INTERVAL-TYPE="CLOSED">1073741824</UPPER-LIMIT>
                    <COMPU-CONST>
                      <VT>Function30_on</VT>
                    </COMPU-CONST>
                  </COMPU-SCALE>
                  <COMPU-SCALE>
                    <SHORT-LABEL>Function22_on</SHORT-LABEL>
                    <SYMBOL>bf32_in_Function22_on</SYMBOL>
                    <MASK>4194304</MASK>
                    <LOWER-LIMIT INTERVAL-TYPE="CLOSED">4194304</LOWER-LIMIT>
                    <UPPER-LIMIT INTERVAL-TYPE="CLOSED">4194304</UPPER-LIMIT>
                    <COMPU-CONST>
                      <VT>Function22_on</VT>
                    </COMPU-CONST>
                  </COMPU-SCALE>
                  <COMPU-SCALE>
                    <SHORT-LABEL>Function22_off</SHORT-LABEL>
                    <SYMBOL>bf32_in_Function22_off</SYMBOL>
                    <MASK>4194304</MASK>
                    <LOWER-LIMIT INTERVAL-TYPE="CLOSED">0</LOWER-LIMIT>
                    <UPPER-LIMIT INTERVAL-TYPE="CLOSED">0</UPPER-LIMIT>
                    <COMPU-CONST>
                      <VT>Function22_off</VT>
                    </COMPU-CONST>
                  </COMPU-SCALE>
                  <COMPU-SCALE>
                    <SHORT-LABEL>Function6_on</SHORT-LABEL>
                    <SYMBOL>bf32_in_Function6_on</SYMBOL>
                    <MASK>64</MASK>
                    <LOWER-LIMIT INTERVAL-TYPE="CLOSED">64</LOWER-LIMIT>
                    <UPPER-LIMIT INTERVAL-TYPE="CLOSED">64</UPPER-LIMIT>
                    <COMPU-CONST>
                      <VT>Function6_on</VT>
                    </COMPU-CONST>
                  </COMPU-SCALE>
                  <COMPU-SCALE>
                    <SHORT-LABEL>Function6_off</SHORT-LABEL>
                    <SYMBOL>bf32_in_Function6_off</SYMBOL>
                    <MASK>64</MASK>
                    <LOWER-LIMIT INTERVAL-TYPE="CLOSED">0</LOWER-LIMIT>
                    <UPPER-LIMIT INTERVAL-TYPE="CLOSED">0</UPPER-LIMIT>
                    <COMPU-CONST>
                      <VT>Function6_off</VT>
                    </COMPU-CONST>
                  </COMPU-SCALE>
                  <COMPU-SCALE>
                    <SHORT-LABEL>Function7_off</SHORT-LABEL>
                    <SYMBOL>bf32_in_Function7_off</SYMBOL>
                    <MASK>128</MASK>
                    <LOWER-LIMIT INTERVAL-TYPE="CLOSED">0</LOWER-LIMIT>
                    <UPPER-LIMIT INTERVAL-TYPE="CLOSED">0</UPPER-LIMIT>
                    <COMPU-CONST>
                      <VT>Function7_off</VT>
                    </COMPU-CONST>
                  </COMPU-SCALE>
                  <COMPU-SCALE>
                    <SHORT-LABEL>Function7_on</SHORT-LABEL>
                    <SYMBOL>bf32_in_Function7_on</SYMBOL>
                    <MASK>128</MASK>
                    <LOWER-LIMIT INTERVAL-TYPE="CLOSED">128</LOWER-LIMIT>
                    <UPPER-LIMIT INTERVAL-TYPE="CLOSED">128</UPPER-LIMIT>
                    <COMPU-CONST>
                      <VT>Function7_on</VT>
                    </COMPU-CONST>
                  </COMPU-SCALE>
                  <COMPU-SCALE>
                    <SHORT-LABEL>Function25_on</SHORT-LABEL>
                    <SYMBOL>bf32_in_Function25_on</SYMBOL>
                    <MASK>33554432</MASK>
                    <LOWER-LIMIT INTERVAL-TYPE="CLOSED">33554432</LOWER-LIMIT>
                    <UPPER-LIMIT INTERVAL-TYPE="CLOSED">33554432</UPPER-LIMIT>
                    <COMPU-CONST>
                      <VT>Function25_on</VT>
                    </COMPU-CONST>
                  </COMPU-SCALE>
                  <COMPU-SCALE>
                    <SHORT-LABEL>Function25_off</SHORT-LABEL>
                    <SYMBOL>bf32_in_Function25_off</SYMBOL>
                    <MASK>33554432</MASK>
                    <LOWER-LIMIT INTERVAL-TYPE="CLOSED">0</LOWER-LIMIT>
                    <UPPER-LIMIT INTERVAL-TYPE="CLOSED">0</UPPER-LIMIT>
                    <COMPU-CONST>
                      <VT>Function25_off</VT>
                    </COMPU-CONST>
                  </COMPU-SCALE>
                  <COMPU-SCALE>
                    <SHORT-LABEL>Function4_on</SHORT-LABEL>
                    <SYMBOL>bf32_in_Function4_on</SYMBOL>
                    <MASK>16</MASK>
                    <LOWER-LIMIT INTERVAL-TYPE="CLOSED">16</LOWER-LIMIT>
                    <UPPER-LIMIT INTERVAL-TYPE="CLOSED">16</UPPER-LIMIT>
                    <COMPU-CONST>
                      <VT>Function4_on</VT>
                    </COMPU-CONST>
                  </COMPU-SCALE>
                  <COMPU-SCALE>
                    <SHORT-LABEL>Function4_off</SHORT-LABEL>
                    <SYMBOL>bf32_in_Function4_off</SYMBOL>
                    <MASK>16</MASK>
                    <LOWER-LIMIT INTERVAL-TYPE="CLOSED">0</LOWER-LIMIT>
                    <UPPER-LIMIT INTERVAL-TYPE="CLOSED">0</UPPER-LIMIT>
                    <COMPU-CONST>
                      <VT>Function4_off</VT>
                    </COMPU-CONST>
                  </COMPU-SCALE>
                </COMPU-SCALES>
              </COMPU-INTERNAL-TO-PHYS>
            </COMPU-METHOD>
            <COMPU-METHOD>
              <SHORT-NAME>ETS_Bitfield_uint32_return</SHORT-NAME>
              <CATEGORY>BITFIELD_TEXTTABLE</CATEGORY>
              <UNIT-REF DEST="UNIT">/ETS/Units/ETS_NoUnit</UNIT-REF>
              <COMPU-INTERNAL-TO-PHYS>
                <COMPU-SCALES>
                  <COMPU-SCALE>
                    <SHORT-LABEL>Function11_on</SHORT-LABEL>
                    <SYMBOL>bf32_out_Function11_on</SYMBOL>
                    <MASK>1048576</MASK>
                    <LOWER-LIMIT INTERVAL-TYPE="CLOSED">1048576</LOWER-LIMIT>
                    <UPPER-LIMIT INTERVAL-TYPE="CLOSED">1048576</UPPER-LIMIT>
                    <COMPU-CONST>
                      <VT>Function11_on</VT>
                    </COMPU-CONST>
                  </COMPU-SCALE>
                  <COMPU-SCALE>
                    <SHORT-LABEL>Function11_off</SHORT-LABEL>
                    <SYMBOL>bf32_out_Function11_off</SYMBOL>
                    <MASK>1048576</MASK>
                    <LOWER-LIMIT INTERVAL-TYPE="CLOSED">0</LOWER-LIMIT>
                    <UPPER-LIMIT INTERVAL-TYPE="CLOSED">0</UPPER-LIMIT>
                    <COMPU-CONST>
                      <VT>Function11_off</VT>
                    </COMPU-CONST>
                  </COMPU-SCALE>
                  <COMPU-SCALE>
                    <SHORT-LABEL>Function23_on</SHORT-LABEL>
                    <SYMBOL>bf32_out_Function23_on</SYMBOL>
                    <MASK>256</MASK>
                    <LOWER-LIMIT INTERVAL-TYPE="CLOSED">256</LOWER-LIMIT>
                    <UPPER-LIMIT INTERVAL-TYPE="CLOSED">256</UPPER-LIMIT>
                    <COMPU-CONST>
                      <VT>Function23_on</VT>
                    </COMPU-CONST>
                  </COMPU-SCALE>
                  <COMPU-SCALE>
                    <SHORT-LABEL>Function23_off</SHORT-LABEL>
                    <SYMBOL>bf32_out_Function23_off</SYMBOL>
                    <MASK>256</MASK>
                    <LOWER-LIMIT INTERVAL-TYPE="CLOSED">0</LOWER-LIMIT>
                    <UPPER-LIMIT INTERVAL-TYPE="CLOSED">0</UPPER-LIMIT>
                    <COMPU-CONST>
                      <VT>Function23_off</VT>
                    </COMPU-CONST>
                  </COMPU-SCALE>
                  <COMPU-SCALE>
                    <SHORT-LABEL>Function9_off</SHORT-LABEL>
                    <SYMBOL>bf32_out_Function9_off</SYMBOL>
                    <MASK>4194304</MASK>
                    <LOWER-LIMIT INTERVAL-TYPE="CLOSED">0</LOWER-LIMIT>
                    <UPPER-LIMIT INTERVAL-TYPE="CLOSED">0</UPPER-LIMIT>
                    <COMPU-CONST>
                      <VT>Function9_off</VT>
                    </COMPU-CONST>
                  </COMPU-SCALE>
                  <COMPU-SCALE>
                    <SHORT-LABEL>Function9_on</SHORT-LABEL>
                    <SYMBOL>bf32_out_Function9_on</SYMBOL>
                    <MASK>4194304</MASK>
                    <LOWER-LIMIT INTERVAL-TYPE="CLOSED">4194304</LOWER-LIMIT>
                    <UPPER-LIMIT INTERVAL-TYPE="CLOSED">4194304</UPPER-LIMIT>
                    <COMPU-CONST>
                      <VT>Function9_on</VT>
                    </COMPU-CONST>
                  </COMPU-SCALE>
                  <COMPU-SCALE>
                    <SHORT-LABEL>Function16_off</SHORT-LABEL>
                    <SYMBOL>bf32_out_Function16_off</SYMBOL>
                    <MASK>32768</MASK>
                    <LOWER-LIMIT INTERVAL-TYPE="CLOSED">0</LOWER-LIMIT>
                    <UPPER-LIMIT INTERVAL-TYPE="CLOSED">0</UPPER-LIMIT>
                    <COMPU-CONST>
                      <VT>Function16_off</VT>
                    </COMPU-CONST>
                  </COMPU-SCALE>
                  <COMPU-SCALE>
                    <SHORT-LABEL>Function16_on</SHORT-LABEL>
                    <SYMBOL>bf32_out_Function16_on</SYMBOL>
                    <MASK>32768</MASK>
                    <LOWER-LIMIT INTERVAL-TYPE="CLOSED">32768</LOWER-LIMIT>
                    <UPPER-LIMIT INTERVAL-TYPE="CLOSED">32768</UPPER-LIMIT>
                    <COMPU-CONST>
                      <VT>Function16_on</VT>
                    </COMPU-CONST>
                  </COMPU-SCALE>
                  <COMPU-SCALE>
                    <SHORT-LABEL>Function24_off</SHORT-LABEL>
                    <SYMBOL>bf32_out_Function24_off</SYMBOL>
                    <MASK>128</MASK>
                    <LOWER-LIMIT INTERVAL-TYPE="CLOSED">0</LOWER-LIMIT>
                    <UPPER-LIMIT INTERVAL-TYPE="CLOSED">0</UPPER-LIMIT>
                    <COMPU-CONST>
                      <VT>Function24_off</VT>
                    </COMPU-CONST>
                  </COMPU-SCALE>
                  <COMPU-SCALE>
                    <SHORT-LABEL>Function24_on</SHORT-LABEL>
                    <SYMBOL>bf32_out_Function24_on</SYMBOL>
                    <MASK>128</MASK>
                    <LOWER-LIMIT INTERVAL-TYPE="CLOSED">128</LOWER-LIMIT>
                    <UPPER-LIMIT INTERVAL-TYPE="CLOSED">128</UPPER-LIMIT>
                    <COMPU-CONST>
                      <VT>Function24_on</VT>
                    </COMPU-CONST>
                  </COMPU-SCALE>
                  <COMPU-SCALE>
                    <SHORT-LABEL>Function21_off</SHORT-LABEL>
                    <SYMBOL>bf32_out_Function21_off</SYMBOL>
                    <MASK>1024</MASK>
                    <LOWER-LIMIT INTERVAL-TYPE="CLOSED">0</LOWER-LIMIT>
                    <UPPER-LIMIT INTERVAL-TYPE="CLOSED">0</UPPER-LIMIT>
                    <COMPU-CONST>
                      <VT>Function21_off</VT>
                    </COMPU-CONST>
                  </COMPU-SCALE>
                  <COMPU-SCALE>
                    <SHORT-LABEL>Function21_on</SHORT-LABEL>
                    <SYMBOL>bf32_out_Function21_on</SYMBOL>
                    <MASK>1024</MASK>
                    <LOWER-LIMIT INTERVAL-TYPE="CLOSED">1024</LOWER-LIMIT>
                    <UPPER-LIMIT INTERVAL-TYPE="CLOSED">1024</UPPER-LIMIT>
                    <COMPU-CONST>
                      <VT>Function21_on</VT>
                    </COMPU-CONST>
                  </COMPU-SCALE>
                  <COMPU-SCALE>
                    <SHORT-LABEL>Function0_off</SHORT-LABEL>
                    <SYMBOL>bf32_out_Function0_off</SYMBOL>
                    <MASK>2147483648</MASK>
                    <LOWER-LIMIT INTERVAL-TYPE="CLOSED">0</LOWER-LIMIT>
                    <UPPER-LIMIT INTERVAL-TYPE="CLOSED">0</UPPER-LIMIT>
                    <COMPU-CONST>
                      <VT>Function0_off</VT>
                    </COMPU-CONST>
                  </COMPU-SCALE>
                  <COMPU-SCALE>
                    <SHORT-LABEL>Function0_on</SHORT-LABEL>
                    <SYMBOL>bf32_out_Function0_on</SYMBOL>
                    <MASK>2147483648</MASK>
                    <LOWER-LIMIT INTERVAL-TYPE="CLOSED">2147483648</LOWER-LIMIT>
                    <UPPER-LIMIT INTERVAL-TYPE="CLOSED">2147483648</UPPER-LIMIT>
                    <COMPU-CONST>
                      <VT>Function0_on</VT>
                    </COMPU-CONST>
                  </COMPU-SCALE>
                  <COMPU-SCALE>
                    <SHORT-LABEL>Function22_off</SHORT-LABEL>
                    <SYMBOL>bf32_out_Function22_off</SYMBOL>
                    <MASK>512</MASK>
                    <LOWER-LIMIT INTERVAL-TYPE="CLOSED">0</LOWER-LIMIT>
                    <UPPER-LIMIT INTERVAL-TYPE="CLOSED">0</UPPER-LIMIT>
                    <COMPU-CONST>
                      <VT>Function22_off</VT>
                    </COMPU-CONST>
                  </COMPU-SCALE>
                  <COMPU-SCALE>
                    <SHORT-LABEL>Function22_on</SHORT-LABEL>
                    <SYMBOL>bf32_out_Function22_on</SYMBOL>
                    <MASK>512</MASK>
                    <LOWER-LIMIT INTERVAL-TYPE="CLOSED">512</LOWER-LIMIT>
                    <UPPER-LIMIT INTERVAL-TYPE="CLOSED">512</UPPER-LIMIT>
                    <COMPU-CONST>
                      <VT>Function22_on</VT>
                    </COMPU-CONST>
                  </COMPU-SCALE>
                  <COMPU-SCALE>
                    <SHORT-LABEL>Function28_off</SHORT-LABEL>
                    <SYMBOL>bf32_out_Function28_off</SYMBOL>
                    <MASK>8</MASK>
                    <LOWER-LIMIT INTERVAL-TYPE="CLOSED">0</LOWER-LIMIT>
                    <UPPER-LIMIT INTERVAL-TYPE="CLOSED">0</UPPER-LIMIT>
                    <COMPU-CONST>
                      <VT>Function28_off</VT>
                    </COMPU-CONST>
                  </COMPU-SCALE>
                  <COMPU-SCALE>
                    <SHORT-LABEL>Function28_on</SHORT-LABEL>
                    <SYMBOL>bf32_out_Function28_on</SYMBOL>
                    <MASK>8</MASK>
                    <LOWER-LIMIT INTERVAL-TYPE="CLOSED">8</LOWER-LIMIT>
                    <UPPER-LIMIT INTERVAL-TYPE="CLOSED">8</UPPER-LIMIT>
                    <COMPU-CONST>
                      <VT>Function28_on</VT>
                    </COMPU-CONST>
                  </COMPU-SCALE>
                  <COMPU-SCALE>
                    <SHORT-LABEL>Function19_on</SHORT-LABEL>
                    <SYMBOL>bf32_out_Function19_on</SYMBOL>
                    <MASK>4096</MASK>
                    <LOWER-LIMIT INTERVAL-TYPE="CLOSED">4096</LOWER-LIMIT>
                    <UPPER-LIMIT INTERVAL-TYPE="CLOSED">4096</UPPER-LIMIT>
                    <COMPU-CONST>
                      <VT>Function19_on</VT>
                    </COMPU-CONST>
                  </COMPU-SCALE>
                  <COMPU-SCALE>
                    <SHORT-LABEL>Function19_off</SHORT-LABEL>
                    <SYMBOL>bf32_out_Function19_off</SYMBOL>
                    <MASK>4096</MASK>
                    <LOWER-LIMIT INTERVAL-TYPE="CLOSED">0</LOWER-LIMIT>
                    <UPPER-LIMIT INTERVAL-TYPE="CLOSED">0</UPPER-LIMIT>
                    <COMPU-CONST>
                      <VT>Function19_off</VT>
                    </COMPU-CONST>
                  </COMPU-SCALE>
                  <COMPU-SCALE>
                    <SHORT-LABEL>Function6_on</SHORT-LABEL>
                    <SYMBOL>bf32_out_Function6_on</SYMBOL>
                    <MASK>33554432</MASK>
                    <LOWER-LIMIT INTERVAL-TYPE="CLOSED">33554432</LOWER-LIMIT>
                    <UPPER-LIMIT INTERVAL-TYPE="CLOSED">33554432</UPPER-LIMIT>
                    <COMPU-CONST>
                      <VT>Function6_on</VT>
                    </COMPU-CONST>
                  </COMPU-SCALE>
                  <COMPU-SCALE>
                    <SHORT-LABEL>Function6_off</SHORT-LABEL>
                    <SYMBOL>bf32_out_Function6_off</SYMBOL>
                    <MASK>33554432</MASK>
                    <LOWER-LIMIT INTERVAL-TYPE="CLOSED">0</LOWER-LIMIT>
                    <UPPER-LIMIT INTERVAL-TYPE="CLOSED">0</UPPER-LIMIT>
                    <COMPU-CONST>
                      <VT>Function6_off</VT>
                    </COMPU-CONST>
                  </COMPU-SCALE>
                  <COMPU-SCALE>
                    <SHORT-LABEL>Function26_on</SHORT-LABEL>
                    <SYMBOL>bf32_out_Function26_on</SYMBOL>
                    <MASK>32</MASK>
                    <LOWER-LIMIT INTERVAL-TYPE="CLOSED">32</LOWER-LIMIT>
                    <UPPER-LIMIT INTERVAL-TYPE="CLOSED">32</UPPER-LIMIT>
                    <COMPU-CONST>
                      <VT>Function26_on</VT>
                    </COMPU-CONST>
                  </COMPU-SCALE>
                  <COMPU-SCALE>
                    <SHORT-LABEL>Function26_off</SHORT-LABEL>
                    <SYMBOL>bf32_out_Function26_off</SYMBOL>
                    <MASK>32</MASK>
                    <LOWER-LIMIT INTERVAL-TYPE="CLOSED">0</LOWER-LIMIT>
                    <UPPER-LIMIT INTERVAL-TYPE="CLOSED">0</UPPER-LIMIT>
                    <COMPU-CONST>
                      <VT>Function26_off</VT>
                    </COMPU-CONST>
                  </COMPU-SCALE>
                  <COMPU-SCALE>
                    <SHORT-LABEL>Function30_on</SHORT-LABEL>
                    <SYMBOL>bf32_out_Function30_on</SYMBOL>
                    <MASK>2</MASK>
                    <LOWER-LIMIT INTERVAL-TYPE="CLOSED">2</LOWER-LIMIT>
                    <UPPER-LIMIT INTERVAL-TYPE="CLOSED">2</UPPER-LIMIT>
                    <COMPU-CONST>
                      <VT>Function30_on</VT>
                    </COMPU-CONST>
                  </COMPU-SCALE>
                  <COMPU-SCALE>
                    <SHORT-LABEL>Function30_off</SHORT-LABEL>
                    <SYMBOL>bf32_out_Function30_off</SYMBOL>
                    <MASK>2</MASK>
                    <LOWER-LIMIT INTERVAL-TYPE="CLOSED">0</LOWER-LIMIT>
                    <UPPER-LIMIT INTERVAL-TYPE="CLOSED">0</UPPER-LIMIT>
                    <COMPU-CONST>
                      <VT>Function30_off</VT>
                    </COMPU-CONST>
                  </COMPU-SCALE>
                  <COMPU-SCALE>
                    <SHORT-LABEL>Function8_off</SHORT-LABEL>
                    <SYMBOL>bf32_out_Function8_off</SYMBOL>
                    <MASK>8388608</MASK>
                    <LOWER-LIMIT INTERVAL-TYPE="CLOSED">0</LOWER-LIMIT>
                    <UPPER-LIMIT INTERVAL-TYPE="CLOSED">0</UPPER-LIMIT>
                    <COMPU-CONST>
                      <VT>Function8_off</VT>
                    </COMPU-CONST>
                  </COMPU-SCALE>
                  <COMPU-SCALE>
                    <SHORT-LABEL>Function8_on</SHORT-LABEL>
                    <SYMBOL>bf32_out_Function8_on</SYMBOL>
                    <MASK>8388608</MASK>
                    <LOWER-LIMIT INTERVAL-TYPE="CLOSED">8388608</LOWER-LIMIT>
                    <UPPER-LIMIT INTERVAL-TYPE="CLOSED">8388608</UPPER-LIMIT>
                    <COMPU-CONST>
                      <VT>Function8_on</VT>
                    </COMPU-CONST>
                  </COMPU-SCALE>
                  <COMPU-SCALE>
                    <SHORT-LABEL>Function25_off</SHORT-LABEL>
                    <SYMBOL>bf32_out_Function25_off</SYMBOL>
                    <MASK>64</MASK>
                    <LOWER-LIMIT INTERVAL-TYPE="CLOSED">0</LOWER-LIMIT>
                    <UPPER-LIMIT INTERVAL-TYPE="CLOSED">0</UPPER-LIMIT>
                    <COMPU-CONST>
                      <VT>Function25_off</VT>
                    </COMPU-CONST>
                  </COMPU-SCALE>
                  <COMPU-SCALE>
                    <SHORT-LABEL>Function25_on</SHORT-LABEL>
                    <SYMBOL>bf32_out_Function25_on</SYMBOL>
                    <MASK>64</MASK>
                    <LOWER-LIMIT INTERVAL-TYPE="CLOSED">64</LOWER-LIMIT>
                    <UPPER-LIMIT INTERVAL-TYPE="CLOSED">64</UPPER-LIMIT>
                    <COMPU-CONST>
                      <VT>Function25_on</VT>
                    </COMPU-CONST>
                  </COMPU-SCALE>
                  <COMPU-SCALE>
                    <SHORT-LABEL>Function5_off</SHORT-LABEL>
                    <SYMBOL>bf32_out_Function5_off</SYMBOL>
                    <MASK>67108864</MASK>
                    <LOWER-LIMIT INTERVAL-TYPE="CLOSED">0</LOWER-LIMIT>
                    <UPPER-LIMIT INTERVAL-TYPE="CLOSED">0</UPPER-LIMIT>
                    <COMPU-CONST>
                      <VT>Function5_off</VT>
                    </COMPU-CONST>
                  </COMPU-SCALE>
                  <COMPU-SCALE>
                    <SHORT-LABEL>Function5_on</SHORT-LABEL>
                    <SYMBOL>bf32_out_Function5_on</SYMBOL>
                    <MASK>67108864</MASK>
                    <LOWER-LIMIT INTERVAL-TYPE="CLOSED">67108864</LOWER-LIMIT>
                    <UPPER-LIMIT INTERVAL-TYPE="CLOSED">67108864</UPPER-LIMIT>
                    <COMPU-CONST>
                      <VT>Function5_on</VT>
                    </COMPU-CONST>
                  </COMPU-SCALE>
                  <COMPU-SCALE>
                    <SHORT-LABEL>Function10_on</SHORT-LABEL>
                    <SYMBOL>bf32_out_Function10_on</SYMBOL>
                    <MASK>2097152</MASK>
                    <LOWER-LIMIT INTERVAL-TYPE="CLOSED">2097152</LOWER-LIMIT>
                    <UPPER-LIMIT INTERVAL-TYPE="CLOSED">2097152</UPPER-LIMIT>
                    <COMPU-CONST>
                      <VT>Function10_on</VT>
                    </COMPU-CONST>
                  </COMPU-SCALE>
                  <COMPU-SCALE>
                    <SHORT-LABEL>Function10_off</SHORT-LABEL>
                    <SYMBOL>bf32_out_Function10_off</SYMBOL>
                    <MASK>2097152</MASK>
                    <LOWER-LIMIT INTERVAL-TYPE="CLOSED">0</LOWER-LIMIT>
                    <UPPER-LIMIT INTERVAL-TYPE="CLOSED">0</UPPER-LIMIT>
                    <COMPU-CONST>
                      <VT>Function10_off</VT>
                    </COMPU-CONST>
                  </COMPU-SCALE>
                  <COMPU-SCALE>
                    <SHORT-LABEL>Function3_on</SHORT-LABEL>
                    <SYMBOL>bf32_out_Function3_on</SYMBOL>
                    <MASK>268435456</MASK>
                    <LOWER-LIMIT INTERVAL-TYPE="CLOSED">268435456</LOWER-LIMIT>
                    <UPPER-LIMIT INTERVAL-TYPE="CLOSED">268435456</UPPER-LIMIT>
                    <COMPU-CONST>
                      <VT>Function3_on</VT>
                    </COMPU-CONST>
                  </COMPU-SCALE>
                  <COMPU-SCALE>
                    <SHORT-LABEL>Function3_off</SHORT-LABEL>
                    <SYMBOL>bf32_out_Function3_off</SYMBOL>
                    <MASK>268435456</MASK>
                    <LOWER-LIMIT INTERVAL-TYPE="CLOSED">0</LOWER-LIMIT>
                    <UPPER-LIMIT INTERVAL-TYPE="CLOSED">0</UPPER-LIMIT>
                    <COMPU-CONST>
                      <VT>Function3_off</VT>
                    </COMPU-CONST>
                  </COMPU-SCALE>
                  <COMPU-SCALE>
                    <SHORT-LABEL>Function13_off</SHORT-LABEL>
                    <SYMBOL>bf32_out_Function13_off</SYMBOL>
                    <MASK>262144</MASK>
                    <LOWER-LIMIT INTERVAL-TYPE="CLOSED">0</LOWER-LIMIT>
                    <UPPER-LIMIT INTERVAL-TYPE="CLOSED">0</UPPER-LIMIT>
                    <COMPU-CONST>
                      <VT>Function13_off</VT>
                    </COMPU-CONST>
                  </COMPU-SCALE>
                  <COMPU-SCALE>
                    <SHORT-LABEL>Function13_on</SHORT-LABEL>
                    <SYMBOL>bf32_out_Function13_on</SYMBOL>
                    <MASK>262144</MASK>
                    <LOWER-LIMIT INTERVAL-TYPE="CLOSED">262144</LOWER-LIMIT>
                    <UPPER-LIMIT INTERVAL-TYPE="CLOSED">262144</UPPER-LIMIT>
                    <COMPU-CONST>
                      <VT>Function13_on</VT>
                    </COMPU-CONST>
                  </COMPU-SCALE>
                  <COMPU-SCALE>
                    <SHORT-LABEL>Function29_on</SHORT-LABEL>
                    <SYMBOL>bf32_out_Function29_on</SYMBOL>
                    <MASK>4</MASK>
                    <LOWER-LIMIT INTERVAL-TYPE="CLOSED">4</LOWER-LIMIT>
                    <UPPER-LIMIT INTERVAL-TYPE="CLOSED">4</UPPER-LIMIT>
                    <COMPU-CONST>
                      <VT>Function29_on</VT>
                    </COMPU-CONST>
                  </COMPU-SCALE>
                  <COMPU-SCALE>
                    <SHORT-LABEL>Function29_off</SHORT-LABEL>
                    <SYMBOL>bf32_out_Function29_off</SYMBOL>
                    <MASK>4</MASK>
                    <LOWER-LIMIT INTERVAL-TYPE="CLOSED">0</LOWER-LIMIT>
                    <UPPER-LIMIT INTERVAL-TYPE="CLOSED">0</UPPER-LIMIT>
                    <COMPU-CONST>
                      <VT>Function29_off</VT>
                    </COMPU-CONST>
                  </COMPU-SCALE>
                  <COMPU-SCALE>
                    <SHORT-LABEL>Function27_on</SHORT-LABEL>
                    <SYMBOL>bf32_out_Function27_on</SYMBOL>
                    <MASK>16</MASK>
                    <LOWER-LIMIT INTERVAL-TYPE="CLOSED">16</LOWER-LIMIT>
                    <UPPER-LIMIT INTERVAL-TYPE="CLOSED">16</UPPER-LIMIT>
                    <COMPU-CONST>
                      <VT>Function27_on</VT>
                    </COMPU-CONST>
                  </COMPU-SCALE>
                  <COMPU-SCALE>
                    <SHORT-LABEL>Function27_off</SHORT-LABEL>
                    <SYMBOL>bf32_out_Function27_off</SYMBOL>
                    <MASK>16</MASK>
                    <LOWER-LIMIT INTERVAL-TYPE="CLOSED">0</LOWER-LIMIT>
                    <UPPER-LIMIT INTERVAL-TYPE="CLOSED">0</UPPER-LIMIT>
                    <COMPU-CONST>
                      <VT>Function27_off</VT>
                    </COMPU-CONST>
                  </COMPU-SCALE>
                  <COMPU-SCALE>
                    <SHORT-LABEL>Function7_off</SHORT-LABEL>
                    <SYMBOL>bf32_out_Function7_off</SYMBOL>
                    <MASK>16777216</MASK>
                    <LOWER-LIMIT INTERVAL-TYPE="CLOSED">0</LOWER-LIMIT>
                    <UPPER-LIMIT INTERVAL-TYPE="CLOSED">0</UPPER-LIMIT>
                    <COMPU-CONST>
                      <VT>Function7_off</VT>
                    </COMPU-CONST>
                  </COMPU-SCALE>
                  <COMPU-SCALE>
                    <SHORT-LABEL>Function7_on</SHORT-LABEL>
                    <SYMBOL>bf32_out_Function7_on</SYMBOL>
                    <MASK>16777216</MASK>
                    <LOWER-LIMIT INTERVAL-TYPE="CLOSED">16777216</LOWER-LIMIT>
                    <UPPER-LIMIT INTERVAL-TYPE="CLOSED">16777216</UPPER-LIMIT>
                    <COMPU-CONST>
                      <VT>Function7_on</VT>
                    </COMPU-CONST>
                  </COMPU-SCALE>
                  <COMPU-SCALE>
                    <SHORT-LABEL>Function31_off</SHORT-LABEL>
                    <SYMBOL>bf32_out_Function31_off</SYMBOL>
                    <MASK>1</MASK>
                    <LOWER-LIMIT INTERVAL-TYPE="CLOSED">0</LOWER-LIMIT>
                    <UPPER-LIMIT INTERVAL-TYPE="CLOSED">0</UPPER-LIMIT>
                    <COMPU-CONST>
                      <VT>Function31_off</VT>
                    </COMPU-CONST>
                  </COMPU-SCALE>
                  <COMPU-SCALE>
                    <SHORT-LABEL>Function31_on</SHORT-LABEL>
                    <SYMBOL>bf32_out_Function31_on</SYMBOL>
                    <MASK>1</MASK>
                    <LOWER-LIMIT INTERVAL-TYPE="CLOSED">1</LOWER-LIMIT>
                    <UPPER-LIMIT INTERVAL-TYPE="CLOSED">1</UPPER-LIMIT>
                    <COMPU-CONST>
                      <VT>Function31_on</VT>
                    </COMPU-CONST>
                  </COMPU-SCALE>
                  <COMPU-SCALE>
                    <SHORT-LABEL>Function20_off</SHORT-LABEL>
                    <SYMBOL>bf32_out_Function20_off</SYMBOL>
                    <MASK>2048</MASK>
                    <LOWER-LIMIT INTERVAL-TYPE="CLOSED">0</LOWER-LIMIT>
                    <UPPER-LIMIT INTERVAL-TYPE="CLOSED">0</UPPER-LIMIT>
                    <COMPU-CONST>
                      <VT>Function20_off</VT>
                    </COMPU-CONST>
                  </COMPU-SCALE>
                  <COMPU-SCALE>
                    <SHORT-LABEL>Function20_on</SHORT-LABEL>
                    <SYMBOL>bf32_out_Function20_on</SYMBOL>
                    <MASK>2048</MASK>
                    <LOWER-LIMIT INTERVAL-TYPE="CLOSED">2048</LOWER-LIMIT>
                    <UPPER-LIMIT INTERVAL-TYPE="CLOSED">2048</UPPER-LIMIT>
                    <COMPU-CONST>
                      <VT>Function20_on</VT>
                    </COMPU-CONST>
                  </COMPU-SCALE>
                  <COMPU-SCALE>
                    <SHORT-LABEL>Function12_off</SHORT-LABEL>
                    <SYMBOL>bf32_out_Function12_off</SYMBOL>
                    <MASK>524288</MASK>
                    <LOWER-LIMIT INTERVAL-TYPE="CLOSED">0</LOWER-LIMIT>
                    <UPPER-LIMIT INTERVAL-TYPE="CLOSED">0</UPPER-LIMIT>
                    <COMPU-CONST>
                      <VT>Function12_off</VT>
                    </COMPU-CONST>
                  </COMPU-SCALE>
                  <COMPU-SCALE>
                    <SHORT-LABEL>Function12_on</SHORT-LABEL>
                    <SYMBOL>bf32_out_Function12_on</SYMBOL>
                    <MASK>524288</MASK>
                    <LOWER-LIMIT INTERVAL-TYPE="CLOSED">524288</LOWER-LIMIT>
                    <UPPER-LIMIT INTERVAL-TYPE="CLOSED">524288</UPPER-LIMIT>
                    <COMPU-CONST>
                      <VT>Function12_on</VT>
                    </COMPU-CONST>
                  </COMPU-SCALE>
                  <COMPU-SCALE>
                    <SHORT-LABEL>Function15_off</SHORT-LABEL>
                    <SYMBOL>bf32_out_Function15_off</SYMBOL>
                    <MASK>65536</MASK>
                    <LOWER-LIMIT INTERVAL-TYPE="CLOSED">0</LOWER-LIMIT>
                    <UPPER-LIMIT INTERVAL-TYPE="CLOSED">0</UPPER-LIMIT>
                    <COMPU-CONST>
                      <VT>Function15_off</VT>
                    </COMPU-CONST>
                  </COMPU-SCALE>
                  <COMPU-SCALE>
                    <SHORT-LABEL>Function15_on</SHORT-LABEL>
                    <SYMBOL>bf32_out_Function15_on</SYMBOL>
                    <MASK>65536</MASK>
                    <LOWER-LIMIT INTERVAL-TYPE="CLOSED">65536</LOWER-LIMIT>
                    <UPPER-LIMIT INTERVAL-TYPE="CLOSED">65536</UPPER-LIMIT>
                    <COMPU-CONST>
                      <VT>Function15_on</VT>
                    </COMPU-CONST>
                  </COMPU-SCALE>
                  <COMPU-SCALE>
                    <SHORT-LABEL>Function4_on</SHORT-LABEL>
                    <SYMBOL>bf32_out_Function4_on</SYMBOL>
                    <MASK>134217728</MASK>
                    <LOWER-LIMIT INTERVAL-TYPE="CLOSED">134217728</LOWER-LIMIT>
                    <UPPER-LIMIT INTERVAL-TYPE="CLOSED">134217728</UPPER-LIMIT>
                    <COMPU-CONST>
                      <VT>Function4_on</VT>
                    </COMPU-CONST>
                  </COMPU-SCALE>
                  <COMPU-SCALE>
                    <SHORT-LABEL>Function4_off</SHORT-LABEL>
                    <SYMBOL>bf32_out_Function4_off</SYMBOL>
                    <MASK>134217728</MASK>
                    <LOWER-LIMIT INTERVAL-TYPE="CLOSED">0</LOWER-LIMIT>
                    <UPPER-LIMIT INTERVAL-TYPE="CLOSED">0</UPPER-LIMIT>
                    <COMPU-CONST>
                      <VT>Function4_off</VT>
                    </COMPU-CONST>
                  </COMPU-SCALE>
                  <COMPU-SCALE>
                    <SHORT-LABEL>Function18_on</SHORT-LABEL>
                    <SYMBOL>bf32_out_Function18_on</SYMBOL>
                    <MASK>8192</MASK>
                    <LOWER-LIMIT INTERVAL-TYPE="CLOSED">8192</LOWER-LIMIT>
                    <UPPER-LIMIT INTERVAL-TYPE="CLOSED">8192</UPPER-LIMIT>
                    <COMPU-CONST>
                      <VT>Function18_on</VT>
                    </COMPU-CONST>
                  </COMPU-SCALE>
                  <COMPU-SCALE>
                    <SHORT-LABEL>Function18_off</SHORT-LABEL>
                    <SYMBOL>bf32_out_Function18_off</SYMBOL>
                    <MASK>8192</MASK>
                    <LOWER-LIMIT INTERVAL-TYPE="CLOSED">0</LOWER-LIMIT>
                    <UPPER-LIMIT INTERVAL-TYPE="CLOSED">0</UPPER-LIMIT>
                    <COMPU-CONST>
                      <VT>Function18_off</VT>
                    </COMPU-CONST>
                  </COMPU-SCALE>
                  <COMPU-SCALE>
                    <SHORT-LABEL>Function1_off</SHORT-LABEL>
                    <SYMBOL>bf32_out_Function1_off</SYMBOL>
                    <MASK>1073741824</MASK>
                    <LOWER-LIMIT INTERVAL-TYPE="CLOSED">0</LOWER-LIMIT>
                    <UPPER-LIMIT INTERVAL-TYPE="CLOSED">0</UPPER-LIMIT>
                    <COMPU-CONST>
                      <VT>Function1_off</VT>
                    </COMPU-CONST>
                  </COMPU-SCALE>
                  <COMPU-SCALE>
                    <SHORT-LABEL>Function1_on</SHORT-LABEL>
                    <SYMBOL>bf32_out_Function1_on</SYMBOL>
                    <MASK>1073741824</MASK>
                    <LOWER-LIMIT INTERVAL-TYPE="CLOSED">1073741824</LOWER-LIMIT>
                    <UPPER-LIMIT INTERVAL-TYPE="CLOSED">1073741824</UPPER-LIMIT>
                    <COMPU-CONST>
                      <VT>Function1_on</VT>
                    </COMPU-CONST>
                  </COMPU-SCALE>
                  <COMPU-SCALE>
                    <SHORT-LABEL>Function17_on</SHORT-LABEL>
                    <SYMBOL>bf32_out_Function17_on</SYMBOL>
                    <MASK>16384</MASK>
                    <LOWER-LIMIT INTERVAL-TYPE="CLOSED">16384</LOWER-LIMIT>
                    <UPPER-LIMIT INTERVAL-TYPE="CLOSED">16384</UPPER-LIMIT>
                    <COMPU-CONST>
                      <VT>Function17_on</VT>
                    </COMPU-CONST>
                  </COMPU-SCALE>
                  <COMPU-SCALE>
                    <SHORT-LABEL>Function17_off</SHORT-LABEL>
                    <SYMBOL>bf32_out_Function17_off</SYMBOL>
                    <MASK>16384</MASK>
                    <LOWER-LIMIT INTERVAL-TYPE="CLOSED">0</LOWER-LIMIT>
                    <UPPER-LIMIT INTERVAL-TYPE="CLOSED">0</UPPER-LIMIT>
                    <COMPU-CONST>
                      <VT>Function17_off</VT>
                    </COMPU-CONST>
                  </COMPU-SCALE>
                  <COMPU-SCALE>
                    <SHORT-LABEL>Function14_on</SHORT-LABEL>
                    <SYMBOL>bf32_out_Function14_on</SYMBOL>
                    <MASK>131072</MASK>
                    <LOWER-LIMIT INTERVAL-TYPE="CLOSED">131072</LOWER-LIMIT>
                    <UPPER-LIMIT INTERVAL-TYPE="CLOSED">131072</UPPER-LIMIT>
                    <COMPU-CONST>
                      <VT>Function14_on</VT>
                    </COMPU-CONST>
                  </COMPU-SCALE>
                  <COMPU-SCALE>
                    <SHORT-LABEL>Function14_off</SHORT-LABEL>
                    <SYMBOL>bf32_out_Function14_off</SYMBOL>
                    <MASK>131072</MASK>
                    <LOWER-LIMIT INTERVAL-TYPE="CLOSED">0</LOWER-LIMIT>
                    <UPPER-LIMIT INTERVAL-TYPE="CLOSED">0</UPPER-LIMIT>
                    <COMPU-CONST>
                      <VT>Function14_off</VT>
                    </COMPU-CONST>
                  </COMPU-SCALE>
                  <COMPU-SCALE>
                    <SHORT-LABEL>Function2_off</SHORT-LABEL>
                    <SYMBOL>bf32_out_Function2_off</SYMBOL>
                    <MASK>536870912</MASK>
                    <LOWER-LIMIT INTERVAL-TYPE="CLOSED">0</LOWER-LIMIT>
                    <UPPER-LIMIT INTERVAL-TYPE="CLOSED">0</UPPER-LIMIT>
                    <COMPU-CONST>
                      <VT>Function2_off</VT>
                    </COMPU-CONST>
                  </COMPU-SCALE>
                  <COMPU-SCALE>
                    <SHORT-LABEL>Function2_on</SHORT-LABEL>
                    <SYMBOL>bf32_out_Function2_on</SYMBOL>
                    <MASK>536870912</MASK>
                    <LOWER-LIMIT INTERVAL-TYPE="CLOSED">536870912</LOWER-LIMIT>
                    <UPPER-LIMIT INTERVAL-TYPE="CLOSED">536870912</UPPER-LIMIT>
                    <COMPU-CONST>
                      <VT>Function2_on</VT>
                    </COMPU-CONST>
                  </COMPU-SCALE>
                </COMPU-SCALES>
              </COMPU-INTERNAL-TO-PHYS>
            </COMPU-METHOD>
            <COMPU-METHOD>
              <SHORT-NAME>ETS_Bitfield_uint8</SHORT-NAME>
              <CATEGORY>BITFIELD_TEXTTABLE</CATEGORY>
              <UNIT-REF DEST="UNIT">/ETS/Units/ETS_NoUnit</UNIT-REF>
              <COMPU-INTERNAL-TO-PHYS>
                <COMPU-SCALES>
                  <COMPU-SCALE>
                    <SHORT-LABEL>Function1_on</SHORT-LABEL>
                    <SYMBOL>bf8_in_Function1_on</SYMBOL>
                    <MASK>2</MASK>
                    <LOWER-LIMIT INTERVAL-TYPE="CLOSED">2</LOWER-LIMIT>
                    <UPPER-LIMIT INTERVAL-TYPE="CLOSED">2</UPPER-LIMIT>
                    <COMPU-CONST>
                      <VT>Function1_on</VT>
                    </COMPU-CONST>
                  </COMPU-SCALE>
                  <COMPU-SCALE>
                    <SHORT-LABEL>Function1_off</SHORT-LABEL>
                    <SYMBOL>bf8_in_Function1_off</SYMBOL>
                    <MASK>2</MASK>
                    <LOWER-LIMIT INTERVAL-TYPE="CLOSED">0</LOWER-LIMIT>
                    <UPPER-LIMIT INTERVAL-TYPE="CLOSED">0</UPPER-LIMIT>
                    <COMPU-CONST>
                      <VT>Function1_off</VT>
                    </COMPU-CONST>
                  </COMPU-SCALE>
                  <COMPU-SCALE>
                    <SHORT-LABEL>Function2_on</SHORT-LABEL>
                    <SYMBOL>bf8_in_Function2_on</SYMBOL>
                    <MASK>4</MASK>
                    <LOWER-LIMIT INTERVAL-TYPE="CLOSED">4</LOWER-LIMIT>
                    <UPPER-LIMIT INTERVAL-TYPE="CLOSED">4</UPPER-LIMIT>
                    <COMPU-CONST>
                      <VT>Function2_on</VT>
                    </COMPU-CONST>
                  </COMPU-SCALE>
                  <COMPU-SCALE>
                    <SHORT-LABEL>Function2_off</SHORT-LABEL>
                    <SYMBOL>bf8_in_Function2_off</SYMBOL>
                    <MASK>4</MASK>
                    <LOWER-LIMIT INTERVAL-TYPE="CLOSED">0</LOWER-LIMIT>
                    <UPPER-LIMIT INTERVAL-TYPE="CLOSED">0</UPPER-LIMIT>
                    <COMPU-CONST>
                      <VT>Function2_off</VT>
                    </COMPU-CONST>
                  </COMPU-SCALE>
                  <COMPU-SCALE>
                    <SHORT-LABEL>Function6_on</SHORT-LABEL>
                    <SYMBOL>bf8_in_Function6_on</SYMBOL>
                    <MASK>64</MASK>
                    <LOWER-LIMIT INTERVAL-TYPE="CLOSED">64</LOWER-LIMIT>
                    <UPPER-LIMIT INTERVAL-TYPE="CLOSED">64</UPPER-LIMIT>
                    <COMPU-CONST>
                      <VT>Function6_on</VT>
                    </COMPU-CONST>
                  </COMPU-SCALE>
                  <COMPU-SCALE>
                    <SHORT-LABEL>Function6_off</SHORT-LABEL>
                    <SYMBOL>bf8_in_Function6_off</SYMBOL>
                    <MASK>64</MASK>
                    <LOWER-LIMIT INTERVAL-TYPE="CLOSED">0</LOWER-LIMIT>
                    <UPPER-LIMIT INTERVAL-TYPE="CLOSED">0</UPPER-LIMIT>
                    <COMPU-CONST>
                      <VT>Function6_off</VT>
                    </COMPU-CONST>
                  </COMPU-SCALE>
                  <COMPU-SCALE>
                    <SHORT-LABEL>Function4_on</SHORT-LABEL>
                    <SYMBOL>bf8_in_Function4_on</SYMBOL>
                    <MASK>16</MASK>
                    <LOWER-LIMIT INTERVAL-TYPE="CLOSED">16</LOWER-LIMIT>
                    <UPPER-LIMIT INTERVAL-TYPE="CLOSED">16</UPPER-LIMIT>
                    <COMPU-CONST>
                      <VT>Function4_on</VT>
                    </COMPU-CONST>
                  </COMPU-SCALE>
                  <COMPU-SCALE>
                    <SHORT-LABEL>Function4_off</SHORT-LABEL>
                    <SYMBOL>bf8_in_Function4_off</SYMBOL>
                    <MASK>16</MASK>
                    <LOWER-LIMIT INTERVAL-TYPE="CLOSED">0</LOWER-LIMIT>
                    <UPPER-LIMIT INTERVAL-TYPE="CLOSED">0</UPPER-LIMIT>
                    <COMPU-CONST>
                      <VT>Function4_off</VT>
                    </COMPU-CONST>
                  </COMPU-SCALE>
                  <COMPU-SCALE>
                    <SHORT-LABEL>Function0_on</SHORT-LABEL>
                    <SYMBOL>bf8_in_Function0_on</SYMBOL>
                    <MASK>1</MASK>
                    <LOWER-LIMIT INTERVAL-TYPE="CLOSED">1</LOWER-LIMIT>
                    <UPPER-LIMIT INTERVAL-TYPE="CLOSED">1</UPPER-LIMIT>
                    <COMPU-CONST>
                      <VT>Function0_on</VT>
                    </COMPU-CONST>
                  </COMPU-SCALE>
                  <COMPU-SCALE>
                    <SHORT-LABEL>Function0_off</SHORT-LABEL>
                    <SYMBOL>bf8_in_Function0_off</SYMBOL>
                    <MASK>1</MASK>
                    <LOWER-LIMIT INTERVAL-TYPE="CLOSED">0</LOWER-LIMIT>
                    <UPPER-LIMIT INTERVAL-TYPE="CLOSED">0</UPPER-LIMIT>
                    <COMPU-CONST>
                      <VT>Function0_off</VT>
                    </COMPU-CONST>
                  </COMPU-SCALE>
                  <COMPU-SCALE>
                    <SHORT-LABEL>Function7_on</SHORT-LABEL>
                    <SYMBOL>bf8_in_Function7_on</SYMBOL>
                    <MASK>128</MASK>
                    <LOWER-LIMIT INTERVAL-TYPE="CLOSED">128</LOWER-LIMIT>
                    <UPPER-LIMIT INTERVAL-TYPE="CLOSED">128</UPPER-LIMIT>
                    <COMPU-CONST>
                      <VT>Function7_on</VT>
                    </COMPU-CONST>
                  </COMPU-SCALE>
                  <COMPU-SCALE>
                    <SHORT-LABEL>Function7_off</SHORT-LABEL>
                    <SYMBOL>bf8_in_Function7_off</SYMBOL>
                    <MASK>128</MASK>
                    <LOWER-LIMIT INTERVAL-TYPE="CLOSED">0</LOWER-LIMIT>
                    <UPPER-LIMIT INTERVAL-TYPE="CLOSED">0</UPPER-LIMIT>
                    <COMPU-CONST>
                      <VT>Function7_off</VT>
                    </COMPU-CONST>
                  </COMPU-SCALE>
                  <COMPU-SCALE>
                    <SHORT-LABEL>Function3_on</SHORT-LABEL>
                    <SYMBOL>bf8_in_Function3_on</SYMBOL>
                    <MASK>8</MASK>
                    <LOWER-LIMIT INTERVAL-TYPE="CLOSED">8</LOWER-LIMIT>
                    <UPPER-LIMIT INTERVAL-TYPE="CLOSED">8</UPPER-LIMIT>
                    <COMPU-CONST>
                      <VT>Function3_on</VT>
                    </COMPU-CONST>
                  </COMPU-SCALE>
                  <COMPU-SCALE>
                    <SHORT-LABEL>Function3_off</SHORT-LABEL>
                    <SYMBOL>bf8_in_Function3_off</SYMBOL>
                    <MASK>8</MASK>
                    <LOWER-LIMIT INTERVAL-TYPE="CLOSED">0</LOWER-LIMIT>
                    <UPPER-LIMIT INTERVAL-TYPE="CLOSED">0</UPPER-LIMIT>
                    <COMPU-CONST>
                      <VT>Function3_off</VT>
                    </COMPU-CONST>
                  </COMPU-SCALE>
                  <COMPU-SCALE>
                    <SHORT-LABEL>Function5_off</SHORT-LABEL>
                    <SYMBOL>bf8_in_Function5_off</SYMBOL>
                    <MASK>32</MASK>
                    <LOWER-LIMIT INTERVAL-TYPE="CLOSED">0</LOWER-LIMIT>
                    <UPPER-LIMIT INTERVAL-TYPE="CLOSED">0</UPPER-LIMIT>
                    <COMPU-CONST>
                      <VT>Function5_off</VT>
                    </COMPU-CONST>
                  </COMPU-SCALE>
                  <COMPU-SCALE>
                    <SHORT-LABEL>Function5_on</SHORT-LABEL>
                    <SYMBOL>bf8_in_Function5_on</SYMBOL>
                    <MASK>32</MASK>
                    <LOWER-LIMIT INTERVAL-TYPE="CLOSED">32</LOWER-LIMIT>
                    <UPPER-LIMIT INTERVAL-TYPE="CLOSED">32</UPPER-LIMIT>
                    <COMPU-CONST>
                      <VT>Function5_on</VT>
                    </COMPU-CONST>
                  </COMPU-SCALE>
                </COMPU-SCALES>
              </COMPU-INTERNAL-TO-PHYS>
            </COMPU-METHOD>
            <COMPU-METHOD>
              <SHORT-NAME>ETS_Bitfield_uint8_return</SHORT-NAME>
              <CATEGORY>BITFIELD_TEXTTABLE</CATEGORY>
              <UNIT-REF DEST="UNIT">/ETS/Units/ETS_NoUnit</UNIT-REF>
              <COMPU-INTERNAL-TO-PHYS>
                <COMPU-SCALES>
                  <COMPU-SCALE>
                    <SHORT-LABEL>Function3_off</SHORT-LABEL>
                    <SYMBOL>bf8_out_Function3_off</SYMBOL>
                    <MASK>16</MASK>
                    <LOWER-LIMIT INTERVAL-TYPE="CLOSED">0</LOWER-LIMIT>
                    <UPPER-LIMIT INTERVAL-TYPE="CLOSED">0</UPPER-LIMIT>
                    <COMPU-CONST>
                      <VT>Function3_off</VT>
                    </COMPU-CONST>
                  </COMPU-SCALE>
                  <COMPU-SCALE>
                    <SHORT-LABEL>Function3_on</SHORT-LABEL>
                    <SYMBOL>bf8_out_Function3_on</SYMBOL>
                    <MASK>16</MASK>
                    <LOWER-LIMIT INTERVAL-TYPE="CLOSED">16</LOWER-LIMIT>
                    <UPPER-LIMIT INTERVAL-TYPE="CLOSED">16</UPPER-LIMIT>
                    <COMPU-CONST>
                      <VT>Function3_on</VT>
                    </COMPU-CONST>
                  </COMPU-SCALE>
                  <COMPU-SCALE>
                    <SHORT-LABEL>Function0_on</SHORT-LABEL>
                    <SYMBOL>bf8_out_Function0_on</SYMBOL>
                    <MASK>128</MASK>
                    <LOWER-LIMIT INTERVAL-TYPE="CLOSED">128</LOWER-LIMIT>
                    <UPPER-LIMIT INTERVAL-TYPE="CLOSED">128</UPPER-LIMIT>
                    <COMPU-CONST>
                      <VT>Function0_on</VT>
                    </COMPU-CONST>
                  </COMPU-SCALE>
                  <COMPU-SCALE>
                    <SHORT-LABEL>Function0_off</SHORT-LABEL>
                    <SYMBOL>bf8_out_Function0_off</SYMBOL>
                    <MASK>128</MASK>
                    <LOWER-LIMIT INTERVAL-TYPE="CLOSED">0</LOWER-LIMIT>
                    <UPPER-LIMIT INTERVAL-TYPE="CLOSED">0</UPPER-LIMIT>
                    <COMPU-CONST>
                      <VT>Function0_off</VT>
                    </COMPU-CONST>
                  </COMPU-SCALE>
                  <COMPU-SCALE>
                    <SHORT-LABEL>Function1_off</SHORT-LABEL>
                    <SYMBOL>bf8_out_Function1_off</SYMBOL>
                    <MASK>64</MASK>
                    <LOWER-LIMIT INTERVAL-TYPE="CLOSED">0</LOWER-LIMIT>
                    <UPPER-LIMIT INTERVAL-TYPE="CLOSED">0</UPPER-LIMIT>
                    <COMPU-CONST>
                      <VT>Function1_off</VT>
                    </COMPU-CONST>
                  </COMPU-SCALE>
                  <COMPU-SCALE>
                    <SHORT-LABEL>Function1_on</SHORT-LABEL>
                    <SYMBOL>bf8_out_Function1_on</SYMBOL>
                    <MASK>64</MASK>
                    <LOWER-LIMIT INTERVAL-TYPE="CLOSED">64</LOWER-LIMIT>
                    <UPPER-LIMIT INTERVAL-TYPE="CLOSED">64</UPPER-LIMIT>
                    <COMPU-CONST>
                      <VT>Function1_on</VT>
                    </COMPU-CONST>
                  </COMPU-SCALE>
                  <COMPU-SCALE>
                    <SHORT-LABEL>Function4_on</SHORT-LABEL>
                    <SYMBOL>bf8_out_Function4_on</SYMBOL>
                    <MASK>8</MASK>
                    <LOWER-LIMIT INTERVAL-TYPE="CLOSED">8</LOWER-LIMIT>
                    <UPPER-LIMIT INTERVAL-TYPE="CLOSED">8</UPPER-LIMIT>
                    <COMPU-CONST>
                      <VT>Function4_on</VT>
                    </COMPU-CONST>
                  </COMPU-SCALE>
                  <COMPU-SCALE>
                    <SHORT-LABEL>Function4_off</SHORT-LABEL>
                    <SYMBOL>bf8_out_Function4_off</SYMBOL>
                    <MASK>8</MASK>
                    <LOWER-LIMIT INTERVAL-TYPE="CLOSED">0</LOWER-LIMIT>
                    <UPPER-LIMIT INTERVAL-TYPE="CLOSED">0</UPPER-LIMIT>
                    <COMPU-CONST>
                      <VT>Function4_off</VT>
                    </COMPU-CONST>
                  </COMPU-SCALE>
                  <COMPU-SCALE>
                    <SHORT-LABEL>Function6_off</SHORT-LABEL>
                    <SYMBOL>bf8_out_Function6_off</SYMBOL>
                    <MASK>2</MASK>
                    <LOWER-LIMIT INTERVAL-TYPE="CLOSED">0</LOWER-LIMIT>
                    <UPPER-LIMIT INTERVAL-TYPE="CLOSED">0</UPPER-LIMIT>
                    <COMPU-CONST>
                      <VT>Function6_off</VT>
                    </COMPU-CONST>
                  </COMPU-SCALE>
                  <COMPU-SCALE>
                    <SHORT-LABEL>Function6_on</SHORT-LABEL>
                    <SYMBOL>bf8_out_Function6_on</SYMBOL>
                    <MASK>2</MASK>
                    <LOWER-LIMIT INTERVAL-TYPE="CLOSED">2</LOWER-LIMIT>
                    <UPPER-LIMIT INTERVAL-TYPE="CLOSED">2</UPPER-LIMIT>
                    <COMPU-CONST>
                      <VT>Function6_on</VT>
                    </COMPU-CONST>
                  </COMPU-SCALE>
                  <COMPU-SCALE>
                    <SHORT-LABEL>Function5_on</SHORT-LABEL>
                    <SYMBOL>bf8_out_Function5_on</SYMBOL>
                    <MASK>4</MASK>
                    <LOWER-LIMIT INTERVAL-TYPE="CLOSED">4</LOWER-LIMIT>
                    <UPPER-LIMIT INTERVAL-TYPE="CLOSED">4</UPPER-LIMIT>
                    <COMPU-CONST>
                      <VT>Function5_on</VT>
                    </COMPU-CONST>
                  </COMPU-SCALE>
                  <COMPU-SCALE>
                    <SHORT-LABEL>Function5_off</SHORT-LABEL>
                    <SYMBOL>bf8_out_Function5_off</SYMBOL>
                    <MASK>4</MASK>
                    <LOWER-LIMIT INTERVAL-TYPE="CLOSED">0</LOWER-LIMIT>
                    <UPPER-LIMIT INTERVAL-TYPE="CLOSED">0</UPPER-LIMIT>
                    <COMPU-CONST>
                      <VT>Function5_off</VT>
                    </COMPU-CONST>
                  </COMPU-SCALE>
                  <COMPU-SCALE>
                    <SHORT-LABEL>Function7_off</SHORT-LABEL>
                    <SYMBOL>bf8_out_Function7_off</SYMBOL>
                    <MASK>1</MASK>
                    <LOWER-LIMIT INTERVAL-TYPE="CLOSED">0</LOWER-LIMIT>
                    <UPPER-LIMIT INTERVAL-TYPE="CLOSED">0</UPPER-LIMIT>
                    <COMPU-CONST>
                      <VT>Function7_off</VT>
                    </COMPU-CONST>
                  </COMPU-SCALE>
                  <COMPU-SCALE>
                    <SHORT-LABEL>Function7_on</SHORT-LABEL>
                    <SYMBOL>bf8_out_Function7_on</SYMBOL>
                    <MASK>1</MASK>
                    <LOWER-LIMIT INTERVAL-TYPE="CLOSED">1</LOWER-LIMIT>
                    <UPPER-LIMIT INTERVAL-TYPE="CLOSED">1</UPPER-LIMIT>
                    <COMPU-CONST>
                      <VT>Function7_on</VT>
                    </COMPU-CONST>
                  </COMPU-SCALE>
                  <COMPU-SCALE>
                    <SHORT-LABEL>Function2_off</SHORT-LABEL>
                    <SYMBOL>bf8_out_Function2_off</SYMBOL>
                    <MASK>32</MASK>
                    <LOWER-LIMIT INTERVAL-TYPE="CLOSED">0</LOWER-LIMIT>
                    <UPPER-LIMIT INTERVAL-TYPE="CLOSED">0</UPPER-LIMIT>
                    <COMPU-CONST>
                      <VT>Function2_off</VT>
                    </COMPU-CONST>
                  </COMPU-SCALE>
                  <COMPU-SCALE>
                    <SHORT-LABEL>Function2_on</SHORT-LABEL>
                    <SYMBOL>bf8_out_Function2_on</SYMBOL>
                    <MASK>32</MASK>
                    <LOWER-LIMIT INTERVAL-TYPE="CLOSED">32</LOWER-LIMIT>
                    <UPPER-LIMIT INTERVAL-TYPE="CLOSED">32</UPPER-LIMIT>
                    <COMPU-CONST>
                      <VT>Function2_on</VT>
                    </COMPU-CONST>
                  </COMPU-SCALE>
                </COMPU-SCALES>
              </COMPU-INTERNAL-TO-PHYS>
            </COMPU-METHOD>
            <COMPU-METHOD>
              <SHORT-NAME>Coding_Version_Major</SHORT-NAME>
              <CATEGORY>IDENTICAL</CATEGORY>
            </COMPU-METHOD>
            <COMPU-METHOD>
              <SHORT-NAME>Coding_Version_Minor</SHORT-NAME>
              <CATEGORY>IDENTICAL</CATEGORY>
            </COMPU-METHOD>
          </ELEMENTS>
        </AR-PACKAGE>
        <AR-PACKAGE>
          <SHORT-NAME>DataConstraints</SHORT-NAME>
          <ELEMENTS>
            <DATA-CONSTR>
              <SHORT-NAME>ETS_UINT8</SHORT-NAME>
              <DATA-CONSTR-RULES>
                <DATA-CONSTR-RULE>
                  <PHYS-CONSTRS>
                    <LOWER-LIMIT INTERVAL-TYPE="CLOSED">0</LOWER-LIMIT>
                    <UPPER-LIMIT INTERVAL-TYPE="CLOSED">255</UPPER-LIMIT>
                    <UNIT-REF DEST="UNIT">/ETS/Units/ETS_NoUnit</UNIT-REF>
                  </PHYS-CONSTRS>
                </DATA-CONSTR-RULE>
              </DATA-CONSTR-RULES>
            </DATA-CONSTR>
            <DATA-CONSTR>
              <SHORT-NAME>ETS_UINT16</SHORT-NAME>
              <DATA-CONSTR-RULES>
                <DATA-CONSTR-RULE>
                  <PHYS-CONSTRS>
                    <LOWER-LIMIT INTERVAL-TYPE="CLOSED">0</LOWER-LIMIT>
                    <UPPER-LIMIT INTERVAL-TYPE="CLOSED">65535</UPPER-LIMIT>
                    <UNIT-REF DEST="UNIT">/ETS/Units/ETS_NoUnit</UNIT-REF>
                  </PHYS-CONSTRS>
                </DATA-CONSTR-RULE>
              </DATA-CONSTR-RULES>
            </DATA-CONSTR>
            <DATA-CONSTR>
              <SHORT-NAME>ETS_FLOAT32</SHORT-NAME>
              <DATA-CONSTR-RULES>
                <DATA-CONSTR-RULE>
                  <PHYS-CONSTRS>
                    <LOWER-LIMIT INTERVAL-TYPE="INFINITE"></LOWER-LIMIT>
                    <UPPER-LIMIT INTERVAL-TYPE="INFINITE"></UPPER-LIMIT>
                    <UNIT-REF DEST="UNIT">/ETS/Units/ETS_NoUnit</UNIT-REF>
                  </PHYS-CONSTRS>
                </DATA-CONSTR-RULE>
              </DATA-CONSTR-RULES>
            </DATA-CONSTR>
            <DATA-CONSTR>
              <SHORT-NAME>Coding_Version_Major</SHORT-NAME>
              <DATA-CONSTR-RULES>
                <DATA-CONSTR-RULE>
                  <PHYS-CONSTRS>
                    <LOWER-LIMIT INTERVAL-TYPE="CLOSED">1</LOWER-LIMIT>
                    <UPPER-LIMIT INTERVAL-TYPE="CLOSED">255</UPPER-LIMIT>
                    <UNIT-REF DEST="UNIT">/ETS/Units/ETS_NoUnit</UNIT-REF>
                  </PHYS-CONSTRS>
                </DATA-CONSTR-RULE>
              </DATA-CONSTR-RULES>
            </DATA-CONSTR>
            <DATA-CONSTR>
              <SHORT-NAME>Coding_Version_Minor</SHORT-NAME>
              <DATA-CONSTR-RULES>
                <DATA-CONSTR-RULE>
                  <PHYS-CONSTRS>
                    <LOWER-LIMIT INTERVAL-TYPE="CLOSED">0</LOWER-LIMIT>
                    <UPPER-LIMIT INTERVAL-TYPE="CLOSED">4294967295</UPPER-LIMIT>
                    <UNIT-REF DEST="UNIT">/ETS/Units/ETS_NoUnit</UNIT-REF>
                  </PHYS-CONSTRS>
                </DATA-CONSTR-RULE>
              </DATA-CONSTR-RULES>
            </DATA-CONSTR>
          </ELEMENTS>
        </AR-PACKAGE>
        <AR-PACKAGE>
          <SHORT-NAME>DataTypeMappingSets</SHORT-NAME>
          <ELEMENTS>
            <DATA-TYPE-MAPPING-SET>
              <SHORT-NAME>ETS_ModeMappings</SHORT-NAME>
              <MODE-REQUEST-TYPE-MAPS>
                <MODE-REQUEST-TYPE-MAP>
                  <IMPLEMENTATION-DATA-TYPE-REF DEST="IMPLEMENTATION-DATA-TYPE">/ETS/ImplementationDataTypes/ETS_SD_ConsumeEventGroupModeType</IMPLEMENTATION-DATA-TYPE-REF>
                  <MODE-GROUP-REF DEST="MODE-DECLARATION-GROUP">/ETS/ModeDeclarationGroups/ETS_SD_ConsumeEventGroupMode</MODE-GROUP-REF>
                </MODE-REQUEST-TYPE-MAP>
                <MODE-REQUEST-TYPE-MAP>
                  <IMPLEMENTATION-DATA-TYPE-REF DEST="IMPLEMENTATION-DATA-TYPE">/AUTOSAR_Platform/ImplementationDataTypes/uint8</IMPLEMENTATION-DATA-TYPE-REF>
                  <MODE-GROUP-REF DEST="MODE-DECLARATION-GROUP">/ETS/ModeDeclarationGroups/ETS_CurrentMode</MODE-GROUP-REF>
                </MODE-REQUEST-TYPE-MAP>
                <MODE-REQUEST-TYPE-MAP>
                  <IMPLEMENTATION-DATA-TYPE-REF DEST="IMPLEMENTATION-DATA-TYPE">/ETS/ImplementationDataTypes/ETS_SD_ClientServiceModeType</IMPLEMENTATION-DATA-TYPE-REF>
                  <MODE-GROUP-REF DEST="MODE-DECLARATION-GROUP">/ETS/ModeDeclarationGroups/ETS_SD_ClientServiceMode</MODE-GROUP-REF>
                </MODE-REQUEST-TYPE-MAP>
                <MODE-REQUEST-TYPE-MAP>
                  <IMPLEMENTATION-DATA-TYPE-REF DEST="IMPLEMENTATION-DATA-TYPE">/ETS/ImplementationDataTypes/ETS_SD_ServerServiceModeType</IMPLEMENTATION-DATA-TYPE-REF>
                  <MODE-GROUP-REF DEST="MODE-DECLARATION-GROUP">/ETS/ModeDeclarationGroups/ETS_SD_ServerServiceMode</MODE-GROUP-REF>
                </MODE-REQUEST-TYPE-MAP>
              </MODE-REQUEST-TYPE-MAPS>
            </DATA-TYPE-MAPPING-SET>
            <DATA-TYPE-MAPPING-SET>
              <SHORT-NAME>ETS_Types</SHORT-NAME>
              <DATA-TYPE-MAPS>
                <DATA-TYPE-MAP>
                  <APPLICATION-DATA-TYPE-REF DEST="APPLICATION-PRIMITIVE-DATA-TYPE">/ETS/ApplicationDataTypes/ETS_ENUM</APPLICATION-DATA-TYPE-REF>
                  <IMPLEMENTATION-DATA-TYPE-REF DEST="IMPLEMENTATION-DATA-TYPE">/AUTOSAR_Platform/ImplementationDataTypes/uint8</IMPLEMENTATION-DATA-TYPE-REF>
                </DATA-TYPE-MAP>
                <DATA-TYPE-MAP>
                  <APPLICATION-DATA-TYPE-REF DEST="APPLICATION-RECORD-DATA-TYPE">/ETS/ApplicationDataTypes/ETS_VersionType</APPLICATION-DATA-TYPE-REF>
                  <IMPLEMENTATION-DATA-TYPE-REF DEST="IMPLEMENTATION-DATA-TYPE">/ETS/ImplementationDataTypes/ETS_VersionType</IMPLEMENTATION-DATA-TYPE-REF>
                </DATA-TYPE-MAP>
              </DATA-TYPE-MAPS>
            </DATA-TYPE-MAPPING-SET>
            <DATA-TYPE-MAPPING-SET>
              <SHORT-NAME>ETS_Arrays</SHORT-NAME>
              <DATA-TYPE-MAPS>
                <DATA-TYPE-MAP>
                  <APPLICATION-DATA-TYPE-REF DEST="APPLICATION-ARRAY-DATA-TYPE">/ETS/ApplicationDataTypes/ETS_Uint8Array</APPLICATION-DATA-TYPE-REF>
                  <IMPLEMENTATION-DATA-TYPE-REF DEST="IMPLEMENTATION-DATA-TYPE">/ETS/ImplementationDataTypes/ETS_Uint8Array</IMPLEMENTATION-DATA-TYPE-REF>
                </DATA-TYPE-MAP>
                <DATA-TYPE-MAP>
                  <APPLICATION-DATA-TYPE-REF DEST="APPLICATION-ARRAY-DATA-TYPE">/ETS/ApplicationDataTypes/ETS_UINT8Array16Bitlength</APPLICATION-DATA-TYPE-REF>
                  <IMPLEMENTATION-DATA-TYPE-REF DEST="IMPLEMENTATION-DATA-TYPE">/ETS/ImplementationDataTypes/ETS_UINT8Array16Bitlength</IMPLEMENTATION-DATA-TYPE-REF>
                </DATA-TYPE-MAP>
                <DATA-TYPE-MAP>
                  <APPLICATION-DATA-TYPE-REF DEST="APPLICATION-ARRAY-DATA-TYPE">/ETS/ApplicationDataTypes/ETS_UINT8Array8Bitlength</APPLICATION-DATA-TYPE-REF>
                  <IMPLEMENTATION-DATA-TYPE-REF DEST="IMPLEMENTATION-DATA-TYPE">/ETS/ImplementationDataTypes/ETS_UINT8Array8Bitlength</IMPLEMENTATION-DATA-TYPE-REF>
                </DATA-TYPE-MAP>
                <DATA-TYPE-MAP>
                  <APPLICATION-DATA-TYPE-REF DEST="APPLICATION-ARRAY-DATA-TYPE">/ETS/ApplicationDataTypes/ETS_StaticUint8Array</APPLICATION-DATA-TYPE-REF>
                  <IMPLEMENTATION-DATA-TYPE-REF DEST="IMPLEMENTATION-DATA-TYPE">/ETS/ImplementationDataTypes/ETS_SimpleUint8Array</IMPLEMENTATION-DATA-TYPE-REF>
                </DATA-TYPE-MAP>
                <DATA-TYPE-MAP>
                  <APPLICATION-DATA-TYPE-REF DEST="APPLICATION-ARRAY-DATA-TYPE">/ETS/ApplicationDataTypes/ETS_SimpleStructArray</APPLICATION-DATA-TYPE-REF>
                  <IMPLEMENTATION-DATA-TYPE-REF DEST="IMPLEMENTATION-DATA-TYPE">/ETS/ImplementationDataTypes/ETS_SimpleStructArray</IMPLEMENTATION-DATA-TYPE-REF>
                </DATA-TYPE-MAP>
                <DATA-TYPE-MAP>
                  <APPLICATION-DATA-TYPE-REF DEST="APPLICATION-ARRAY-DATA-TYPE">/ETS/ApplicationDataTypes/ETS_TwoDimUint8Array</APPLICATION-DATA-TYPE-REF>
                  <IMPLEMENTATION-DATA-TYPE-REF DEST="IMPLEMENTATION-DATA-TYPE">/ETS/ImplementationDataTypes/ETS_TwoDimUint8Array</IMPLEMENTATION-DATA-TYPE-REF>
                </DATA-TYPE-MAP>
                <DATA-TYPE-MAP>
                  <APPLICATION-DATA-TYPE-REF DEST="APPLICATION-ARRAY-DATA-TYPE">/ETS/ApplicationDataTypes/ETS_UTF8FixedArray</APPLICATION-DATA-TYPE-REF>
                  <IMPLEMENTATION-DATA-TYPE-REF DEST="IMPLEMENTATION-DATA-TYPE">/ETS/ImplementationDataTypes/ETS_UTF8FixedArray</IMPLEMENTATION-DATA-TYPE-REF>
                </DATA-TYPE-MAP>
                <DATA-TYPE-MAP>
                  <APPLICATION-DATA-TYPE-REF DEST="APPLICATION-ARRAY-DATA-TYPE">/ETS/ApplicationDataTypes/ETS_UTF16FixedArray</APPLICATION-DATA-TYPE-REF>
                  <IMPLEMENTATION-DATA-TYPE-REF DEST="IMPLEMENTATION-DATA-TYPE">/ETS/ImplementationDataTypes/ETS_UTF16FixedArray</IMPLEMENTATION-DATA-TYPE-REF>
                </DATA-TYPE-MAP>
              </DATA-TYPE-MAPS>
            </DATA-TYPE-MAPPING-SET>
            <DATA-TYPE-MAPPING-SET>
              <SHORT-NAME>ETS_Bitfields</SHORT-NAME>
              <DATA-TYPE-MAPS>
                <DATA-TYPE-MAP>
                  <APPLICATION-DATA-TYPE-REF DEST="APPLICATION-PRIMITIVE-DATA-TYPE">/ETS/ApplicationDataTypes/Coding_Version_Minor</APPLICATION-DATA-TYPE-REF>
                  <IMPLEMENTATION-DATA-TYPE-REF DEST="IMPLEMENTATION-DATA-TYPE">/AUTOSAR_Platform/ImplementationDataTypes/uint32</IMPLEMENTATION-DATA-TYPE-REF>
                </DATA-TYPE-MAP>
                <DATA-TYPE-MAP>
                  <APPLICATION-DATA-TYPE-REF DEST="APPLICATION-PRIMITIVE-DATA-TYPE">/ETS/ApplicationDataTypes/Coding_Version_Major</APPLICATION-DATA-TYPE-REF>
                  <IMPLEMENTATION-DATA-TYPE-REF DEST="IMPLEMENTATION-DATA-TYPE">/AUTOSAR_Platform/ImplementationDataTypes/uint8</IMPLEMENTATION-DATA-TYPE-REF>
                </DATA-TYPE-MAP>
                <DATA-TYPE-MAP>
                  <APPLICATION-DATA-TYPE-REF DEST="APPLICATION-PRIMITIVE-DATA-TYPE">/ETS/ApplicationDataTypes/ETS_Bitfield_uint8</APPLICATION-DATA-TYPE-REF>
                  <IMPLEMENTATION-DATA-TYPE-REF DEST="IMPLEMENTATION-DATA-TYPE">/ETS/ImplementationDataTypes/ETS_Bitfield_uint8_tr</IMPLEMENTATION-DATA-TYPE-REF>
                </DATA-TYPE-MAP>
                <DATA-TYPE-MAP>
                  <APPLICATION-DATA-TYPE-REF DEST="APPLICATION-PRIMITIVE-DATA-TYPE">/ETS/ApplicationDataTypes/ETS_Bitfield_uint16</APPLICATION-DATA-TYPE-REF>
                  <IMPLEMENTATION-DATA-TYPE-REF DEST="IMPLEMENTATION-DATA-TYPE">/ETS/ImplementationDataTypes/ETS_Bitfield_uint16_tr</IMPLEMENTATION-DATA-TYPE-REF>
                </DATA-TYPE-MAP>
                <DATA-TYPE-MAP>
                  <APPLICATION-DATA-TYPE-REF DEST="APPLICATION-PRIMITIVE-DATA-TYPE">/ETS/ApplicationDataTypes/ETS_Bitfield_uint32</APPLICATION-DATA-TYPE-REF>
                  <IMPLEMENTATION-DATA-TYPE-REF DEST="IMPLEMENTATION-DATA-TYPE">/ETS/ImplementationDataTypes/ETS_Bitfield_uint32_tr</IMPLEMENTATION-DATA-TYPE-REF>
                </DATA-TYPE-MAP>
                <DATA-TYPE-MAP>
                  <APPLICATION-DATA-TYPE-REF DEST="APPLICATION-PRIMITIVE-DATA-TYPE">/ETS/ApplicationDataTypes/ETS_Bitfield_uint8_return</APPLICATION-DATA-TYPE-REF>
                  <IMPLEMENTATION-DATA-TYPE-REF DEST="IMPLEMENTATION-DATA-TYPE">/ETS/ImplementationDataTypes/ETS_Bitfield_uint8_return_tr</IMPLEMENTATION-DATA-TYPE-REF>
                </DATA-TYPE-MAP>
                <DATA-TYPE-MAP>
                  <APPLICATION-DATA-TYPE-REF DEST="APPLICATION-PRIMITIVE-DATA-TYPE">/ETS/ApplicationDataTypes/ETS_Bitfield_uint16_return</APPLICATION-DATA-TYPE-REF>
                  <IMPLEMENTATION-DATA-TYPE-REF DEST="IMPLEMENTATION-DATA-TYPE">/ETS/ImplementationDataTypes/ETS_Bitfield_uint16_return_tr</IMPLEMENTATION-DATA-TYPE-REF>
                </DATA-TYPE-MAP>
                <DATA-TYPE-MAP>
                  <APPLICATION-DATA-TYPE-REF DEST="APPLICATION-PRIMITIVE-DATA-TYPE">/ETS/ApplicationDataTypes/ETS_Bitfield_uint32_return</APPLICATION-DATA-TYPE-REF>
                  <IMPLEMENTATION-DATA-TYPE-REF DEST="IMPLEMENTATION-DATA-TYPE">/ETS/ImplementationDataTypes/ETS_Bitfield_uint32_return_tr</IMPLEMENTATION-DATA-TYPE-REF>
                </DATA-TYPE-MAP>
              </DATA-TYPE-MAPS>
            </DATA-TYPE-MAPPING-SET>
            <DATA-TYPE-MAPPING-SET>
              <SHORT-NAME>ETS_Timings</SHORT-NAME>
              <DATA-TYPE-MAPS>
                <DATA-TYPE-MAP>
                  <APPLICATION-DATA-TYPE-REF DEST="APPLICATION-RECORD-DATA-TYPE">/ETS/ApplicationDataTypes/ETS_Uint8Value</APPLICATION-DATA-TYPE-REF>
                  <IMPLEMENTATION-DATA-TYPE-REF DEST="IMPLEMENTATION-DATA-TYPE">/ETS/ImplementationDataTypes/ETS_Uint8Value</IMPLEMENTATION-DATA-TYPE-REF>
                </DATA-TYPE-MAP>
                <DATA-TYPE-MAP>
                  <APPLICATION-DATA-TYPE-REF DEST="APPLICATION-RECORD-DATA-TYPE">/ETS/ApplicationDataTypes/ETS_TimePeriod</APPLICATION-DATA-TYPE-REF>
                  <IMPLEMENTATION-DATA-TYPE-REF DEST="IMPLEMENTATION-DATA-TYPE">/ETS/ImplementationDataTypes/ETS_TimePeriod</IMPLEMENTATION-DATA-TYPE-REF>
                </DATA-TYPE-MAP>
              </DATA-TYPE-MAPS>
            </DATA-TYPE-MAPPING-SET>
          </ELEMENTS>
        </AR-PACKAGE>
        <AR-PACKAGE>
          <SHORT-NAME>ImplementationDataTypes</SHORT-NAME>
          <ELEMENTS>
            <IMPLEMENTATION-DATA-TYPE>
              <SHORT-NAME>ETS_SD_ClientServiceModeType</SHORT-NAME>
              <CATEGORY>TYPE_REFERENCE</CATEGORY>
              <SW-DATA-DEF-PROPS>
                <SW-DATA-DEF-PROPS-VARIANTS>
                  <SW-DATA-DEF-PROPS-CONDITIONAL>
                    <COMPU-METHOD-REF DEST="COMPU-METHOD">/ETS/CompuMethods/CM_ETS_SD_ClientServiceModeType</COMPU-METHOD-REF>
                    <IMPLEMENTATION-DATA-TYPE-REF DEST="IMPLEMENTATION-DATA-TYPE">/AUTOSAR_Platform/ImplementationDataTypes/uint8</IMPLEMENTATION-DATA-TYPE-REF>
                  </SW-DATA-DEF-PROPS-CONDITIONAL>
                </SW-DATA-DEF-PROPS-VARIANTS>
              </SW-DATA-DEF-PROPS>
            </IMPLEMENTATION-DATA-TYPE>
            <IMPLEMENTATION-DATA-TYPE>
              <SHORT-NAME>ETS_SD_ConsumeEventGroupModeType</SHORT-NAME>
              <CATEGORY>TYPE_REFERENCE</CATEGORY>
              <SW-DATA-DEF-PROPS>
                <SW-DATA-DEF-PROPS-VARIANTS>
                  <SW-DATA-DEF-PROPS-CONDITIONAL>
                    <COMPU-METHOD-REF DEST="COMPU-METHOD">/ETS/CompuMethods/CM_ETS_SD_ConsumeEventGroupModeType</COMPU-METHOD-REF>
                    <IMPLEMENTATION-DATA-TYPE-REF DEST="IMPLEMENTATION-DATA-TYPE">/AUTOSAR_Platform/ImplementationDataTypes/uint8</IMPLEMENTATION-DATA-TYPE-REF>
                  </SW-DATA-DEF-PROPS-CONDITIONAL>
                </SW-DATA-DEF-PROPS-VARIANTS>
              </SW-DATA-DEF-PROPS>
            </IMPLEMENTATION-DATA-TYPE>
            <IMPLEMENTATION-DATA-TYPE>
              <SHORT-NAME>ETS_SD_ServerServiceModeType</SHORT-NAME>
              <CATEGORY>TYPE_REFERENCE</CATEGORY>
              <SW-DATA-DEF-PROPS>
                <SW-DATA-DEF-PROPS-VARIANTS>
                  <SW-DATA-DEF-PROPS-CONDITIONAL>
                    <COMPU-METHOD-REF DEST="COMPU-METHOD">/ETS/CompuMethods/CM_ETS_SD_ServerServiceModeType</COMPU-METHOD-REF>
                    <IMPLEMENTATION-DATA-TYPE-REF DEST="IMPLEMENTATION-DATA-TYPE">/AUTOSAR_Platform/ImplementationDataTypes/uint8</IMPLEMENTATION-DATA-TYPE-REF>
                  </SW-DATA-DEF-PROPS-CONDITIONAL>
                </SW-DATA-DEF-PROPS-VARIANTS>
              </SW-DATA-DEF-PROPS>
            </IMPLEMENTATION-DATA-TYPE>
            <IMPLEMENTATION-DATA-TYPE>
              <SHORT-NAME>ETS_TriggerEventType</SHORT-NAME>
              <CATEGORY>STRUCTURE</CATEGORY>
              <SW-DATA-DEF-PROPS>
                <SW-DATA-DEF-PROPS-VARIANTS>
                  <SW-DATA-DEF-PROPS-CONDITIONAL></SW-DATA-DEF-PROPS-CONDITIONAL>
                </SW-DATA-DEF-PROPS-VARIANTS>
              </SW-DATA-DEF-PROPS>
              <SUB-ELEMENTS>
                <IMPLEMENTATION-DATA-TYPE-ELEMENT>
                  <SHORT-NAME>start</SHORT-NAME>
                  <CATEGORY>VALUE</CATEGORY>
                  <SW-DATA-DEF-PROPS>
                    <SW-DATA-DEF-PROPS-VARIANTS>
                      <SW-DATA-DEF-PROPS-CONDITIONAL>
                        <BASE-TYPE-REF DEST="SW-BASE-TYPE">/AUTOSAR_Platform/BaseTypes/uint8</BASE-TYPE-REF>
                        <DATA-CONSTR-REF DEST="DATA-CONSTR">/ETS/ImplementationDataTypes/dc_start</DATA-CONSTR-REF>
                      </SW-DATA-DEF-PROPS-CONDITIONAL>
                    </SW-DATA-DEF-PROPS-VARIANTS>
                  </SW-DATA-DEF-PROPS>
                </IMPLEMENTATION-DATA-TYPE-ELEMENT>
                <IMPLEMENTATION-DATA-TYPE-ELEMENT>
                  <SHORT-NAME>duration</SHORT-NAME>
                  <CATEGORY>VALUE</CATEGORY>
                  <SW-DATA-DEF-PROPS>
                    <SW-DATA-DEF-PROPS-VARIANTS>
                      <SW-DATA-DEF-PROPS-CONDITIONAL>
                        <BASE-TYPE-REF DEST="SW-BASE-TYPE">/AUTOSAR_Platform/BaseTypes/uint8</BASE-TYPE-REF>
                        <DATA-CONSTR-REF DEST="DATA-CONSTR">/ETS/ImplementationDataTypes/dc_duration</DATA-CONSTR-REF>
                      </SW-DATA-DEF-PROPS-CONDITIONAL>
                    </SW-DATA-DEF-PROPS-VARIANTS>
                  </SW-DATA-DEF-PROPS>
                </IMPLEMENTATION-DATA-TYPE-ELEMENT>
                <IMPLEMENTATION-DATA-TYPE-ELEMENT>
                  <SHORT-NAME>debounceTime</SHORT-NAME>
                  <CATEGORY>VALUE</CATEGORY>
                  <SW-DATA-DEF-PROPS>
                    <SW-DATA-DEF-PROPS-VARIANTS>
                      <SW-DATA-DEF-PROPS-CONDITIONAL>
                        <BASE-TYPE-REF DEST="SW-BASE-TYPE">/AUTOSAR_Platform/BaseTypes/uint8</BASE-TYPE-REF>
                        <DATA-CONSTR-REF DEST="DATA-CONSTR">/ETS/ImplementationDataTypes/dc_debounceTime</DATA-CONSTR-REF>
                      </SW-DATA-DEF-PROPS-CONDITIONAL>
                    </SW-DATA-DEF-PROPS-VARIANTS>
                  </SW-DATA-DEF-PROPS>
                </IMPLEMENTATION-DATA-TYPE-ELEMENT>
              </SUB-ELEMENTS>
            </IMPLEMENTATION-DATA-TYPE>
            <IMPLEMENTATION-DATA-TYPE>
              <SHORT-NAME>ETS_UINT8Array16Bitlength</SHORT-NAME>
              <CATEGORY>STRUCTURE</CATEGORY>
              <DYNAMIC-ARRAY-SIZE-PROFILE>VSA_LINEAR</DYNAMIC-ARRAY-SIZE-PROFILE>
              <SUB-ELEMENTS>
                <IMPLEMENTATION-DATA-TYPE-ELEMENT>
                  <SHORT-NAME>size</SHORT-NAME>
                  <CATEGORY>TYPE_REFERENCE</CATEGORY>
                  <SW-DATA-DEF-PROPS>
                    <SW-DATA-DEF-PROPS-VARIANTS>
                      <SW-DATA-DEF-PROPS-CONDITIONAL>
                        <IMPLEMENTATION-DATA-TYPE-REF DEST="IMPLEMENTATION-DATA-TYPE">/AUTOSAR_Platform/ImplementationDataTypes/uint16</IMPLEMENTATION-DATA-TYPE-REF>
                      </SW-DATA-DEF-PROPS-CONDITIONAL>
                    </SW-DATA-DEF-PROPS-VARIANTS>
                  </SW-DATA-DEF-PROPS>
                </IMPLEMENTATION-DATA-TYPE-ELEMENT>
                <IMPLEMENTATION-DATA-TYPE-ELEMENT>
                  <SHORT-NAME>elem</SHORT-NAME>
                  <CATEGORY>ARRAY</CATEGORY>
                  <SUB-ELEMENTS>
                    <IMPLEMENTATION-DATA-TYPE-ELEMENT>
                      <SHORT-NAME>Element</SHORT-NAME>
                      <CATEGORY>TYPE_REFERENCE</CATEGORY>
                      <ARRAY-SIZE>5</ARRAY-SIZE>
                      <ARRAY-SIZE-HANDLING>ALL-INDICES-SAME-ARRAY-SIZE</ARRAY-SIZE-HANDLING>
                      <ARRAY-SIZE-SEMANTICS>VARIABLE-SIZE</ARRAY-SIZE-SEMANTICS>
                      <SW-DATA-DEF-PROPS>
                        <SW-DATA-DEF-PROPS-VARIANTS>
                          <SW-DATA-DEF-PROPS-CONDITIONAL>
                            <IMPLEMENTATION-DATA-TYPE-REF DEST="IMPLEMENTATION-DATA-TYPE">/AUTOSAR_Platform/ImplementationDataTypes/uint8</IMPLEMENTATION-DATA-TYPE-REF>
                          </SW-DATA-DEF-PROPS-CONDITIONAL>
                        </SW-DATA-DEF-PROPS-VARIANTS>
                      </SW-DATA-DEF-PROPS>
                    </IMPLEMENTATION-DATA-TYPE-ELEMENT>
                  </SUB-ELEMENTS>
                </IMPLEMENTATION-DATA-TYPE-ELEMENT>
              </SUB-ELEMENTS>
            </IMPLEMENTATION-DATA-TYPE>
            <IMPLEMENTATION-DATA-TYPE>
              <SHORT-NAME>ETS_UINT8Array8Bitlength</SHORT-NAME>
              <CATEGORY>STRUCTURE</CATEGORY>
              <DYNAMIC-ARRAY-SIZE-PROFILE>VSA_LINEAR</DYNAMIC-ARRAY-SIZE-PROFILE>
              <SUB-ELEMENTS>
                <IMPLEMENTATION-DATA-TYPE-ELEMENT>
                  <SHORT-NAME>size</SHORT-NAME>
                  <CATEGORY>TYPE_REFERENCE</CATEGORY>
                  <SW-DATA-DEF-PROPS>
                    <SW-DATA-DEF-PROPS-VARIANTS>
                      <SW-DATA-DEF-PROPS-CONDITIONAL>
                        <IMPLEMENTATION-DATA-TYPE-REF DEST="IMPLEMENTATION-DATA-TYPE">/AUTOSAR_Platform/ImplementationDataTypes/uint8</IMPLEMENTATION-DATA-TYPE-REF>
                      </SW-DATA-DEF-PROPS-CONDITIONAL>
                    </SW-DATA-DEF-PROPS-VARIANTS>
                  </SW-DATA-DEF-PROPS>
                </IMPLEMENTATION-DATA-TYPE-ELEMENT>
                <IMPLEMENTATION-DATA-TYPE-ELEMENT>
                  <SHORT-NAME>elem</SHORT-NAME>
                  <CATEGORY>ARRAY</CATEGORY>
                  <SUB-ELEMENTS>
                    <IMPLEMENTATION-DATA-TYPE-ELEMENT>
                      <SHORT-NAME>Element</SHORT-NAME>
                      <CATEGORY>TYPE_REFERENCE</CATEGORY>
                      <ARRAY-SIZE>5</ARRAY-SIZE>
                      <ARRAY-SIZE-HANDLING>ALL-INDICES-SAME-ARRAY-SIZE</ARRAY-SIZE-HANDLING>
                      <ARRAY-SIZE-SEMANTICS>VARIABLE-SIZE</ARRAY-SIZE-SEMANTICS>
                      <SW-DATA-DEF-PROPS>
                        <SW-DATA-DEF-PROPS-VARIANTS>
                          <SW-DATA-DEF-PROPS-CONDITIONAL>
                            <IMPLEMENTATION-DATA-TYPE-REF DEST="IMPLEMENTATION-DATA-TYPE">/AUTOSAR_Platform/ImplementationDataTypes/uint8</IMPLEMENTATION-DATA-TYPE-REF>
                          </SW-DATA-DEF-PROPS-CONDITIONAL>
                        </SW-DATA-DEF-PROPS-VARIANTS>
                      </SW-DATA-DEF-PROPS>
                    </IMPLEMENTATION-DATA-TYPE-ELEMENT>
                  </SUB-ELEMENTS>
                </IMPLEMENTATION-DATA-TYPE-ELEMENT>
              </SUB-ELEMENTS>
            </IMPLEMENTATION-DATA-TYPE>			
            <IMPLEMENTATION-DATA-TYPE>
              <SHORT-NAME>ETS_Uint8Array</SHORT-NAME>
              <CATEGORY>STRUCTURE</CATEGORY>
              <DYNAMIC-ARRAY-SIZE-PROFILE>VSA_LINEAR</DYNAMIC-ARRAY-SIZE-PROFILE>
              <SUB-ELEMENTS>
                <IMPLEMENTATION-DATA-TYPE-ELEMENT>
                  <SHORT-NAME>size</SHORT-NAME>
                  <CATEGORY>TYPE_REFERENCE</CATEGORY>
                  <SW-DATA-DEF-PROPS>
                    <SW-DATA-DEF-PROPS-VARIANTS>
                      <SW-DATA-DEF-PROPS-CONDITIONAL>
                        <IMPLEMENTATION-DATA-TYPE-REF DEST="IMPLEMENTATION-DATA-TYPE">/AUTOSAR_Platform/ImplementationDataTypes/uint32</IMPLEMENTATION-DATA-TYPE-REF>
                      </SW-DATA-DEF-PROPS-CONDITIONAL>
                    </SW-DATA-DEF-PROPS-VARIANTS>
                  </SW-DATA-DEF-PROPS>
                </IMPLEMENTATION-DATA-TYPE-ELEMENT>
                <IMPLEMENTATION-DATA-TYPE-ELEMENT>
                  <SHORT-NAME>elem</SHORT-NAME>
                  <CATEGORY>ARRAY</CATEGORY>
                  <SUB-ELEMENTS>
                    <IMPLEMENTATION-DATA-TYPE-ELEMENT>
                      <SHORT-NAME>Element</SHORT-NAME>
                      <CATEGORY>TYPE_REFERENCE</CATEGORY>
                      <ARRAY-SIZE>5</ARRAY-SIZE>
                      <ARRAY-SIZE-HANDLING>ALL-INDICES-SAME-ARRAY-SIZE</ARRAY-SIZE-HANDLING>
                      <ARRAY-SIZE-SEMANTICS>VARIABLE-SIZE</ARRAY-SIZE-SEMANTICS>
                      <SW-DATA-DEF-PROPS>
                        <SW-DATA-DEF-PROPS-VARIANTS>
                          <SW-DATA-DEF-PROPS-CONDITIONAL>
                            <IMPLEMENTATION-DATA-TYPE-REF DEST="IMPLEMENTATION-DATA-TYPE">/AUTOSAR_Platform/ImplementationDataTypes/uint8</IMPLEMENTATION-DATA-TYPE-REF>
                          </SW-DATA-DEF-PROPS-CONDITIONAL>
                        </SW-DATA-DEF-PROPS-VARIANTS>
                      </SW-DATA-DEF-PROPS>
                    </IMPLEMENTATION-DATA-TYPE-ELEMENT>
                  </SUB-ELEMENTS>
                </IMPLEMENTATION-DATA-TYPE-ELEMENT>
              </SUB-ELEMENTS>
            </IMPLEMENTATION-DATA-TYPE>
            <IMPLEMENTATION-DATA-TYPE>
              <SHORT-NAME>ETS_SimpleUint8Array</SHORT-NAME>
              <CATEGORY>ARRAY</CATEGORY>
              <SUB-ELEMENTS>
                <IMPLEMENTATION-DATA-TYPE-ELEMENT>
                  <SHORT-NAME>UINT8</SHORT-NAME>
                  <CATEGORY>TYPE_REFERENCE</CATEGORY>
                  <ARRAY-SIZE>5</ARRAY-SIZE>
                  <ARRAY-SIZE-SEMANTICS>FIXED-SIZE</ARRAY-SIZE-SEMANTICS>
                  <SW-DATA-DEF-PROPS>
                    <SW-DATA-DEF-PROPS-VARIANTS>
                      <SW-DATA-DEF-PROPS-CONDITIONAL>
                        <IMPLEMENTATION-DATA-TYPE-REF DEST="IMPLEMENTATION-DATA-TYPE">/AUTOSAR_Platform/ImplementationDataTypes/uint8</IMPLEMENTATION-DATA-TYPE-REF>
                      </SW-DATA-DEF-PROPS-CONDITIONAL>
                    </SW-DATA-DEF-PROPS-VARIANTS>
                  </SW-DATA-DEF-PROPS>
                </IMPLEMENTATION-DATA-TYPE-ELEMENT>
              </SUB-ELEMENTS>
            </IMPLEMENTATION-DATA-TYPE>
            <IMPLEMENTATION-DATA-TYPE>
              <SHORT-NAME>ETS_TwoDimUint8Array</SHORT-NAME>
              <CATEGORY>STRUCTURE</CATEGORY>
              <DYNAMIC-ARRAY-SIZE-PROFILE>VSA_FULLY_FLEXIBLE</DYNAMIC-ARRAY-SIZE-PROFILE>
              <SUB-ELEMENTS>
                <IMPLEMENTATION-DATA-TYPE-ELEMENT>
                  <SHORT-NAME>size</SHORT-NAME>
                  <CATEGORY>TYPE_REFERENCE</CATEGORY>
                  <SW-DATA-DEF-PROPS>
                    <SW-DATA-DEF-PROPS-VARIANTS>
                      <SW-DATA-DEF-PROPS-CONDITIONAL>
                        <IMPLEMENTATION-DATA-TYPE-REF DEST="IMPLEMENTATION-DATA-TYPE">/AUTOSAR_Platform/ImplementationDataTypes/uint8</IMPLEMENTATION-DATA-TYPE-REF>
                      </SW-DATA-DEF-PROPS-CONDITIONAL>
                    </SW-DATA-DEF-PROPS-VARIANTS>
                  </SW-DATA-DEF-PROPS>
                </IMPLEMENTATION-DATA-TYPE-ELEMENT>
                <IMPLEMENTATION-DATA-TYPE-ELEMENT>
                  <SHORT-NAME>payload</SHORT-NAME>
                  <CATEGORY>ARRAY</CATEGORY>
                  <SUB-ELEMENTS>
                    <IMPLEMENTATION-DATA-TYPE-ELEMENT>
                      <SHORT-NAME>echoUINT8Array2Dim_uINT8Array_UINT8_ARRAY_Dim2</SHORT-NAME>
                      <CATEGORY>STRUCTURE</CATEGORY>
                      <ARRAY-SIZE>5</ARRAY-SIZE>
                      <ARRAY-SIZE-HANDLING>ALL-INDICES-DIFFERENT-ARRAY-SIZE</ARRAY-SIZE-HANDLING>
                      <ARRAY-SIZE-SEMANTICS>VARIABLE-SIZE</ARRAY-SIZE-SEMANTICS>
                      <SUB-ELEMENTS>
                        <IMPLEMENTATION-DATA-TYPE-ELEMENT>
                          <SHORT-NAME>size</SHORT-NAME>
                          <CATEGORY>TYPE_REFERENCE</CATEGORY>
                          <SW-DATA-DEF-PROPS>
                            <SW-DATA-DEF-PROPS-VARIANTS>
                              <SW-DATA-DEF-PROPS-CONDITIONAL>
                                <IMPLEMENTATION-DATA-TYPE-REF DEST="IMPLEMENTATION-DATA-TYPE">/AUTOSAR_Platform/ImplementationDataTypes/uint8</IMPLEMENTATION-DATA-TYPE-REF>
                              </SW-DATA-DEF-PROPS-CONDITIONAL>
                            </SW-DATA-DEF-PROPS-VARIANTS>
                          </SW-DATA-DEF-PROPS>
                        </IMPLEMENTATION-DATA-TYPE-ELEMENT>
                        <IMPLEMENTATION-DATA-TYPE-ELEMENT>
                          <SHORT-NAME>elem</SHORT-NAME>
                          <CATEGORY>ARRAY</CATEGORY>
                          <SUB-ELEMENTS>
                            <IMPLEMENTATION-DATA-TYPE-ELEMENT>
                              <SHORT-NAME>UINT8</SHORT-NAME>
                              <CATEGORY>VALUE</CATEGORY>
                              <ARRAY-SIZE>5</ARRAY-SIZE>
                              <ARRAY-SIZE-HANDLING>ALL-INDICES-SAME-ARRAY-SIZE</ARRAY-SIZE-HANDLING>
                              <ARRAY-SIZE-SEMANTICS>VARIABLE-SIZE</ARRAY-SIZE-SEMANTICS>
                              <SW-DATA-DEF-PROPS>
                                <SW-DATA-DEF-PROPS-VARIANTS>
                                  <SW-DATA-DEF-PROPS-CONDITIONAL>
                                    <BASE-TYPE-REF DEST="SW-BASE-TYPE">/AUTOSAR_Platform/BaseTypes/uint8</BASE-TYPE-REF>
                                  </SW-DATA-DEF-PROPS-CONDITIONAL>
                                </SW-DATA-DEF-PROPS-VARIANTS>
                              </SW-DATA-DEF-PROPS>
                            </IMPLEMENTATION-DATA-TYPE-ELEMENT>
                          </SUB-ELEMENTS>
                        </IMPLEMENTATION-DATA-TYPE-ELEMENT>
                      </SUB-ELEMENTS>
                    </IMPLEMENTATION-DATA-TYPE-ELEMENT>
                  </SUB-ELEMENTS>
                </IMPLEMENTATION-DATA-TYPE-ELEMENT>
              </SUB-ELEMENTS>
            </IMPLEMENTATION-DATA-TYPE>
            <IMPLEMENTATION-DATA-TYPE>
              <SHORT-NAME>ETS_SimpleStruct</SHORT-NAME>
              <CATEGORY>STRUCTURE</CATEGORY>
              <SUB-ELEMENTS>
                <IMPLEMENTATION-DATA-TYPE-ELEMENT>
                  <SHORT-NAME>floatStructureSimple</SHORT-NAME>
                  <CATEGORY>TYPE_REFERENCE</CATEGORY>
                  <SW-DATA-DEF-PROPS>
                    <SW-DATA-DEF-PROPS-VARIANTS>
                      <SW-DATA-DEF-PROPS-CONDITIONAL>
                        <IMPLEMENTATION-DATA-TYPE-REF DEST="IMPLEMENTATION-DATA-TYPE">/AUTOSAR_Platform/ImplementationDataTypes/float32</IMPLEMENTATION-DATA-TYPE-REF>
                      </SW-DATA-DEF-PROPS-CONDITIONAL>
                    </SW-DATA-DEF-PROPS-VARIANTS>
                  </SW-DATA-DEF-PROPS>
                </IMPLEMENTATION-DATA-TYPE-ELEMENT>
                <IMPLEMENTATION-DATA-TYPE-ELEMENT>
                  <SHORT-NAME>uint8StructureSimple</SHORT-NAME>
                  <CATEGORY>TYPE_REFERENCE</CATEGORY>
                  <SW-DATA-DEF-PROPS>
                    <SW-DATA-DEF-PROPS-VARIANTS>
                      <SW-DATA-DEF-PROPS-CONDITIONAL>
                        <IMPLEMENTATION-DATA-TYPE-REF DEST="IMPLEMENTATION-DATA-TYPE">/AUTOSAR_Platform/ImplementationDataTypes/uint8</IMPLEMENTATION-DATA-TYPE-REF>
                      </SW-DATA-DEF-PROPS-CONDITIONAL>
                    </SW-DATA-DEF-PROPS-VARIANTS>
                  </SW-DATA-DEF-PROPS>
                </IMPLEMENTATION-DATA-TYPE-ELEMENT>
              </SUB-ELEMENTS>
            </IMPLEMENTATION-DATA-TYPE>
            <IMPLEMENTATION-DATA-TYPE>
              <SHORT-NAME>ETS_SimpleStructArray</SHORT-NAME>
              <CATEGORY>ARRAY</CATEGORY>
              <SUB-ELEMENTS>
                <IMPLEMENTATION-DATA-TYPE-ELEMENT>
                  <SHORT-NAME>StructureSimple</SHORT-NAME>
                  <CATEGORY>TYPE_REFERENCE</CATEGORY>
                  <ARRAY-SIZE>2</ARRAY-SIZE>
                  <ARRAY-SIZE-SEMANTICS>FIXED-SIZE</ARRAY-SIZE-SEMANTICS>
                  <SW-DATA-DEF-PROPS>
                    <SW-DATA-DEF-PROPS-VARIANTS>
                      <SW-DATA-DEF-PROPS-CONDITIONAL>
                        <IMPLEMENTATION-DATA-TYPE-REF DEST="IMPLEMENTATION-DATA-TYPE">/ETS/ImplementationDataTypes/ETS_SimpleStruct</IMPLEMENTATION-DATA-TYPE-REF>
                      </SW-DATA-DEF-PROPS-CONDITIONAL>
                    </SW-DATA-DEF-PROPS-VARIANTS>
                  </SW-DATA-DEF-PROPS>
                </IMPLEMENTATION-DATA-TYPE-ELEMENT>
              </SUB-ELEMENTS>
            </IMPLEMENTATION-DATA-TYPE>
            <IMPLEMENTATION-DATA-TYPE>
              <SHORT-NAME>ETS_Bitfield_uint16_return_tr</SHORT-NAME>
              <CATEGORY>TYPE_REFERENCE</CATEGORY>
              <SW-DATA-DEF-PROPS>
                <SW-DATA-DEF-PROPS-VARIANTS>
                  <SW-DATA-DEF-PROPS-CONDITIONAL>
                    <IMPLEMENTATION-DATA-TYPE-REF DEST="IMPLEMENTATION-DATA-TYPE">/AUTOSAR_Platform/ImplementationDataTypes/uint16</IMPLEMENTATION-DATA-TYPE-REF>
                  </SW-DATA-DEF-PROPS-CONDITIONAL>
                </SW-DATA-DEF-PROPS-VARIANTS>
              </SW-DATA-DEF-PROPS>
            </IMPLEMENTATION-DATA-TYPE>
            <IMPLEMENTATION-DATA-TYPE>
              <SHORT-NAME>ETS_Bitfield_uint16_tr</SHORT-NAME>
              <CATEGORY>TYPE_REFERENCE</CATEGORY>
              <SW-DATA-DEF-PROPS>
                <SW-DATA-DEF-PROPS-VARIANTS>
                  <SW-DATA-DEF-PROPS-CONDITIONAL>
                    <IMPLEMENTATION-DATA-TYPE-REF DEST="IMPLEMENTATION-DATA-TYPE">/AUTOSAR_Platform/ImplementationDataTypes/uint16</IMPLEMENTATION-DATA-TYPE-REF>
                  </SW-DATA-DEF-PROPS-CONDITIONAL>
                </SW-DATA-DEF-PROPS-VARIANTS>
              </SW-DATA-DEF-PROPS>
            </IMPLEMENTATION-DATA-TYPE>
            <IMPLEMENTATION-DATA-TYPE>
              <SHORT-NAME>ETS_Bitfield_uint32_return_tr</SHORT-NAME>
              <CATEGORY>TYPE_REFERENCE</CATEGORY>
              <SW-DATA-DEF-PROPS>
                <SW-DATA-DEF-PROPS-VARIANTS>
                  <SW-DATA-DEF-PROPS-CONDITIONAL>
                    <IMPLEMENTATION-DATA-TYPE-REF DEST="IMPLEMENTATION-DATA-TYPE">/AUTOSAR_Platform/ImplementationDataTypes/uint32</IMPLEMENTATION-DATA-TYPE-REF>
                    <ADDITIONAL-NATIVE-TYPE-QUALIFIER></ADDITIONAL-NATIVE-TYPE-QUALIFIER>
                  </SW-DATA-DEF-PROPS-CONDITIONAL>
                </SW-DATA-DEF-PROPS-VARIANTS>
              </SW-DATA-DEF-PROPS>
            </IMPLEMENTATION-DATA-TYPE>
            <IMPLEMENTATION-DATA-TYPE>
              <SHORT-NAME>ETS_Bitfield_uint32_tr</SHORT-NAME>
              <CATEGORY>TYPE_REFERENCE</CATEGORY>
              <SW-DATA-DEF-PROPS>
                <SW-DATA-DEF-PROPS-VARIANTS>
                  <SW-DATA-DEF-PROPS-CONDITIONAL>
                    <IMPLEMENTATION-DATA-TYPE-REF DEST="IMPLEMENTATION-DATA-TYPE">/AUTOSAR_Platform/ImplementationDataTypes/uint32</IMPLEMENTATION-DATA-TYPE-REF>
                    <ADDITIONAL-NATIVE-TYPE-QUALIFIER></ADDITIONAL-NATIVE-TYPE-QUALIFIER>
                  </SW-DATA-DEF-PROPS-CONDITIONAL>
                </SW-DATA-DEF-PROPS-VARIANTS>
              </SW-DATA-DEF-PROPS>
            </IMPLEMENTATION-DATA-TYPE>
            <IMPLEMENTATION-DATA-TYPE>
              <SHORT-NAME>ETS_Bitfield_uint8_return_tr</SHORT-NAME>
              <CATEGORY>TYPE_REFERENCE</CATEGORY>
              <SW-DATA-DEF-PROPS>
                <SW-DATA-DEF-PROPS-VARIANTS>
                  <SW-DATA-DEF-PROPS-CONDITIONAL>
                    <IMPLEMENTATION-DATA-TYPE-REF DEST="IMPLEMENTATION-DATA-TYPE">/AUTOSAR_Platform/ImplementationDataTypes/uint8</IMPLEMENTATION-DATA-TYPE-REF>
                  </SW-DATA-DEF-PROPS-CONDITIONAL>
                </SW-DATA-DEF-PROPS-VARIANTS>
              </SW-DATA-DEF-PROPS>
            </IMPLEMENTATION-DATA-TYPE>
            <IMPLEMENTATION-DATA-TYPE>
              <SHORT-NAME>ETS_Bitfield_uint8_tr</SHORT-NAME>
              <CATEGORY>TYPE_REFERENCE</CATEGORY>
              <SW-DATA-DEF-PROPS>
                <SW-DATA-DEF-PROPS-VARIANTS>
                  <SW-DATA-DEF-PROPS-CONDITIONAL>
                    <IMPLEMENTATION-DATA-TYPE-REF DEST="IMPLEMENTATION-DATA-TYPE">/AUTOSAR_Platform/ImplementationDataTypes/uint8</IMPLEMENTATION-DATA-TYPE-REF>
                  </SW-DATA-DEF-PROPS-CONDITIONAL>
                </SW-DATA-DEF-PROPS-VARIANTS>
              </SW-DATA-DEF-PROPS>
            </IMPLEMENTATION-DATA-TYPE>
            <IMPLEMENTATION-DATA-TYPE>
              <SHORT-NAME>ETS_UNION</SHORT-NAME>
              <CATEGORY>UNION</CATEGORY>
              <SUB-ELEMENTS>
                <IMPLEMENTATION-DATA-TYPE-ELEMENT>
                  <SHORT-NAME>uint8Union</SHORT-NAME>
                  <CATEGORY>TYPE_REFERENCE</CATEGORY>
                  <SW-DATA-DEF-PROPS>
                    <SW-DATA-DEF-PROPS-VARIANTS>
                      <SW-DATA-DEF-PROPS-CONDITIONAL>
                        <IMPLEMENTATION-DATA-TYPE-REF DEST="IMPLEMENTATION-DATA-TYPE">/AUTOSAR_Platform/ImplementationDataTypes/uint8</IMPLEMENTATION-DATA-TYPE-REF>
                      </SW-DATA-DEF-PROPS-CONDITIONAL>
                    </SW-DATA-DEF-PROPS-VARIANTS>
                  </SW-DATA-DEF-PROPS>
                </IMPLEMENTATION-DATA-TYPE-ELEMENT>
              </SUB-ELEMENTS>
            </IMPLEMENTATION-DATA-TYPE>
            <IMPLEMENTATION-DATA-TYPE>
              <SHORT-NAME>ETS_UTF8FixedArray</SHORT-NAME>
              <CATEGORY>ARRAY</CATEGORY>
              <SUB-ELEMENTS>
                <IMPLEMENTATION-DATA-TYPE-ELEMENT>
                  <SHORT-NAME>UINT8</SHORT-NAME>
                  <CATEGORY>TYPE_REFERENCE</CATEGORY>
                  <ARRAY-SIZE>64</ARRAY-SIZE>
                  <ARRAY-SIZE-SEMANTICS>FIXED-SIZE</ARRAY-SIZE-SEMANTICS>
                  <SW-DATA-DEF-PROPS>
                    <SW-DATA-DEF-PROPS-VARIANTS>
                      <SW-DATA-DEF-PROPS-CONDITIONAL>
                        <IMPLEMENTATION-DATA-TYPE-REF DEST="IMPLEMENTATION-DATA-TYPE">/AUTOSAR_Platform/ImplementationDataTypes/uint8</IMPLEMENTATION-DATA-TYPE-REF>
                      </SW-DATA-DEF-PROPS-CONDITIONAL>
                    </SW-DATA-DEF-PROPS-VARIANTS>
                  </SW-DATA-DEF-PROPS>
                </IMPLEMENTATION-DATA-TYPE-ELEMENT>
              </SUB-ELEMENTS>
            </IMPLEMENTATION-DATA-TYPE>
            <IMPLEMENTATION-DATA-TYPE>
              <SHORT-NAME>ETS_UTF16FixedArray</SHORT-NAME>
              <CATEGORY>ARRAY</CATEGORY>
              <SUB-ELEMENTS>
                <IMPLEMENTATION-DATA-TYPE-ELEMENT>
                  <SHORT-NAME>UINT16</SHORT-NAME>
                  <CATEGORY>TYPE_REFERENCE</CATEGORY>
                  <ARRAY-SIZE>64</ARRAY-SIZE>
                  <ARRAY-SIZE-SEMANTICS>FIXED-SIZE</ARRAY-SIZE-SEMANTICS>
                  <SW-DATA-DEF-PROPS>
                    <SW-DATA-DEF-PROPS-VARIANTS>
                      <SW-DATA-DEF-PROPS-CONDITIONAL>
                        <IMPLEMENTATION-DATA-TYPE-REF DEST="IMPLEMENTATION-DATA-TYPE">/AUTOSAR_Platform/ImplementationDataTypes/uint16</IMPLEMENTATION-DATA-TYPE-REF>
                      </SW-DATA-DEF-PROPS-CONDITIONAL>
                    </SW-DATA-DEF-PROPS-VARIANTS>
                  </SW-DATA-DEF-PROPS>
                </IMPLEMENTATION-DATA-TYPE-ELEMENT>
              </SUB-ELEMENTS>
            </IMPLEMENTATION-DATA-TYPE>
            <IMPLEMENTATION-DATA-TYPE>
              <SHORT-NAME>ETS_TimePeriod</SHORT-NAME>
              <CATEGORY>STRUCTURE</CATEGORY>
              <SW-DATA-DEF-PROPS>
                <SW-DATA-DEF-PROPS-VARIANTS>
                  <SW-DATA-DEF-PROPS-CONDITIONAL>
                    <SW-CALIBRATION-ACCESS>NOT-ACCESSIBLE</SW-CALIBRATION-ACCESS>
                  </SW-DATA-DEF-PROPS-CONDITIONAL>
                </SW-DATA-DEF-PROPS-VARIANTS>
              </SW-DATA-DEF-PROPS>
              <SUB-ELEMENTS>
                <IMPLEMENTATION-DATA-TYPE-ELEMENT>
                  <SHORT-NAME>start</SHORT-NAME>
                  <CATEGORY>TYPE_REFERENCE</CATEGORY>
                  <SW-DATA-DEF-PROPS>
                    <SW-DATA-DEF-PROPS-VARIANTS>
                      <SW-DATA-DEF-PROPS-CONDITIONAL>
                        <IMPLEMENTATION-DATA-TYPE-REF DEST="IMPLEMENTATION-DATA-TYPE">/AUTOSAR_Platform/ImplementationDataTypes/uint8</IMPLEMENTATION-DATA-TYPE-REF>
                      </SW-DATA-DEF-PROPS-CONDITIONAL>
                    </SW-DATA-DEF-PROPS-VARIANTS>
                  </SW-DATA-DEF-PROPS>
                </IMPLEMENTATION-DATA-TYPE-ELEMENT>
                <IMPLEMENTATION-DATA-TYPE-ELEMENT>
                  <SHORT-NAME>duration</SHORT-NAME>
                  <CATEGORY>TYPE_REFERENCE</CATEGORY>
                  <SW-DATA-DEF-PROPS>
                    <SW-DATA-DEF-PROPS-VARIANTS>
                      <SW-DATA-DEF-PROPS-CONDITIONAL>
                        <IMPLEMENTATION-DATA-TYPE-REF DEST="IMPLEMENTATION-DATA-TYPE">/AUTOSAR_Platform/ImplementationDataTypes/uint8</IMPLEMENTATION-DATA-TYPE-REF>
                      </SW-DATA-DEF-PROPS-CONDITIONAL>
                    </SW-DATA-DEF-PROPS-VARIANTS>
                  </SW-DATA-DEF-PROPS>
                </IMPLEMENTATION-DATA-TYPE-ELEMENT>
              </SUB-ELEMENTS>
            </IMPLEMENTATION-DATA-TYPE>
            <IMPLEMENTATION-DATA-TYPE>
              <SHORT-NAME>ETS_Uint8Value</SHORT-NAME>
              <CATEGORY>STRUCTURE</CATEGORY>
              <SUB-ELEMENTS>
                <IMPLEMENTATION-DATA-TYPE-ELEMENT>
                  <SHORT-NAME>uINT8Value</SHORT-NAME>
                  <CATEGORY>TYPE_REFERENCE</CATEGORY>
                  <SW-DATA-DEF-PROPS>
                    <SW-DATA-DEF-PROPS-VARIANTS>
                      <SW-DATA-DEF-PROPS-CONDITIONAL>
                        <IMPLEMENTATION-DATA-TYPE-REF DEST="IMPLEMENTATION-DATA-TYPE">/AUTOSAR_Platform/ImplementationDataTypes/uint8</IMPLEMENTATION-DATA-TYPE-REF>
                      </SW-DATA-DEF-PROPS-CONDITIONAL>
                    </SW-DATA-DEF-PROPS-VARIANTS>
                  </SW-DATA-DEF-PROPS>
                </IMPLEMENTATION-DATA-TYPE-ELEMENT>
              </SUB-ELEMENTS>
            </IMPLEMENTATION-DATA-TYPE>
            <IMPLEMENTATION-DATA-TYPE>
              <SHORT-NAME>ETS_VersionType</SHORT-NAME>
              <CATEGORY>STRUCTURE</CATEGORY>
              <SUB-ELEMENTS>
                <IMPLEMENTATION-DATA-TYPE-ELEMENT>
                  <SHORT-NAME>majorEtsVersion</SHORT-NAME>
                  <CATEGORY>TYPE_REFERENCE</CATEGORY>
                  <SW-DATA-DEF-PROPS>
                    <SW-DATA-DEF-PROPS-VARIANTS>
                      <SW-DATA-DEF-PROPS-CONDITIONAL>
                        <IMPLEMENTATION-DATA-TYPE-REF DEST="IMPLEMENTATION-DATA-TYPE">/AUTOSAR_Platform/ImplementationDataTypes/uint8</IMPLEMENTATION-DATA-TYPE-REF>
                      </SW-DATA-DEF-PROPS-CONDITIONAL>
                    </SW-DATA-DEF-PROPS-VARIANTS>
                  </SW-DATA-DEF-PROPS>
                </IMPLEMENTATION-DATA-TYPE-ELEMENT>
                <IMPLEMENTATION-DATA-TYPE-ELEMENT>
                  <SHORT-NAME>minorEtsVersion</SHORT-NAME>
                  <CATEGORY>TYPE_REFERENCE</CATEGORY>
                  <SW-DATA-DEF-PROPS>
                    <SW-DATA-DEF-PROPS-VARIANTS>
                      <SW-DATA-DEF-PROPS-CONDITIONAL>
                        <IMPLEMENTATION-DATA-TYPE-REF DEST="IMPLEMENTATION-DATA-TYPE">/AUTOSAR_Platform/ImplementationDataTypes/uint32</IMPLEMENTATION-DATA-TYPE-REF>
                      </SW-DATA-DEF-PROPS-CONDITIONAL>
                    </SW-DATA-DEF-PROPS-VARIANTS>
                  </SW-DATA-DEF-PROPS>
                </IMPLEMENTATION-DATA-TYPE-ELEMENT>
              </SUB-ELEMENTS>
            </IMPLEMENTATION-DATA-TYPE>
            <DATA-CONSTR>
              <SHORT-NAME>dc_debounceTime</SHORT-NAME>
              <DATA-CONSTR-RULES>
                <DATA-CONSTR-RULE>
                  <INTERNAL-CONSTRS>
                    <LOWER-LIMIT INTERVAL-TYPE="CLOSED">0</LOWER-LIMIT>
                    <UPPER-LIMIT INTERVAL-TYPE="CLOSED">255</UPPER-LIMIT>
                  </INTERNAL-CONSTRS>
                </DATA-CONSTR-RULE>
              </DATA-CONSTR-RULES>
            </DATA-CONSTR>
            <DATA-CONSTR>
              <SHORT-NAME>dc_duration</SHORT-NAME>
              <DATA-CONSTR-RULES>
                <DATA-CONSTR-RULE>
                  <INTERNAL-CONSTRS>
                    <LOWER-LIMIT INTERVAL-TYPE="CLOSED">0</LOWER-LIMIT>
                    <UPPER-LIMIT INTERVAL-TYPE="CLOSED">255</UPPER-LIMIT>
                  </INTERNAL-CONSTRS>
                </DATA-CONSTR-RULE>
              </DATA-CONSTR-RULES>
            </DATA-CONSTR>
            <DATA-CONSTR>
              <SHORT-NAME>dc_start</SHORT-NAME>
              <DATA-CONSTR-RULES>
                <DATA-CONSTR-RULE>
                  <INTERNAL-CONSTRS>
                    <LOWER-LIMIT INTERVAL-TYPE="CLOSED">0</LOWER-LIMIT>
                    <UPPER-LIMIT INTERVAL-TYPE="CLOSED">255</UPPER-LIMIT>
                  </INTERNAL-CONSTRS>
                </DATA-CONSTR-RULE>
              </DATA-CONSTR-RULES>
            </DATA-CONSTR>
          </ELEMENTS>
        </AR-PACKAGE>
        <AR-PACKAGE>
          <SHORT-NAME>ModeDeclarationGroups</SHORT-NAME>
          <ELEMENTS>
            <MODE-DECLARATION-GROUP>
              <SHORT-NAME>ETS_CurrentMode</SHORT-NAME>
              <CATEGORY>EXPLICIT_ORDER</CATEGORY>
              <INITIAL-MODE-REF DEST="MODE-DECLARATION">/ETS/ModeDeclarationGroups/ETS_CurrentMode/ETS_STOP_MODE</INITIAL-MODE-REF>
              <MODE-DECLARATIONS>
                <MODE-DECLARATION>
                  <SHORT-NAME>ETS_STOP_MODE</SHORT-NAME>
                  <VALUE>0</VALUE>
                </MODE-DECLARATION>
                <MODE-DECLARATION>
                  <SHORT-NAME>ETS_INIT_MODE</SHORT-NAME>
                  <VALUE>1</VALUE>
                </MODE-DECLARATION>
                <MODE-DECLARATION>
                  <SHORT-NAME>ETS_RUN_MODE</SHORT-NAME>
                  <VALUE>2</VALUE>
                </MODE-DECLARATION>
              </MODE-DECLARATIONS>
              <ON-TRANSITION-VALUE>3</ON-TRANSITION-VALUE>
            </MODE-DECLARATION-GROUP>
            <MODE-DECLARATION-GROUP>
              <SHORT-NAME>ETS_SD_ClientServiceMode</SHORT-NAME>
              <CATEGORY>EXPLICIT_ORDER</CATEGORY>
              <INITIAL-MODE-REF DEST="MODE-DECLARATION">/ETS/ModeDeclarationGroups/ETS_SD_ClientServiceMode/ETS_SD_CLIENT_SERVICE_RELEASED</INITIAL-MODE-REF>
              <MODE-DECLARATIONS>
                <MODE-DECLARATION>
                  <SHORT-NAME>ETS_SD_CLIENT_SERVICE_RELEASED</SHORT-NAME>
                  <VALUE>0</VALUE>
                </MODE-DECLARATION>
                <MODE-DECLARATION>
                  <SHORT-NAME>ETS_SD_CLIENT_SERVICE_REQUESTED</SHORT-NAME>
                  <VALUE>1</VALUE>
                </MODE-DECLARATION>
              </MODE-DECLARATIONS>
              <ON-TRANSITION-VALUE>2</ON-TRANSITION-VALUE>
            </MODE-DECLARATION-GROUP>
            <MODE-DECLARATION-GROUP>
              <SHORT-NAME>ETS_SD_ConsumeEventGroupMode</SHORT-NAME>
              <CATEGORY>EXPLICIT_ORDER</CATEGORY>
              <INITIAL-MODE-REF DEST="MODE-DECLARATION">/ETS/ModeDeclarationGroups/ETS_SD_ConsumeEventGroupMode/ETS_SD_CONSUMED_EVENTGROUP_RELEASED</INITIAL-MODE-REF>
              <MODE-DECLARATIONS>
                <MODE-DECLARATION>
                  <SHORT-NAME>ETS_SD_CONSUMED_EVENTGROUP_RELEASED</SHORT-NAME>
                  <VALUE>0</VALUE>
                </MODE-DECLARATION>
                <MODE-DECLARATION>
                  <SHORT-NAME>ETS_SD_CONSUMED_EVENTGROUP_REQUESTED</SHORT-NAME>
                  <VALUE>1</VALUE>
                </MODE-DECLARATION>
              </MODE-DECLARATIONS>
              <ON-TRANSITION-VALUE>2</ON-TRANSITION-VALUE>
            </MODE-DECLARATION-GROUP>
            <MODE-DECLARATION-GROUP>
              <SHORT-NAME>ETS_SD_ServerServiceMode</SHORT-NAME>
              <CATEGORY>EXPLICIT_ORDER</CATEGORY>
              <INITIAL-MODE-REF DEST="MODE-DECLARATION">/ETS/ModeDeclarationGroups/ETS_SD_ServerServiceMode/ETS_SD_SERVER_SERVICE_DOWN</INITIAL-MODE-REF>
              <MODE-DECLARATIONS>
                <MODE-DECLARATION>
                  <SHORT-NAME>ETS_SD_SERVER_SERVICE_DOWN</SHORT-NAME>
                  <VALUE>0</VALUE>
                </MODE-DECLARATION>
                <MODE-DECLARATION>
                  <SHORT-NAME>ETS_SD_SERVER_SERVICE_AVAILABLE</SHORT-NAME>
                  <VALUE>1</VALUE>
                </MODE-DECLARATION>
              </MODE-DECLARATIONS>
              <ON-TRANSITION-VALUE>2</ON-TRANSITION-VALUE>
            </MODE-DECLARATION-GROUP>
          </ELEMENTS>
        </AR-PACKAGE>
        <AR-PACKAGE>
          <SHORT-NAME>PortInterfaces</SHORT-NAME>
          <ELEMENTS>
