<?xml version="1.0" encoding="ISO-8859-1"?>
[!AUTOSPACING!][!//
<AUTOSAR xmlns="http://autosar.org/3.2.2"
  xmlns:xsi="http://www.w3.org/2001/XMLSchema-instance"
  xsi:schemaLocation="http://autosar.org/3.2.2 AUTOSAR_STRICT_COMPACT.xsd">
[!IF "EcuMGeneral/EcuMServiceAPI/EcuMDefaultASRServiceAPI = 'AUTOSAR_32'"!][!//
[!VAR "bswModuleEntryPackageName" = "'SwServices'"!][!//
[!ELSE!][!//
[!VAR "bswModuleEntryPackageName" = "'BswModuleEntrys'"!][!//
[!ENDIF!][!//
  <TOP-LEVEL-PACKAGES>
    <AR-PACKAGE>
      <SHORT-NAME>AUTOSAR_EcuM</SHORT-NAME>
      <SUB-PACKAGES>
        <AR-PACKAGE>
          <SHORT-NAME>BswModuleDescriptions</SHORT-NAME>
          <ELEMENTS>
            <BSW-MODULE-DESCRIPTION>
              <SHORT-NAME>EcuM</SHORT-NAME>
              <MODULE-ID>10</MODULE-ID>
              <PROVIDED-ENTRY-REFS>
                  <PROVIDED-ENTRY-REF DEST="BSW-MODULE-ENTRY">/AUTOSAR_EcuM/[!"$bswModuleEntryPackageName"!]/EcuM_MainFunction</PROVIDED-ENTRY-REF>
              </PROVIDED-ENTRY-REFS>
            </BSW-MODULE-DESCRIPTION>
          </ELEMENTS>
        </AR-PACKAGE>
        <AR-PACKAGE>
          <SHORT-NAME>InternalBehaviors</SHORT-NAME>
          <ELEMENTS>
            <BSW-BEHAVIOR>
              <SHORT-NAME>InternalBehavior_0</SHORT-NAME>
              <ENTITYS>
                <BSW-SCHEDULABLE-ENTITY>
                  <SHORT-NAME>EcuM_MainFunction</SHORT-NAME>
                  <CAN-ENTER-EXCLUSIVE-AREA-REFS>
                    <CAN-ENTER-EXCLUSIVE-AREA-REF DEST="EXCLUSIVE-AREA">/AUTOSAR_EcuM/InternalBehaviors/InternalBehavior_0/SCHM_ECUM_EXCLUSIVE_AREA_0</CAN-ENTER-EXCLUSIVE-AREA-REF>
                  </CAN-ENTER-EXCLUSIVE-AREA-REFS>
                  <IMPLEMENTED-ENTRY-REF DEST="BSW-MODULE-ENTRY">/AUTOSAR_EcuM/[!"$bswModuleEntryPackageName"!]/EcuM_MainFunction</IMPLEMENTED-ENTRY-REF>
                </BSW-SCHEDULABLE-ENTITY>
              </ENTITYS>
              <EVENTS>
                <BSW-CYCLIC-EVENT>
                  <SHORT-NAME>TimingEvent_MainFunction</SHORT-NAME>
                  <STARTS-ON-EVENT-REF DEST="BSW-SCHEDULABLE-ENTITY">/AUTOSAR_EcuM/InternalBehaviors/InternalBehavior_0/EcuM_MainFunction</STARTS-ON-EVENT-REF>
                  <CYCLE-TIME>[!"EcuMGeneral/EcuMMainFunctionPeriod"!]</CYCLE-TIME>
                </BSW-CYCLIC-EVENT>
              </EVENTS>
              <EXCLUSIVE-AREAS>
                <EXCLUSIVE-AREA>
                  <SHORT-NAME>SCHM_ECUM_EXCLUSIVE_AREA_0</SHORT-NAME>
                </EXCLUSIVE-AREA>
              </EXCLUSIVE-AREAS>
              <MODULE-REF DEST="BSW-MODULE-DESCRIPTION">/AUTOSAR_EcuM/BswModuleDescriptions/EcuM</MODULE-REF>
            </BSW-BEHAVIOR>
          </ELEMENTS>
        </AR-PACKAGE>
        
        <AR-PACKAGE>
          <SHORT-NAME>[!"$bswModuleEntryPackageName"!]</SHORT-NAME>
          <ELEMENTS>
            <BSW-MODULE-ENTRY>
              <SHORT-NAME>EcuM_MainFunction</SHORT-NAME>
              <SW-SERVICE-PROPS>
                <SW-IMPL-POLICY>STANDARD</SW-IMPL-POLICY>
              </SW-SERVICE-PROPS>
              <CALL-TYPE>SCHEDULED</CALL-TYPE>
              <EXECUTION-CONTEXT>TASK</EXECUTION-CONTEXT>
              <IS-SYNCHRONOUS>true</IS-SYNCHRONOUS>
              <SERVICE-ID>24</SERVICE-ID> <!-- 0x18 -->
            </BSW-MODULE-ENTRY>
          </ELEMENTS>
        </AR-PACKAGE>
      </SUB-PACKAGES>
    </AR-PACKAGE>
    <AR-PACKAGE>
      <SHORT-NAME>EB_EcuM</SHORT-NAME>
      <SUB-PACKAGES>
        <AR-PACKAGE>
          <SHORT-NAME>Implementations</SHORT-NAME>
          <ELEMENTS>
            <BSW-IMPLEMENTATION>
              <SHORT-NAME>BswImplementation_0</SHORT-NAME>
              <CODE-DESCRIPTORS>
                <CODE>
                  <SHORT-NAME>EcuMHeaderFiles</SHORT-NAME>
                  <TYPE>SRC</TYPE>
                  <XFILES>
                    <XFILE>
                      <SHORT-NAME>Autosar_include_EcuM_h</SHORT-NAME>
                      <URL>Autosar/include/EcuM.h</URL>
                    </XFILE>
                    <XFILE>
                      <SHORT-NAME>Autosar_include_EcuM_BSW_h</SHORT-NAME>
                      <URL>Autosar/include/EcuM_BSW.h</URL>
                    </XFILE>
                    <XFILE>
                      <SHORT-NAME>Autosar_include_EcuM_BSW_Types_h</SHORT-NAME>
                      <URL>Autosar/include/EcuM_BSW_Types.h</URL>
                    </XFILE>
                    <XFILE>
                      <SHORT-NAME>Autosar_include_EcuM_BootTarget_h</SHORT-NAME>
                      <URL>Autosar/include/EcuM_BootTarget.h</URL>
                    </XFILE>
                    <XFILE>
                      <SHORT-NAME>Autosar_include_EcuM_Cbk_h</SHORT-NAME>
                      <URL>Autosar/include/EcuM_Cbk.h</URL>
                    </XFILE>
                    <XFILE>
                      <SHORT-NAME>Autosar_include_EcuM_Externals_h</SHORT-NAME>
                      <URL>Autosar/include/EcuM_Externals.h</URL>
                    </XFILE>
                    <XFILE>
                      <SHORT-NAME>Autosar_include_EcuM_Int_h</SHORT-NAME>
                      <URL>Autosar/include/EcuM_Int.h</URL>
                    </XFILE>
                    <XFILE>
                      <SHORT-NAME>Autosar_include_EcuM_Trace_h</SHORT-NAME>
                      <URL>Autosar/include/EcuM_Trace.h</URL>
                    </XFILE>
                    <XFILE>
                      <SHORT-NAME>Autosar_include_EcuM_Trace_Internal_h</SHORT-NAME>
                      <URL>Autosar/include/EcuM_Trace_Internal.h</URL>
                    </XFILE>
                    <XFILE>
                      <SHORT-NAME>Autosar_include_EcuM_Types_h</SHORT-NAME>
                      <URL>Autosar/include/EcuM_Types.h</URL>
                    </XFILE>
                    <XFILE>
                      <SHORT-NAME>Autosar_include_EcuM_Version_h</SHORT-NAME>
                      <URL>Autosar/include/EcuM_Version.h</URL>
                    </XFILE>
                  </XFILES>
                </CODE>
                <CODE>
                  <SHORT-NAME>EcuMSourceFiles</SHORT-NAME>
                  <TYPE>SRC</TYPE>
                  <XFILES>
                    <XFILE>
                      <SHORT-NAME>Autosar_src_EcuM_c</SHORT-NAME>
                      <URL>Autosar/src/EcuM.c</URL>
                    </XFILE>
                    <XFILE>
                      <SHORT-NAME>Autosar_src_EcuM_ASR32_Rte_c</SHORT-NAME>
                      <URL>Autosar/src/EcuM_ASR32_Rte.c</URL>
                    </XFILE>
                    <XFILE>
                      <SHORT-NAME>Autosar_src_EcuM_ASR40_Rte_c</SHORT-NAME>
                      <URL>Autosar/src/EcuM_ASR40_Rte.c</URL>
                    </XFILE>
                    <XFILE>
                      <SHORT-NAME>Autosar_src_EcuM_BootTarget_c</SHORT-NAME>
                      <URL>Autosar/src/EcuM_BootTarget.c</URL>
                    </XFILE>
                    <XFILE>
                      <SHORT-NAME>Autosar_src_EcuM_Rte_c</SHORT-NAME>
                      <URL>Autosar/src/EcuM_Rte.c</URL>
                    </XFILE>
                  </XFILES>
                </CODE>
              </CODE-DESCRIPTORS>
              <PROGRAMMING-LANGUAGE>C</PROGRAMMING-LANGUAGE>
              <RESOURCE-CONSUMPTION>
                <SHORT-NAME>Resources</SHORT-NAME>
                <OBJECT-FILE-SECTIONS>
                  <MEMORY-SECTION>
                    <SHORT-NAME>CODE</SHORT-NAME>
                    <ALIGNMENT>1</ALIGNMENT>
                    <SECTION-NAME>CODE</SECTION-NAME>
                    <SECTION-TYPE>CODE</SECTION-TYPE>
                    <SIZE>0</SIZE>
                    <SW-ADDR-METHOD-REFS>
                      <SW-ADDR-METHOD-REF DEST="SW-ADDR-METHOD">/AUTOSAR_MemMap/SwAddrMethods/CODE</SW-ADDR-METHOD-REF>
                    </SW-ADDR-METHOD-REFS>
                  </MEMORY-SECTION>
                </OBJECT-FILE-SECTIONS>
              </RESOURCE-CONSUMPTION>
              <SW-MAJOR-VERSION>5</SW-MAJOR-VERSION>
              <SW-MINOR-VERSION>15</SW-MINOR-VERSION>
              <SW-PATCH-VERSION>11</SW-PATCH-VERSION>
              <VENDOR-ID>1</VENDOR-ID>
              <AR-MAJOR-VERSION>4</AR-MAJOR-VERSION>
              <AR-MINOR-VERSION>6</AR-MINOR-VERSION>
              <AR-PATCH-VERSION>0</AR-PATCH-VERSION>
              <BEHAVIOR-REF DEST="BSW-BEHAVIOR">/AUTOSAR_EcuM/InternalBehaviors/InternalBehavior_0</BEHAVIOR-REF>
              <VENDOR-SPECIFIC-MODULE-DEF-REF DEST="MODULE-DEF">/TS_TxDxM5I15R0/EcuM</VENDOR-SPECIFIC-MODULE-DEF-REF>
            </BSW-IMPLEMENTATION>
          </ELEMENTS>
        </AR-PACKAGE>
      </SUB-PACKAGES>
    </AR-PACKAGE>

  </TOP-LEVEL-PACKAGES>
</AUTOSAR>
