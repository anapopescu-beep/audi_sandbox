AUTOSAR XML (schema 00046)
package /AUTOSAR_Adc/BswModuleDescriptions
  bsw module description Adc: module-id=123
    provided-entrys:
      Adc_Calibrate
      Adc_ConfigureThreshold
      Adc_CtuDisableHwTrigger
      Adc_CtuDisableNotification
      Adc_CtuEnableHwTrigger
      Adc_CtuEnableNotification
      Adc_CtuMasterReload
      Adc_CtuReadConvData
      Adc_CtuReadConvResult
      Adc_CtuReadFifoData
      Adc_CtuReadFifoResult
      Adc_CtuSetFifoWatermark
      Adc_CtuSetList
      Adc_CtuSetListPointer
      Adc_CtuSetPowerMode
      Adc_CtuSetTriggerAdcCmdAddress
      Adc_CtuSetTriggerCompare
      Adc_CtuSetTriggerEnable
      Adc_CtuStartConversion
      Adc_CtuStopLoopConversions
      Adc_CtuWriteTriggerEnableMask
      Adc_DeInit
      Adc_DisableCTUTrigger
      Adc_DisableChannel
      Adc_DisableCtuControlMode
      Adc_DisableGroupNotification
      Adc_DisableHardwareTrigger
      Adc_DisableWdgNotification
      Adc_EnableCTUTrigger
      Adc_EnableChannel
      Adc_EnableCtuControlMode
      Adc_EnableGroupNotification
      Adc_EnableHardwareTrigger
      Adc_EnableWdgNotification
      Adc_GetCurrentPowerState
      Adc_GetGroupStatus
      Adc_GetInjectedConversionStatus
      Adc_GetStreamLastPointer
      Adc_GetTargetPowerState
      Adc_GetVersionInfo
      Adc_HwResultReadGroup
      Adc_Init
      Adc_Ip_ClearLatchedTriggers
      Adc_Ip_ClearTrigErrReg
      Adc_Ip_DisableChannelNotification
      Adc_Ip_EnableChannelNotification
      Adc_Ip_SetSoftwarePretrigger
      Adc_Ip_StartConversion
      Adc_Main_PowerTransitionManager
      Adc_PreparePowerState
      Adc_ReadGroup
      Adc_ReadRawData
      Adc_SelfTest
      Adc_SetChannel
      Adc_SetClockMode
      Adc_SetHwUnitPowerMode
      Adc_SetPowerState
      Adc_SetupResultBuffer
      Adc_StartGroupConversion
      Adc_StopGroupConversion
      Adc_TempSenseCalculateTemp
      Adc_TempSenseGetTemp
      Adc_TempSenseSetPowerMode
      Adc_0_Isr
      Adc_1_Isr
      Pdb_0_Isr
      Pdb_1_Isr
    bsw internal behavior InternalBehavior_0
      38 x exclusive area:
        ADC_EXCLUSIVE_AREA_{00..03}
        ADC_EXCLUSIVE_AREA_{10..32}
        ADC_EXCLUSIVE_AREA_{34..41}
        ADC_EXCLUSIVE_AREA_45
        ADC_EXCLUSIVE_AREA_47
        ADC_EXCLUSIVE_AREA_48
      63 x bsw called entity:
        Adc_Calibrate: can-enter-exclusive-area=[ADC_EXCLUSIVE_AREA_13, ADC_EXCLUSIVE_AREA_15, ADC_EXCLUSIVE_AREA_24, ADC_EXCLUSIVE_AREA_29], implemented-entry=Adc_Calibrate
        Adc_ConfigureThreshold: implemented-entry=Adc_ConfigureThreshold
        Adc_CtuDisableHwTrigger: implemented-entry=Adc_CtuDisableHwTrigger
        Adc_CtuDisableNotification: implemented-entry=Adc_CtuDisableNotification
        Adc_CtuEnableHwTrigger: implemented-entry=Adc_CtuEnableHwTrigger
        Adc_CtuEnableNotification: implemented-entry=Adc_CtuEnableNotification
        Adc_CtuMasterReload: implemented-entry=Adc_CtuMasterReload
        Adc_CtuReadConvData: implemented-entry=Adc_CtuReadConvData
        Adc_CtuReadConvResult: implemented-entry=Adc_CtuReadConvResult
        Adc_CtuReadFifoData: implemented-entry=Adc_CtuReadFifoData
        Adc_CtuReadFifoResult: implemented-entry=Adc_CtuReadFifoResult
        Adc_CtuSetFifoWatermark: implemented-entry=Adc_CtuSetFifoWatermark
        Adc_CtuSetList: implemented-entry=Adc_CtuSetList
        Adc_CtuSetListPointer: implemented-entry=Adc_CtuSetListPointer
        Adc_CtuSetPowerMode: implemented-entry=Adc_CtuSetPowerMode
        Adc_CtuSetTriggerAdcCmdAddress: implemented-entry=Adc_CtuSetTriggerAdcCmdAddress
        Adc_CtuSetTriggerCompare: implemented-entry=Adc_CtuSetTriggerCompare
        Adc_CtuSetTriggerEnable: implemented-entry=Adc_CtuSetTriggerEnable
        Adc_CtuStartConversion: implemented-entry=Adc_CtuStartConversion
        Adc_CtuStopLoopConversions: implemented-entry=Adc_CtuStopLoopConversions
        Adc_CtuWriteTriggerEnableMask: implemented-entry=Adc_CtuWriteTriggerEnableMask
        Adc_DeInit: implemented-entry=Adc_DeInit
        Adc_DisableCTUTrigger: implemented-entry=Adc_DisableCTUTrigger
        Adc_DisableChannel: implemented-entry=Adc_DisableChannel
        Adc_DisableCtuControlMode: implemented-entry=Adc_DisableCtuControlMode
        Adc_DisableGroupNotification: implemented-entry=Adc_DisableGroupNotification
        Adc_DisableHardwareTrigger: can-enter-exclusive-area=[ADC_EXCLUSIVE_AREA_21, ADC_EXCLUSIVE_AREA_22, ADC_EXCLUSIVE_AREA_32, ADC_EXCLUSIVE_AREA_40, ADC_EXCLUSIVE_AREA_45, ADC_EXCLUSIVE_AREA_47], implemented-entry=Adc_DisableHardwareTrigger
        Adc_DisableWdgNotification: implemented-entry=Adc_DisableWdgNotification
        Adc_EnableCTUTrigger: implemented-entry=Adc_EnableCTUTrigger
        Adc_EnableChannel: implemented-entry=Adc_EnableChannel
        Adc_EnableCtuControlMode: implemented-entry=Adc_EnableCtuControlMode
        Adc_EnableGroupNotification: implemented-entry=Adc_EnableGroupNotification
        Adc_EnableHardwareTrigger: can-enter-exclusive-area=[ADC_EXCLUSIVE_AREA_16, ADC_EXCLUSIVE_AREA_21, ADC_EXCLUSIVE_AREA_26, ADC_EXCLUSIVE_AREA_27, ADC_EXCLUSIVE_AREA_32, ADC_EXCLUSIVE_AREA_34, ADC_EXCLUSIVE_AREA_35, ADC_EXCLUSIVE_AREA_36, ADC_EXCLUSIVE_AREA_38, ADC_EXCLUSIVE_AREA_39, ADC_EXCLUSIVE_AREA_40, ADC_EXCLUSIVE_AREA_41, ADC_EXCLUSIVE_AREA_45, ADC_EXCLUSIVE_AREA_47, ADC_EXCLUSIVE_AREA_48], implemented-entry=Adc_EnableHardwareTrigger
        Adc_EnableWdgNotification: implemented-entry=Adc_EnableWdgNotification
        Adc_GetCurrentPowerState: implemented-entry=Adc_GetCurrentPowerState
        Adc_GetGroupStatus: implemented-entry=Adc_GetGroupStatus
        Adc_GetInjectedConversionStatus: implemented-entry=Adc_GetInjectedConversionStatus
        Adc_GetStreamLastPointer: implemented-entry=Adc_GetStreamLastPointer
        Adc_GetTargetPowerState: implemented-entry=Adc_GetTargetPowerState
        Adc_GetVersionInfo: implemented-entry=Adc_GetVersionInfo
        Adc_HwResultReadGroup: implemented-entry=Adc_HwResultReadGroup
        Adc_Init: can-enter-exclusive-area=ADC_EXCLUSIVE_AREA_10, implemented-entry=Adc_Init
        Adc_Ip_ClearLatchedTriggers: can-enter-exclusive-area=ADC_EXCLUSIVE_AREA_12, implemented-entry=Adc_Ip_ClearLatchedTriggers
        Adc_Ip_ClearTrigErrReg: can-enter-exclusive-area=ADC_EXCLUSIVE_AREA_25, implemented-entry=Adc_Ip_ClearTrigErrReg
        Adc_Ip_DisableChannelNotification: can-enter-exclusive-area=ADC_EXCLUSIVE_AREA_20, implemented-entry=Adc_Ip_DisableChannelNotification
        Adc_Ip_EnableChannelNotification: can-enter-exclusive-area=ADC_EXCLUSIVE_AREA_19, implemented-entry=Adc_Ip_EnableChannelNotification
        Adc_Ip_SetSoftwarePretrigger: can-enter-exclusive-area=ADC_EXCLUSIVE_AREA_31, implemented-entry=Adc_Ip_SetSoftwarePretrigger
        Adc_Ip_StartConversion: can-enter-exclusive-area=ADC_EXCLUSIVE_AREA_18, implemented-entry=Adc_Ip_StartConversion
        Adc_Main_PowerTransitionManager: implemented-entry=Adc_Main_PowerTransitionManager
        Adc_PreparePowerState: implemented-entry=Adc_PreparePowerState
        Adc_ReadGroup: can-enter-exclusive-area=[ADC_EXCLUSIVE_AREA_00, ADC_EXCLUSIVE_AREA_03, ADC_EXCLUSIVE_AREA_16, ADC_EXCLUSIVE_AREA_17, ADC_EXCLUSIVE_AREA_21, ADC_EXCLUSIVE_AREA_22, ADC_EXCLUSIVE_AREA_23, ADC_EXCLUSIVE_AREA_26, ADC_EXCLUSIVE_AREA_27, ADC_EXCLUSIVE_AREA_32, ADC_EXCLUSIVE_AREA_34, ADC_EXCLUSIVE_AREA_35, ADC_EXCLUSIVE_AREA_36, ADC_EXCLUSIVE_AREA_37, ADC_EXCLUSIVE_AREA_38, ADC_EXCLUSIVE_AREA_39, ADC_EXCLUSIVE_AREA_40, ADC_EXCLUSIVE_AREA_41, ADC_EXCLUSIVE_AREA_45, ADC_EXCLUSIVE_AREA_47, ADC_EXCLUSIVE_AREA_48], implemented-entry=Adc_ReadGroup
        Adc_ReadRawData: implemented-entry=Adc_ReadRawData
        Adc_SelfTest: implemented-entry=Adc_SelfTest
        Adc_SetChannel: implemented-entry=Adc_SetChannel
        Adc_SetClockMode: can-enter-exclusive-area=[ADC_EXCLUSIVE_AREA_11, ADC_EXCLUSIVE_AREA_14, ADC_EXCLUSIVE_AREA_28], implemented-entry=Adc_SetClockMode
        Adc_SetHwUnitPowerMode: implemented-entry=Adc_SetHwUnitPowerMode
        Adc_SetPowerState: implemented-entry=Adc_SetPowerState
        Adc_SetupResultBuffer: implemented-entry=Adc_SetupResultBuffer
        Adc_StartGroupConversion: can-enter-exclusive-area=[ADC_EXCLUSIVE_AREA_01, ADC_EXCLUSIVE_AREA_16, ADC_EXCLUSIVE_AREA_17, ADC_EXCLUSIVE_AREA_21, ADC_EXCLUSIVE_AREA_22, ADC_EXCLUSIVE_AREA_23, ADC_EXCLUSIVE_AREA_26, ADC_EXCLUSIVE_AREA_27, ADC_EXCLUSIVE_AREA_30, ADC_EXCLUSIVE_AREA_32, ADC_EXCLUSIVE_AREA_34, ADC_EXCLUSIVE_AREA_35, ADC_EXCLUSIVE_AREA_36, ADC_EXCLUSIVE_AREA_37, ADC_EXCLUSIVE_AREA_38, ADC_EXCLUSIVE_AREA_39, ADC_EXCLUSIVE_AREA_40, ADC_EXCLUSIVE_AREA_41, ADC_EXCLUSIVE_AREA_45, ADC_EXCLUSIVE_AREA_47, ADC_EXCLUSIVE_AREA_48], implemented-entry=Adc_StartGroupConversion
        Adc_StopGroupConversion: can-enter-exclusive-area=[ADC_EXCLUSIVE_AREA_00, ADC_EXCLUSIVE_AREA_02, ADC_EXCLUSIVE_AREA_16, ADC_EXCLUSIVE_AREA_17, ADC_EXCLUSIVE_AREA_21, ADC_EXCLUSIVE_AREA_22, ADC_EXCLUSIVE_AREA_23, ADC_EXCLUSIVE_AREA_26, ADC_EXCLUSIVE_AREA_27, ADC_EXCLUSIVE_AREA_30, ADC_EXCLUSIVE_AREA_32, ADC_EXCLUSIVE_AREA_34, ADC_EXCLUSIVE_AREA_35, ADC_EXCLUSIVE_AREA_36, ADC_EXCLUSIVE_AREA_37, ADC_EXCLUSIVE_AREA_38, ADC_EXCLUSIVE_AREA_39, ADC_EXCLUSIVE_AREA_40, ADC_EXCLUSIVE_AREA_41, ADC_EXCLUSIVE_AREA_45, ADC_EXCLUSIVE_AREA_47, ADC_EXCLUSIVE_AREA_48], implemented-entry=Adc_StopGroupConversion
        Adc_TempSenseCalculateTemp: implemented-entry=Adc_TempSenseCalculateTemp
        Adc_TempSenseGetTemp: implemented-entry=Adc_TempSenseGetTemp
        Adc_TempSenseSetPowerMode: implemented-entry=Adc_TempSenseSetPowerMode
      4 x bsw interrupt entity, all with interrupt-category=CAT-2, interrupt-source=Hardware:
        Adc_0_Isr: implemented-entry=Adc_0_Isr
        Adc_1_Isr: implemented-entry=Adc_1_Isr
        Pdb_0_Isr: implemented-entry=Pdb_0_Isr
        Pdb_1_Isr: implemented-entry=Pdb_1_Isr
package /AUTOSAR_Adc/BswModuleEntrys
  67 x bsw module entry, all with sw-service-impl-policy=STANDARD:
    Adc_Calibrate: service-id=0x29, is-reentrant=false, is-synchronous=true, call-type=REGULAR, execution-context=UNSPECIFIED
    Adc_ConfigureThreshold: service-id=0x2b, is-reentrant=false, is-synchronous=true, call-type=REGULAR, execution-context=UNSPECIFIED
    Adc_CtuDisableHwTrigger: service-id=0x35, is-reentrant=false, is-synchronous=true, call-type=REGULAR, execution-context=UNSPECIFIED
    Adc_CtuDisableNotification: service-id=0x3d, is-reentrant=false, is-synchronous=true, call-type=REGULAR, execution-context=UNSPECIFIED
    Adc_CtuEnableHwTrigger: service-id=0x34, is-reentrant=false, is-synchronous=true, call-type=REGULAR, execution-context=UNSPECIFIED
    Adc_CtuEnableNotification: service-id=0x3c, is-reentrant=false, is-synchronous=true, call-type=REGULAR, execution-context=UNSPECIFIED
    Adc_CtuMasterReload: service-id=0x41, is-reentrant=false, is-synchronous=true, call-type=REGULAR, execution-context=UNSPECIFIED
    Adc_CtuReadConvData: service-id=0x37, is-reentrant=false, is-synchronous=true, call-type=REGULAR, execution-context=UNSPECIFIED
    Adc_CtuReadConvResult: service-id=0x38, is-reentrant=false, is-synchronous=true, call-type=REGULAR, execution-context=UNSPECIFIED
    Adc_CtuReadFifoData: service-id=0x39, is-reentrant=false, is-synchronous=true, call-type=REGULAR, execution-context=UNSPECIFIED
    Adc_CtuReadFifoResult: service-id=0x3a, is-reentrant=false, is-synchronous=true, call-type=REGULAR, execution-context=UNSPECIFIED
    Adc_CtuSetFifoWatermark: service-id=0x3b, is-reentrant=false, is-synchronous=true, call-type=REGULAR, execution-context=UNSPECIFIED
    Adc_CtuSetList: service-id=0x3f, is-reentrant=false, is-synchronous=true, call-type=REGULAR, execution-context=UNSPECIFIED
    Adc_CtuSetListPointer: service-id=0x3e, is-reentrant=false, is-synchronous=true, call-type=REGULAR, execution-context=UNSPECIFIED
    Adc_CtuSetPowerMode: service-id=0x24, is-reentrant=false, is-synchronous=true, call-type=REGULAR, execution-context=UNSPECIFIED
    Adc_CtuSetTriggerAdcCmdAddress: service-id=0x2e, is-reentrant=false, is-synchronous=true, call-type=REGULAR, execution-context=UNSPECIFIED
    Adc_CtuSetTriggerCompare: service-id=0x2f, is-reentrant=false, is-synchronous=true, call-type=REGULAR, execution-context=UNSPECIFIED
    Adc_CtuSetTriggerEnable: service-id=0x2d, is-reentrant=false, is-synchronous=true, call-type=REGULAR, execution-context=UNSPECIFIED
    Adc_CtuStartConversion: service-id=0x36, is-reentrant=false, is-synchronous=true, call-type=REGULAR, execution-context=UNSPECIFIED
    Adc_CtuStopLoopConversions: service-id=0x40, is-reentrant=false, is-synchronous=true, call-type=REGULAR, execution-context=UNSPECIFIED
    Adc_CtuWriteTriggerEnableMask: service-id=0x2c, is-reentrant=false, is-synchronous=true, call-type=REGULAR, execution-context=UNSPECIFIED
    Adc_DeInit: service-id=0x01, is-reentrant=false, is-synchronous=true, call-type=REGULAR, execution-context=UNSPECIFIED
    Adc_DisableCTUTrigger: service-id=0x22, is-reentrant=false, is-synchronous=true, call-type=REGULAR, execution-context=UNSPECIFIED
    Adc_DisableChannel: service-id=0x27, is-reentrant=false, is-synchronous=true, call-type=REGULAR, execution-context=UNSPECIFIED
    Adc_DisableCtuControlMode: service-id=0x33, is-reentrant=false, is-synchronous=true, call-type=REGULAR, execution-context=UNSPECIFIED
    Adc_DisableGroupNotification: service-id=0x08, is-reentrant=true, is-synchronous=false, call-type=REGULAR, execution-context=UNSPECIFIED
    Adc_DisableHardwareTrigger: service-id=0x06, is-reentrant=true, is-synchronous=false, call-type=REGULAR, execution-context=UNSPECIFIED
    Adc_DisableWdgNotification: service-id=0x44, is-reentrant=false, is-synchronous=true, call-type=REGULAR, execution-context=UNSPECIFIED
    Adc_EnableCTUTrigger: service-id=0x21, is-reentrant=false, is-synchronous=true, call-type=REGULAR, execution-context=UNSPECIFIED
    Adc_EnableChannel: service-id=0x26, is-reentrant=false, is-synchronous=true, call-type=REGULAR, execution-context=UNSPECIFIED
    Adc_EnableCtuControlMode: service-id=0x32, is-reentrant=false, is-synchronous=true, call-type=REGULAR, execution-context=UNSPECIFIED
    Adc_EnableGroupNotification: service-id=0x07, is-reentrant=true, is-synchronous=false, call-type=REGULAR, execution-context=UNSPECIFIED
    Adc_EnableHardwareTrigger: service-id=0x05, is-reentrant=true, is-synchronous=false, call-type=REGULAR, execution-context=UNSPECIFIED
    Adc_EnableWdgNotification: service-id=0x43, is-reentrant=false, is-synchronous=true, call-type=REGULAR, execution-context=UNSPECIFIED
    Adc_GetCurrentPowerState: service-id=0x11, is-reentrant=false, is-synchronous=true, call-type=REGULAR, execution-context=UNSPECIFIED
    Adc_GetGroupStatus: service-id=0x09, is-reentrant=true, is-synchronous=true, call-type=REGULAR, execution-context=UNSPECIFIED
    Adc_GetInjectedConversionStatus: service-id=0x28, is-reentrant=false, is-synchronous=true, call-type=REGULAR, execution-context=UNSPECIFIED
    Adc_GetStreamLastPointer: service-id=0x0b, is-reentrant=true, is-synchronous=true, call-type=REGULAR, execution-context=UNSPECIFIED
    Adc_GetTargetPowerState: service-id=0x12, is-reentrant=false, is-synchronous=true, call-type=REGULAR, execution-context=UNSPECIFIED
    Adc_GetVersionInfo: service-id=0x0a, is-reentrant=true, is-synchronous=true, call-type=REGULAR, execution-context=UNSPECIFIED
    Adc_HwResultReadGroup: service-id=0x20, is-reentrant=false, is-synchronous=true, call-type=REGULAR, execution-context=UNSPECIFIED
    Adc_Init: service-id=0x00, is-reentrant=false, is-synchronous=true, call-type=REGULAR, execution-context=UNSPECIFIED
    Adc_Ip_ClearLatchedTriggers: service-id=0xf7, is-reentrant=false, is-synchronous=true, call-type=REGULAR, execution-context=UNSPECIFIED
    Adc_Ip_ClearTrigErrReg: service-id=0xf3, is-reentrant=false, is-synchronous=true, call-type=REGULAR, execution-context=UNSPECIFIED
    Adc_Ip_DisableChannelNotification: service-id=0xf4, is-reentrant=false, is-synchronous=true, call-type=REGULAR, execution-context=UNSPECIFIED
    Adc_Ip_EnableChannelNotification: service-id=0xf5, is-reentrant=false, is-synchronous=true, call-type=REGULAR, execution-context=UNSPECIFIED
    Adc_Ip_SetSoftwarePretrigger: service-id=0xf2, is-reentrant=false, is-synchronous=true, call-type=REGULAR, execution-context=UNSPECIFIED
    Adc_Ip_StartConversion: service-id=0xf6, is-reentrant=false, is-synchronous=true, call-type=REGULAR, execution-context=UNSPECIFIED
    Adc_Main_PowerTransitionManager: service-id=0x14, is-reentrant=false, is-synchronous=true, call-type=REGULAR, execution-context=UNSPECIFIED
    Adc_PreparePowerState: service-id=0x13, is-reentrant=false, is-synchronous=true, call-type=REGULAR, execution-context=UNSPECIFIED
    Adc_ReadGroup: service-id=0x04, is-reentrant=true, is-synchronous=true, call-type=REGULAR, execution-context=UNSPECIFIED
    Adc_ReadRawData: service-id=0x42, is-reentrant=false, is-synchronous=true, call-type=REGULAR, execution-context=UNSPECIFIED
    Adc_SelfTest: service-id=0x2a, is-reentrant=false, is-synchronous=true, call-type=REGULAR, execution-context=UNSPECIFIED
    Adc_SetChannel: service-id=0x30, is-reentrant=false, is-synchronous=true, call-type=REGULAR, execution-context=UNSPECIFIED
    Adc_SetClockMode: service-id=0x25, is-reentrant=false, is-synchronous=true, call-type=REGULAR, execution-context=UNSPECIFIED
    Adc_SetHwUnitPowerMode: service-id=0x23, is-reentrant=false, is-synchronous=true, call-type=REGULAR, execution-context=UNSPECIFIED
    Adc_SetPowerState: service-id=0x10, is-reentrant=false, is-synchronous=true, call-type=REGULAR, execution-context=UNSPECIFIED
    Adc_SetupResultBuffer: service-id=0x0c, is-reentrant=true, is-synchronous=false, call-type=REGULAR, execution-context=UNSPECIFIED
    Adc_StartGroupConversion: service-id=0x02, is-reentrant=true, is-synchronous=false, call-type=REGULAR, execution-context=UNSPECIFIED
    Adc_StopGroupConversion: service-id=0x03, is-reentrant=true, is-synchronous=true, call-type=REGULAR, execution-context=UNSPECIFIED
    Adc_TempSenseCalculateTemp: service-id=0x4a, is-reentrant=false, is-synchronous=true, call-type=REGULAR, execution-context=UNSPECIFIED
    Adc_TempSenseGetTemp: service-id=0x4b, is-reentrant=false, is-synchronous=true, call-type=REGULAR, execution-context=UNSPECIFIED
    Adc_TempSenseSetPowerMode: service-id=0x4c, is-reentrant=false, is-synchronous=true, call-type=REGULAR, execution-context=UNSPECIFIED
    Adc_0_Isr: service-id=0, is-reentrant=false, is-synchronous=true, call-type=INTERRUPT, execution-context=INTERRUPT-CAT-2
    Adc_1_Isr: service-id=0, is-reentrant=false, is-synchronous=true, call-type=INTERRUPT, execution-context=INTERRUPT-CAT-2
    Pdb_0_Isr: service-id=0, is-reentrant=false, is-synchronous=true, call-type=INTERRUPT, execution-context=INTERRUPT-CAT-2
    Pdb_1_Isr: service-id=0, is-reentrant=false, is-synchronous=true, call-type=INTERRUPT, execution-context=INTERRUPT-CAT-2
package /Adc_TS_T40D2M10I1R0/Implementations
  bsw implementation BswImplementation_0: programming-language=C, sw-version=1.0.1, vendor-id=43, ar-release-version=4.4.0, behavior=InternalBehavior_0, vendor-specific-module-def=Adc
    code-descriptors:
      code Files
        artifact-descriptors:
          short-label=config::Adc.xdm, category=SWCFG
          short-label=doc::RTD_ADC_IM.pdf, category=SWDOC
          short-label=doc::RTD_ADC_UM.pdf, category=SWDOC
          short-label=examples::EBT::Adc_example_S32K118::generate::epc::Adc.xdm, category=SWCFG
          short-label=examples::EBT::Adc_example_S32K118::generate::epc::Base.xdm, category=SWCFG
          short-label=examples::EBT::Adc_example_S32K118::generate::epc::Dem.xdm, category=SWCFG
          short-label=examples::EBT::Adc_example_S32K118::generate::epc::EcuC.xdm, category=SWCFG
          short-label=examples::EBT::Adc_example_S32K118::generate::epc::Mcu.xdm, category=SWCFG
          short-label=examples::EBT::Adc_example_S32K118::generate::epc::Os.xdm, category=SWCFG
          short-label=examples::EBT::Adc_example_S32K118::generate::epc::Platform.xdm, category=SWCFG
          short-label=examples::EBT::Adc_example_S32K118::generate::epc::Resource.xdm, category=SWCFG
          short-label=examples::EBT::Adc_example_S32K118::include::check_example.h, category=SWHDR
          short-label=examples::EBT::Adc_example_S32K118::src::main.c, category=SWSRC
          short-label=examples::EBT::Adc_example_S32K118::TresosProject::Adc_example_S32K118::.prefs::preferences.xdm, category=SWCFG
          short-label=examples::EBT::Adc_example_S32K118::TresosProject::Adc_example_S32K118::config::Adc.xdm, category=SWCFG
          short-label=examples::EBT::Adc_example_S32K118::TresosProject::Adc_example_S32K118::config::Base.xdm, category=SWCFG
          short-label=examples::EBT::Adc_example_S32K118::TresosProject::Adc_example_S32K118::config::Dem.xdm, category=SWCFG
          short-label=examples::EBT::Adc_example_S32K118::TresosProject::Adc_example_S32K118::config::EcuC.xdm, category=SWCFG
          short-label=examples::EBT::Adc_example_S32K118::TresosProject::Adc_example_S32K118::config::Mcu.xdm, category=SWCFG
          short-label=examples::EBT::Adc_example_S32K118::TresosProject::Adc_example_S32K118::config::Os.xdm, category=SWCFG
          short-label=examples::EBT::Adc_example_S32K118::TresosProject::Adc_example_S32K118::config::Platform.xdm, category=SWCFG
          short-label=examples::EBT::Adc_example_S32K118::TresosProject::Adc_example_S32K118::config::Resource.xdm, category=SWCFG
          short-label=examples::EBT::Adc_example_S32K144::generate::epc::Adc.xdm, category=SWCFG
          short-label=examples::EBT::Adc_example_S32K144::generate::epc::Base.xdm, category=SWCFG
          short-label=examples::EBT::Adc_example_S32K144::generate::epc::Dem.xdm, category=SWCFG
          short-label=examples::EBT::Adc_example_S32K144::generate::epc::EcuC.xdm, category=SWCFG
          short-label=examples::EBT::Adc_example_S32K144::generate::epc::Mcl.xdm, category=SWCFG
          short-label=examples::EBT::Adc_example_S32K144::generate::epc::Mcu.xdm, category=SWCFG
          short-label=examples::EBT::Adc_example_S32K144::generate::epc::Os.xdm, category=SWCFG
          short-label=examples::EBT::Adc_example_S32K144::generate::epc::Platform.xdm, category=SWCFG
          short-label=examples::EBT::Adc_example_S32K144::generate::epc::Resource.xdm, category=SWCFG
          short-label=examples::EBT::Adc_example_S32K144::include::check_example.h, category=SWHDR
          short-label=examples::EBT::Adc_example_S32K144::src::main.c, category=SWSRC
          short-label=examples::EBT::Adc_example_S32K144::TresosProject::Adc_example_S32K144::.prefs::preferences.xdm, category=SWCFG
          short-label=examples::EBT::Adc_example_S32K144::TresosProject::Adc_example_S32K144::config::Adc.xdm, category=SWCFG
          short-label=examples::EBT::Adc_example_S32K144::TresosProject::Adc_example_S32K144::config::Base.xdm, category=SWCFG
          short-label=examples::EBT::Adc_example_S32K144::TresosProject::Adc_example_S32K144::config::Dem.xdm, category=SWCFG
          short-label=examples::EBT::Adc_example_S32K144::TresosProject::Adc_example_S32K144::config::EcuC.xdm, category=SWCFG
          short-label=examples::EBT::Adc_example_S32K144::TresosProject::Adc_example_S32K144::config::Mcl.xdm, category=SWCFG
          short-label=examples::EBT::Adc_example_S32K144::TresosProject::Adc_example_S32K144::config::Mcu.xdm, category=SWCFG
          short-label=examples::EBT::Adc_example_S32K144::TresosProject::Adc_example_S32K144::config::Os.xdm, category=SWCFG
          short-label=examples::EBT::Adc_example_S32K144::TresosProject::Adc_example_S32K144::config::Platform.xdm, category=SWCFG
          short-label=examples::EBT::Adc_example_S32K144::TresosProject::Adc_example_S32K144::config::Resource.xdm, category=SWCFG
          short-label=examples::EBT::Adc_example_S32K144W::generate::epc::Adc.xdm, category=SWCFG
          short-label=examples::EBT::Adc_example_S32K144W::generate::epc::Base.xdm, category=SWCFG
          short-label=examples::EBT::Adc_example_S32K144W::generate::epc::Dem.xdm, category=SWCFG
          short-label=examples::EBT::Adc_example_S32K144W::generate::epc::EcuC.xdm, category=SWCFG
          short-label=examples::EBT::Adc_example_S32K144W::generate::epc::Mcl.xdm, category=SWCFG
          short-label=examples::EBT::Adc_example_S32K144W::generate::epc::Mcu.xdm, category=SWCFG
          short-label=examples::EBT::Adc_example_S32K144W::generate::epc::Os.xdm, category=SWCFG
          short-label=examples::EBT::Adc_example_S32K144W::generate::epc::Platform.xdm, category=SWCFG
          short-label=examples::EBT::Adc_example_S32K144W::generate::epc::Resource.xdm, category=SWCFG
          short-label=examples::EBT::Adc_example_S32K144W::include::check_example.h, category=SWHDR
          short-label=examples::EBT::Adc_example_S32K144W::src::main.c, category=SWSRC
          short-label=examples::EBT::Adc_example_S32K144W::TresosProject::Adc_example_S32K144W::.prefs::preferences.xdm, category=SWCFG
          short-label=examples::EBT::Adc_example_S32K144W::TresosProject::Adc_example_S32K144W::config::Adc.xdm, category=SWCFG
          short-label=examples::EBT::Adc_example_S32K144W::TresosProject::Adc_example_S32K144W::config::Base.xdm, category=SWCFG
          short-label=examples::EBT::Adc_example_S32K144W::TresosProject::Adc_example_S32K144W::config::Dem.xdm, category=SWCFG
          short-label=examples::EBT::Adc_example_S32K144W::TresosProject::Adc_example_S32K144W::config::EcuC.xdm, category=SWCFG
          short-label=examples::EBT::Adc_example_S32K144W::TresosProject::Adc_example_S32K144W::config::Mcl.xdm, category=SWCFG
          short-label=examples::EBT::Adc_example_S32K144W::TresosProject::Adc_example_S32K144W::config::Mcu.xdm, category=SWCFG
          short-label=examples::EBT::Adc_example_S32K144W::TresosProject::Adc_example_S32K144W::config::Os.xdm, category=SWCFG
          short-label=examples::EBT::Adc_example_S32K144W::TresosProject::Adc_example_S32K144W::config::Platform.xdm, category=SWCFG
          short-label=examples::EBT::Adc_example_S32K144W::TresosProject::Adc_example_S32K144W::config::Resource.xdm, category=SWCFG
          short-label=examples::EBT::Adc_example_S32K148::generate::epc::Adc.xdm, category=SWCFG
          short-label=examples::EBT::Adc_example_S32K148::generate::epc::Base.xdm, category=SWCFG
          short-label=examples::EBT::Adc_example_S32K148::generate::epc::Dem.xdm, category=SWCFG
          short-label=examples::EBT::Adc_example_S32K148::generate::epc::EcuC.xdm, category=SWCFG
          short-label=examples::EBT::Adc_example_S32K148::generate::epc::Mcl.xdm, category=SWCFG
          short-label=examples::EBT::Adc_example_S32K148::generate::epc::Mcu.xdm, category=SWCFG
          short-label=examples::EBT::Adc_example_S32K148::generate::epc::Os.xdm, category=SWCFG
          short-label=examples::EBT::Adc_example_S32K148::generate::epc::Platform.xdm, category=SWCFG
          short-label=examples::EBT::Adc_example_S32K148::generate::epc::Resource.xdm, category=SWCFG
          short-label=examples::EBT::Adc_example_S32K148::include::check_example.h, category=SWHDR
          short-label=examples::EBT::Adc_example_S32K148::src::main.c, category=SWSRC
          short-label=examples::EBT::Adc_example_S32K148::TresosProject::Adc_example_S32K148::.prefs::preferences.xdm, category=SWCFG
          short-label=examples::EBT::Adc_example_S32K148::TresosProject::Adc_example_S32K148::config::Adc.xdm, category=SWCFG
          short-label=examples::EBT::Adc_example_S32K148::TresosProject::Adc_example_S32K148::config::Base.xdm, category=SWCFG
          short-label=examples::EBT::Adc_example_S32K148::TresosProject::Adc_example_S32K148::config::Dem.xdm, category=SWCFG
          short-label=examples::EBT::Adc_example_S32K148::TresosProject::Adc_example_S32K148::config::EcuC.xdm, category=SWCFG
          short-label=examples::EBT::Adc_example_S32K148::TresosProject::Adc_example_S32K148::config::Mcl.xdm, category=SWCFG
          short-label=examples::EBT::Adc_example_S32K148::TresosProject::Adc_example_S32K148::config::Mcu.xdm, category=SWCFG
          short-label=examples::EBT::Adc_example_S32K148::TresosProject::Adc_example_S32K148::config::Os.xdm, category=SWCFG
          short-label=examples::EBT::Adc_example_S32K148::TresosProject::Adc_example_S32K148::config::Platform.xdm, category=SWCFG
          short-label=examples::EBT::Adc_example_S32K148::TresosProject::Adc_example_S32K148::config::Resource.xdm, category=SWCFG
          short-label=examples::S32DS::Adc_example_S32K118::include::check_example.h, category=SWHDR
          short-label=examples::S32DS::Adc_example_S32K118::Project_Settings::Startup_Code::exceptions.c, category=SWSRC
          short-label=examples::S32DS::Adc_example_S32K118::Project_Settings::Startup_Code::nvic.c, category=SWSRC
          short-label=examples::S32DS::Adc_example_S32K118::Project_Settings::Startup_Code::startup.c, category=SWSRC
          short-label=examples::S32DS::Adc_example_S32K118::Project_Settings::Startup_Code::system.c, category=SWSRC
          short-label=examples::S32DS::Adc_example_S32K118::src::main.c, category=SWSRC
          short-label=examples::S32DS::Adc_example_S32K144::include::check_example.h, category=SWHDR
          short-label=examples::S32DS::Adc_example_S32K144::Project_Settings::Startup_Code::exceptions.c, category=SWSRC
          short-label=examples::S32DS::Adc_example_S32K144::Project_Settings::Startup_Code::nvic.c, category=SWSRC
          short-label=examples::S32DS::Adc_example_S32K144::Project_Settings::Startup_Code::startup.c, category=SWSRC
          short-label=examples::S32DS::Adc_example_S32K144::Project_Settings::Startup_Code::system.c, category=SWSRC
          short-label=examples::S32DS::Adc_example_S32K144::src::main.c, category=SWSRC
          short-label=examples::S32DS::Adc_example_S32K144W::include::check_example.h, category=SWHDR
          short-label=examples::S32DS::Adc_example_S32K144W::Project_Settings::Startup_Code::exceptions.c, category=SWSRC
          short-label=examples::S32DS::Adc_example_S32K144W::Project_Settings::Startup_Code::nvic.c, category=SWSRC
          short-label=examples::S32DS::Adc_example_S32K144W::Project_Settings::Startup_Code::startup.c, category=SWSRC
          short-label=examples::S32DS::Adc_example_S32K144W::Project_Settings::Startup_Code::system.c, category=SWSRC
          short-label=examples::S32DS::Adc_example_S32K144W::src::main.c, category=SWSRC
          short-label=examples::S32DS::Adc_example_S32K148::include::check_example.h, category=SWHDR
          short-label=examples::S32DS::Adc_example_S32K148::Project_Settings::Startup_Code::exceptions.c, category=SWSRC
          short-label=examples::S32DS::Adc_example_S32K148::Project_Settings::Startup_Code::nvic.c, category=SWSRC
          short-label=examples::S32DS::Adc_example_S32K148::Project_Settings::Startup_Code::startup.c, category=SWSRC
          short-label=examples::S32DS::Adc_example_S32K148::Project_Settings::Startup_Code::system.c, category=SWSRC
          short-label=examples::S32DS::Adc_example_S32K148::src::main.c, category=SWSRC
          short-label=examples::S32DS::Adc_Pdb_Ip_example_S32K118::include::check_example.h, category=SWHDR
          short-label=examples::S32DS::Adc_Pdb_Ip_example_S32K118::Project_Settings::Startup_Code::exceptions.c, category=SWSRC
          short-label=examples::S32DS::Adc_Pdb_Ip_example_S32K118::Project_Settings::Startup_Code::nvic.c, category=SWSRC
          short-label=examples::S32DS::Adc_Pdb_Ip_example_S32K118::Project_Settings::Startup_Code::startup.c, category=SWSRC
          short-label=examples::S32DS::Adc_Pdb_Ip_example_S32K118::Project_Settings::Startup_Code::system.c, category=SWSRC
          short-label=examples::S32DS::Adc_Pdb_Ip_example_S32K118::src::main.c, category=SWSRC
          short-label=examples::S32DS::Adc_Pdb_Ip_example_S32K144::include::check_example.h, category=SWHDR
          short-label=examples::S32DS::Adc_Pdb_Ip_example_S32K144::Project_Settings::Startup_Code::exceptions.c, category=SWSRC
          short-label=examples::S32DS::Adc_Pdb_Ip_example_S32K144::Project_Settings::Startup_Code::nvic.c, category=SWSRC
          short-label=examples::S32DS::Adc_Pdb_Ip_example_S32K144::Project_Settings::Startup_Code::startup.c, category=SWSRC
          short-label=examples::S32DS::Adc_Pdb_Ip_example_S32K144::Project_Settings::Startup_Code::system.c, category=SWSRC
          short-label=examples::S32DS::Adc_Pdb_Ip_example_S32K144::src::main.c, category=SWSRC
          short-label=examples::S32DS::Adc_Pdb_Ip_example_S32K144W::include::check_example.h, category=SWHDR
          short-label=examples::S32DS::Adc_Pdb_Ip_example_S32K144W::Project_Settings::Startup_Code::exceptions.c, category=SWSRC
          short-label=examples::S32DS::Adc_Pdb_Ip_example_S32K144W::Project_Settings::Startup_Code::nvic.c, category=SWSRC
          short-label=examples::S32DS::Adc_Pdb_Ip_example_S32K144W::Project_Settings::Startup_Code::startup.c, category=SWSRC
          short-label=examples::S32DS::Adc_Pdb_Ip_example_S32K144W::Project_Settings::Startup_Code::system.c, category=SWSRC
          short-label=examples::S32DS::Adc_Pdb_Ip_example_S32K144W::src::main.c, category=SWSRC
          short-label=examples::S32DS::Adc_Pdb_Ip_example_S32K148::include::check_example.h, category=SWHDR
          short-label=examples::S32DS::Adc_Pdb_Ip_example_S32K148::Project_Settings::Startup_Code::exceptions.c, category=SWSRC
          short-label=examples::S32DS::Adc_Pdb_Ip_example_S32K148::Project_Settings::Startup_Code::nvic.c, category=SWSRC
          short-label=examples::S32DS::Adc_Pdb_Ip_example_S32K148::Project_Settings::Startup_Code::startup.c, category=SWSRC
          short-label=examples::S32DS::Adc_Pdb_Ip_example_S32K148::Project_Settings::Startup_Code::system.c, category=SWSRC
          short-label=examples::S32DS::Adc_Pdb_Ip_example_S32K148::src::main.c, category=SWSRC
          short-label=include::Adc.h, category=SWHDR
          short-label=include::Adc_Ip.h, category=SWHDR
          short-label=include::Adc_Ipw.h, category=SWHDR
          short-label=include::Adc_Ipw_Irq.h, category=SWHDR
          short-label=include::Adc_Ipw_Types.h, category=SWHDR
          short-label=include::Adc_Ip_HeaderWrapper_S32K14x_Extended.h, category=SWHDR
          short-label=include::Adc_Ip_HeaderWrapper_S32K1xx.h, category=SWHDR
          short-label=include::Adc_Ip_HwAccess.h, category=SWHDR
          short-label=include::Adc_Ip_Irq.h, category=SWHDR
          short-label=include::Adc_Ip_TrustedFunctions.h, category=SWHDR
          short-label=include::Adc_Ip_Types.h, category=SWHDR
          short-label=include::Adc_Types.h, category=SWHDR
          short-label=include::Pdb_Adc_Ip.h, category=SWHDR
          short-label=include::Pdb_Adc_Ip_HwAccess.h, category=SWHDR
          short-label=include::Pdb_Adc_Ip_Irq.h, category=SWHDR
          short-label=include::Pdb_Adc_Ip_TrustedFunctions.h, category=SWHDR
          short-label=include::Pdb_Adc_Ip_Types.h, category=SWHDR
          short-label=src::Adc.c, category=SWSRC
          short-label=src::Adc_Ip.c, category=SWSRC
          short-label=src::Adc_Ipw.c, category=SWSRC
          short-label=src::Adc_Ipw_Irq.c, category=SWSRC
          short-label=src::Adc_Ip_Irq.c, category=SWSRC
          short-label=src::Pdb_Adc_Ip.c, category=SWSRC
          short-label=src::Pdb_Adc_Ip_Irq.c, category=SWSRC
    compiler GCC_Compiler:
      name=GCC Compiler
      options=-mcpu=cortex-m4 -mcpu=cortex-m0plus -mthumb -mlittle-endian -mfpu=fpv4-sp-d16 -mfloat-abi=hard -mfpu=auto -mfloat-abi=soft -std=c99 -Os -ggdb3 -Wall -Wextra -pedantic -Wstrict-prototypes -Wundef -Wunused -Werror=implicit-function-declaration -Wsign-compare -Wdouble-promotion -fno-short-enums -funsigned-char -funsigned-bitfields -fomit-frame-pointer -fno-common -fstack-usage -fdump-ipa-all -c -DS32K1XX -DS32K148 -DGCC -DUSE_SW_VECTOR_MODE -DI_CACHE_ENABLE -DENABLE_FPU -DMCAL_ENABLE_USER_MODE_SUPPORT
      vendor=GCC Systems
      version=NXP GCC 9.2.0 20190812 (Build 1649 Revision gaf57174)
    compiler GHS_Compiler:
      name=Green Hills
      options=-cpu=cortexm4 -cpu=cortexm0plus -thumb -fpu=vfpv4_d16 -fsingle -fsoft -C99 --ghstd=last -Osize --gnu_asm -dual_debug -G -keeptempfiles -Wimplicit-int -Wshadow -Wtrigraphs -Wundef --unsigned_chars --unsigned_fields --no_commons --no_exceptions --no_slash_comment --prototype_errors --incorrect_pragma_warnings -c -DS32K1XX -DS32K148 -DGHS -DUSE_SW_VECTOR_MODE -DI_CACHE_ENABLE -DENABLE_FPU -DMCAL_ENABLE_USER_MODE_SUPPORT
      vendor=Green Hills
      version=Green Hills Multi 7.1.6d / Compiler 2020.1.4
    compiler IAR_Compiler:
      name=IAR Compiler
      options=--cpu=Cortex-M4 --cpu=Cortex-M0+ --cpu_mode=thumb --endian=little --fpu=FPv4-SP --fpu=none -e -Ohz --debug --no_clustering --no_mem_idioms --no_explicit_zero_opt --require_prototypes --no_wrap_diagnostics --diag_suppress=Pa050 -DS32K1XX -DS32K148 -DIAR -DUSE_SW_VECTOR_MODE -DI_CACHE_ENABLE -DENABLE_FPU -DMCAL_ENABLE_USER_MODE_SUPPORT
      vendor=IAR Systems
      version=IAR ANSI C/C++ Compiler V8.40.3.228/W32 for ARM Functional Safety
    generated-artifacts:
      17 x dependency on artifact:
        Adc_Ipw_PBcfg_h: artifact-descriptor={short-label=generate_PB::include::Adc_Ipw_PBcfg.h, category=SWHDR}, usages=EXECUTE
        Adc_Ip_PBcfg_h: artifact-descriptor={short-label=generate_PB::include::Adc_Ip_PBcfg.h, category=SWHDR}, usages=EXECUTE
        Adc_PBcfg_h: artifact-descriptor={short-label=generate_PB::include::Adc_PBcfg.h, category=SWHDR}, usages=EXECUTE
        Pdb_Adc_Ip_PBcfg_h: artifact-descriptor={short-label=generate_PB::include::Pdb_Adc_Ip_PBcfg.h, category=SWHDR}, usages=EXECUTE
        Adc_Ipw_PBcfg_c: artifact-descriptor={short-label=generate_PB::src::Adc_Ipw_PBcfg.c, category=SWSRC}, usages=EXECUTE
        Adc_Ip_PBcfg_c: artifact-descriptor={short-label=generate_PB::src::Adc_Ip_PBcfg.c, category=SWSRC}, usages=EXECUTE
        Adc_PBcfg_c: artifact-descriptor={short-label=generate_PB::src::Adc_PBcfg.c, category=SWSRC}, usages=EXECUTE
        Pdb_Adc_Ip_PBcfg_c: artifact-descriptor={short-label=generate_PB::src::Pdb_Adc_Ip_PBcfg.c, category=SWSRC}, usages=EXECUTE
        Adc_Cfg_h: artifact-descriptor={short-label=generate_PC::include::Adc_Cfg.h, category=SWHDR}, usages=COMPILE
        Adc_CfgDefines_h: artifact-descriptor={short-label=generate_PC::include::Adc_CfgDefines.h, category=SWHDR}, usages=COMPILE
        Adc_Ipw_Cfg_h: artifact-descriptor={short-label=generate_PC::include::Adc_Ipw_Cfg.h, category=SWHDR}, usages=COMPILE
        Adc_Ipw_CfgDefines_h: artifact-descriptor={short-label=generate_PC::include::Adc_Ipw_CfgDefines.h, category=SWHDR}, usages=COMPILE
        Adc_Ip_Cfg_h: artifact-descriptor={short-label=generate_PC::include::Adc_Ip_Cfg.h, category=SWHDR}, usages=COMPILE
        Adc_Ip_CfgDefines_h: artifact-descriptor={short-label=generate_PC::include::Adc_Ip_CfgDefines.h, category=SWHDR}, usages=COMPILE
        Pdb_Adc_Ip_Cfg_h: artifact-descriptor={short-label=generate_PC::include::Pdb_Adc_Ip_Cfg.h, category=SWHDR}, usages=COMPILE
        Pdb_Adc_Ip_CfgDefines_h: artifact-descriptor={short-label=generate_PC::include::Pdb_Adc_Ip_CfgDefines.h, category=SWHDR}, usages=COMPILE
        Adc_Cfg_c: artifact-descriptor={short-label=generate_PC::src::Adc_Cfg.c, category=SWSRC}, usages=COMPILE
    linker GCC_Linker: name=GCC Compiler, options=-Wl,-Map,filename -T linkerfile --entry=Reset_Handler -nostartfiles -mcpu=cortex-m4 -mcpu=cortex-m0plus -mthumb -mfpu=fpv4-sp-d16 -mfloat-abi=hard -mfpu=auto -mfloat-abi=soft -mlittle-endian -ggdb3 -lc -lm -lgcc -n, vendor=GCC Systems, version=NXP GCC 9.2.0 20190812 (Build 1649 Revision gaf57174)
    linker GHS_Linker: name=Green Hills, options=-e Reset_Handler -T linker_script_file.ld -map -keepmap -Mn -delete -ignore_debug_references -Llibrary_path -larch -lstartup -lind_sd -lind_sf -v -keep=C40_Ip_AccessCode -nostartfiles, vendor=Green Hills, version=Green Hills Multi 7.1.6d / Compiler 2020.1.4
    linker IAR_Linker: name=IAR Compiler, options=--map filename --config linkerfile --cpu=Cortex-M4 --cpu=Cortex-M0+ --fpu=FPv4-SP --fpu=none --entry _start --enable_stack_usage --skip_dynamic_initialization --no_wrap_diagnostics, vendor=IAR Systems, version=IAR ANSI C/C++ Compiler V8.40.3.228/W32 for ARM Functional Safety
    resource consumption ResourceConsumption
      10 x memory section:
        ADC_CODE: alignment=UNSPECIFIED, sw-addrmethod=CODE, symbol=CODE
        ADC_CONFIG_DATA_16: alignment=16, sw-addrmethod=CONFIG_DATA, symbol=CONFIG_DATA_16
        ADC_CONFIG_DATA_8: alignment=8, sw-addrmethod=CONFIG_DATA, symbol=CONFIG_DATA_8
        ADC_CONFIG_DATA_UNSPECIFIED: alignment=UNSPECIFIED, sw-addrmethod=CONFIG_DATA, symbol=CONFIG_DATA_UNSPECIFIED
        ADC_CONST_UNSPECIFIED: alignment=UNSPECIFIED, sw-addrmethod=CONST, symbol=CONST_UNSPECIFIED
        ADC_VAR_CLEARED_16_NO_CACHEABLE: alignment=UNSPECIFIED, sw-addrmethod=VAR_CLEARED_16_NO, symbol=VAR_CLEARED_16_NO_CACHEABLE
        ADC_VAR_CLEARED_8: alignment=8, sw-addrmethod=VAR_CLEARED, symbol=VAR_CLEARED_8
        ADC_VAR_CLEARED_BOOLEAN: alignment=BOOLEAN, sw-addrmethod=VAR_CLEARED, symbol=VAR_CLEARED_BOOLEAN
        ADC_VAR_CLEARED_UNSPECIFIED: alignment=UNSPECIFIED, sw-addrmethod=VAR_CLEARED, symbol=VAR_CLEARED_UNSPECIFIED
        ADC_VAR_INIT_UNSPECIFIED_NO_CACHEABLE: alignment=UNSPECIFIED, sw-addrmethod=VAR_INIT, symbol=VAR_INIT_UNSPECIFIED_NO_CACHEABLE
