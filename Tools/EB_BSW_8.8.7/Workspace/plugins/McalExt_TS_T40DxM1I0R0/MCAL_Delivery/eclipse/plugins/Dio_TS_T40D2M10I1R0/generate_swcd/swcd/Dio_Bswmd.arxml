AUTOSAR XML (schema 00046)
package /AUTOSAR_Dio/BswModuleDescriptions
  bsw module description Dio: module-id=120
    provided-entrys:
      Dio_FlipChannel
      Dio_GetVersionInfo
      Dio_MaskedWritePort
      Dio_ReadChannel
      Dio_ReadChannelGroup
      Dio_ReadPort
      Dio_WriteChannel
      Dio_WriteChannelGroup
      Dio_WritePort
    bsw internal behavior InternalBehavior_0
      9 x bsw called entity:
        Dio_FlipChannel: implemented-entry=Dio_FlipChannel
        Dio_GetVersionInfo: implemented-entry=Dio_GetVersionInfo
        Dio_MaskedWritePort: implemented-entry=Dio_MaskedWritePort
        Dio_ReadChannel: implemented-entry=Dio_ReadChannel
        Dio_ReadChannelGroup: implemented-entry=Dio_ReadChannelGroup
        Dio_ReadPort: implemented-entry=Dio_ReadPort
        Dio_WriteChannel: implemented-entry=Dio_WriteChannel
        Dio_WriteChannelGroup: implemented-entry=Dio_WriteChannelGroup
        Dio_WritePort: implemented-entry=Dio_WritePort
package /AUTOSAR_Dio/BswModuleEntrys
  9 x bsw module entry, all with is-reentrant=true, is-synchronous=true, call-type=REGULAR, execution-context=UNSPECIFIED, sw-service-impl-policy=STANDARD:
    Dio_FlipChannel: service-id=0x11
    Dio_GetVersionInfo: service-id=0x12
    Dio_MaskedWritePort: service-id=0x13
    Dio_ReadChannel: service-id=0x00
    Dio_ReadChannelGroup: service-id=0x04
    Dio_ReadPort: service-id=0x02
    Dio_WriteChannel: service-id=0x01
    Dio_WriteChannelGroup: service-id=0x05
    Dio_WritePort: service-id=0x03
package /Dio_TS_T40D2M10I1R0/Implementations
  bsw implementation BswImplementation_0: programming-language=C, sw-version=1.0.1, vendor-id=43, ar-release-version=4.4.0, behavior=InternalBehavior_0, vendor-specific-module-def=Dio
    code-descriptors:
      code Files
        artifact-descriptors:
          short-label=config::Dio.xdm, category=SWCFG
          short-label=doc::RTD_DIO_IM.pdf, category=SWDOC
          short-label=doc::RTD_DIO_UM.pdf, category=SWDOC
          short-label=examples::EBT::Dio_Example_S32K118::generate::epc::Base.xdm, category=SWCFG
          short-label=examples::EBT::Dio_Example_S32K118::generate::epc::Dem.xdm, category=SWCFG
          short-label=examples::EBT::Dio_Example_S32K118::generate::epc::Dio.xdm, category=SWCFG
          short-label=examples::EBT::Dio_Example_S32K118::generate::epc::Mcu.xdm, category=SWCFG
          short-label=examples::EBT::Dio_Example_S32K118::generate::epc::Os.xdm, category=SWCFG
          short-label=examples::EBT::Dio_Example_S32K118::generate::epc::Port.xdm, category=SWCFG
          short-label=examples::EBT::Dio_Example_S32K118::generate::epc::Resource.xdm, category=SWCFG
          short-label=examples::EBT::Dio_Example_S32K118::include::check_example.h, category=SWHDR
          short-label=examples::EBT::Dio_Example_S32K118::src::main.c, category=SWSRC
          short-label=examples::EBT::Dio_Example_S32K118::TresosProject::Dio_Example_S32K118::.prefs::preferences.xdm, category=SWCFG
          short-label=examples::EBT::Dio_Example_S32K118::TresosProject::Dio_Example_S32K118::config::Base.xdm, category=SWCFG
          short-label=examples::EBT::Dio_Example_S32K118::TresosProject::Dio_Example_S32K118::config::Dem.xdm, category=SWCFG
          short-label=examples::EBT::Dio_Example_S32K118::TresosProject::Dio_Example_S32K118::config::Dio.xdm, category=SWCFG
          short-label=examples::EBT::Dio_Example_S32K118::TresosProject::Dio_Example_S32K118::config::EcuC.xdm, category=SWCFG
          short-label=examples::EBT::Dio_Example_S32K118::TresosProject::Dio_Example_S32K118::config::Mcu.xdm, category=SWCFG
          short-label=examples::EBT::Dio_Example_S32K118::TresosProject::Dio_Example_S32K118::config::Os.xdm, category=SWCFG
          short-label=examples::EBT::Dio_Example_S32K118::TresosProject::Dio_Example_S32K118::config::Port.xdm, category=SWCFG
          short-label=examples::EBT::Dio_Example_S32K118::TresosProject::Dio_Example_S32K118::config::Resource.xdm, category=SWCFG
          short-label=examples::EBT::Dio_Example_S32K144::generate::epc::Base.xdm, category=SWCFG
          short-label=examples::EBT::Dio_Example_S32K144::generate::epc::Dem.xdm, category=SWCFG
          short-label=examples::EBT::Dio_Example_S32K144::generate::epc::Dio.xdm, category=SWCFG
          short-label=examples::EBT::Dio_Example_S32K144::generate::epc::Mcu.xdm, category=SWCFG
          short-label=examples::EBT::Dio_Example_S32K144::generate::epc::Os.xdm, category=SWCFG
          short-label=examples::EBT::Dio_Example_S32K144::generate::epc::Port.xdm, category=SWCFG
          short-label=examples::EBT::Dio_Example_S32K144::generate::epc::Resource.xdm, category=SWCFG
          short-label=examples::EBT::Dio_Example_S32K144::include::check_example.h, category=SWHDR
          short-label=examples::EBT::Dio_Example_S32K144::src::main.c, category=SWSRC
          short-label=examples::EBT::Dio_Example_S32K144::TresosProject::Dio_Example_S32K144::.prefs::preferences.xdm, category=SWCFG
          short-label=examples::EBT::Dio_Example_S32K144::TresosProject::Dio_Example_S32K144::config::Base.xdm, category=SWCFG
          short-label=examples::EBT::Dio_Example_S32K144::TresosProject::Dio_Example_S32K144::config::Dem.xdm, category=SWCFG
          short-label=examples::EBT::Dio_Example_S32K144::TresosProject::Dio_Example_S32K144::config::Dio.xdm, category=SWCFG
          short-label=examples::EBT::Dio_Example_S32K144::TresosProject::Dio_Example_S32K144::config::EcuC.xdm, category=SWCFG
          short-label=examples::EBT::Dio_Example_S32K144::TresosProject::Dio_Example_S32K144::config::Mcu.xdm, category=SWCFG
          short-label=examples::EBT::Dio_Example_S32K144::TresosProject::Dio_Example_S32K144::config::Os.xdm, category=SWCFG
          short-label=examples::EBT::Dio_Example_S32K144::TresosProject::Dio_Example_S32K144::config::Port.xdm, category=SWCFG
          short-label=examples::EBT::Dio_Example_S32K144::TresosProject::Dio_Example_S32K144::config::Resource.xdm, category=SWCFG
          short-label=examples::EBT::Dio_Example_S32K144W::generate::epc::Base.xdm, category=SWCFG
          short-label=examples::EBT::Dio_Example_S32K144W::generate::epc::Dem.xdm, category=SWCFG
          short-label=examples::EBT::Dio_Example_S32K144W::generate::epc::Dio.xdm, category=SWCFG
          short-label=examples::EBT::Dio_Example_S32K144W::generate::epc::Mcu.xdm, category=SWCFG
          short-label=examples::EBT::Dio_Example_S32K144W::generate::epc::Os.xdm, category=SWCFG
          short-label=examples::EBT::Dio_Example_S32K144W::generate::epc::Port.xdm, category=SWCFG
          short-label=examples::EBT::Dio_Example_S32K144W::generate::epc::Resource.xdm, category=SWCFG
          short-label=examples::EBT::Dio_Example_S32K144W::include::check_example.h, category=SWHDR
          short-label=examples::EBT::Dio_Example_S32K144W::src::main.c, category=SWSRC
          short-label=examples::EBT::Dio_Example_S32K144W::TresosProject::Dio_Example_S32K144W::.prefs::preferences.xdm, category=SWCFG
          short-label=examples::EBT::Dio_Example_S32K144W::TresosProject::Dio_Example_S32K144W::config::Base.xdm, category=SWCFG
          short-label=examples::EBT::Dio_Example_S32K144W::TresosProject::Dio_Example_S32K144W::config::Dem.xdm, category=SWCFG
          short-label=examples::EBT::Dio_Example_S32K144W::TresosProject::Dio_Example_S32K144W::config::Dio.xdm, category=SWCFG
          short-label=examples::EBT::Dio_Example_S32K144W::TresosProject::Dio_Example_S32K144W::config::EcuC.xdm, category=SWCFG
          short-label=examples::EBT::Dio_Example_S32K144W::TresosProject::Dio_Example_S32K144W::config::Mcu.xdm, category=SWCFG
          short-label=examples::EBT::Dio_Example_S32K144W::TresosProject::Dio_Example_S32K144W::config::Os.xdm, category=SWCFG
          short-label=examples::EBT::Dio_Example_S32K144W::TresosProject::Dio_Example_S32K144W::config::Port.xdm, category=SWCFG
          short-label=examples::EBT::Dio_Example_S32K144W::TresosProject::Dio_Example_S32K144W::config::Resource.xdm, category=SWCFG
          short-label=examples::EBT::Dio_Example_S32K148::generate::epc::Base.xdm, category=SWCFG
          short-label=examples::EBT::Dio_Example_S32K148::generate::epc::Dem.xdm, category=SWCFG
          short-label=examples::EBT::Dio_Example_S32K148::generate::epc::Dio.xdm, category=SWCFG
          short-label=examples::EBT::Dio_Example_S32K148::generate::epc::Mcu.xdm, category=SWCFG
          short-label=examples::EBT::Dio_Example_S32K148::generate::epc::Os.xdm, category=SWCFG
          short-label=examples::EBT::Dio_Example_S32K148::generate::epc::Port.xdm, category=SWCFG
          short-label=examples::EBT::Dio_Example_S32K148::generate::epc::Resource.xdm, category=SWCFG
          short-label=examples::EBT::Dio_Example_S32K148::include::check_example.h, category=SWHDR
          short-label=examples::EBT::Dio_Example_S32K148::src::main.c, category=SWSRC
          short-label=examples::EBT::Dio_Example_S32K148::TresosProject::Dio_Example_S32K148::.prefs::preferences.xdm, category=SWCFG
          short-label=examples::EBT::Dio_Example_S32K148::TresosProject::Dio_Example_S32K148::config::Base.xdm, category=SWCFG
          short-label=examples::EBT::Dio_Example_S32K148::TresosProject::Dio_Example_S32K148::config::Dem.xdm, category=SWCFG
          short-label=examples::EBT::Dio_Example_S32K148::TresosProject::Dio_Example_S32K148::config::Dio.xdm, category=SWCFG
          short-label=examples::EBT::Dio_Example_S32K148::TresosProject::Dio_Example_S32K148::config::EcuC.xdm, category=SWCFG
          short-label=examples::EBT::Dio_Example_S32K148::TresosProject::Dio_Example_S32K148::config::Mcu.xdm, category=SWCFG
          short-label=examples::EBT::Dio_Example_S32K148::TresosProject::Dio_Example_S32K148::config::Os.xdm, category=SWCFG
          short-label=examples::EBT::Dio_Example_S32K148::TresosProject::Dio_Example_S32K148::config::Port.xdm, category=SWCFG
          short-label=examples::EBT::Dio_Example_S32K148::TresosProject::Dio_Example_S32K148::config::Resource.xdm, category=SWCFG
          short-label=examples::S32DS::Dio_Example_S32K118::include::check_example.h, category=SWHDR
          short-label=examples::S32DS::Dio_Example_S32K118::Project_Settings::Startup_Code::exceptions.c, category=SWSRC
          short-label=examples::S32DS::Dio_Example_S32K118::Project_Settings::Startup_Code::nvic.c, category=SWSRC
          short-label=examples::S32DS::Dio_Example_S32K118::Project_Settings::Startup_Code::startup.c, category=SWSRC
          short-label=examples::S32DS::Dio_Example_S32K118::Project_Settings::Startup_Code::system.c, category=SWSRC
          short-label=examples::S32DS::Dio_Example_S32K118::src::main.c, category=SWSRC
          short-label=examples::S32DS::Dio_Example_S32K144::include::check_example.h, category=SWHDR
          short-label=examples::S32DS::Dio_Example_S32K144::Project_Settings::Startup_Code::exceptions.c, category=SWSRC
          short-label=examples::S32DS::Dio_Example_S32K144::Project_Settings::Startup_Code::nvic.c, category=SWSRC
          short-label=examples::S32DS::Dio_Example_S32K144::Project_Settings::Startup_Code::startup.c, category=SWSRC
          short-label=examples::S32DS::Dio_Example_S32K144::Project_Settings::Startup_Code::system.c, category=SWSRC
          short-label=examples::S32DS::Dio_Example_S32K144::src::main.c, category=SWSRC
          short-label=examples::S32DS::Dio_Example_S32K144W::include::check_example.h, category=SWHDR
          short-label=examples::S32DS::Dio_Example_S32K144W::Project_Settings::Startup_Code::exceptions.c, category=SWSRC
          short-label=examples::S32DS::Dio_Example_S32K144W::Project_Settings::Startup_Code::nvic.c, category=SWSRC
          short-label=examples::S32DS::Dio_Example_S32K144W::Project_Settings::Startup_Code::startup.c, category=SWSRC
          short-label=examples::S32DS::Dio_Example_S32K144W::Project_Settings::Startup_Code::system.c, category=SWSRC
          short-label=examples::S32DS::Dio_Example_S32K144W::src::main.c, category=SWSRC
          short-label=examples::S32DS::Dio_Example_S32K148::include::check_example.h, category=SWHDR
          short-label=examples::S32DS::Dio_Example_S32K148::Project_Settings::Startup_Code::exceptions.c, category=SWSRC
          short-label=examples::S32DS::Dio_Example_S32K148::Project_Settings::Startup_Code::nvic.c, category=SWSRC
          short-label=examples::S32DS::Dio_Example_S32K148::Project_Settings::Startup_Code::startup.c, category=SWSRC
          short-label=examples::S32DS::Dio_Example_S32K148::Project_Settings::Startup_Code::system.c, category=SWSRC
          short-label=examples::S32DS::Dio_Example_S32K148::src::main.c, category=SWSRC
          short-label=examples::S32DS::Gpio_Ip_Dio_Ip_Example_S32K118::include::check_example.h, category=SWHDR
          short-label=examples::S32DS::Gpio_Ip_Dio_Ip_Example_S32K118::Project_Settings::Startup_Code::exceptions.c, category=SWSRC
          short-label=examples::S32DS::Gpio_Ip_Dio_Ip_Example_S32K118::Project_Settings::Startup_Code::nvic.c, category=SWSRC
          short-label=examples::S32DS::Gpio_Ip_Dio_Ip_Example_S32K118::Project_Settings::Startup_Code::startup.c, category=SWSRC
          short-label=examples::S32DS::Gpio_Ip_Dio_Ip_Example_S32K118::Project_Settings::Startup_Code::system.c, category=SWSRC
          short-label=examples::S32DS::Gpio_Ip_Dio_Ip_Example_S32K118::src::main.c, category=SWSRC
          short-label=examples::S32DS::Gpio_Ip_Dio_Ip_Example_S32K144::include::check_example.h, category=SWHDR
          short-label=examples::S32DS::Gpio_Ip_Dio_Ip_Example_S32K144::Project_Settings::Startup_Code::exceptions.c, category=SWSRC
          short-label=examples::S32DS::Gpio_Ip_Dio_Ip_Example_S32K144::Project_Settings::Startup_Code::nvic.c, category=SWSRC
          short-label=examples::S32DS::Gpio_Ip_Dio_Ip_Example_S32K144::Project_Settings::Startup_Code::startup.c, category=SWSRC
          short-label=examples::S32DS::Gpio_Ip_Dio_Ip_Example_S32K144::Project_Settings::Startup_Code::system.c, category=SWSRC
          short-label=examples::S32DS::Gpio_Ip_Dio_Ip_Example_S32K144::src::main.c, category=SWSRC
          short-label=examples::S32DS::Gpio_Ip_Dio_Ip_Example_S32K144W::include::check_example.h, category=SWHDR
          short-label=examples::S32DS::Gpio_Ip_Dio_Ip_Example_S32K144W::Project_Settings::Startup_Code::exceptions.c, category=SWSRC
          short-label=examples::S32DS::Gpio_Ip_Dio_Ip_Example_S32K144W::Project_Settings::Startup_Code::nvic.c, category=SWSRC
          short-label=examples::S32DS::Gpio_Ip_Dio_Ip_Example_S32K144W::Project_Settings::Startup_Code::startup.c, category=SWSRC
          short-label=examples::S32DS::Gpio_Ip_Dio_Ip_Example_S32K144W::Project_Settings::Startup_Code::system.c, category=SWSRC
          short-label=examples::S32DS::Gpio_Ip_Dio_Ip_Example_S32K144W::src::main.c, category=SWSRC
          short-label=examples::S32DS::Gpio_Ip_Dio_Ip_Example_S32K148::include::check_example.h, category=SWHDR
          short-label=examples::S32DS::Gpio_Ip_Dio_Ip_Example_S32K148::Project_Settings::Startup_Code::exceptions.c, category=SWSRC
          short-label=examples::S32DS::Gpio_Ip_Dio_Ip_Example_S32K148::Project_Settings::Startup_Code::nvic.c, category=SWSRC
          short-label=examples::S32DS::Gpio_Ip_Dio_Ip_Example_S32K148::Project_Settings::Startup_Code::startup.c, category=SWSRC
          short-label=examples::S32DS::Gpio_Ip_Dio_Ip_Example_S32K148::Project_Settings::Startup_Code::system.c, category=SWSRC
          short-label=examples::S32DS::Gpio_Ip_Dio_Ip_Example_S32K148::src::main.c, category=SWSRC
          short-label=include::Dio.h, category=SWHDR
          short-label=include::Dio_Ipw.h, category=SWHDR
          short-label=include::Gpio_Dio_Ip.h, category=SWHDR
          short-label=src::Dio.c, category=SWSRC
          short-label=src::Dio_Ipw.c, category=SWSRC
          short-label=src::Gpio_Dio_Ip.c, category=SWSRC
    compiler GCC_Compiler:
      name=GCC Compiler
      options=-mcpu=cortex-m4 -mcpu=cortex-m0plus -mthumb -mlittle-endian -mfpu=fpv4-sp-d16 -mfloat-abi=hard -mfpu=auto -mfloat-abi=soft -std=c99 -Os -ggdb3 -Wall -Wextra -pedantic -Wstrict-prototypes -Wundef -Wunused -Werror=implicit-function-declaration -Wsign-compare -Wdouble-promotion -fno-short-enums -funsigned-char -funsigned-bitfields -fomit-frame-pointer -fno-common -fstack-usage -fdump-ipa-all -c -DS32K1XX -DS32K148 -DGCC -DUSE_SW_VECTOR_MODE -DI_CACHE_ENABLE -DENABLE_FPU -DMCAL_ENABLE_USER_MODE_SUPPORT
      vendor=GCC Systems
      version=NXP GCC 9.2.0 20190812 (Build 1649 Revision gaf57174)
    compiler GHS_Compiler:
      name=Green Hills
      options=-cpu=cortexm4 -cpu=cortexm0plus -thumb -fpu=vfpv4_d16 -fsingle -fsoft -C99 --ghstd=last -Osize --gnu_asm -dual_debug -G -keeptempfiles -Wimplicit-int -Wshadow -Wtrigraphs -Wundef --unsigned_chars --unsigned_fields --no_commons --no_exceptions --no_slash_comment --prototype_errors --incorrect_pragma_warnings -c -DS32K1XX -DS32K148 -DGHS -DUSE_SW_VECTOR_MODE -DI_CACHE_ENABLE -DENABLE_FPU -DMCAL_ENABLE_USER_MODE_SUPPORT
      vendor=Green Hills
      version=Green Hills Multi 7.1.6d / Compiler 2020.1.4
    compiler IAR_Compiler:
      name=IAR Compiler
      options=--cpu=Cortex-M4 --cpu=Cortex-M0+ --cpu_mode=thumb --endian=little --fpu=FPv4-SP --fpu=none -e -Ohz --debug --no_clustering --no_mem_idioms --no_explicit_zero_opt --require_prototypes --no_wrap_diagnostics --diag_suppress=Pa050 -DS32K1XX -DS32K148 -DIAR -DUSE_SW_VECTOR_MODE -DI_CACHE_ENABLE -DENABLE_FPU -DMCAL_ENABLE_USER_MODE_SUPPORT
      vendor=IAR Systems
      version=IAR ANSI C/C++ Compiler V8.40.3.228/W32 for ARM Functional Safety
    generated-artifacts:
      dependency on artifact Dio_Cfg_h: artifact-descriptor={short-label=generate_PC::include::Dio_Cfg.h, category=SWHDR}, usages=COMPILE
      dependency on artifact Gpio_Dio_Ip_Cfg_h: artifact-descriptor={short-label=generate_PC::include::Gpio_Dio_Ip_Cfg.h, category=SWHDR}, usages=COMPILE
      dependency on artifact Dio_Cfg_c: artifact-descriptor={short-label=generate_PC::src::Dio_Cfg.c, category=SWSRC}, usages=COMPILE
    linker GCC_Linker: name=GCC Compiler, options=-Wl,-Map,filename -T linkerfile --entry=Reset_Handler -nostartfiles -mcpu=cortex-m4 -mcpu=cortex-m0plus -mthumb -mfpu=fpv4-sp-d16 -mfloat-abi=hard -mfpu=auto -mfloat-abi=soft -mlittle-endian -ggdb3 -lc -lm -lgcc -n, vendor=GCC Systems, version=NXP GCC 9.2.0 20190812 (Build 1649 Revision gaf57174)
    linker GHS_Linker: name=Green Hills, options=-e Reset_Handler -T linker_script_file.ld -map -keepmap -Mn -delete -ignore_debug_references -Llibrary_path -larch -lstartup -lind_sd -lind_sf -v -keep=C40_Ip_AccessCode -nostartfiles, vendor=Green Hills, version=Green Hills Multi 7.1.6d / Compiler 2020.1.4
    linker IAR_Linker: name=IAR Compiler, options=--map filename --config linkerfile --cpu=Cortex-M4 --cpu=Cortex-M0+ --fpu=FPv4-SP --fpu=none --entry _start --enable_stack_usage --skip_dynamic_initialization --no_wrap_diagnostics, vendor=IAR Systems, version=IAR ANSI C/C++ Compiler V8.40.3.228/W32 for ARM Functional Safety
    resource consumption ResourceConsumption
      4 x memory section:
        DIO_CODE: alignment=UNSPECIFIED, sw-addrmethod=CODE, symbol=CODE
        DIO_CONFIG_DATA_UNSPECIFIED: alignment=UNSPECIFIED, sw-addrmethod=CONFIG_DATA, symbol=CONFIG_DATA_UNSPECIFIED
        DIO_CONST_32: alignment=32, sw-addrmethod=CONST, symbol=CONST_32
        DIO_VAR_INIT_32: alignment=32, sw-addrmethod=VAR_INIT, symbol=VAR_INIT_32
