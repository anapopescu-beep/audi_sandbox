AUTOSAR XML (schema 00046)
package /AUTOSAR_I2c/BswModuleDescriptions
  bsw module description I2c: module-id=255
    provided-entrys:
      I2c_AsyncTransmit
      I2c_DeInit
      I2c_GetStatus
      I2c_GetVersionInfo
      I2c_Init
      I2c_PrepareSlaveBuffer
      I2c_StartListening
      I2c_SyncTransmit
      LPI2C0_Master_IRQHandler
      LPI2C0_Master_Slave_IRQHandler
      LPI2C0_Slave_IRQHandler
      LPI2C1_Master_IRQHandler
      LPI2C1_Master_Slave_IRQHandler
      LPI2C1_Slave_IRQHandler
    bsw internal behavior InternalBehavior_0
      exclusive area I2C_EXCLUSIVE_AREA_00
      exclusive area I2C_EXCLUSIVE_AREA_01
      8 x bsw called entity:
        I2c_AsyncTransmit: can-enter-exclusive-area=I2C_EXCLUSIVE_AREA_01, implemented-entry=I2c_AsyncTransmit
        I2c_DeInit: implemented-entry=I2c_DeInit
        I2c_GetStatus: implemented-entry=I2c_GetStatus
        I2c_GetVersionInfo: implemented-entry=I2c_GetVersionInfo
        I2c_Init: implemented-entry=I2c_Init
        I2c_PrepareSlaveBuffer: implemented-entry=I2c_PrepareSlaveBuffer
        I2c_StartListening: implemented-entry=I2c_StartListening
        I2c_SyncTransmit: can-enter-exclusive-area=I2C_EXCLUSIVE_AREA_00, implemented-entry=I2c_SyncTransmit
      6 x bsw interrupt entity, all with interrupt-category=CAT-2, interrupt-source=Hardware:
        LPI2C0_Master_IRQHandler: implemented-entry=LPI2C0_Master_IRQHandler
        LPI2C0_Master_Slave_IRQHandler: implemented-entry=LPI2C0_Master_Slave_IRQHandler
        LPI2C0_Slave_IRQHandler: implemented-entry=LPI2C0_Slave_IRQHandler
        LPI2C1_Master_IRQHandler: implemented-entry=LPI2C1_Master_IRQHandler
        LPI2C1_Master_Slave_IRQHandler: implemented-entry=LPI2C1_Master_Slave_IRQHandler
        LPI2C1_Slave_IRQHandler: implemented-entry=LPI2C1_Slave_IRQHandler
package /AUTOSAR_I2c/BswModuleEntrys
  14 x bsw module entry, all with sw-service-impl-policy=STANDARD:
    I2c_AsyncTransmit: service-id=0x03, is-reentrant=true, is-synchronous=true, call-type=REGULAR, execution-context=UNSPECIFIED
    I2c_DeInit: service-id=0x01, is-reentrant=false, is-synchronous=true, call-type=REGULAR, execution-context=UNSPECIFIED
    I2c_GetStatus: service-id=0x04, is-reentrant=true, is-synchronous=true, call-type=REGULAR, execution-context=UNSPECIFIED
    I2c_GetVersionInfo: service-id=0x0a, is-reentrant=true, is-synchronous=false, call-type=REGULAR, execution-context=UNSPECIFIED
    I2c_Init: service-id=0x00, is-reentrant=false, is-synchronous=true, call-type=REGULAR, execution-context=UNSPECIFIED
    I2c_PrepareSlaveBuffer: service-id=0x05, is-reentrant=true, is-synchronous=true, call-type=REGULAR, execution-context=UNSPECIFIED
    I2c_StartListening: service-id=0x06, is-reentrant=true, is-synchronous=true, call-type=REGULAR, execution-context=UNSPECIFIED
    I2c_SyncTransmit: service-id=0x02, is-reentrant=true, is-synchronous=true, call-type=REGULAR, execution-context=UNSPECIFIED
    LPI2C0_Master_IRQHandler: service-id=0, is-reentrant=false, is-synchronous=true, call-type=INTERRUPT, execution-context=INTERRUPT-CAT-2
    LPI2C0_Master_Slave_IRQHandler: service-id=0, is-reentrant=false, is-synchronous=true, call-type=INTERRUPT, execution-context=INTERRUPT-CAT-2
    LPI2C0_Slave_IRQHandler: service-id=0, is-reentrant=false, is-synchronous=true, call-type=INTERRUPT, execution-context=INTERRUPT-CAT-2
    LPI2C1_Master_IRQHandler: service-id=0, is-reentrant=false, is-synchronous=true, call-type=INTERRUPT, execution-context=INTERRUPT-CAT-2
    LPI2C1_Master_Slave_IRQHandler: service-id=0, is-reentrant=false, is-synchronous=true, call-type=INTERRUPT, execution-context=INTERRUPT-CAT-2
    LPI2C1_Slave_IRQHandler: service-id=0, is-reentrant=false, is-synchronous=true, call-type=INTERRUPT, execution-context=INTERRUPT-CAT-2
package /I2c_TS_T40D2M10I1R0/Implementations
  bsw implementation BswImplementation_0: programming-language=C, sw-version=1.0.1, vendor-id=43, ar-release-version=4.4.0, behavior=InternalBehavior_0, vendor-specific-module-def=I2c
    code-descriptors:
      code Files
        artifact-descriptors:
          short-label=config::I2c.xdm, category=SWCFG
          short-label=doc::RTD_I2C_IM.pdf, category=SWDOC
          short-label=doc::RTD_I2C_UM.pdf, category=SWDOC
          short-label=examples::EBT::I2c_HLD_Example_S32K118::generate::epc::Base.xdm, category=SWCFG
          short-label=examples::EBT::I2c_HLD_Example_S32K118::generate::epc::Dem.xdm, category=SWCFG
          short-label=examples::EBT::I2c_HLD_Example_S32K118::generate::epc::EcuC.xdm, category=SWCFG
          short-label=examples::EBT::I2c_HLD_Example_S32K118::generate::epc::I2c.xdm, category=SWCFG
          short-label=examples::EBT::I2c_HLD_Example_S32K118::generate::epc::Mcl.xdm, category=SWCFG
          short-label=examples::EBT::I2c_HLD_Example_S32K118::generate::epc::Mcu.xdm, category=SWCFG
          short-label=examples::EBT::I2c_HLD_Example_S32K118::generate::epc::Os.xdm, category=SWCFG
          short-label=examples::EBT::I2c_HLD_Example_S32K118::generate::epc::Platform.xdm, category=SWCFG
          short-label=examples::EBT::I2c_HLD_Example_S32K118::generate::epc::Port.xdm, category=SWCFG
          short-label=examples::EBT::I2c_HLD_Example_S32K118::generate::epc::Resource.xdm, category=SWCFG
          short-label=examples::EBT::I2c_HLD_Example_S32K118::include::check_example.h, category=SWHDR
          short-label=examples::EBT::I2c_HLD_Example_S32K118::src::main.c, category=SWSRC
          short-label=examples::EBT::I2c_HLD_Example_S32K118::TresosProject::I2c_HLD_Example_S32K118::.prefs::preferences.xdm, category=SWCFG
          short-label=examples::EBT::I2c_HLD_Example_S32K118::TresosProject::I2c_HLD_Example_S32K118::config::Base.xdm, category=SWCFG
          short-label=examples::EBT::I2c_HLD_Example_S32K118::TresosProject::I2c_HLD_Example_S32K118::config::Dem.xdm, category=SWCFG
          short-label=examples::EBT::I2c_HLD_Example_S32K118::TresosProject::I2c_HLD_Example_S32K118::config::EcuC.xdm, category=SWCFG
          short-label=examples::EBT::I2c_HLD_Example_S32K118::TresosProject::I2c_HLD_Example_S32K118::config::I2c.xdm, category=SWCFG
          short-label=examples::EBT::I2c_HLD_Example_S32K118::TresosProject::I2c_HLD_Example_S32K118::config::Mcl.xdm, category=SWCFG
          short-label=examples::EBT::I2c_HLD_Example_S32K118::TresosProject::I2c_HLD_Example_S32K118::config::Mcu.xdm, category=SWCFG
          short-label=examples::EBT::I2c_HLD_Example_S32K118::TresosProject::I2c_HLD_Example_S32K118::config::Os.xdm, category=SWCFG
          short-label=examples::EBT::I2c_HLD_Example_S32K118::TresosProject::I2c_HLD_Example_S32K118::config::Platform.xdm, category=SWCFG
          short-label=examples::EBT::I2c_HLD_Example_S32K118::TresosProject::I2c_HLD_Example_S32K118::config::Port.xdm, category=SWCFG
          short-label=examples::EBT::I2c_HLD_Example_S32K118::TresosProject::I2c_HLD_Example_S32K118::config::Resource.xdm, category=SWCFG
          short-label=examples::EBT::I2c_HLD_Example_S32K144::generate::epc::Base.xdm, category=SWCFG
          short-label=examples::EBT::I2c_HLD_Example_S32K144::generate::epc::Dem.xdm, category=SWCFG
          short-label=examples::EBT::I2c_HLD_Example_S32K144::generate::epc::EcuC.xdm, category=SWCFG
          short-label=examples::EBT::I2c_HLD_Example_S32K144::generate::epc::I2c.xdm, category=SWCFG
          short-label=examples::EBT::I2c_HLD_Example_S32K144::generate::epc::Mcl.xdm, category=SWCFG
          short-label=examples::EBT::I2c_HLD_Example_S32K144::generate::epc::Mcu.xdm, category=SWCFG
          short-label=examples::EBT::I2c_HLD_Example_S32K144::generate::epc::Os.xdm, category=SWCFG
          short-label=examples::EBT::I2c_HLD_Example_S32K144::generate::epc::Platform.xdm, category=SWCFG
          short-label=examples::EBT::I2c_HLD_Example_S32K144::generate::epc::Port.xdm, category=SWCFG
          short-label=examples::EBT::I2c_HLD_Example_S32K144::generate::epc::Resource.xdm, category=SWCFG
          short-label=examples::EBT::I2c_HLD_Example_S32K144::include::check_example.h, category=SWHDR
          short-label=examples::EBT::I2c_HLD_Example_S32K144::src::main.c, category=SWSRC
          short-label=examples::EBT::I2c_HLD_Example_S32K144::TresosProject::I2c_HLD_Example_S32K144::.prefs::preferences.xdm, category=SWCFG
          short-label=examples::EBT::I2c_HLD_Example_S32K144::TresosProject::I2c_HLD_Example_S32K144::config::Base.xdm, category=SWCFG
          short-label=examples::EBT::I2c_HLD_Example_S32K144::TresosProject::I2c_HLD_Example_S32K144::config::Dem.xdm, category=SWCFG
          short-label=examples::EBT::I2c_HLD_Example_S32K144::TresosProject::I2c_HLD_Example_S32K144::config::EcuC.xdm, category=SWCFG
          short-label=examples::EBT::I2c_HLD_Example_S32K144::TresosProject::I2c_HLD_Example_S32K144::config::I2c.xdm, category=SWCFG
          short-label=examples::EBT::I2c_HLD_Example_S32K144::TresosProject::I2c_HLD_Example_S32K144::config::Mcl.xdm, category=SWCFG
          short-label=examples::EBT::I2c_HLD_Example_S32K144::TresosProject::I2c_HLD_Example_S32K144::config::Mcu.xdm, category=SWCFG
          short-label=examples::EBT::I2c_HLD_Example_S32K144::TresosProject::I2c_HLD_Example_S32K144::config::Os.xdm, category=SWCFG
          short-label=examples::EBT::I2c_HLD_Example_S32K144::TresosProject::I2c_HLD_Example_S32K144::config::Platform.xdm, category=SWCFG
          short-label=examples::EBT::I2c_HLD_Example_S32K144::TresosProject::I2c_HLD_Example_S32K144::config::Port.xdm, category=SWCFG
          short-label=examples::EBT::I2c_HLD_Example_S32K144::TresosProject::I2c_HLD_Example_S32K144::config::Resource.xdm, category=SWCFG
          short-label=examples::EBT::I2c_HLD_Example_S32K144W::generate::epc::Base.xdm, category=SWCFG
          short-label=examples::EBT::I2c_HLD_Example_S32K144W::generate::epc::Dem.xdm, category=SWCFG
          short-label=examples::EBT::I2c_HLD_Example_S32K144W::generate::epc::EcuC.xdm, category=SWCFG
          short-label=examples::EBT::I2c_HLD_Example_S32K144W::generate::epc::I2c.xdm, category=SWCFG
          short-label=examples::EBT::I2c_HLD_Example_S32K144W::generate::epc::Mcl.xdm, category=SWCFG
          short-label=examples::EBT::I2c_HLD_Example_S32K144W::generate::epc::Mcu.xdm, category=SWCFG
          short-label=examples::EBT::I2c_HLD_Example_S32K144W::generate::epc::Os.xdm, category=SWCFG
          short-label=examples::EBT::I2c_HLD_Example_S32K144W::generate::epc::Platform.xdm, category=SWCFG
          short-label=examples::EBT::I2c_HLD_Example_S32K144W::generate::epc::Port.xdm, category=SWCFG
          short-label=examples::EBT::I2c_HLD_Example_S32K144W::generate::epc::Resource.xdm, category=SWCFG
          short-label=examples::EBT::I2c_HLD_Example_S32K144W::include::check_example.h, category=SWHDR
          short-label=examples::EBT::I2c_HLD_Example_S32K144W::src::main.c, category=SWSRC
          short-label=examples::EBT::I2c_HLD_Example_S32K144W::TresosProject::I2c_HLD_Example_S32K144W::.prefs::preferences.xdm, category=SWCFG
          short-label=examples::EBT::I2c_HLD_Example_S32K144W::TresosProject::I2c_HLD_Example_S32K144W::config::Base.xdm, category=SWCFG
          short-label=examples::EBT::I2c_HLD_Example_S32K144W::TresosProject::I2c_HLD_Example_S32K144W::config::Dem.xdm, category=SWCFG
          short-label=examples::EBT::I2c_HLD_Example_S32K144W::TresosProject::I2c_HLD_Example_S32K144W::config::EcuC.xdm, category=SWCFG
          short-label=examples::EBT::I2c_HLD_Example_S32K144W::TresosProject::I2c_HLD_Example_S32K144W::config::I2c.xdm, category=SWCFG
          short-label=examples::EBT::I2c_HLD_Example_S32K144W::TresosProject::I2c_HLD_Example_S32K144W::config::Mcl.xdm, category=SWCFG
          short-label=examples::EBT::I2c_HLD_Example_S32K144W::TresosProject::I2c_HLD_Example_S32K144W::config::Mcu.xdm, category=SWCFG
          short-label=examples::EBT::I2c_HLD_Example_S32K144W::TresosProject::I2c_HLD_Example_S32K144W::config::Os.xdm, category=SWCFG
          short-label=examples::EBT::I2c_HLD_Example_S32K144W::TresosProject::I2c_HLD_Example_S32K144W::config::Platform.xdm, category=SWCFG
          short-label=examples::EBT::I2c_HLD_Example_S32K144W::TresosProject::I2c_HLD_Example_S32K144W::config::Port.xdm, category=SWCFG
          short-label=examples::EBT::I2c_HLD_Example_S32K144W::TresosProject::I2c_HLD_Example_S32K144W::config::Resource.xdm, category=SWCFG
          short-label=examples::EBT::I2c_HLD_Example_S32K148::generate::epc::Base.xdm, category=SWCFG
          short-label=examples::EBT::I2c_HLD_Example_S32K148::generate::epc::Dem.xdm, category=SWCFG
          short-label=examples::EBT::I2c_HLD_Example_S32K148::generate::epc::EcuC.xdm, category=SWCFG
          short-label=examples::EBT::I2c_HLD_Example_S32K148::generate::epc::I2c.xdm, category=SWCFG
          short-label=examples::EBT::I2c_HLD_Example_S32K148::generate::epc::Mcl.xdm, category=SWCFG
          short-label=examples::EBT::I2c_HLD_Example_S32K148::generate::epc::Mcu.xdm, category=SWCFG
          short-label=examples::EBT::I2c_HLD_Example_S32K148::generate::epc::Os.xdm, category=SWCFG
          short-label=examples::EBT::I2c_HLD_Example_S32K148::generate::epc::Platform.xdm, category=SWCFG
          short-label=examples::EBT::I2c_HLD_Example_S32K148::generate::epc::Port.xdm, category=SWCFG
          short-label=examples::EBT::I2c_HLD_Example_S32K148::generate::epc::Resource.xdm, category=SWCFG
          short-label=examples::EBT::I2c_HLD_Example_S32K148::include::check_example.h, category=SWHDR
          short-label=examples::EBT::I2c_HLD_Example_S32K148::src::main.c, category=SWSRC
          short-label=examples::EBT::I2c_HLD_Example_S32K148::TresosProject::I2c_HLD_Example_S32K148::.prefs::preferences.xdm, category=SWCFG
          short-label=examples::EBT::I2c_HLD_Example_S32K148::TresosProject::I2c_HLD_Example_S32K148::config::Base.xdm, category=SWCFG
          short-label=examples::EBT::I2c_HLD_Example_S32K148::TresosProject::I2c_HLD_Example_S32K148::config::Dem.xdm, category=SWCFG
          short-label=examples::EBT::I2c_HLD_Example_S32K148::TresosProject::I2c_HLD_Example_S32K148::config::EcuC.xdm, category=SWCFG
          short-label=examples::EBT::I2c_HLD_Example_S32K148::TresosProject::I2c_HLD_Example_S32K148::config::I2c.xdm, category=SWCFG
          short-label=examples::EBT::I2c_HLD_Example_S32K148::TresosProject::I2c_HLD_Example_S32K148::config::Mcl.xdm, category=SWCFG
          short-label=examples::EBT::I2c_HLD_Example_S32K148::TresosProject::I2c_HLD_Example_S32K148::config::Mcu.xdm, category=SWCFG
          short-label=examples::EBT::I2c_HLD_Example_S32K148::TresosProject::I2c_HLD_Example_S32K148::config::Os.xdm, category=SWCFG
          short-label=examples::EBT::I2c_HLD_Example_S32K148::TresosProject::I2c_HLD_Example_S32K148::config::Platform.xdm, category=SWCFG
          short-label=examples::EBT::I2c_HLD_Example_S32K148::TresosProject::I2c_HLD_Example_S32K148::config::Port.xdm, category=SWCFG
          short-label=examples::EBT::I2c_HLD_Example_S32K148::TresosProject::I2c_HLD_Example_S32K148::config::Resource.xdm, category=SWCFG
          short-label=examples::S32DS::Flexio_I2c_Ip_Example_S32K118::include::check_example.h, category=SWHDR
          short-label=examples::S32DS::Flexio_I2c_Ip_Example_S32K118::Project_Settings::Startup_Code::exceptions.c, category=SWSRC
          short-label=examples::S32DS::Flexio_I2c_Ip_Example_S32K118::Project_Settings::Startup_Code::nvic.c, category=SWSRC
          short-label=examples::S32DS::Flexio_I2c_Ip_Example_S32K118::Project_Settings::Startup_Code::startup.c, category=SWSRC
          short-label=examples::S32DS::Flexio_I2c_Ip_Example_S32K118::Project_Settings::Startup_Code::system.c, category=SWSRC
          short-label=examples::S32DS::Flexio_I2c_Ip_Example_S32K118::src::main.c, category=SWSRC
          short-label=examples::S32DS::Flexio_I2c_Ip_Example_S32K144::include::check_example.h, category=SWHDR
          short-label=examples::S32DS::Flexio_I2c_Ip_Example_S32K144::Project_Settings::Startup_Code::exceptions.c, category=SWSRC
          short-label=examples::S32DS::Flexio_I2c_Ip_Example_S32K144::Project_Settings::Startup_Code::nvic.c, category=SWSRC
          short-label=examples::S32DS::Flexio_I2c_Ip_Example_S32K144::Project_Settings::Startup_Code::startup.c, category=SWSRC
          short-label=examples::S32DS::Flexio_I2c_Ip_Example_S32K144::Project_Settings::Startup_Code::system.c, category=SWSRC
          short-label=examples::S32DS::Flexio_I2c_Ip_Example_S32K144::src::main.c, category=SWSRC
          short-label=examples::S32DS::Flexio_I2c_Ip_Example_S32K144W::include::check_example.h, category=SWHDR
          short-label=examples::S32DS::Flexio_I2c_Ip_Example_S32K144W::Project_Settings::Startup_Code::exceptions.c, category=SWSRC
          short-label=examples::S32DS::Flexio_I2c_Ip_Example_S32K144W::Project_Settings::Startup_Code::nvic.c, category=SWSRC
          short-label=examples::S32DS::Flexio_I2c_Ip_Example_S32K144W::Project_Settings::Startup_Code::startup.c, category=SWSRC
          short-label=examples::S32DS::Flexio_I2c_Ip_Example_S32K144W::Project_Settings::Startup_Code::system.c, category=SWSRC
          short-label=examples::S32DS::Flexio_I2c_Ip_Example_S32K144W::src::main.c, category=SWSRC
          short-label=examples::S32DS::Flexio_I2c_Ip_Example_S32K148::include::check_example.h, category=SWHDR
          short-label=examples::S32DS::Flexio_I2c_Ip_Example_S32K148::Project_Settings::Startup_Code::exceptions.c, category=SWSRC
          short-label=examples::S32DS::Flexio_I2c_Ip_Example_S32K148::Project_Settings::Startup_Code::nvic.c, category=SWSRC
          short-label=examples::S32DS::Flexio_I2c_Ip_Example_S32K148::Project_Settings::Startup_Code::startup.c, category=SWSRC
          short-label=examples::S32DS::Flexio_I2c_Ip_Example_S32K148::Project_Settings::Startup_Code::system.c, category=SWSRC
          short-label=examples::S32DS::Flexio_I2c_Ip_Example_S32K148::src::main.c, category=SWSRC
          short-label=examples::S32DS::I2c_HLD_Example_S32K118::include::check_example.h, category=SWHDR
          short-label=examples::S32DS::I2c_HLD_Example_S32K118::Project_Settings::Startup_Code::exceptions.c, category=SWSRC
          short-label=examples::S32DS::I2c_HLD_Example_S32K118::Project_Settings::Startup_Code::nvic.c, category=SWSRC
          short-label=examples::S32DS::I2c_HLD_Example_S32K118::Project_Settings::Startup_Code::startup.c, category=SWSRC
          short-label=examples::S32DS::I2c_HLD_Example_S32K118::Project_Settings::Startup_Code::system.c, category=SWSRC
          short-label=examples::S32DS::I2c_HLD_Example_S32K118::src::main.c, category=SWSRC
          short-label=examples::S32DS::I2c_HLD_Example_S32K144::include::check_example.h, category=SWHDR
          short-label=examples::S32DS::I2c_HLD_Example_S32K144::Project_Settings::Startup_Code::exceptions.c, category=SWSRC
          short-label=examples::S32DS::I2c_HLD_Example_S32K144::Project_Settings::Startup_Code::nvic.c, category=SWSRC
          short-label=examples::S32DS::I2c_HLD_Example_S32K144::Project_Settings::Startup_Code::startup.c, category=SWSRC
          short-label=examples::S32DS::I2c_HLD_Example_S32K144::Project_Settings::Startup_Code::system.c, category=SWSRC
          short-label=examples::S32DS::I2c_HLD_Example_S32K144::src::main.c, category=SWSRC
          short-label=examples::S32DS::I2c_HLD_Example_S32K144W::include::check_example.h, category=SWHDR
          short-label=examples::S32DS::I2c_HLD_Example_S32K144W::Project_Settings::Startup_Code::exceptions.c, category=SWSRC
          short-label=examples::S32DS::I2c_HLD_Example_S32K144W::Project_Settings::Startup_Code::nvic.c, category=SWSRC
          short-label=examples::S32DS::I2c_HLD_Example_S32K144W::Project_Settings::Startup_Code::startup.c, category=SWSRC
          short-label=examples::S32DS::I2c_HLD_Example_S32K144W::Project_Settings::Startup_Code::system.c, category=SWSRC
          short-label=examples::S32DS::I2c_HLD_Example_S32K144W::src::main.c, category=SWSRC
          short-label=examples::S32DS::I2c_HLD_Example_S32K148::include::check_example.h, category=SWHDR
          short-label=examples::S32DS::I2c_HLD_Example_S32K148::Project_Settings::Startup_Code::exceptions.c, category=SWSRC
          short-label=examples::S32DS::I2c_HLD_Example_S32K148::Project_Settings::Startup_Code::nvic.c, category=SWSRC
          short-label=examples::S32DS::I2c_HLD_Example_S32K148::Project_Settings::Startup_Code::startup.c, category=SWSRC
          short-label=examples::S32DS::I2c_HLD_Example_S32K148::Project_Settings::Startup_Code::system.c, category=SWSRC
          short-label=examples::S32DS::I2c_HLD_Example_S32K148::src::main.c, category=SWSRC
          short-label=include::CDD_I2c.h, category=SWHDR
          short-label=include::Flexio_I2c_Ip.h, category=SWHDR
          short-label=include::Flexio_I2c_Ip_Callbacks.h, category=SWHDR
          short-label=include::Flexio_I2c_Ip_Features.h, category=SWHDR
          short-label=include::Flexio_I2c_Ip_HwAccess.h, category=SWHDR
          short-label=include::Flexio_I2c_Ip_Irq.h, category=SWHDR
          short-label=include::Flexio_I2c_Ip_TrustedFunctions.h, category=SWHDR
          short-label=include::Flexio_I2c_Ip_Types.h, category=SWHDR
          short-label=include::I2c_Ipw.h, category=SWHDR
          short-label=include::I2c_Ipw_Types.h, category=SWHDR
          short-label=include::I2c_Types.h, category=SWHDR
          short-label=include::Lpi2c_Ip.h, category=SWHDR
          short-label=include::Lpi2c_Ip_Callbacks.h, category=SWHDR
          short-label=include::Lpi2c_Ip_Features.h, category=SWHDR
          short-label=include::Lpi2c_Ip_HwAccess.h, category=SWHDR
          short-label=include::Lpi2c_Ip_Irq.h, category=SWHDR
          short-label=include::Lpi2c_Ip_TrustedFunctions.h, category=SWHDR
          short-label=include::Lpi2c_Ip_Types.h, category=SWHDR
          short-label=src::CDD_I2c.c, category=SWSRC
          short-label=src::Flexio_I2c_Ip.c, category=SWSRC
          short-label=src::I2c_Ipw.c, category=SWSRC
          short-label=src::Lpi2c_Ip.c, category=SWSRC
          short-label=src::Lpi2c_Ip_HwAccess.c, category=SWSRC
          short-label=src::Lpi2c_Ip_Irq.c, category=SWSRC
    compiler GCC_Compiler:
      name=GCC Compiler
      options=-mcpu=cortex-m4 -mcpu=cortex-m0plus -mthumb -mlittle-endian -mfpu=fpv4-sp-d16 -mfloat-abi=hard -mfpu=auto -mfloat-abi=soft -std=c99 -Os -ggdb3 -Wall -Wextra -pedantic -Wstrict-prototypes -Wundef -Wunused -Werror=implicit-function-declaration -Wsign-compare -Wdouble-promotion -fno-short-enums -funsigned-char -funsigned-bitfields -fomit-frame-pointer -fno-common -fstack-usage -fdump-ipa-all -c -DS32K1XX -DS32K148 -DGCC -DUSE_SW_VECTOR_MODE -DI_CACHE_ENABLE -DENABLE_FPU -DMCAL_ENABLE_USER_MODE_SUPPORT
      vendor=GCC Systems
      version=NXP GCC 9.2.0 20190812 (Build 1649 Revision gaf57174)
    compiler GHS_Compiler:
      name=Green Hills
      options=-cpu=cortexm4 -cpu=cortexm0plus -thumb -fpu=vfpv4_d16 -fsingle -fsoft -C99 --ghstd=last -Osize --gnu_asm -dual_debug -G -keeptempfiles -Wimplicit-int -Wshadow -Wtrigraphs -Wundef --unsigned_chars --unsigned_fields --no_commons --no_exceptions --no_slash_comment --prototype_errors --incorrect_pragma_warnings -c -DS32K1XX -DS32K148 -DGHS -DUSE_SW_VECTOR_MODE -DI_CACHE_ENABLE -DENABLE_FPU -DMCAL_ENABLE_USER_MODE_SUPPORT
      vendor=Green Hills
      version=Green Hills Multi 7.1.6d / Compiler 2020.1.4
    compiler IAR_Compiler:
      name=IAR Compiler
      options=--cpu=Cortex-M4 --cpu=Cortex-M0+ --cpu_mode=thumb --endian=little --fpu=FPv4-SP --fpu=none -e -Ohz --debug --no_clustering --no_mem_idioms --no_explicit_zero_opt --require_prototypes --no_wrap_diagnostics --diag_suppress=Pa050 -DS32K1XX -DS32K148 -DIAR -DUSE_SW_VECTOR_MODE -DI_CACHE_ENABLE -DENABLE_FPU -DMCAL_ENABLE_USER_MODE_SUPPORT
      vendor=IAR Systems
      version=IAR ANSI C/C++ Compiler V8.40.3.228/W32 for ARM Functional Safety
    generated-artifacts:
      14 x dependency on artifact:
        CDD_I2c_PBcfg_h: artifact-descriptor={short-label=generate_PB::include::CDD_I2c_PBcfg.h, category=SWHDR}, usages=EXECUTE
        Flexio_I2c_Ip_Cfg_h: artifact-descriptor={short-label=generate_PB::include::Flexio_I2c_Ip_Cfg.h, category=SWHDR}, usages=EXECUTE
        Flexio_I2c_Ip_CfgDefines_h: artifact-descriptor={short-label=generate_PB::include::Flexio_I2c_Ip_CfgDefines.h, category=SWHDR}, usages=EXECUTE
        Flexio_I2c_Ip_PBcfg_h: artifact-descriptor={short-label=generate_PB::include::Flexio_I2c_Ip_PBcfg.h, category=SWHDR}, usages=EXECUTE
        I2c_Ipw_PBcfg_h: artifact-descriptor={short-label=generate_PB::include::I2c_Ipw_PBcfg.h, category=SWHDR}, usages=EXECUTE
        Lpi2c_Ip_Cfg_h: artifact-descriptor={short-label=generate_PB::include::Lpi2c_Ip_Cfg.h, category=SWHDR}, usages=EXECUTE
        Lpi2c_Ip_CfgDefines_h: artifact-descriptor={short-label=generate_PB::include::Lpi2c_Ip_CfgDefines.h, category=SWHDR}, usages=EXECUTE
        Lpi2c_Ip_PBcfg_h: artifact-descriptor={short-label=generate_PB::include::Lpi2c_Ip_PBcfg.h, category=SWHDR}, usages=EXECUTE
        CDD_I2c_PBcfg_c: artifact-descriptor={short-label=generate_PB::src::CDD_I2c_PBcfg.c, category=SWSRC}, usages=EXECUTE
        Flexio_I2c_Ip_PBcfg_c: artifact-descriptor={short-label=generate_PB::src::Flexio_I2c_Ip_PBcfg.c, category=SWSRC}, usages=EXECUTE
        I2c_Ipw_PBcfg_c: artifact-descriptor={short-label=generate_PB::src::I2c_Ipw_PBcfg.c, category=SWSRC}, usages=EXECUTE
        Lpi2c_Ip_PBcfg_c: artifact-descriptor={short-label=generate_PB::src::Lpi2c_Ip_PBcfg.c, category=SWSRC}, usages=EXECUTE
        CDD_I2c_Cfg_h: artifact-descriptor={short-label=generate_PC::include::CDD_I2c_Cfg.h, category=SWHDR}, usages=COMPILE
        CDD_I2c_Cfg_c: artifact-descriptor={short-label=generate_PC::src::CDD_I2c_Cfg.c, category=SWSRC}, usages=COMPILE
    linker GCC_Linker: name=GCC Compiler, options=-Wl,-Map,filename -T linkerfile --entry=Reset_Handler -nostartfiles -mcpu=cortex-m4 -mcpu=cortex-m0plus -mthumb -mfpu=fpv4-sp-d16 -mfloat-abi=hard -mfpu=auto -mfloat-abi=soft -mlittle-endian -ggdb3 -lc -lm -lgcc -n, vendor=GCC Systems, version=NXP GCC 9.2.0 20190812 (Build 1649 Revision gaf57174)
    linker GHS_Linker: name=Green Hills, options=-e Reset_Handler -T linker_script_file.ld -map -keepmap -Mn -delete -ignore_debug_references -Llibrary_path -larch -lstartup -lind_sd -lind_sf -v -keep=C40_Ip_AccessCode -nostartfiles, vendor=Green Hills, version=Green Hills Multi 7.1.6d / Compiler 2020.1.4
    linker IAR_Linker: name=IAR Compiler, options=--map filename --config linkerfile --cpu=Cortex-M4 --cpu=Cortex-M0+ --fpu=FPv4-SP --fpu=none --entry _start --enable_stack_usage --skip_dynamic_initialization --no_wrap_diagnostics, vendor=IAR Systems, version=IAR ANSI C/C++ Compiler V8.40.3.228/W32 for ARM Functional Safety
    resource consumption ResourceConsumption
      9 x memory section:
        I2C_CODE: alignment=UNSPECIFIED, sw-addrmethod=CODE, symbol=CODE
        I2C_CONFIG_DATA_UNSPECIFIED: alignment=UNSPECIFIED, sw-addrmethod=CONFIG_DATA, symbol=CONFIG_DATA_UNSPECIFIED
        I2C_CONST_UNSPECIFIED: alignment=UNSPECIFIED, sw-addrmethod=CONST, symbol=CONST_UNSPECIFIED
        I2C_VAR_CLEARED_8: alignment=8, sw-addrmethod=VAR_CLEARED, symbol=VAR_CLEARED_8
        I2C_VAR_CLEARED_UNSPECIFIED: alignment=UNSPECIFIED, sw-addrmethod=VAR_CLEARED, symbol=VAR_CLEARED_UNSPECIFIED
        I2C_VAR_CLEARED_UNSPECIFIED_NO_CACHEABLE: alignment=UNSPECIFIED, sw-addrmethod=VAR_CLEARED_UNSPECIFIED_NO, symbol=VAR_CLEARED_UNSPECIFIED_NO_CACHEABLE
        I2C_VAR_INIT_8: alignment=8, sw-addrmethod=VAR_INIT, symbol=VAR_INIT_8
        I2C_VAR_INIT_8_NO_CACHEABLE: alignment=UNSPECIFIED, sw-addrmethod=VAR_INIT, symbol=VAR_INIT_8_NO_CACHEABLE
        I2C_VAR_INIT_UNSPECIFIED: alignment=UNSPECIFIED, sw-addrmethod=VAR_INIT, symbol=VAR_INIT_UNSPECIFIED
