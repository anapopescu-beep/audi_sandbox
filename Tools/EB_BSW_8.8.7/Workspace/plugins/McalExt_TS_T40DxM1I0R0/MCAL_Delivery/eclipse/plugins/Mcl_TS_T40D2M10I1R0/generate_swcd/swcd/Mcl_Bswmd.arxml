AUTOSAR XML (schema 00046)
package /AUTOSAR_Mcl/BswModuleDescriptions
  bsw module description Mcl: module-id=255
    provided-entrys:
      Mcl_DeInit
      Mcl_GetDmaChannelParam
      Mcl_GetDmaChannelStatus
      Mcl_GetDmaInstanceStatus
      Mcl_GetVersionInfo
      Mcl_Init
      Mcl_SetDmaChannelCommand
      Mcl_SetDmaChannelGlobalList
      Mcl_SetDmaChannelScatterGatherConfig
      Mcl_SetDmaChannelScatterGatherList
      Mcl_SetDmaChannelTransferList
      Mcl_SetDmaInstanceCommand
      Mcl_SetTrgMuxInput
      Mcl_SetTrgMuxLock
      Dma0_Ch0_IRQHandler
      Dma0_Ch{10..15}_IRQHandler
      Dma0_Ch{1..9}_IRQHandler
      Dma0_Error_IrqHandler
      MCL_FLEXIO_ISR
    bsw internal behavior InternalBehavior_0
      30 x exclusive area:
        MCL_EXCLUSIVE_AREA_{00..21}
        MCL_EXCLUSIVE_AREA_{39..46}
      14 x bsw called entity:
        Mcl_DeInit: can-enter-exclusive-area=[MCL_EXCLUSIVE_AREA_01, MCL_EXCLUSIVE_AREA_04], implemented-entry=Mcl_DeInit
        Mcl_GetDmaChannelParam: implemented-entry=Mcl_GetDmaChannelParam
        Mcl_GetDmaChannelStatus: can-enter-exclusive-area=MCL_EXCLUSIVE_AREA_06, implemented-entry=Mcl_GetDmaChannelStatus
        Mcl_GetDmaInstanceStatus: implemented-entry=Mcl_GetDmaInstanceStatus
        Mcl_GetVersionInfo: implemented-entry=Mcl_GetVersionInfo
        Mcl_Init: can-enter-exclusive-area=[MCL_EXCLUSIVE_AREA_00, MCL_EXCLUSIVE_AREA_03, MCL_EXCLUSIVE_AREA_12, MCL_EXCLUSIVE_AREA_19, MCL_EXCLUSIVE_AREA_39, MCL_EXCLUSIVE_AREA_40, MCL_EXCLUSIVE_AREA_41, MCL_EXCLUSIVE_AREA_42, MCL_EXCLUSIVE_AREA_43, MCL_EXCLUSIVE_AREA_44, MCL_EXCLUSIVE_AREA_45, MCL_EXCLUSIVE_AREA_46], implemented-entry=Mcl_Init
        Mcl_SetDmaChannelCommand: can-enter-exclusive-area=MCL_EXCLUSIVE_AREA_05, implemented-entry=Mcl_SetDmaChannelCommand
        Mcl_SetDmaChannelGlobalList: can-enter-exclusive-area=[MCL_EXCLUSIVE_AREA_07, MCL_EXCLUSIVE_AREA_08], implemented-entry=Mcl_SetDmaChannelGlobalList
        Mcl_SetDmaChannelScatterGatherConfig: can-enter-exclusive-area=MCL_EXCLUSIVE_AREA_11, implemented-entry=Mcl_SetDmaChannelScatterGatherConfig
        Mcl_SetDmaChannelScatterGatherList: can-enter-exclusive-area=[MCL_EXCLUSIVE_AREA_09, MCL_EXCLUSIVE_AREA_10], implemented-entry=Mcl_SetDmaChannelScatterGatherList
        Mcl_SetDmaChannelTransferList: implemented-entry=Mcl_SetDmaChannelTransferList
        Mcl_SetDmaInstanceCommand: can-enter-exclusive-area=MCL_EXCLUSIVE_AREA_02, implemented-entry=Mcl_SetDmaInstanceCommand
        Mcl_SetTrgMuxInput: can-enter-exclusive-area=MCL_EXCLUSIVE_AREA_20, implemented-entry=Mcl_SetTrgMuxInput
        Mcl_SetTrgMuxLock: can-enter-exclusive-area=MCL_EXCLUSIVE_AREA_21, implemented-entry=Mcl_SetTrgMuxLock
      18 x bsw interrupt entity, all with interrupt-category=CAT-2, interrupt-source=Hardware:
        Dma0_Ch0_IRQHandler: implemented-entry=Dma0_Ch0_IRQHandler
        Dma0_Ch{10..15}_IRQHandler: implemented-entry=Dma0_Ch{10..15}_IRQHandler
        Dma0_Ch{1..9}_IRQHandler: implemented-entry=Dma0_Ch{1..9}_IRQHandler
        Dma0_Error_IrqHandler: implemented-entry=Dma0_Error_IrqHandler
        MCL_FLEXIO_ISR: implemented-entry=MCL_FLEXIO_ISR
package /AUTOSAR_Mcl/BswModuleEntrys
  32 x bsw module entry, all with is-synchronous=true, sw-service-impl-policy=STANDARD:
    Mcl_DeInit: service-id=0x0b, is-reentrant=false, call-type=REGULAR, execution-context=UNSPECIFIED
    Mcl_GetDmaChannelParam: service-id=0x08, is-reentrant=true, call-type=REGULAR, execution-context=UNSPECIFIED
    Mcl_GetDmaChannelStatus: service-id=0x04, is-reentrant=true, call-type=REGULAR, execution-context=UNSPECIFIED
    Mcl_GetDmaInstanceStatus: service-id=0x02, is-reentrant=true, call-type=REGULAR, execution-context=UNSPECIFIED
    Mcl_GetVersionInfo: service-id=0x60, is-reentrant=true, call-type=REGULAR, execution-context=UNSPECIFIED
    Mcl_Init: service-id=0x00, is-reentrant=false, call-type=REGULAR, execution-context=UNSPECIFIED
    Mcl_SetDmaChannelCommand: service-id=0x03, is-reentrant=true, call-type=REGULAR, execution-context=UNSPECIFIED
    Mcl_SetDmaChannelGlobalList: service-id=0x05, is-reentrant=true, call-type=REGULAR, execution-context=UNSPECIFIED
    Mcl_SetDmaChannelScatterGatherConfig: service-id=0x09, is-reentrant=true, call-type=REGULAR, execution-context=UNSPECIFIED
    Mcl_SetDmaChannelScatterGatherList: service-id=0x07, is-reentrant=true, call-type=REGULAR, execution-context=UNSPECIFIED
    Mcl_SetDmaChannelTransferList: service-id=0x06, is-reentrant=true, call-type=REGULAR, execution-context=UNSPECIFIED
    Mcl_SetDmaInstanceCommand: service-id=0x01, is-reentrant=true, call-type=REGULAR, execution-context=UNSPECIFIED
    Mcl_SetTrgMuxInput: service-id=0x20, is-reentrant=true, call-type=REGULAR, execution-context=UNSPECIFIED
    Mcl_SetTrgMuxLock: service-id=0x21, is-reentrant=true, call-type=REGULAR, execution-context=UNSPECIFIED
    Dma0_Ch0_IRQHandler: service-id=0, is-reentrant=false, call-type=INTERRUPT, execution-context=INTERRUPT-CAT-2
    Dma0_Ch{10..15}_IRQHandler: service-id=0, is-reentrant=false, call-type=INTERRUPT, execution-context=INTERRUPT-CAT-2
    Dma0_Ch{1..9}_IRQHandler: service-id=0, is-reentrant=false, call-type=INTERRUPT, execution-context=INTERRUPT-CAT-2
    Dma0_Error_IrqHandler: service-id=0, is-reentrant=false, call-type=INTERRUPT, execution-context=INTERRUPT-CAT-2
    MCL_FLEXIO_ISR: service-id=0, is-reentrant=false, call-type=INTERRUPT, execution-context=INTERRUPT-CAT-2
package /Mcl_TS_T40D2M10I1R0/Implementations
  bsw implementation BswImplementation_0: programming-language=C, sw-version=1.0.1, vendor-id=43, ar-release-version=4.4.0, behavior=InternalBehavior_0, vendor-specific-module-def=Mcl
    code-descriptors:
      code Files
        artifact-descriptors:
          short-label=config::Mcl.xdm, category=SWCFG
          short-label=doc::RTD_MCL_IM.pdf, category=SWDOC
          short-label=doc::RTD_MCL_UM.pdf, category=SWDOC
          short-label=examples::EBT::Mcl_DmaTransfer_S32K118::generate::epc::Base.xdm, category=SWCFG
          short-label=examples::EBT::Mcl_DmaTransfer_S32K118::generate::epc::Dem.xdm, category=SWCFG
          short-label=examples::EBT::Mcl_DmaTransfer_S32K118::generate::epc::Mcl.xdm, category=SWCFG
          short-label=examples::EBT::Mcl_DmaTransfer_S32K118::generate::epc::Mcu.xdm, category=SWCFG
          short-label=examples::EBT::Mcl_DmaTransfer_S32K118::generate::epc::Platform.xdm, category=SWCFG
          short-label=examples::EBT::Mcl_DmaTransfer_S32K118::generate::epc::Resource.xdm, category=SWCFG
          short-label=examples::EBT::Mcl_DmaTransfer_S32K118::include::check_example.h, category=SWHDR
          short-label=examples::EBT::Mcl_DmaTransfer_S32K118::include::Mcl_Example_EBT.h, category=SWHDR
          short-label=examples::EBT::Mcl_DmaTransfer_S32K118::src::main.c, category=SWSRC
          short-label=examples::EBT::Mcl_DmaTransfer_S32K118::TresosProject::Mcl_DmaTransfer_S32K118::.prefs::preferences.xdm, category=SWCFG
          short-label=examples::EBT::Mcl_DmaTransfer_S32K118::TresosProject::Mcl_DmaTransfer_S32K118::config::Base.xdm, category=SWCFG
          short-label=examples::EBT::Mcl_DmaTransfer_S32K118::TresosProject::Mcl_DmaTransfer_S32K118::config::Dem.xdm, category=SWCFG
          short-label=examples::EBT::Mcl_DmaTransfer_S32K118::TresosProject::Mcl_DmaTransfer_S32K118::config::EcuC.xdm, category=SWCFG
          short-label=examples::EBT::Mcl_DmaTransfer_S32K118::TresosProject::Mcl_DmaTransfer_S32K118::config::Mcl.xdm, category=SWCFG
          short-label=examples::EBT::Mcl_DmaTransfer_S32K118::TresosProject::Mcl_DmaTransfer_S32K118::config::Mcu.xdm, category=SWCFG
          short-label=examples::EBT::Mcl_DmaTransfer_S32K118::TresosProject::Mcl_DmaTransfer_S32K118::config::Platform.xdm, category=SWCFG
          short-label=examples::EBT::Mcl_DmaTransfer_S32K118::TresosProject::Mcl_DmaTransfer_S32K118::config::Resource.xdm, category=SWCFG
          short-label=examples::EBT::Mcl_DmaTransfer_S32K144::generate::epc::Base.xdm, category=SWCFG
          short-label=examples::EBT::Mcl_DmaTransfer_S32K144::generate::epc::Dem.xdm, category=SWCFG
          short-label=examples::EBT::Mcl_DmaTransfer_S32K144::generate::epc::Mcl.xdm, category=SWCFG
          short-label=examples::EBT::Mcl_DmaTransfer_S32K144::generate::epc::Mcu.xdm, category=SWCFG
          short-label=examples::EBT::Mcl_DmaTransfer_S32K144::generate::epc::Platform.xdm, category=SWCFG
          short-label=examples::EBT::Mcl_DmaTransfer_S32K144::generate::epc::Resource.xdm, category=SWCFG
          short-label=examples::EBT::Mcl_DmaTransfer_S32K144::include::check_example.h, category=SWHDR
          short-label=examples::EBT::Mcl_DmaTransfer_S32K144::include::Mcl_Example_EBT.h, category=SWHDR
          short-label=examples::EBT::Mcl_DmaTransfer_S32K144::src::main.c, category=SWSRC
          short-label=examples::EBT::Mcl_DmaTransfer_S32K144::TresosProject::Mcl_DmaTransfer_S32K144::.prefs::preferences.xdm, category=SWCFG
          short-label=examples::EBT::Mcl_DmaTransfer_S32K144::TresosProject::Mcl_DmaTransfer_S32K144::config::Base.xdm, category=SWCFG
          short-label=examples::EBT::Mcl_DmaTransfer_S32K144::TresosProject::Mcl_DmaTransfer_S32K144::config::Dem.xdm, category=SWCFG
          short-label=examples::EBT::Mcl_DmaTransfer_S32K144::TresosProject::Mcl_DmaTransfer_S32K144::config::EcuC.xdm, category=SWCFG
          short-label=examples::EBT::Mcl_DmaTransfer_S32K144::TresosProject::Mcl_DmaTransfer_S32K144::config::Mcl.xdm, category=SWCFG
          short-label=examples::EBT::Mcl_DmaTransfer_S32K144::TresosProject::Mcl_DmaTransfer_S32K144::config::Mcu.xdm, category=SWCFG
          short-label=examples::EBT::Mcl_DmaTransfer_S32K144::TresosProject::Mcl_DmaTransfer_S32K144::config::Platform.xdm, category=SWCFG
          short-label=examples::EBT::Mcl_DmaTransfer_S32K144::TresosProject::Mcl_DmaTransfer_S32K144::config::Resource.xdm, category=SWCFG
          short-label=examples::EBT::Mcl_DmaTransfer_S32K144W::generate::epc::Base.xdm, category=SWCFG
          short-label=examples::EBT::Mcl_DmaTransfer_S32K144W::generate::epc::Dem.xdm, category=SWCFG
          short-label=examples::EBT::Mcl_DmaTransfer_S32K144W::generate::epc::Mcl.xdm, category=SWCFG
          short-label=examples::EBT::Mcl_DmaTransfer_S32K144W::generate::epc::Mcu.xdm, category=SWCFG
          short-label=examples::EBT::Mcl_DmaTransfer_S32K144W::generate::epc::Platform.xdm, category=SWCFG
          short-label=examples::EBT::Mcl_DmaTransfer_S32K144W::generate::epc::Resource.xdm, category=SWCFG
          short-label=examples::EBT::Mcl_DmaTransfer_S32K144W::include::check_example.h, category=SWHDR
          short-label=examples::EBT::Mcl_DmaTransfer_S32K144W::include::Mcl_Example_EBT.h, category=SWHDR
          short-label=examples::EBT::Mcl_DmaTransfer_S32K144W::src::main.c, category=SWSRC
          short-label=examples::EBT::Mcl_DmaTransfer_S32K144W::TresosProject::Mcl_DmaTransfer_S32K144W::.prefs::preferences.xdm, category=SWCFG
          short-label=examples::EBT::Mcl_DmaTransfer_S32K144W::TresosProject::Mcl_DmaTransfer_S32K144W::config::Base.xdm, category=SWCFG
          short-label=examples::EBT::Mcl_DmaTransfer_S32K144W::TresosProject::Mcl_DmaTransfer_S32K144W::config::Dem.xdm, category=SWCFG
          short-label=examples::EBT::Mcl_DmaTransfer_S32K144W::TresosProject::Mcl_DmaTransfer_S32K144W::config::EcuC.xdm, category=SWCFG
          short-label=examples::EBT::Mcl_DmaTransfer_S32K144W::TresosProject::Mcl_DmaTransfer_S32K144W::config::Mcl.xdm, category=SWCFG
          short-label=examples::EBT::Mcl_DmaTransfer_S32K144W::TresosProject::Mcl_DmaTransfer_S32K144W::config::Mcu.xdm, category=SWCFG
          short-label=examples::EBT::Mcl_DmaTransfer_S32K144W::TresosProject::Mcl_DmaTransfer_S32K144W::config::Platform.xdm, category=SWCFG
          short-label=examples::EBT::Mcl_DmaTransfer_S32K144W::TresosProject::Mcl_DmaTransfer_S32K144W::config::Resource.xdm, category=SWCFG
          short-label=examples::EBT::Mcl_DmaTransfer_S32K148::generate::epc::Base.xdm, category=SWCFG
          short-label=examples::EBT::Mcl_DmaTransfer_S32K148::generate::epc::Dem.xdm, category=SWCFG
          short-label=examples::EBT::Mcl_DmaTransfer_S32K148::generate::epc::Mcl.xdm, category=SWCFG
          short-label=examples::EBT::Mcl_DmaTransfer_S32K148::generate::epc::Mcu.xdm, category=SWCFG
          short-label=examples::EBT::Mcl_DmaTransfer_S32K148::generate::epc::Platform.xdm, category=SWCFG
          short-label=examples::EBT::Mcl_DmaTransfer_S32K148::generate::epc::Resource.xdm, category=SWCFG
          short-label=examples::EBT::Mcl_DmaTransfer_S32K148::include::check_example.h, category=SWHDR
          short-label=examples::EBT::Mcl_DmaTransfer_S32K148::include::Mcl_Example_EBT.h, category=SWHDR
          short-label=examples::EBT::Mcl_DmaTransfer_S32K148::src::main.c, category=SWSRC
          short-label=examples::EBT::Mcl_DmaTransfer_S32K148::TresosProject::Mcl_DmaTransfer_S32K148::.prefs::preferences.xdm, category=SWCFG
          short-label=examples::EBT::Mcl_DmaTransfer_S32K148::TresosProject::Mcl_DmaTransfer_S32K148::config::Base.xdm, category=SWCFG
          short-label=examples::EBT::Mcl_DmaTransfer_S32K148::TresosProject::Mcl_DmaTransfer_S32K148::config::Dem.xdm, category=SWCFG
          short-label=examples::EBT::Mcl_DmaTransfer_S32K148::TresosProject::Mcl_DmaTransfer_S32K148::config::EcuC.xdm, category=SWCFG
          short-label=examples::EBT::Mcl_DmaTransfer_S32K148::TresosProject::Mcl_DmaTransfer_S32K148::config::Mcl.xdm, category=SWCFG
          short-label=examples::EBT::Mcl_DmaTransfer_S32K148::TresosProject::Mcl_DmaTransfer_S32K148::config::Mcu.xdm, category=SWCFG
          short-label=examples::EBT::Mcl_DmaTransfer_S32K148::TresosProject::Mcl_DmaTransfer_S32K148::config::Platform.xdm, category=SWCFG
          short-label=examples::EBT::Mcl_DmaTransfer_S32K148::TresosProject::Mcl_DmaTransfer_S32K148::config::Resource.xdm, category=SWCFG
          short-label=examples::S32DS::Dma_Ip_DmaTransfer_S32K118::include::check_example.h, category=SWHDR
          short-label=examples::S32DS::Dma_Ip_DmaTransfer_S32K118::Project_Settings::Startup_Code::exceptions.c, category=SWSRC
          short-label=examples::S32DS::Dma_Ip_DmaTransfer_S32K118::Project_Settings::Startup_Code::nvic.c, category=SWSRC
          short-label=examples::S32DS::Dma_Ip_DmaTransfer_S32K118::Project_Settings::Startup_Code::startup.c, category=SWSRC
          short-label=examples::S32DS::Dma_Ip_DmaTransfer_S32K118::Project_Settings::Startup_Code::system.c, category=SWSRC
          short-label=examples::S32DS::Dma_Ip_DmaTransfer_S32K118::src::main.c, category=SWSRC
          short-label=examples::S32DS::Dma_Ip_DmaTransfer_S32K144::include::check_example.h, category=SWHDR
          short-label=examples::S32DS::Dma_Ip_DmaTransfer_S32K144::Project_Settings::Startup_Code::exceptions.c, category=SWSRC
          short-label=examples::S32DS::Dma_Ip_DmaTransfer_S32K144::Project_Settings::Startup_Code::nvic.c, category=SWSRC
          short-label=examples::S32DS::Dma_Ip_DmaTransfer_S32K144::Project_Settings::Startup_Code::startup.c, category=SWSRC
          short-label=examples::S32DS::Dma_Ip_DmaTransfer_S32K144::Project_Settings::Startup_Code::system.c, category=SWSRC
          short-label=examples::S32DS::Dma_Ip_DmaTransfer_S32K144::src::main.c, category=SWSRC
          short-label=examples::S32DS::Dma_Ip_DmaTransfer_S32K144W::include::check_example.h, category=SWHDR
          short-label=examples::S32DS::Dma_Ip_DmaTransfer_S32K144W::Project_Settings::Startup_Code::exceptions.c, category=SWSRC
          short-label=examples::S32DS::Dma_Ip_DmaTransfer_S32K144W::Project_Settings::Startup_Code::nvic.c, category=SWSRC
          short-label=examples::S32DS::Dma_Ip_DmaTransfer_S32K144W::Project_Settings::Startup_Code::startup.c, category=SWSRC
          short-label=examples::S32DS::Dma_Ip_DmaTransfer_S32K144W::Project_Settings::Startup_Code::system.c, category=SWSRC
          short-label=examples::S32DS::Dma_Ip_DmaTransfer_S32K144W::src::main.c, category=SWSRC
          short-label=examples::S32DS::Dma_Ip_DmaTransfer_S32K148::include::check_example.h, category=SWHDR
          short-label=examples::S32DS::Dma_Ip_DmaTransfer_S32K148::Project_Settings::Startup_Code::exceptions.c, category=SWSRC
          short-label=examples::S32DS::Dma_Ip_DmaTransfer_S32K148::Project_Settings::Startup_Code::nvic.c, category=SWSRC
          short-label=examples::S32DS::Dma_Ip_DmaTransfer_S32K148::Project_Settings::Startup_Code::startup.c, category=SWSRC
          short-label=examples::S32DS::Dma_Ip_DmaTransfer_S32K148::Project_Settings::Startup_Code::system.c, category=SWSRC
          short-label=examples::S32DS::Dma_Ip_DmaTransfer_S32K148::src::main.c, category=SWSRC
          short-label=examples::S32DS::Mcl_DmaTransfer_S32K118::include::check_example.h, category=SWHDR
          short-label=examples::S32DS::Mcl_DmaTransfer_S32K118::Project_Settings::Startup_Code::exceptions.c, category=SWSRC
          short-label=examples::S32DS::Mcl_DmaTransfer_S32K118::Project_Settings::Startup_Code::nvic.c, category=SWSRC
          short-label=examples::S32DS::Mcl_DmaTransfer_S32K118::Project_Settings::Startup_Code::startup.c, category=SWSRC
          short-label=examples::S32DS::Mcl_DmaTransfer_S32K118::Project_Settings::Startup_Code::system.c, category=SWSRC
          short-label=examples::S32DS::Mcl_DmaTransfer_S32K118::src::main.c, category=SWSRC
          short-label=examples::S32DS::Mcl_DmaTransfer_S32K144::include::check_example.h, category=SWHDR
          short-label=examples::S32DS::Mcl_DmaTransfer_S32K144::Project_Settings::Startup_Code::exceptions.c, category=SWSRC
          short-label=examples::S32DS::Mcl_DmaTransfer_S32K144::Project_Settings::Startup_Code::nvic.c, category=SWSRC
          short-label=examples::S32DS::Mcl_DmaTransfer_S32K144::Project_Settings::Startup_Code::startup.c, category=SWSRC
          short-label=examples::S32DS::Mcl_DmaTransfer_S32K144::Project_Settings::Startup_Code::system.c, category=SWSRC
          short-label=examples::S32DS::Mcl_DmaTransfer_S32K144::src::main.c, category=SWSRC
          short-label=examples::S32DS::Mcl_DmaTransfer_S32K144W::include::check_example.h, category=SWHDR
          short-label=examples::S32DS::Mcl_DmaTransfer_S32K144W::Project_Settings::Startup_Code::exceptions.c, category=SWSRC
          short-label=examples::S32DS::Mcl_DmaTransfer_S32K144W::Project_Settings::Startup_Code::nvic.c, category=SWSRC
          short-label=examples::S32DS::Mcl_DmaTransfer_S32K144W::Project_Settings::Startup_Code::startup.c, category=SWSRC
          short-label=examples::S32DS::Mcl_DmaTransfer_S32K144W::Project_Settings::Startup_Code::system.c, category=SWSRC
          short-label=examples::S32DS::Mcl_DmaTransfer_S32K144W::src::main.c, category=SWSRC
          short-label=examples::S32DS::Mcl_DmaTransfer_S32K148::include::check_example.h, category=SWHDR
          short-label=examples::S32DS::Mcl_DmaTransfer_S32K148::Project_Settings::Startup_Code::exceptions.c, category=SWSRC
          short-label=examples::S32DS::Mcl_DmaTransfer_S32K148::Project_Settings::Startup_Code::nvic.c, category=SWSRC
          short-label=examples::S32DS::Mcl_DmaTransfer_S32K148::Project_Settings::Startup_Code::startup.c, category=SWSRC
          short-label=examples::S32DS::Mcl_DmaTransfer_S32K148::Project_Settings::Startup_Code::system.c, category=SWSRC
          short-label=examples::S32DS::Mcl_DmaTransfer_S32K148::src::main.c, category=SWSRC
          short-label=include::Cache_Ip.h, category=SWHDR
          short-label=include::Cache_Ip_Devassert.h, category=SWHDR
          short-label=include::Cache_Ip_HwAcc_Lmem.h, category=SWHDR
          short-label=include::Cache_Ip_TrustedFunctions.h, category=SWHDR
          short-label=include::Cache_Ip_Types.h, category=SWHDR
          short-label=include::CDD_Mcl.h, category=SWHDR
          short-label=include::CDD_Mcl_Ipw.h, category=SWHDR
          short-label=include::CDD_Mcl_Irq.h, category=SWHDR
          short-label=include::Dma_Ip.h, category=SWHDR
          short-label=include::Dma_Ip_Devassert.h, category=SWHDR
          short-label=include::Dma_Ip_Driver_State.h, category=SWHDR
          short-label=include::Dma_Ip_Hwv2_AccessInline.h, category=SWHDR
          short-label=include::Dma_Ip_Hw_Access.h, category=SWHDR
          short-label=include::Dma_Ip_Irq.h, category=SWHDR
          short-label=include::Dma_Ip_Multicore.h, category=SWHDR
          short-label=include::Dma_Ip_TrustedFunctions.h, category=SWHDR
          short-label=include::Dma_Ip_Types.h, category=SWHDR
          short-label=include::Flexio_Mcl_Ip.h, category=SWHDR
          short-label=include::Flexio_Mcl_Ip_HwAccess.h, category=SWHDR
          short-label=include::Flexio_Mcl_Ip_Types.h, category=SWHDR
          short-label=include::Ftm_Ip_TrustedFunctions.h, category=SWHDR
          short-label=include::Ftm_Mcl_Ip.h, category=SWHDR
          short-label=include::Mcl.h, category=SWHDR
          short-label=include::Mcl_Types.h, category=SWHDR
          short-label=include::Trgmux_Ip.h, category=SWHDR
          short-label=include::Trgmux_Ip_Devassert.h, category=SWHDR
          short-label=include::Trgmux_Ip_HwAcc.h, category=SWHDR
          short-label=include::Trgmux_Ip_TrustedFunctions.h, category=SWHDR
          short-label=include::Trgmux_Ip_Types.h, category=SWHDR
          short-label=src::CDD_Mcl.c, category=SWSRC
          short-label=src::CDD_Mcl_Ipw.c, category=SWSRC
          short-label=src::Dma_Ip.c, category=SWSRC
          short-label=src::Dma_Ip_Driver_State.c, category=SWSRC
          short-label=src::Dma_Ip_Hw_Access.c, category=SWSRC
          short-label=src::Dma_Ip_Irq.c, category=SWSRC
          short-label=src::Dma_Ip_Multicore.c, category=SWSRC
          short-label=src::Flexio_Mcl_Ip.c, category=SWSRC
          short-label=src::Flexio_Mcl_Ip_HwAccess.c, category=SWSRC
          short-label=src::Flexio_Mcl_Ip_Irq.c, category=SWSRC
          short-label=src::Ftm_Mcl_Ip.c, category=SWSRC
          short-label=src::Trgmux_Ip.c, category=SWSRC
          short-label=src::Trgmux_Ip_HwAcc.c, category=SWSRC
    compiler GCC_Compiler:
      name=GCC Compiler
      options=-mcpu=cortex-m4 -mcpu=cortex-m0plus -mthumb -mlittle-endian -mfpu=fpv4-sp-d16 -mfloat-abi=hard -mfpu=auto -mfloat-abi=soft -std=c99 -Os -ggdb3 -Wall -Wextra -pedantic -Wstrict-prototypes -Wundef -Wunused -Werror=implicit-function-declaration -Wsign-compare -Wdouble-promotion -fno-short-enums -funsigned-char -funsigned-bitfields -fomit-frame-pointer -fno-common -fstack-usage -fdump-ipa-all -c -DS32K1XX -DS32K148 -DGCC -DUSE_SW_VECTOR_MODE -DI_CACHE_ENABLE -DENABLE_FPU -DMCAL_ENABLE_USER_MODE_SUPPORT
      vendor=GCC Systems
      version=NXP GCC 9.2.0 20190812 (Build 1649 Revision gaf57174)
    compiler GHS_Compiler:
      name=Green Hills
      options=-cpu=cortexm4 -cpu=cortexm0plus -thumb -fpu=vfpv4_d16 -fsingle -fsoft -C99 --ghstd=last -Osize --gnu_asm -dual_debug -G -keeptempfiles -Wimplicit-int -Wshadow -Wtrigraphs -Wundef --unsigned_chars --unsigned_fields --no_commons --no_exceptions --no_slash_comment --prototype_errors --incorrect_pragma_warnings -c -DS32K1XX -DS32K148 -DGHS -DUSE_SW_VECTOR_MODE -DI_CACHE_ENABLE -DENABLE_FPU -DMCAL_ENABLE_USER_MODE_SUPPORT
      vendor=Green Hills
      version=Green Hills Multi 7.1.6d / Compiler 2020.1.4
    compiler IAR_Compiler:
      name=IAR Compiler
      options=--cpu=Cortex-M4 --cpu=Cortex-M0+ --cpu_mode=thumb --endian=little --fpu=FPv4-SP --fpu=none -e -Ohz --debug --no_clustering --no_mem_idioms --no_explicit_zero_opt --require_prototypes --no_wrap_diagnostics --diag_suppress=Pa050 -DS32K1XX -DS32K148 -DIAR -DUSE_SW_VECTOR_MODE -DI_CACHE_ENABLE -DENABLE_FPU -DMCAL_ENABLE_USER_MODE_SUPPORT
      vendor=IAR Systems
      version=IAR ANSI C/C++ Compiler V8.40.3.228/W32 for ARM Functional Safety
    generated-artifacts:
      27 x dependency on artifact:
        CDD_Mcl_PBcfg_h: artifact-descriptor={short-label=generate_PB::include::CDD_Mcl_PBcfg.h, category=SWHDR}, usages=EXECUTE
        Dma_Ip_PBcfg_h: artifact-descriptor={short-label=generate_PB::include::Dma_Ip_PBcfg.h, category=SWHDR}, usages=EXECUTE
        Flexio_Mcl_Ip_PBcfg_h: artifact-descriptor={short-label=generate_PB::include::Flexio_Mcl_Ip_PBcfg.h, category=SWHDR}, usages=EXECUTE
        Trgmux_Ip_PBcfg_h: artifact-descriptor={short-label=generate_PB::include::Trgmux_Ip_PBcfg.h, category=SWHDR}, usages=EXECUTE
        CDD_Mcl_PBcfg_c: artifact-descriptor={short-label=generate_PB::src::CDD_Mcl_PBcfg.c, category=SWSRC}, usages=EXECUTE
        Dma_Ip_PBcfg_c: artifact-descriptor={short-label=generate_PB::src::Dma_Ip_PBcfg.c, category=SWSRC}, usages=EXECUTE
        Flexio_Mcl_Ip_PBcfg_c: artifact-descriptor={short-label=generate_PB::src::Flexio_Mcl_Ip_PBcfg.c, category=SWSRC}, usages=EXECUTE
        Trgmux_Ip_PBcfg_c: artifact-descriptor={short-label=generate_PB::src::Trgmux_Ip_PBcfg.c, category=SWSRC}, usages=EXECUTE
        Cache_Ip_Cfg_Defines_h: artifact-descriptor={short-label=generate_PC::include::Cache_Ip_Cfg_Defines.h, category=SWHDR}, usages=COMPILE
        Cache_Ip_Cfg_DeviceRegisters_h: artifact-descriptor={short-label=generate_PC::include::Cache_Ip_Cfg_DeviceRegisters.h, category=SWHDR}, usages=COMPILE
        CDD_Mcl_Cfg_h: artifact-descriptor={short-label=generate_PC::include::CDD_Mcl_Cfg.h, category=SWHDR}, usages=COMPILE
        CDD_Mcl_Cfg_Defines_h: artifact-descriptor={short-label=generate_PC::include::CDD_Mcl_Cfg_Defines.h, category=SWHDR}, usages=COMPILE
        Dma_Ip_Cfg_h: artifact-descriptor={short-label=generate_PC::include::Dma_Ip_Cfg.h, category=SWHDR}, usages=COMPILE
        Dma_Ip_Cfg_Defines_h: artifact-descriptor={short-label=generate_PC::include::Dma_Ip_Cfg_Defines.h, category=SWHDR}, usages=COMPILE
        Dma_Ip_Cfg_DeviceRegistersV2_h: artifact-descriptor={short-label=generate_PC::include::Dma_Ip_Cfg_DeviceRegistersV2.h, category=SWHDR}, usages=COMPILE
        Dma_Ip_Cfg_Devices_h: artifact-descriptor={short-label=generate_PC::include::Dma_Ip_Cfg_Devices.h, category=SWHDR}, usages=COMPILE
        Flexio_Mcl_Ip_Cfg_h: artifact-descriptor={short-label=generate_PC::include::Flexio_Mcl_Ip_Cfg.h, category=SWHDR}, usages=COMPILE
        Flexio_Mcl_Ip_Cfg_Defines_h: artifact-descriptor={short-label=generate_PC::include::Flexio_Mcl_Ip_Cfg_Defines.h, category=SWHDR}, usages=COMPILE
        Flexio_Mcl_Ip_Cfg_DeviceRegisters_h: artifact-descriptor={short-label=generate_PC::include::Flexio_Mcl_Ip_Cfg_DeviceRegisters.h, category=SWHDR}, usages=COMPILE
        Ftm_Mcl_Ip_Cfg_h: artifact-descriptor={short-label=generate_PC::include::Ftm_Mcl_Ip_Cfg.h, category=SWHDR}, usages=COMPILE
        Ftm_Mcl_Ip_Cfg_DeviceRegisters_h: artifact-descriptor={short-label=generate_PC::include::Ftm_Mcl_Ip_Cfg_DeviceRegisters.h, category=SWHDR}, usages=COMPILE
        Trgmux_Ip_Cfg_h: artifact-descriptor={short-label=generate_PC::include::Trgmux_Ip_Cfg.h, category=SWHDR}, usages=COMPILE
        Trgmux_Ip_Cfg_Defines_h: artifact-descriptor={short-label=generate_PC::include::Trgmux_Ip_Cfg_Defines.h, category=SWHDR}, usages=COMPILE
        Trgmux_Ip_Cfg_DeviceRegisters_h: artifact-descriptor={short-label=generate_PC::include::Trgmux_Ip_Cfg_DeviceRegisters.h, category=SWHDR}, usages=COMPILE
        CDD_Mcl_Cfg_c: artifact-descriptor={short-label=generate_PC::src::CDD_Mcl_Cfg.c, category=SWSRC}, usages=COMPILE
        Dma_Ip_Cfg_c: artifact-descriptor={short-label=generate_PC::src::Dma_Ip_Cfg.c, category=SWSRC}, usages=COMPILE
        Trgmux_Ip_Cfg_c: artifact-descriptor={short-label=generate_PC::src::Trgmux_Ip_Cfg.c, category=SWSRC}, usages=COMPILE
    linker GCC_Linker: name=GCC Compiler, options=-Wl,-Map,filename -T linkerfile --entry=Reset_Handler -nostartfiles -mcpu=cortex-m4 -mcpu=cortex-m0plus -mthumb -mfpu=fpv4-sp-d16 -mfloat-abi=hard -mfpu=auto -mfloat-abi=soft -mlittle-endian -ggdb3 -lc -lm -lgcc -n, vendor=GCC Systems, version=NXP GCC 9.2.0 20190812 (Build 1649 Revision gaf57174)
    linker GHS_Linker: name=Green Hills, options=-e Reset_Handler -T linker_script_file.ld -map -keepmap -Mn -delete -ignore_debug_references -Llibrary_path -larch -lstartup -lind_sd -lind_sf -v -keep=C40_Ip_AccessCode -nostartfiles, vendor=Green Hills, version=Green Hills Multi 7.1.6d / Compiler 2020.1.4
    linker IAR_Linker: name=IAR Compiler, options=--map filename --config linkerfile --cpu=Cortex-M4 --cpu=Cortex-M0+ --fpu=FPv4-SP --fpu=none --entry _start --enable_stack_usage --skip_dynamic_initialization --no_wrap_diagnostics, vendor=IAR Systems, version=IAR ANSI C/C++ Compiler V8.40.3.228/W32 for ARM Functional Safety
    resource consumption ResourceConsumption
      7 x memory section, all with alignment=UNSPECIFIED:
        MCL_CODE: sw-addrmethod=CODE, symbol=CODE
        MCL_CONFIG_DATA_UNSPECIFIED: sw-addrmethod=CONFIG_DATA, symbol=CONFIG_DATA_UNSPECIFIED
        MCL_CONST_UNSPECIFIED: sw-addrmethod=CONST, symbol=CONST_UNSPECIFIED
        MCL_VAR_CLEARED_BOOLEAN_NO_CACHEABLE: sw-addrmethod=VAR_CLEARED_BOOLEAN_NO, symbol=VAR_CLEARED_BOOLEAN_NO_CACHEABLE
        MCL_VAR_CLEARED_UNSPECIFIED_NO_CACHEABLE: sw-addrmethod=VAR_CLEARED_UNSPECIFIED_NO, symbol=VAR_CLEARED_UNSPECIFIED_NO_CACHEABLE
        MCL_VAR_INIT_UNSPECIFIED: sw-addrmethod=VAR_INIT, symbol=VAR_INIT_UNSPECIFIED
        MCL_VAR_INIT_UNSPECIFIED_NO_CACHEABLE: sw-addrmethod=VAR_INIT, symbol=VAR_INIT_UNSPECIFIED_NO_CACHEABLE
