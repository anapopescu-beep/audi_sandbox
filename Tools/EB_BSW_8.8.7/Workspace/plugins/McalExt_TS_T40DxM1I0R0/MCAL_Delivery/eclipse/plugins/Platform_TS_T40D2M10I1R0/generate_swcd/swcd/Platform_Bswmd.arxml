AUTOSAR XML (schema 00046)
package /AUTOSAR_Platform/BswModuleDescriptions
  bsw module description Platform: module-id=255, provided-entrys=[Platform_GetIrqPriority, Platform_Init, Platform_InstallIrqHandler, Platform_SetIrq, Platform_SetIrqPriority]
    bsw internal behavior InternalBehavior_0
      5 x bsw called entity:
        Platform_GetIrqPriority: implemented-entry=Platform_GetIrqPriority
        Platform_Init: implemented-entry=Platform_Init
        Platform_InstallIrqHandler: implemented-entry=Platform_InstallIrqHandler
        Platform_SetIrq: implemented-entry=Platform_SetIrq
        Platform_SetIrqPriority: implemented-entry=Platform_SetIrqPriority
package /AUTOSAR_Platform/BswModuleEntrys
  5 x bsw module entry, all with is-reentrant=false, is-synchronous=true, call-type=REGULAR, execution-context=UNSPECIFIED, sw-service-impl-policy=STANDARD:
    Platform_GetIrqPriority: service-id=0x23
    Platform_Init: service-id=0x20
    Platform_InstallIrqHandler: service-id=0x24
    Platform_SetIrq: service-id=0x21
    Platform_SetIrqPriority: service-id=0x22
package /Platform_TS_T40D2M10I1R0/Implementations
  bsw implementation BswImplementation_0: programming-language=C, sw-version=1.0.1, vendor-id=43, ar-release-version=4.4.0, behavior=InternalBehavior_0, vendor-specific-module-def=Platform
    code-descriptors:
      code Files
        artifact-descriptors:
          short-label=config::Platform.xdm, category=SWCFG
          short-label=doc::RTD_PLATFORM_IM.pdf, category=SWDOC
          short-label=doc::RTD_PLATFORM_UM.pdf, category=SWDOC
          short-label=include::IntCtrl_Ip.h, category=SWHDR
          short-label=include::IntCtrl_Ip_DeviceRegisters.h, category=SWHDR
          short-label=include::IntCtrl_Ip_TrustedFunctions.h, category=SWHDR
          short-label=include::IntCtrl_Ip_TypesDef.h, category=SWHDR
          short-label=include::Platform.h, category=SWHDR
          short-label=include::Platform_Ipw.h, category=SWHDR
          short-label=include::Platform_Ipw_TypesDef.h, category=SWHDR
          short-label=include::Platform_TypesDef.h, category=SWHDR
          short-label=include::System_Ip.h, category=SWHDR
          short-label=include::System_Ip_DeviceRegisters.h, category=SWHDR
          short-label=src::IntCtrl_Ip.c, category=SWSRC
          short-label=src::Platform.c, category=SWSRC
          short-label=src::Platform_Ipw.c, category=SWSRC
          short-label=src::System_Ip.c, category=SWSRC
          short-label=startup::include::nvic.h, category=SWHDR
          short-label=startup::include::system.h, category=SWHDR
          short-label=startup::include::sys_init.h, category=SWHDR
          short-label=startup::src::m0p::exceptions.c, category=SWSRC
          short-label=startup::src::m4::exceptions.c, category=SWSRC
          short-label=startup::src::nvic.c, category=SWSRC
          short-label=startup::src::startup.c, category=SWSRC
          short-label=startup::src::system.c, category=SWSRC
          short-label=startup::src::sys_init.c, category=SWSRC
    compiler GCC_Compiler:
      name=GCC Compiler
      options=-mcpu=cortex-m4 -mcpu=cortex-m0plus -mthumb -mlittle-endian -mfpu=fpv4-sp-d16 -mfloat-abi=hard -mfpu=auto -mfloat-abi=soft -std=c99 -Os -ggdb3 -Wall -Wextra -pedantic -Wstrict-prototypes -Wundef -Wunused -Werror=implicit-function-declaration -Wsign-compare -Wdouble-promotion -fno-short-enums -funsigned-char -funsigned-bitfields -fomit-frame-pointer -fno-common -fstack-usage -fdump-ipa-all -c -DS32K1XX -DS32K148 -DGCC -DUSE_SW_VECTOR_MODE -DI_CACHE_ENABLE -DENABLE_FPU -DMCAL_ENABLE_USER_MODE_SUPPORT
      vendor=GCC Systems
      version=NXP GCC 9.2.0 20190812 (Build 1649 Revision gaf57174)
    compiler GHS_Compiler:
      name=Green Hills
      options=-cpu=cortexm4 -cpu=cortexm0plus -thumb -fpu=vfpv4_d16 -fsingle -fsoft -C99 --ghstd=last -Osize --gnu_asm -dual_debug -G -keeptempfiles -Wimplicit-int -Wshadow -Wtrigraphs -Wundef --unsigned_chars --unsigned_fields --no_commons --no_exceptions --no_slash_comment --prototype_errors --incorrect_pragma_warnings -c -DS32K1XX -DS32K148 -DGHS -DUSE_SW_VECTOR_MODE -DI_CACHE_ENABLE -DENABLE_FPU -DMCAL_ENABLE_USER_MODE_SUPPORT
      vendor=Green Hills
      version=Green Hills Multi 7.1.6d / Compiler 2020.1.4
    compiler IAR_Compiler:
      name=IAR Compiler
      options=--cpu=Cortex-M4 --cpu=Cortex-M0+ --cpu_mode=thumb --endian=little --fpu=FPv4-SP --fpu=none -e -Ohz --debug --no_clustering --no_mem_idioms --no_explicit_zero_opt --require_prototypes --no_wrap_diagnostics --diag_suppress=Pa050 -DS32K1XX -DS32K148 -DIAR -DUSE_SW_VECTOR_MODE -DI_CACHE_ENABLE -DENABLE_FPU -DMCAL_ENABLE_USER_MODE_SUPPORT
      vendor=IAR Systems
      version=IAR ANSI C/C++ Compiler V8.40.3.228/W32 for ARM Functional Safety
    generated-artifacts:
      10 x dependency on artifact, all with usages=COMPILE:
        IntCtrl_Ip_Cfg_h: artifact-descriptor={short-label=generate::include::IntCtrl_Ip_Cfg.h, category=SWHDR}
        IntCtrl_Ip_CfgDefines_h: artifact-descriptor={short-label=generate::include::IntCtrl_Ip_CfgDefines.h, category=SWHDR}
        Platform_Cfg_h: artifact-descriptor={short-label=generate::include::Platform_Cfg.h, category=SWHDR}
        Platform_CfgDefines_h: artifact-descriptor={short-label=generate::include::Platform_CfgDefines.h, category=SWHDR}
        Platform_Ipw_Cfg_h: artifact-descriptor={short-label=generate::include::Platform_Ipw_Cfg.h, category=SWHDR}
        System_Ip_Cfg_h: artifact-descriptor={short-label=generate::include::System_Ip_Cfg.h, category=SWHDR}
        System_Ip_CfgDefines_h: artifact-descriptor={short-label=generate::include::System_Ip_CfgDefines.h, category=SWHDR}
        IntCtrl_Ip_Cfg_c: artifact-descriptor={short-label=generate::src::IntCtrl_Ip_Cfg.c, category=SWSRC}
        Platform_Cfg_c: artifact-descriptor={short-label=generate::src::Platform_Cfg.c, category=SWSRC}
        Platform_Ipw_Cfg_c: artifact-descriptor={short-label=generate::src::Platform_Ipw_Cfg.c, category=SWSRC}
    linker GCC_Linker: name=GCC Compiler, options=-Wl,-Map,filename -T linkerfile --entry=Reset_Handler -nostartfiles -mcpu=cortex-m4 -mcpu=cortex-m0plus -mthumb -mfpu=fpv4-sp-d16 -mfloat-abi=hard -mfpu=auto -mfloat-abi=soft -mlittle-endian -ggdb3 -lc -lm -lgcc -n, vendor=GCC Systems, version=NXP GCC 9.2.0 20190812 (Build 1649 Revision gaf57174)
    linker GHS_Linker: name=Green Hills, options=-e Reset_Handler -T linker_script_file.ld -map -keepmap -Mn -delete -ignore_debug_references -Llibrary_path -larch -lstartup -lind_sd -lind_sf -v -keep=C40_Ip_AccessCode -nostartfiles, vendor=Green Hills, version=Green Hills Multi 7.1.6d / Compiler 2020.1.4
    linker IAR_Linker: name=IAR Compiler, options=--map filename --config linkerfile --cpu=Cortex-M4 --cpu=Cortex-M0+ --fpu=FPv4-SP --fpu=none --entry _start --enable_stack_usage --skip_dynamic_initialization --no_wrap_diagnostics, vendor=IAR Systems, version=IAR ANSI C/C++ Compiler V8.40.3.228/W32 for ARM Functional Safety
    resource consumption ResourceConsumption
      memory section PLATFORM_CODE: alignment=UNSPECIFIED, sw-addrmethod=CODE, symbol=CODE
      memory section PLATFORM_CONFIG_DATA_UNSPECIFIED: alignment=UNSPECIFIED, sw-addrmethod=CONFIG_DATA, symbol=CONFIG_DATA_UNSPECIFIED
