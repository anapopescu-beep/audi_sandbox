AUTOSAR XML (schema 00046)
package /AUTOSAR_Pwm/BswModuleDescriptions
  bsw module description Pwm: module-id=121
    provided-entrys:
      Pwm_DeInit
      Pwm_DisableNotification
      Pwm_DisableTrigger
      Pwm_EnableNotification
      Pwm_EnableTrigger
      Pwm_ForceOutputToZero
      Pwm_GetChannelState
      Pwm_GetCurrentPowerState
      Pwm_GetOutputState
      Pwm_GetTargetPowerState
      Pwm_GetVersionInfo
      Pwm_Init
      Pwm_Main_PowerTransitionManager
      Pwm_MaskOutputs
      Pwm_PreparePowerState
      Pwm_ResetCounterDisable
      Pwm_ResetCounterEnable
      Pwm_SetChannelDeadTime
      Pwm_SetChannelOutput
      Pwm_SetClockMode
      Pwm_SetCounterBus
      Pwm_SetDutyCycle
      Pwm_SetDutyCycle_NoUpdate
      Pwm_SetDutyPhaseShift
      Pwm_SetOutputToIdle
      Pwm_SetPeriodAndDuty
      Pwm_SetPeriodAndDuty_NoUpdate
      Pwm_SetPhaseShift
      Pwm_SetPhaseShift_NoUpdate
      Pwm_SetPowerState
      Pwm_SetTriggerDelay
      Pwm_SyncUpdate
      Pwm_UnMaskOutputs
      FTM_0_CH_0_CH_1_ISR
      FTM_0_CH_2_CH_3_ISR
      FTM_0_CH_4_CH_5_ISR
      FTM_0_CH_6_CH_7_ISR
      FTM_0_FAULT_ISR
      FTM_0_ISR
      FTM_0_OVF_ISR
      FTM_1_CH_0_CH_1_ISR
      FTM_1_CH_2_CH_3_ISR
      FTM_1_CH_4_CH_5_ISR
      FTM_1_CH_6_CH_7_ISR
      FTM_1_FAULT_ISR
      FTM_1_ISR
      FTM_1_OVF_ISR
      FTM_2_CH_0_CH_1_ISR
      FTM_2_CH_2_CH_3_ISR
      FTM_2_CH_4_CH_5_ISR
      FTM_2_CH_6_CH_7_ISR
      FTM_2_FAULT_ISR
      FTM_2_OVF_ISR
      FTM_3_CH_0_CH_1_ISR
      FTM_3_CH_2_CH_3_ISR
      FTM_3_CH_4_CH_5_ISR
      FTM_3_CH_6_CH_7_ISR
      FTM_3_FAULT_ISR
      FTM_3_OVF_ISR
      FTM_4_CH_0_CH_1_ISR
      FTM_4_CH_2_CH_3_ISR
      FTM_4_CH_4_CH_5_ISR
      FTM_4_CH_6_CH_7_ISR
      FTM_4_FAULT_ISR
      FTM_4_OVF_ISR
      FTM_5_CH_0_CH_1_ISR
      FTM_5_CH_2_CH_3_ISR
      FTM_5_CH_4_CH_5_ISR
      FTM_5_CH_6_CH_7_ISR
      FTM_5_FAULT_ISR
      FTM_5_OVF_ISR
      FTM_6_CH_0_CH_1_ISR
      FTM_6_CH_2_CH_3_ISR
      FTM_6_CH_4_CH_5_ISR
      FTM_6_CH_6_CH_7_ISR
      FTM_6_FAULT_ISR
      FTM_6_OVF_ISR
      FTM_7_CH_0_CH_1_ISR
      FTM_7_CH_2_CH_3_ISR
      FTM_7_CH_4_CH_5_ISR
      FTM_7_CH_6_CH_7_ISR
      FTM_7_FAULT_ISR
      FTM_7_OVF_ISR
    bsw internal behavior InternalBehavior_0
      14 x exclusive area:
        PWM_EXCLUSIVE_AREA_00
        PWM_EXCLUSIVE_AREA_01
        PWM_EXCLUSIVE_AREA_{03..05}
        PWM_EXCLUSIVE_AREA_{07..13}
        PWM_EXCLUSIVE_AREA_33
        PWM_EXCLUSIVE_AREA_34
      33 x bsw called entity:
        Pwm_DeInit: implemented-entry=Pwm_DeInit
        Pwm_DisableNotification: can-enter-exclusive-area=[PWM_EXCLUSIVE_AREA_04, PWM_EXCLUSIVE_AREA_34], implemented-entry=Pwm_DisableNotification
        Pwm_DisableTrigger: can-enter-exclusive-area=PWM_EXCLUSIVE_AREA_10, implemented-entry=Pwm_DisableTrigger
        Pwm_EnableNotification: can-enter-exclusive-area=[PWM_EXCLUSIVE_AREA_05, PWM_EXCLUSIVE_AREA_34], implemented-entry=Pwm_EnableNotification
        Pwm_EnableTrigger: can-enter-exclusive-area=PWM_EXCLUSIVE_AREA_11, implemented-entry=Pwm_EnableTrigger
        Pwm_ForceOutputToZero: implemented-entry=Pwm_ForceOutputToZero
        Pwm_GetChannelState: implemented-entry=Pwm_GetChannelState
        Pwm_GetCurrentPowerState: implemented-entry=Pwm_GetCurrentPowerState
        Pwm_GetOutputState: can-enter-exclusive-area=PWM_EXCLUSIVE_AREA_03, implemented-entry=Pwm_GetOutputState
        Pwm_GetTargetPowerState: implemented-entry=Pwm_GetTargetPowerState
        Pwm_GetVersionInfo: implemented-entry=Pwm_GetVersionInfo
        Pwm_Init: implemented-entry=Pwm_Init
        Pwm_Main_PowerTransitionManager: implemented-entry=Pwm_Main_PowerTransitionManager
        Pwm_MaskOutputs: can-enter-exclusive-area=PWM_EXCLUSIVE_AREA_07, implemented-entry=Pwm_MaskOutputs
        Pwm_PreparePowerState: implemented-entry=Pwm_PreparePowerState
        Pwm_ResetCounterDisable: implemented-entry=Pwm_ResetCounterDisable
        Pwm_ResetCounterEnable: implemented-entry=Pwm_ResetCounterEnable
        Pwm_SetChannelDeadTime: can-enter-exclusive-area=PWM_EXCLUSIVE_AREA_13, implemented-entry=Pwm_SetChannelDeadTime
        Pwm_SetChannelOutput: implemented-entry=Pwm_SetChannelOutput
        Pwm_SetClockMode: implemented-entry=Pwm_SetClockMode
        Pwm_SetCounterBus: implemented-entry=Pwm_SetCounterBus
        Pwm_SetDutyCycle: can-enter-exclusive-area=[PWM_EXCLUSIVE_AREA_00, PWM_EXCLUSIVE_AREA_33], implemented-entry=Pwm_SetDutyCycle
        Pwm_SetDutyCycle_NoUpdate: can-enter-exclusive-area=PWM_EXCLUSIVE_AREA_00, implemented-entry=Pwm_SetDutyCycle_NoUpdate
        Pwm_SetDutyPhaseShift: implemented-entry=Pwm_SetDutyPhaseShift
        Pwm_SetOutputToIdle: implemented-entry=Pwm_SetOutputToIdle
        Pwm_SetPeriodAndDuty: can-enter-exclusive-area=[PWM_EXCLUSIVE_AREA_01, PWM_EXCLUSIVE_AREA_33], implemented-entry=Pwm_SetPeriodAndDuty
        Pwm_SetPeriodAndDuty_NoUpdate: can-enter-exclusive-area=PWM_EXCLUSIVE_AREA_01, implemented-entry=Pwm_SetPeriodAndDuty_NoUpdate
        Pwm_SetPhaseShift: can-enter-exclusive-area=PWM_EXCLUSIVE_AREA_09, implemented-entry=Pwm_SetPhaseShift
        Pwm_SetPhaseShift_NoUpdate: can-enter-exclusive-area=PWM_EXCLUSIVE_AREA_09, implemented-entry=Pwm_SetPhaseShift_NoUpdate
        Pwm_SetPowerState: implemented-entry=Pwm_SetPowerState
        Pwm_SetTriggerDelay: implemented-entry=Pwm_SetTriggerDelay
        Pwm_SyncUpdate: can-enter-exclusive-area=PWM_EXCLUSIVE_AREA_12, implemented-entry=Pwm_SyncUpdate
        Pwm_UnMaskOutputs: can-enter-exclusive-area=PWM_EXCLUSIVE_AREA_08, implemented-entry=Pwm_UnMaskOutputs
      50 x bsw interrupt entity, all with interrupt-category=CAT-2, interrupt-source=Hardware:
        FTM_0_CH_0_CH_1_ISR: implemented-entry=FTM_0_CH_0_CH_1_ISR
        FTM_0_CH_2_CH_3_ISR: implemented-entry=FTM_0_CH_2_CH_3_ISR
        FTM_0_CH_4_CH_5_ISR: implemented-entry=FTM_0_CH_4_CH_5_ISR
        FTM_0_CH_6_CH_7_ISR: implemented-entry=FTM_0_CH_6_CH_7_ISR
        FTM_0_FAULT_ISR: implemented-entry=FTM_0_FAULT_ISR
        FTM_0_ISR: implemented-entry=FTM_0_ISR
        FTM_0_OVF_ISR: implemented-entry=FTM_0_OVF_ISR
        FTM_1_CH_0_CH_1_ISR: implemented-entry=FTM_1_CH_0_CH_1_ISR
        FTM_1_CH_2_CH_3_ISR: implemented-entry=FTM_1_CH_2_CH_3_ISR
        FTM_1_CH_4_CH_5_ISR: implemented-entry=FTM_1_CH_4_CH_5_ISR
        FTM_1_CH_6_CH_7_ISR: implemented-entry=FTM_1_CH_6_CH_7_ISR
        FTM_1_FAULT_ISR: implemented-entry=FTM_1_FAULT_ISR
        FTM_1_ISR: implemented-entry=FTM_1_ISR
        FTM_1_OVF_ISR: implemented-entry=FTM_1_OVF_ISR
        FTM_2_CH_0_CH_1_ISR: implemented-entry=FTM_2_CH_0_CH_1_ISR
        FTM_2_CH_2_CH_3_ISR: implemented-entry=FTM_2_CH_2_CH_3_ISR
        FTM_2_CH_4_CH_5_ISR: implemented-entry=FTM_2_CH_4_CH_5_ISR
        FTM_2_CH_6_CH_7_ISR: implemented-entry=FTM_2_CH_6_CH_7_ISR
        FTM_2_FAULT_ISR: implemented-entry=FTM_2_FAULT_ISR
        FTM_2_OVF_ISR: implemented-entry=FTM_2_OVF_ISR
        FTM_3_CH_0_CH_1_ISR: implemented-entry=FTM_3_CH_0_CH_1_ISR
        FTM_3_CH_2_CH_3_ISR: implemented-entry=FTM_3_CH_2_CH_3_ISR
        FTM_3_CH_4_CH_5_ISR: implemented-entry=FTM_3_CH_4_CH_5_ISR
        FTM_3_CH_6_CH_7_ISR: implemented-entry=FTM_3_CH_6_CH_7_ISR
        FTM_3_FAULT_ISR: implemented-entry=FTM_3_FAULT_ISR
        FTM_3_OVF_ISR: implemented-entry=FTM_3_OVF_ISR
        FTM_4_CH_0_CH_1_ISR: implemented-entry=FTM_4_CH_0_CH_1_ISR
        FTM_4_CH_2_CH_3_ISR: implemented-entry=FTM_4_CH_2_CH_3_ISR
        FTM_4_CH_4_CH_5_ISR: implemented-entry=FTM_4_CH_4_CH_5_ISR
        FTM_4_CH_6_CH_7_ISR: implemented-entry=FTM_4_CH_6_CH_7_ISR
        FTM_4_FAULT_ISR: implemented-entry=FTM_4_FAULT_ISR
        FTM_4_OVF_ISR: implemented-entry=FTM_4_OVF_ISR
        FTM_5_CH_0_CH_1_ISR: implemented-entry=FTM_5_CH_0_CH_1_ISR
        FTM_5_CH_2_CH_3_ISR: implemented-entry=FTM_5_CH_2_CH_3_ISR
        FTM_5_CH_4_CH_5_ISR: implemented-entry=FTM_5_CH_4_CH_5_ISR
        FTM_5_CH_6_CH_7_ISR: implemented-entry=FTM_5_CH_6_CH_7_ISR
        FTM_5_FAULT_ISR: implemented-entry=FTM_5_FAULT_ISR
        FTM_5_OVF_ISR: implemented-entry=FTM_5_OVF_ISR
        FTM_6_CH_0_CH_1_ISR: implemented-entry=FTM_6_CH_0_CH_1_ISR
        FTM_6_CH_2_CH_3_ISR: implemented-entry=FTM_6_CH_2_CH_3_ISR
        FTM_6_CH_4_CH_5_ISR: implemented-entry=FTM_6_CH_4_CH_5_ISR
        FTM_6_CH_6_CH_7_ISR: implemented-entry=FTM_6_CH_6_CH_7_ISR
        FTM_6_FAULT_ISR: implemented-entry=FTM_6_FAULT_ISR
        FTM_6_OVF_ISR: implemented-entry=FTM_6_OVF_ISR
        FTM_7_CH_0_CH_1_ISR: implemented-entry=FTM_7_CH_0_CH_1_ISR
        FTM_7_CH_2_CH_3_ISR: implemented-entry=FTM_7_CH_2_CH_3_ISR
        FTM_7_CH_4_CH_5_ISR: implemented-entry=FTM_7_CH_4_CH_5_ISR
        FTM_7_CH_6_CH_7_ISR: implemented-entry=FTM_7_CH_6_CH_7_ISR
        FTM_7_FAULT_ISR: implemented-entry=FTM_7_FAULT_ISR
        FTM_7_OVF_ISR: implemented-entry=FTM_7_OVF_ISR
package /AUTOSAR_Pwm/BswModuleEntrys
  83 x bsw module entry, all with sw-service-impl-policy=STANDARD:
    Pwm_DeInit: service-id=0x01, is-reentrant=false, is-synchronous=true, call-type=REGULAR, execution-context=UNSPECIFIED
    Pwm_DisableNotification: service-id=0x06, is-reentrant=false, is-synchronous=false, call-type=REGULAR, execution-context=UNSPECIFIED
    Pwm_DisableTrigger: service-id=0x2f, is-reentrant=true, is-synchronous=true, call-type=REGULAR, execution-context=UNSPECIFIED
    Pwm_EnableNotification: service-id=0x07, is-reentrant=false, is-synchronous=false, call-type=REGULAR, execution-context=UNSPECIFIED
    Pwm_EnableTrigger: service-id=0x2e, is-reentrant=true, is-synchronous=true, call-type=REGULAR, execution-context=UNSPECIFIED
    Pwm_ForceOutputToZero: service-id=0x21, is-reentrant=true, is-synchronous=true, call-type=REGULAR, execution-context=UNSPECIFIED
    Pwm_GetChannelState: service-id=0x20, is-reentrant=true, is-synchronous=true, call-type=REGULAR, execution-context=UNSPECIFIED
    Pwm_GetCurrentPowerState: service-id=0x0a, is-reentrant=false, is-synchronous=true, call-type=REGULAR, execution-context=UNSPECIFIED
    Pwm_GetOutputState: service-id=0x05, is-reentrant=false, is-synchronous=true, call-type=REGULAR, execution-context=UNSPECIFIED
    Pwm_GetTargetPowerState: service-id=0x0b, is-reentrant=false, is-synchronous=true, call-type=REGULAR, execution-context=UNSPECIFIED
    Pwm_GetVersionInfo: service-id=0x08, is-reentrant=true, is-synchronous=true, call-type=REGULAR, execution-context=UNSPECIFIED
    Pwm_Init: service-id=0x00, is-reentrant=false, is-synchronous=true, call-type=REGULAR, execution-context=UNSPECIFIED
    Pwm_Main_PowerTransitionManager: service-id=0x0d, is-reentrant=false, is-synchronous=true, call-type=REGULAR, execution-context=UNSPECIFIED
    Pwm_MaskOutputs: service-id=0x32, is-reentrant=true, is-synchronous=true, call-type=REGULAR, execution-context=UNSPECIFIED
    Pwm_PreparePowerState: service-id=0x0c, is-reentrant=false, is-synchronous=true, call-type=REGULAR, execution-context=UNSPECIFIED
    Pwm_ResetCounterDisable: service-id=0x31, is-reentrant=true, is-synchronous=true, call-type=REGULAR, execution-context=UNSPECIFIED
    Pwm_ResetCounterEnable: service-id=0x30, is-reentrant=true, is-synchronous=true, call-type=REGULAR, execution-context=UNSPECIFIED
    Pwm_SetChannelDeadTime: service-id=0x2b, is-reentrant=true, is-synchronous=true, call-type=REGULAR, execution-context=UNSPECIFIED
    Pwm_SetChannelOutput: service-id=0x23, is-reentrant=true, is-synchronous=true, call-type=REGULAR, execution-context=UNSPECIFIED
    Pwm_SetClockMode: service-id=0x27, is-reentrant=true, is-synchronous=true, call-type=REGULAR, execution-context=UNSPECIFIED
    Pwm_SetCounterBus: service-id=0x22, is-reentrant=true, is-synchronous=true, call-type=REGULAR, execution-context=UNSPECIFIED
    Pwm_SetDutyCycle: service-id=0x02, is-reentrant=false, is-synchronous=false, call-type=REGULAR, execution-context=UNSPECIFIED
    Pwm_SetDutyCycle_NoUpdate: service-id=0x2a, is-reentrant=true, is-synchronous=true, call-type=REGULAR, execution-context=UNSPECIFIED
    Pwm_SetDutyPhaseShift: service-id=0x37, is-reentrant=true, is-synchronous=true, call-type=REGULAR, execution-context=UNSPECIFIED
    Pwm_SetOutputToIdle: service-id=0x04, is-reentrant=false, is-synchronous=false, call-type=REGULAR, execution-context=UNSPECIFIED
    Pwm_SetPeriodAndDuty: service-id=0x03, is-reentrant=false, is-synchronous=false, call-type=REGULAR, execution-context=UNSPECIFIED
    Pwm_SetPeriodAndDuty_NoUpdate: service-id=0x29, is-reentrant=true, is-synchronous=true, call-type=REGULAR, execution-context=UNSPECIFIED
    Pwm_SetPhaseShift: service-id=0x2c, is-reentrant=true, is-synchronous=true, call-type=REGULAR, execution-context=UNSPECIFIED
    Pwm_SetPhaseShift_NoUpdate: service-id=0x2d, is-reentrant=true, is-synchronous=true, call-type=REGULAR, execution-context=UNSPECIFIED
    Pwm_SetPowerState: service-id=0x09, is-reentrant=false, is-synchronous=true, call-type=REGULAR, execution-context=UNSPECIFIED
    Pwm_SetTriggerDelay: service-id=0x24, is-reentrant=true, is-synchronous=true, call-type=REGULAR, execution-context=UNSPECIFIED
    Pwm_SyncUpdate: service-id=0x28, is-reentrant=true, is-synchronous=true, call-type=REGULAR, execution-context=UNSPECIFIED
    Pwm_UnMaskOutputs: service-id=0x33, is-reentrant=true, is-synchronous=true, call-type=REGULAR, execution-context=UNSPECIFIED
    FTM_0_CH_0_CH_1_ISR: service-id=0, is-reentrant=false, is-synchronous=true, call-type=INTERRUPT, execution-context=INTERRUPT-CAT-2
    FTM_0_CH_2_CH_3_ISR: service-id=0, is-reentrant=false, is-synchronous=true, call-type=INTERRUPT, execution-context=INTERRUPT-CAT-2
    FTM_0_CH_4_CH_5_ISR: service-id=0, is-reentrant=false, is-synchronous=true, call-type=INTERRUPT, execution-context=INTERRUPT-CAT-2
    FTM_0_CH_6_CH_7_ISR: service-id=0, is-reentrant=false, is-synchronous=true, call-type=INTERRUPT, execution-context=INTERRUPT-CAT-2
    FTM_0_FAULT_ISR: service-id=0, is-reentrant=false, is-synchronous=true, call-type=INTERRUPT, execution-context=INTERRUPT-CAT-2
    FTM_0_ISR: service-id=0, is-reentrant=false, is-synchronous=true, call-type=INTERRUPT, execution-context=INTERRUPT-CAT-2
    FTM_0_OVF_ISR: service-id=0, is-reentrant=false, is-synchronous=true, call-type=INTERRUPT, execution-context=INTERRUPT-CAT-2
    FTM_1_CH_0_CH_1_ISR: service-id=0, is-reentrant=false, is-synchronous=true, call-type=INTERRUPT, execution-context=INTERRUPT-CAT-2
    FTM_1_CH_2_CH_3_ISR: service-id=0, is-reentrant=false, is-synchronous=true, call-type=INTERRUPT, execution-context=INTERRUPT-CAT-2
    FTM_1_CH_4_CH_5_ISR: service-id=0, is-reentrant=false, is-synchronous=true, call-type=INTERRUPT, execution-context=INTERRUPT-CAT-2
    FTM_1_CH_6_CH_7_ISR: service-id=0, is-reentrant=false, is-synchronous=true, call-type=INTERRUPT, execution-context=INTERRUPT-CAT-2
    FTM_1_FAULT_ISR: service-id=0, is-reentrant=false, is-synchronous=true, call-type=INTERRUPT, execution-context=INTERRUPT-CAT-2
    FTM_1_ISR: service-id=0, is-reentrant=false, is-synchronous=true, call-type=INTERRUPT, execution-context=INTERRUPT-CAT-2
    FTM_1_OVF_ISR: service-id=0, is-reentrant=false, is-synchronous=true, call-type=INTERRUPT, execution-context=INTERRUPT-CAT-2
    FTM_2_CH_0_CH_1_ISR: service-id=0, is-reentrant=false, is-synchronous=true, call-type=INTERRUPT, execution-context=INTERRUPT-CAT-2
    FTM_2_CH_2_CH_3_ISR: service-id=0, is-reentrant=false, is-synchronous=true, call-type=INTERRUPT, execution-context=INTERRUPT-CAT-2
    FTM_2_CH_4_CH_5_ISR: service-id=0, is-reentrant=false, is-synchronous=true, call-type=INTERRUPT, execution-context=INTERRUPT-CAT-2
    FTM_2_CH_6_CH_7_ISR: service-id=0, is-reentrant=false, is-synchronous=true, call-type=INTERRUPT, execution-context=INTERRUPT-CAT-2
    FTM_2_FAULT_ISR: service-id=0, is-reentrant=false, is-synchronous=true, call-type=INTERRUPT, execution-context=INTERRUPT-CAT-2
    FTM_2_OVF_ISR: service-id=0, is-reentrant=false, is-synchronous=true, call-type=INTERRUPT, execution-context=INTERRUPT-CAT-2
    FTM_3_CH_0_CH_1_ISR: service-id=0, is-reentrant=false, is-synchronous=true, call-type=INTERRUPT, execution-context=INTERRUPT-CAT-2
    FTM_3_CH_2_CH_3_ISR: service-id=0, is-reentrant=false, is-synchronous=true, call-type=INTERRUPT, execution-context=INTERRUPT-CAT-2
    FTM_3_CH_4_CH_5_ISR: service-id=0, is-reentrant=false, is-synchronous=true, call-type=INTERRUPT, execution-context=INTERRUPT-CAT-2
    FTM_3_CH_6_CH_7_ISR: service-id=0, is-reentrant=false, is-synchronous=true, call-type=INTERRUPT, execution-context=INTERRUPT-CAT-2
    FTM_3_FAULT_ISR: service-id=0, is-reentrant=false, is-synchronous=true, call-type=INTERRUPT, execution-context=INTERRUPT-CAT-2
    FTM_3_OVF_ISR: service-id=0, is-reentrant=false, is-synchronous=true, call-type=INTERRUPT, execution-context=INTERRUPT-CAT-2
    FTM_4_CH_0_CH_1_ISR: service-id=0, is-reentrant=false, is-synchronous=true, call-type=INTERRUPT, execution-context=INTERRUPT-CAT-2
    FTM_4_CH_2_CH_3_ISR: service-id=0, is-reentrant=false, is-synchronous=true, call-type=INTERRUPT, execution-context=INTERRUPT-CAT-2
    FTM_4_CH_4_CH_5_ISR: service-id=0, is-reentrant=false, is-synchronous=true, call-type=INTERRUPT, execution-context=INTERRUPT-CAT-2
    FTM_4_CH_6_CH_7_ISR: service-id=0, is-reentrant=false, is-synchronous=true, call-type=INTERRUPT, execution-context=INTERRUPT-CAT-2
    FTM_4_FAULT_ISR: service-id=0, is-reentrant=false, is-synchronous=true, call-type=INTERRUPT, execution-context=INTERRUPT-CAT-2
    FTM_4_OVF_ISR: service-id=0, is-reentrant=false, is-synchronous=true, call-type=INTERRUPT, execution-context=INTERRUPT-CAT-2
    FTM_5_CH_0_CH_1_ISR: service-id=0, is-reentrant=false, is-synchronous=true, call-type=INTERRUPT, execution-context=INTERRUPT-CAT-2
    FTM_5_CH_2_CH_3_ISR: service-id=0, is-reentrant=false, is-synchronous=true, call-type=INTERRUPT, execution-context=INTERRUPT-CAT-2
    FTM_5_CH_4_CH_5_ISR: service-id=0, is-reentrant=false, is-synchronous=true, call-type=INTERRUPT, execution-context=INTERRUPT-CAT-2
    FTM_5_CH_6_CH_7_ISR: service-id=0, is-reentrant=false, is-synchronous=true, call-type=INTERRUPT, execution-context=INTERRUPT-CAT-2
    FTM_5_FAULT_ISR: service-id=0, is-reentrant=false, is-synchronous=true, call-type=INTERRUPT, execution-context=INTERRUPT-CAT-2
    FTM_5_OVF_ISR: service-id=0, is-reentrant=false, is-synchronous=true, call-type=INTERRUPT, execution-context=INTERRUPT-CAT-2
    FTM_6_CH_0_CH_1_ISR: service-id=0, is-reentrant=false, is-synchronous=true, call-type=INTERRUPT, execution-context=INTERRUPT-CAT-2
    FTM_6_CH_2_CH_3_ISR: service-id=0, is-reentrant=false, is-synchronous=true, call-type=INTERRUPT, execution-context=INTERRUPT-CAT-2
    FTM_6_CH_4_CH_5_ISR: service-id=0, is-reentrant=false, is-synchronous=true, call-type=INTERRUPT, execution-context=INTERRUPT-CAT-2
    FTM_6_CH_6_CH_7_ISR: service-id=0, is-reentrant=false, is-synchronous=true, call-type=INTERRUPT, execution-context=INTERRUPT-CAT-2
    FTM_6_FAULT_ISR: service-id=0, is-reentrant=false, is-synchronous=true, call-type=INTERRUPT, execution-context=INTERRUPT-CAT-2
    FTM_6_OVF_ISR: service-id=0, is-reentrant=false, is-synchronous=true, call-type=INTERRUPT, execution-context=INTERRUPT-CAT-2
    FTM_7_CH_0_CH_1_ISR: service-id=0, is-reentrant=false, is-synchronous=true, call-type=INTERRUPT, execution-context=INTERRUPT-CAT-2
    FTM_7_CH_2_CH_3_ISR: service-id=0, is-reentrant=false, is-synchronous=true, call-type=INTERRUPT, execution-context=INTERRUPT-CAT-2
    FTM_7_CH_4_CH_5_ISR: service-id=0, is-reentrant=false, is-synchronous=true, call-type=INTERRUPT, execution-context=INTERRUPT-CAT-2
    FTM_7_CH_6_CH_7_ISR: service-id=0, is-reentrant=false, is-synchronous=true, call-type=INTERRUPT, execution-context=INTERRUPT-CAT-2
    FTM_7_FAULT_ISR: service-id=0, is-reentrant=false, is-synchronous=true, call-type=INTERRUPT, execution-context=INTERRUPT-CAT-2
    FTM_7_OVF_ISR: service-id=0, is-reentrant=false, is-synchronous=true, call-type=INTERRUPT, execution-context=INTERRUPT-CAT-2
package /Pwm_TS_T40D2M10I1R0/Implementations
  bsw implementation BswImplementation_0: programming-language=C, sw-version=1.0.1, vendor-id=43, ar-release-version=4.4.0, behavior=InternalBehavior_0, vendor-specific-module-def=Pwm
    code-descriptors:
      code Files
        artifact-descriptors:
          short-label=config::Pwm.xdm, category=SWCFG
          short-label=doc::RTD_PWM_IM.pdf, category=SWDOC
          short-label=doc::RTD_PWM_UM.pdf, category=SWDOC
          short-label=examples::EBT::Pwm_example_S32K118::generate::epc::Base.xdm, category=SWCFG
          short-label=examples::EBT::Pwm_example_S32K118::generate::epc::Dem.xdm, category=SWCFG
          short-label=examples::EBT::Pwm_example_S32K118::generate::epc::Ecuc.xdm, category=SWCFG
          short-label=examples::EBT::Pwm_example_S32K118::generate::epc::Mcl.xdm, category=SWCFG
          short-label=examples::EBT::Pwm_example_S32K118::generate::epc::Mcu.xdm, category=SWCFG
          short-label=examples::EBT::Pwm_example_S32K118::generate::epc::Platform.xdm, category=SWCFG
          short-label=examples::EBT::Pwm_example_S32K118::generate::epc::Port.xdm, category=SWCFG
          short-label=examples::EBT::Pwm_example_S32K118::generate::epc::Pwm.xdm, category=SWCFG
          short-label=examples::EBT::Pwm_example_S32K118::generate::epc::Resource.xdm, category=SWCFG
          short-label=examples::EBT::Pwm_example_S32K118::include::check_example.h, category=SWHDR
          short-label=examples::EBT::Pwm_example_S32K118::src::main.c, category=SWSRC
          short-label=examples::EBT::Pwm_example_S32K118::TresosProject::Pwm_example_S32K118::.prefs::preferences.xdm, category=SWCFG
          short-label=examples::EBT::Pwm_example_S32K118::TresosProject::Pwm_example_S32K118::config::Base.xdm, category=SWCFG
          short-label=examples::EBT::Pwm_example_S32K118::TresosProject::Pwm_example_S32K118::config::Dem.xdm, category=SWCFG
          short-label=examples::EBT::Pwm_example_S32K118::TresosProject::Pwm_example_S32K118::config::Ecuc.xdm, category=SWCFG
          short-label=examples::EBT::Pwm_example_S32K118::TresosProject::Pwm_example_S32K118::config::Mcl.xdm, category=SWCFG
          short-label=examples::EBT::Pwm_example_S32K118::TresosProject::Pwm_example_S32K118::config::Mcu.xdm, category=SWCFG
          short-label=examples::EBT::Pwm_example_S32K118::TresosProject::Pwm_example_S32K118::config::Platform.xdm, category=SWCFG
          short-label=examples::EBT::Pwm_example_S32K118::TresosProject::Pwm_example_S32K118::config::Port.xdm, category=SWCFG
          short-label=examples::EBT::Pwm_example_S32K118::TresosProject::Pwm_example_S32K118::config::Pwm.xdm, category=SWCFG
          short-label=examples::EBT::Pwm_example_S32K118::TresosProject::Pwm_example_S32K118::config::Resource.xdm, category=SWCFG
          short-label=examples::EBT::Pwm_example_S32K144::generate::epc::Base.xdm, category=SWCFG
          short-label=examples::EBT::Pwm_example_S32K144::generate::epc::Dem.xdm, category=SWCFG
          short-label=examples::EBT::Pwm_example_S32K144::generate::epc::Ecuc.xdm, category=SWCFG
          short-label=examples::EBT::Pwm_example_S32K144::generate::epc::Mcl.xdm, category=SWCFG
          short-label=examples::EBT::Pwm_example_S32K144::generate::epc::Mcu.xdm, category=SWCFG
          short-label=examples::EBT::Pwm_example_S32K144::generate::epc::Platform.xdm, category=SWCFG
          short-label=examples::EBT::Pwm_example_S32K144::generate::epc::Port.xdm, category=SWCFG
          short-label=examples::EBT::Pwm_example_S32K144::generate::epc::Pwm.xdm, category=SWCFG
          short-label=examples::EBT::Pwm_example_S32K144::generate::epc::Resource.xdm, category=SWCFG
          short-label=examples::EBT::Pwm_example_S32K144::include::check_example.h, category=SWHDR
          short-label=examples::EBT::Pwm_example_S32K144::src::main.c, category=SWSRC
          short-label=examples::EBT::Pwm_example_S32K144::TresosProject::Pwm_example_S32K144::.prefs::preferences.xdm, category=SWCFG
          short-label=examples::EBT::Pwm_example_S32K144::TresosProject::Pwm_example_S32K144::config::Base.xdm, category=SWCFG
          short-label=examples::EBT::Pwm_example_S32K144::TresosProject::Pwm_example_S32K144::config::Dem.xdm, category=SWCFG
          short-label=examples::EBT::Pwm_example_S32K144::TresosProject::Pwm_example_S32K144::config::Ecuc.xdm, category=SWCFG
          short-label=examples::EBT::Pwm_example_S32K144::TresosProject::Pwm_example_S32K144::config::Mcl.xdm, category=SWCFG
          short-label=examples::EBT::Pwm_example_S32K144::TresosProject::Pwm_example_S32K144::config::Mcu.xdm, category=SWCFG
          short-label=examples::EBT::Pwm_example_S32K144::TresosProject::Pwm_example_S32K144::config::Platform.xdm, category=SWCFG
          short-label=examples::EBT::Pwm_example_S32K144::TresosProject::Pwm_example_S32K144::config::Port.xdm, category=SWCFG
          short-label=examples::EBT::Pwm_example_S32K144::TresosProject::Pwm_example_S32K144::config::Pwm.xdm, category=SWCFG
          short-label=examples::EBT::Pwm_example_S32K144::TresosProject::Pwm_example_S32K144::config::Resource.xdm, category=SWCFG
          short-label=examples::EBT::Pwm_example_S32K144W::generate::epc::Base.xdm, category=SWCFG
          short-label=examples::EBT::Pwm_example_S32K144W::generate::epc::Dem.xdm, category=SWCFG
          short-label=examples::EBT::Pwm_example_S32K144W::generate::epc::Ecuc.xdm, category=SWCFG
          short-label=examples::EBT::Pwm_example_S32K144W::generate::epc::Mcl.xdm, category=SWCFG
          short-label=examples::EBT::Pwm_example_S32K144W::generate::epc::Mcu.xdm, category=SWCFG
          short-label=examples::EBT::Pwm_example_S32K144W::generate::epc::Platform.xdm, category=SWCFG
          short-label=examples::EBT::Pwm_example_S32K144W::generate::epc::Port.xdm, category=SWCFG
          short-label=examples::EBT::Pwm_example_S32K144W::generate::epc::Pwm.xdm, category=SWCFG
          short-label=examples::EBT::Pwm_example_S32K144W::generate::epc::Resource.xdm, category=SWCFG
          short-label=examples::EBT::Pwm_example_S32K144W::include::check_example.h, category=SWHDR
          short-label=examples::EBT::Pwm_example_S32K144W::src::main.c, category=SWSRC
          short-label=examples::EBT::Pwm_example_S32K144W::TresosProject::Pwm_example_S32K144W::.prefs::preferences.xdm, category=SWCFG
          short-label=examples::EBT::Pwm_example_S32K144W::TresosProject::Pwm_example_S32K144W::config::Base.xdm, category=SWCFG
          short-label=examples::EBT::Pwm_example_S32K144W::TresosProject::Pwm_example_S32K144W::config::Dem.xdm, category=SWCFG
          short-label=examples::EBT::Pwm_example_S32K144W::TresosProject::Pwm_example_S32K144W::config::Ecuc.xdm, category=SWCFG
          short-label=examples::EBT::Pwm_example_S32K144W::TresosProject::Pwm_example_S32K144W::config::Mcl.xdm, category=SWCFG
          short-label=examples::EBT::Pwm_example_S32K144W::TresosProject::Pwm_example_S32K144W::config::Mcu.xdm, category=SWCFG
          short-label=examples::EBT::Pwm_example_S32K144W::TresosProject::Pwm_example_S32K144W::config::Platform.xdm, category=SWCFG
          short-label=examples::EBT::Pwm_example_S32K144W::TresosProject::Pwm_example_S32K144W::config::Port.xdm, category=SWCFG
          short-label=examples::EBT::Pwm_example_S32K144W::TresosProject::Pwm_example_S32K144W::config::Pwm.xdm, category=SWCFG
          short-label=examples::EBT::Pwm_example_S32K144W::TresosProject::Pwm_example_S32K144W::config::Resource.xdm, category=SWCFG
          short-label=examples::EBT::Pwm_example_S32K148::generate::epc::Base.xdm, category=SWCFG
          short-label=examples::EBT::Pwm_example_S32K148::generate::epc::Dem.xdm, category=SWCFG
          short-label=examples::EBT::Pwm_example_S32K148::generate::epc::Ecuc.xdm, category=SWCFG
          short-label=examples::EBT::Pwm_example_S32K148::generate::epc::Mcl.xdm, category=SWCFG
          short-label=examples::EBT::Pwm_example_S32K148::generate::epc::Mcu.xdm, category=SWCFG
          short-label=examples::EBT::Pwm_example_S32K148::generate::epc::Platform.xdm, category=SWCFG
          short-label=examples::EBT::Pwm_example_S32K148::generate::epc::Port.xdm, category=SWCFG
          short-label=examples::EBT::Pwm_example_S32K148::generate::epc::Pwm.xdm, category=SWCFG
          short-label=examples::EBT::Pwm_example_S32K148::generate::epc::Resource.xdm, category=SWCFG
          short-label=examples::EBT::Pwm_example_S32K148::include::check_example.h, category=SWHDR
          short-label=examples::EBT::Pwm_example_S32K148::src::main.c, category=SWSRC
          short-label=examples::EBT::Pwm_example_S32K148::TresosProject::Pwm_example_S32K148::.prefs::preferences.xdm, category=SWCFG
          short-label=examples::EBT::Pwm_example_S32K148::TresosProject::Pwm_example_S32K148::config::Base.xdm, category=SWCFG
          short-label=examples::EBT::Pwm_example_S32K148::TresosProject::Pwm_example_S32K148::config::Dem.xdm, category=SWCFG
          short-label=examples::EBT::Pwm_example_S32K148::TresosProject::Pwm_example_S32K148::config::Ecuc.xdm, category=SWCFG
          short-label=examples::EBT::Pwm_example_S32K148::TresosProject::Pwm_example_S32K148::config::Mcl.xdm, category=SWCFG
          short-label=examples::EBT::Pwm_example_S32K148::TresosProject::Pwm_example_S32K148::config::Mcu.xdm, category=SWCFG
          short-label=examples::EBT::Pwm_example_S32K148::TresosProject::Pwm_example_S32K148::config::Platform.xdm, category=SWCFG
          short-label=examples::EBT::Pwm_example_S32K148::TresosProject::Pwm_example_S32K148::config::Port.xdm, category=SWCFG
          short-label=examples::EBT::Pwm_example_S32K148::TresosProject::Pwm_example_S32K148::config::Pwm.xdm, category=SWCFG
          short-label=examples::EBT::Pwm_example_S32K148::TresosProject::Pwm_example_S32K148::config::Resource.xdm, category=SWCFG
          short-label=examples::S32DS::Ftm_Pwm_Ip_Example_S32K118::include::check_example.h, category=SWHDR
          short-label=examples::S32DS::Ftm_Pwm_Ip_Example_S32K118::Project_Settings::Startup_Code::exceptions.c, category=SWSRC
          short-label=examples::S32DS::Ftm_Pwm_Ip_Example_S32K118::Project_Settings::Startup_Code::nvic.c, category=SWSRC
          short-label=examples::S32DS::Ftm_Pwm_Ip_Example_S32K118::Project_Settings::Startup_Code::startup.c, category=SWSRC
          short-label=examples::S32DS::Ftm_Pwm_Ip_Example_S32K118::Project_Settings::Startup_Code::system.c, category=SWSRC
          short-label=examples::S32DS::Ftm_Pwm_Ip_Example_S32K118::src::main.c, category=SWSRC
          short-label=examples::S32DS::Ftm_Pwm_Ip_Example_S32K144::include::check_example.h, category=SWHDR
          short-label=examples::S32DS::Ftm_Pwm_Ip_Example_S32K144::Project_Settings::Startup_Code::exceptions.c, category=SWSRC
          short-label=examples::S32DS::Ftm_Pwm_Ip_Example_S32K144::Project_Settings::Startup_Code::nvic.c, category=SWSRC
          short-label=examples::S32DS::Ftm_Pwm_Ip_Example_S32K144::Project_Settings::Startup_Code::startup.c, category=SWSRC
          short-label=examples::S32DS::Ftm_Pwm_Ip_Example_S32K144::Project_Settings::Startup_Code::system.c, category=SWSRC
          short-label=examples::S32DS::Ftm_Pwm_Ip_Example_S32K144::src::main.c, category=SWSRC
          short-label=examples::S32DS::Ftm_Pwm_Ip_Example_S32K144W::include::check_example.h, category=SWHDR
          short-label=examples::S32DS::Ftm_Pwm_Ip_Example_S32K144W::Project_Settings::Startup_Code::exceptions.c, category=SWSRC
          short-label=examples::S32DS::Ftm_Pwm_Ip_Example_S32K144W::Project_Settings::Startup_Code::nvic.c, category=SWSRC
          short-label=examples::S32DS::Ftm_Pwm_Ip_Example_S32K144W::Project_Settings::Startup_Code::startup.c, category=SWSRC
          short-label=examples::S32DS::Ftm_Pwm_Ip_Example_S32K144W::Project_Settings::Startup_Code::system.c, category=SWSRC
          short-label=examples::S32DS::Ftm_Pwm_Ip_Example_S32K144W::src::main.c, category=SWSRC
          short-label=examples::S32DS::Ftm_Pwm_Ip_Example_S32K148::include::check_example.h, category=SWHDR
          short-label=examples::S32DS::Ftm_Pwm_Ip_Example_S32K148::Project_Settings::Startup_Code::exceptions.c, category=SWSRC
          short-label=examples::S32DS::Ftm_Pwm_Ip_Example_S32K148::Project_Settings::Startup_Code::nvic.c, category=SWSRC
          short-label=examples::S32DS::Ftm_Pwm_Ip_Example_S32K148::Project_Settings::Startup_Code::startup.c, category=SWSRC
          short-label=examples::S32DS::Ftm_Pwm_Ip_Example_S32K148::Project_Settings::Startup_Code::system.c, category=SWSRC
          short-label=examples::S32DS::Ftm_Pwm_Ip_Example_S32K148::src::main.c, category=SWSRC
          short-label=examples::S32DS::Pwm_example_S32K118::include::check_example.h, category=SWHDR
          short-label=examples::S32DS::Pwm_example_S32K118::Project_Settings::Startup_Code::exceptions.c, category=SWSRC
          short-label=examples::S32DS::Pwm_example_S32K118::Project_Settings::Startup_Code::nvic.c, category=SWSRC
          short-label=examples::S32DS::Pwm_example_S32K118::Project_Settings::Startup_Code::startup.c, category=SWSRC
          short-label=examples::S32DS::Pwm_example_S32K118::Project_Settings::Startup_Code::system.c, category=SWSRC
          short-label=examples::S32DS::Pwm_example_S32K118::src::main.c, category=SWSRC
          short-label=examples::S32DS::Pwm_example_S32K144::include::check_example.h, category=SWHDR
          short-label=examples::S32DS::Pwm_example_S32K144::Project_Settings::Startup_Code::exceptions.c, category=SWSRC
          short-label=examples::S32DS::Pwm_example_S32K144::Project_Settings::Startup_Code::nvic.c, category=SWSRC
          short-label=examples::S32DS::Pwm_example_S32K144::Project_Settings::Startup_Code::startup.c, category=SWSRC
          short-label=examples::S32DS::Pwm_example_S32K144::Project_Settings::Startup_Code::system.c, category=SWSRC
          short-label=examples::S32DS::Pwm_example_S32K144::src::main.c, category=SWSRC
          short-label=examples::S32DS::Pwm_example_S32K144W::include::check_example.h, category=SWHDR
          short-label=examples::S32DS::Pwm_example_S32K144W::Project_Settings::Startup_Code::exceptions.c, category=SWSRC
          short-label=examples::S32DS::Pwm_example_S32K144W::Project_Settings::Startup_Code::nvic.c, category=SWSRC
          short-label=examples::S32DS::Pwm_example_S32K144W::Project_Settings::Startup_Code::startup.c, category=SWSRC
          short-label=examples::S32DS::Pwm_example_S32K144W::Project_Settings::Startup_Code::system.c, category=SWSRC
          short-label=examples::S32DS::Pwm_example_S32K144W::src::main.c, category=SWSRC
          short-label=examples::S32DS::Pwm_example_S32K148::include::check_example.h, category=SWHDR
          short-label=examples::S32DS::Pwm_example_S32K148::Project_Settings::Startup_Code::exceptions.c, category=SWSRC
          short-label=examples::S32DS::Pwm_example_S32K148::Project_Settings::Startup_Code::nvic.c, category=SWSRC
          short-label=examples::S32DS::Pwm_example_S32K148::Project_Settings::Startup_Code::startup.c, category=SWSRC
          short-label=examples::S32DS::Pwm_example_S32K148::Project_Settings::Startup_Code::system.c, category=SWSRC
          short-label=examples::S32DS::Pwm_example_S32K148::src::main.c, category=SWSRC
          short-label=include::Flexio_Pwm_Ip.h, category=SWHDR
          short-label=include::Flexio_Pwm_Ip_HwAccess.h, category=SWHDR
          short-label=include::Flexio_Pwm_Ip_Irq.h, category=SWHDR
          short-label=include::Flexio_Pwm_Ip_Types.h, category=SWHDR
          short-label=include::Ftm_Pwm_Ip.h, category=SWHDR
          short-label=include::Ftm_Pwm_Ip_HwAccess.h, category=SWHDR
          short-label=include::Ftm_Pwm_Ip_Irq.h, category=SWHDR
          short-label=include::Ftm_Pwm_Ip_TrustedFunctions.h, category=SWHDR
          short-label=include::Ftm_Pwm_Ip_Types.h, category=SWHDR
          short-label=include::Pwm.h, category=SWHDR
          short-label=include::Pwm_EnvCfg.h, category=SWHDR
          short-label=include::Pwm_Ipw.h, category=SWHDR
          short-label=include::Pwm_Ipw_Notif.h, category=SWHDR
          short-label=include::Pwm_Ipw_Types.h, category=SWHDR
          short-label=include::Pwm_Notif.h, category=SWHDR
          short-label=src::Flexio_Pwm_Ip.c, category=SWSRC
          short-label=src::Flexio_Pwm_Ip_Irq.c, category=SWSRC
          short-label=src::Ftm_Pwm_Ip.c, category=SWSRC
          short-label=src::Ftm_Pwm_Ip_Irq.c, category=SWSRC
          short-label=src::Pwm.c, category=SWSRC
          short-label=src::Pwm_Ipw.c, category=SWSRC
          short-label=src::Pwm_Ipw_Notif.c, category=SWSRC
    compiler GCC_Compiler:
      name=GCC Compiler
      options=-mcpu=cortex-m4 -mcpu=cortex-m0plus -mthumb -mlittle-endian -mfpu=fpv4-sp-d16 -mfloat-abi=hard -mfpu=auto -mfloat-abi=soft -std=c99 -Os -ggdb3 -Wall -Wextra -pedantic -Wstrict-prototypes -Wundef -Wunused -Werror=implicit-function-declaration -Wsign-compare -Wdouble-promotion -fno-short-enums -funsigned-char -funsigned-bitfields -fomit-frame-pointer -fno-common -fstack-usage -fdump-ipa-all -c -DS32K1XX -DS32K148 -DGCC -DUSE_SW_VECTOR_MODE -DI_CACHE_ENABLE -DENABLE_FPU -DMCAL_ENABLE_USER_MODE_SUPPORT
      vendor=GCC Systems
      version=NXP GCC 9.2.0 20190812 (Build 1649 Revision gaf57174)
    compiler GHS_Compiler:
      name=Green Hills
      options=-cpu=cortexm4 -cpu=cortexm0plus -thumb -fpu=vfpv4_d16 -fsingle -fsoft -C99 --ghstd=last -Osize --gnu_asm -dual_debug -G -keeptempfiles -Wimplicit-int -Wshadow -Wtrigraphs -Wundef --unsigned_chars --unsigned_fields --no_commons --no_exceptions --no_slash_comment --prototype_errors --incorrect_pragma_warnings -c -DS32K1XX -DS32K148 -DGHS -DUSE_SW_VECTOR_MODE -DI_CACHE_ENABLE -DENABLE_FPU -DMCAL_ENABLE_USER_MODE_SUPPORT
      vendor=Green Hills
      version=Green Hills Multi 7.1.6d / Compiler 2020.1.4
    compiler IAR_Compiler:
      name=IAR Compiler
      options=--cpu=Cortex-M4 --cpu=Cortex-M0+ --cpu_mode=thumb --endian=little --fpu=FPv4-SP --fpu=none -e -Ohz --debug --no_clustering --no_mem_idioms --no_explicit_zero_opt --require_prototypes --no_wrap_diagnostics --diag_suppress=Pa050 -DS32K1XX -DS32K148 -DIAR -DUSE_SW_VECTOR_MODE -DI_CACHE_ENABLE -DENABLE_FPU -DMCAL_ENABLE_USER_MODE_SUPPORT
      vendor=IAR Systems
      version=IAR ANSI C/C++ Compiler V8.40.3.228/W32 for ARM Functional Safety
    generated-artifacts:
      12 x dependency on artifact:
        Flexio_Pwm_Ip_PBcfg_h: artifact-descriptor={short-label=generate_PB::include::Flexio_Pwm_Ip_PBcfg.h, category=SWHDR}, usages=EXECUTE
        Ftm_Pwm_Ip_PBcfg_h: artifact-descriptor={short-label=generate_PB::include::Ftm_Pwm_Ip_PBcfg.h, category=SWHDR}, usages=EXECUTE
        Pwm_PBcfg_h: artifact-descriptor={short-label=generate_PB::include::Pwm_PBcfg.h, category=SWHDR}, usages=EXECUTE
        Flexio_Pwm_Ip_PBcfg_c: artifact-descriptor={short-label=generate_PB::src::Flexio_Pwm_Ip_PBcfg.c, category=SWSRC}, usages=EXECUTE
        Ftm_Pwm_Ip_PBcfg_c: artifact-descriptor={short-label=generate_PB::src::Ftm_Pwm_Ip_PBcfg.c, category=SWSRC}, usages=EXECUTE
        Pwm_PBcfg_c: artifact-descriptor={short-label=generate_PB::src::Pwm_PBcfg.c, category=SWSRC}, usages=EXECUTE
        Flexio_Pwm_Ip_Cfg_h: artifact-descriptor={short-label=generate_PC::include::Flexio_Pwm_Ip_Cfg.h, category=SWHDR}, usages=COMPILE
        Flexio_Pwm_Ip_CfgDefines_h: artifact-descriptor={short-label=generate_PC::include::Flexio_Pwm_Ip_CfgDefines.h, category=SWHDR}, usages=COMPILE
        Ftm_Pwm_Ip_Cfg_h: artifact-descriptor={short-label=generate_PC::include::Ftm_Pwm_Ip_Cfg.h, category=SWHDR}, usages=COMPILE
        Ftm_Pwm_Ip_CfgDefines_h: artifact-descriptor={short-label=generate_PC::include::Ftm_Pwm_Ip_CfgDefines.h, category=SWHDR}, usages=COMPILE
        Pwm_Cfg_h: artifact-descriptor={short-label=generate_PC::include::Pwm_Cfg.h, category=SWHDR}, usages=COMPILE
        Pwm_Ipw_Cfg_h: artifact-descriptor={short-label=generate_PC::include::Pwm_Ipw_Cfg.h, category=SWHDR}, usages=COMPILE
    linker GCC_Linker: name=GCC Compiler, options=-Wl,-Map,filename -T linkerfile --entry=Reset_Handler -nostartfiles -mcpu=cortex-m4 -mcpu=cortex-m0plus -mthumb -mfpu=fpv4-sp-d16 -mfloat-abi=hard -mfpu=auto -mfloat-abi=soft -mlittle-endian -ggdb3 -lc -lm -lgcc -n, vendor=GCC Systems, version=NXP GCC 9.2.0 20190812 (Build 1649 Revision gaf57174)
    linker GHS_Linker: name=Green Hills, options=-e Reset_Handler -T linker_script_file.ld -map -keepmap -Mn -delete -ignore_debug_references -Llibrary_path -larch -lstartup -lind_sd -lind_sf -v -keep=C40_Ip_AccessCode -nostartfiles, vendor=Green Hills, version=Green Hills Multi 7.1.6d / Compiler 2020.1.4
    linker IAR_Linker: name=IAR Compiler, options=--map filename --config linkerfile --cpu=Cortex-M4 --cpu=Cortex-M0+ --fpu=FPv4-SP --fpu=none --entry _start --enable_stack_usage --skip_dynamic_initialization --no_wrap_diagnostics, vendor=IAR Systems, version=IAR ANSI C/C++ Compiler V8.40.3.228/W32 for ARM Functional Safety
    resource consumption ResourceConsumption
      8 x memory section:
        PWM_CODE: alignment=UNSPECIFIED, sw-addrmethod=CODE, symbol=CODE
        PWM_CONFIG_DATA_UNSPECIFIED: alignment=UNSPECIFIED, sw-addrmethod=CONFIG_DATA, symbol=CONFIG_DATA_UNSPECIFIED
        PWM_CONST_UNSPECIFIED: alignment=UNSPECIFIED, sw-addrmethod=CONST, symbol=CONST_UNSPECIFIED
        PWM_VAR_CLEARED_16: alignment=16, sw-addrmethod=VAR_CLEARED, symbol=VAR_CLEARED_16
        PWM_VAR_CLEARED_32: alignment=32, sw-addrmethod=VAR_CLEARED, symbol=VAR_CLEARED_32
        PWM_VAR_CLEARED_8: alignment=8, sw-addrmethod=VAR_CLEARED, symbol=VAR_CLEARED_8
        PWM_VAR_CLEARED_UNSPECIFIED: alignment=UNSPECIFIED, sw-addrmethod=VAR_CLEARED, symbol=VAR_CLEARED_UNSPECIFIED
        PWM_VAR_INIT_UNSPECIFIED: alignment=UNSPECIFIED, sw-addrmethod=VAR_INIT, symbol=VAR_INIT_UNSPECIFIED
