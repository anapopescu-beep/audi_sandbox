AUTOSAR XML (schema 00046)
package /AUTOSAR_Qdec/BswModuleDescriptions
  bsw module description Qdec: module-id=255
    provided-entrys:
      Qdec_CounterState
      Qdec_DeInit
      Qdec_DisableOverFlowNotification
      Qdec_EnableOverFlowNotification
      Qdec_GetState
      Qdec_Init
      Qdec_ResetState
      Qdec_SetClockMode
      Qdec_SetMode
      FTM_{0..2}_ISR
    bsw internal behavior InternalBehavior_0
      8 x exclusive area:
        QDEC_EXCLUSIVE_AREA_{01..08}
      9 x bsw called entity:
        Qdec_CounterState: can-enter-exclusive-area=QDEC_EXCLUSIVE_AREA_03, implemented-entry=Qdec_CounterState
        Qdec_DeInit: implemented-entry=Qdec_DeInit
        Qdec_DisableOverFlowNotification: can-enter-exclusive-area=QDEC_EXCLUSIVE_AREA_05, implemented-entry=Qdec_DisableOverFlowNotification
        Qdec_EnableOverFlowNotification: can-enter-exclusive-area=QDEC_EXCLUSIVE_AREA_06, implemented-entry=Qdec_EnableOverFlowNotification
        Qdec_GetState: can-enter-exclusive-area=QDEC_EXCLUSIVE_AREA_01, implemented-entry=Qdec_GetState
        Qdec_Init: implemented-entry=Qdec_Init
        Qdec_ResetState: can-enter-exclusive-area=QDEC_EXCLUSIVE_AREA_04, implemented-entry=Qdec_ResetState
        Qdec_SetClockMode: can-enter-exclusive-area=QDEC_EXCLUSIVE_AREA_02, implemented-entry=Qdec_SetClockMode
        Qdec_SetMode: can-enter-exclusive-area=QDEC_EXCLUSIVE_AREA_07, implemented-entry=Qdec_SetMode
      bsw interrupt entity FTM_0_ISR: implemented-entry=FTM_0_ISR, interrupt-category=CAT-2, interrupt-source=Hardware
      bsw interrupt entity FTM_1_ISR: can-enter-exclusive-area=QDEC_EXCLUSIVE_AREA_08, implemented-entry=FTM_1_ISR, interrupt-category=CAT-2, interrupt-source=Hardware
      bsw interrupt entity FTM_2_ISR: can-enter-exclusive-area=QDEC_EXCLUSIVE_AREA_08, implemented-entry=FTM_2_ISR, interrupt-category=CAT-2, interrupt-source=Hardware
package /AUTOSAR_Qdec/BswModuleEntrys
  12 x bsw module entry, all with is-synchronous=true, sw-service-impl-policy=STANDARD:
    Qdec_CounterState: service-id=0x05, is-reentrant=true, call-type=REGULAR, execution-context=UNSPECIFIED
    Qdec_DeInit: service-id=0x02, is-reentrant=false, call-type=REGULAR, execution-context=UNSPECIFIED
    Qdec_DisableOverFlowNotification: service-id=0x07, is-reentrant=true, call-type=REGULAR, execution-context=UNSPECIFIED
    Qdec_EnableOverFlowNotification: service-id=0x08, is-reentrant=true, call-type=REGULAR, execution-context=UNSPECIFIED
    Qdec_GetState: service-id=0x03, is-reentrant=true, call-type=REGULAR, execution-context=UNSPECIFIED
    Qdec_Init: service-id=0x01, is-reentrant=false, call-type=REGULAR, execution-context=UNSPECIFIED
    Qdec_ResetState: service-id=0x06, is-reentrant=true, call-type=REGULAR, execution-context=UNSPECIFIED
    Qdec_SetClockMode: service-id=0x04, is-reentrant=false, call-type=REGULAR, execution-context=UNSPECIFIED
    Qdec_SetMode: service-id=0x09, is-reentrant=true, call-type=REGULAR, execution-context=UNSPECIFIED
    FTM_{0..2}_ISR: service-id=0, is-reentrant=false, call-type=INTERRUPT, execution-context=INTERRUPT-CAT-2
package /Qdec_TS_T40D2M10I1R0/Implementations
  bsw implementation BswImplementation_0: programming-language=C, sw-version=1.0.1, vendor-id=43, ar-release-version=4.4.0, behavior=InternalBehavior_0, vendor-specific-module-def=Qdec
    code-descriptors:
      code Files
        artifact-descriptors:
          short-label=config::Qdec.xdm, category=SWCFG
          short-label=doc::RTD_QDEC_IM.pdf, category=SWDOC
          short-label=doc::RTD_QDEC_UM.pdf, category=SWDOC
          short-label=examples::EBT::Qdec_Example_S32K118::generate::epc::Base.xdm, category=SWCFG
          short-label=examples::EBT::Qdec_Example_S32K118::generate::epc::EcuC.xdm, category=SWCFG
          short-label=examples::EBT::Qdec_Example_S32K118::generate::epc::Mcu.xdm, category=SWCFG
          short-label=examples::EBT::Qdec_Example_S32K118::generate::epc::Os.xdm, category=SWCFG
          short-label=examples::EBT::Qdec_Example_S32K118::generate::epc::Platform.xdm, category=SWCFG
          short-label=examples::EBT::Qdec_Example_S32K118::generate::epc::Port.xdm, category=SWCFG
          short-label=examples::EBT::Qdec_Example_S32K118::generate::epc::Qdec.xdm, category=SWCFG
          short-label=examples::EBT::Qdec_Example_S32K118::generate::epc::Resource.xdm, category=SWCFG
          short-label=examples::EBT::Qdec_Example_S32K118::include::check_example.h, category=SWHDR
          short-label=examples::EBT::Qdec_Example_S32K118::src::main.c, category=SWSRC
          short-label=examples::EBT::Qdec_Example_S32K118::TresosProject::Qdec_Example_S32K118::.prefs::preferences.xdm, category=SWCFG
          short-label=examples::EBT::Qdec_Example_S32K118::TresosProject::Qdec_Example_S32K118::config::Base.xdm, category=SWCFG
          short-label=examples::EBT::Qdec_Example_S32K118::TresosProject::Qdec_Example_S32K118::config::EcuC.xdm, category=SWCFG
          short-label=examples::EBT::Qdec_Example_S32K118::TresosProject::Qdec_Example_S32K118::config::Mcu.xdm, category=SWCFG
          short-label=examples::EBT::Qdec_Example_S32K118::TresosProject::Qdec_Example_S32K118::config::Os.xdm, category=SWCFG
          short-label=examples::EBT::Qdec_Example_S32K118::TresosProject::Qdec_Example_S32K118::config::Platform.xdm, category=SWCFG
          short-label=examples::EBT::Qdec_Example_S32K118::TresosProject::Qdec_Example_S32K118::config::Port.xdm, category=SWCFG
          short-label=examples::EBT::Qdec_Example_S32K118::TresosProject::Qdec_Example_S32K118::config::Qdec.xdm, category=SWCFG
          short-label=examples::EBT::Qdec_Example_S32K118::TresosProject::Qdec_Example_S32K118::config::Resource.xdm, category=SWCFG
          short-label=examples::EBT::Qdec_Example_S32K144::generate::epc::Base.xdm, category=SWCFG
          short-label=examples::EBT::Qdec_Example_S32K144::generate::epc::EcuC.xdm, category=SWCFG
          short-label=examples::EBT::Qdec_Example_S32K144::generate::epc::Mcu.xdm, category=SWCFG
          short-label=examples::EBT::Qdec_Example_S32K144::generate::epc::Os.xdm, category=SWCFG
          short-label=examples::EBT::Qdec_Example_S32K144::generate::epc::Platform.xdm, category=SWCFG
          short-label=examples::EBT::Qdec_Example_S32K144::generate::epc::Port.xdm, category=SWCFG
          short-label=examples::EBT::Qdec_Example_S32K144::generate::epc::Qdec.xdm, category=SWCFG
          short-label=examples::EBT::Qdec_Example_S32K144::generate::epc::Resource.xdm, category=SWCFG
          short-label=examples::EBT::Qdec_Example_S32K144::include::check_example.h, category=SWHDR
          short-label=examples::EBT::Qdec_Example_S32K144::src::main.c, category=SWSRC
          short-label=examples::EBT::Qdec_Example_S32K144::TresosProject::Qdec_Example_S32K144::.prefs::preferences.xdm, category=SWCFG
          short-label=examples::EBT::Qdec_Example_S32K144::TresosProject::Qdec_Example_S32K144::config::Base.xdm, category=SWCFG
          short-label=examples::EBT::Qdec_Example_S32K144::TresosProject::Qdec_Example_S32K144::config::EcuC.xdm, category=SWCFG
          short-label=examples::EBT::Qdec_Example_S32K144::TresosProject::Qdec_Example_S32K144::config::Mcu.xdm, category=SWCFG
          short-label=examples::EBT::Qdec_Example_S32K144::TresosProject::Qdec_Example_S32K144::config::Os.xdm, category=SWCFG
          short-label=examples::EBT::Qdec_Example_S32K144::TresosProject::Qdec_Example_S32K144::config::Platform.xdm, category=SWCFG
          short-label=examples::EBT::Qdec_Example_S32K144::TresosProject::Qdec_Example_S32K144::config::Port.xdm, category=SWCFG
          short-label=examples::EBT::Qdec_Example_S32K144::TresosProject::Qdec_Example_S32K144::config::Qdec.xdm, category=SWCFG
          short-label=examples::EBT::Qdec_Example_S32K144::TresosProject::Qdec_Example_S32K144::config::Resource.xdm, category=SWCFG
          short-label=examples::EBT::Qdec_Example_S32K144W::generate::epc::Base.xdm, category=SWCFG
          short-label=examples::EBT::Qdec_Example_S32K144W::generate::epc::EcuC.xdm, category=SWCFG
          short-label=examples::EBT::Qdec_Example_S32K144W::generate::epc::Mcu.xdm, category=SWCFG
          short-label=examples::EBT::Qdec_Example_S32K144W::generate::epc::Os.xdm, category=SWCFG
          short-label=examples::EBT::Qdec_Example_S32K144W::generate::epc::Platform.xdm, category=SWCFG
          short-label=examples::EBT::Qdec_Example_S32K144W::generate::epc::Port.xdm, category=SWCFG
          short-label=examples::EBT::Qdec_Example_S32K144W::generate::epc::Qdec.xdm, category=SWCFG
          short-label=examples::EBT::Qdec_Example_S32K144W::generate::epc::Resource.xdm, category=SWCFG
          short-label=examples::EBT::Qdec_Example_S32K144W::include::check_example.h, category=SWHDR
          short-label=examples::EBT::Qdec_Example_S32K144W::src::main.c, category=SWSRC
          short-label=examples::EBT::Qdec_Example_S32K144W::TresosProject::Qdec_Example_S32K144W::.prefs::preferences.xdm, category=SWCFG
          short-label=examples::EBT::Qdec_Example_S32K144W::TresosProject::Qdec_Example_S32K144W::config::Base.xdm, category=SWCFG
          short-label=examples::EBT::Qdec_Example_S32K144W::TresosProject::Qdec_Example_S32K144W::config::EcuC.xdm, category=SWCFG
          short-label=examples::EBT::Qdec_Example_S32K144W::TresosProject::Qdec_Example_S32K144W::config::Mcu.xdm, category=SWCFG
          short-label=examples::EBT::Qdec_Example_S32K144W::TresosProject::Qdec_Example_S32K144W::config::Os.xdm, category=SWCFG
          short-label=examples::EBT::Qdec_Example_S32K144W::TresosProject::Qdec_Example_S32K144W::config::Platform.xdm, category=SWCFG
          short-label=examples::EBT::Qdec_Example_S32K144W::TresosProject::Qdec_Example_S32K144W::config::Port.xdm, category=SWCFG
          short-label=examples::EBT::Qdec_Example_S32K144W::TresosProject::Qdec_Example_S32K144W::config::Qdec.xdm, category=SWCFG
          short-label=examples::EBT::Qdec_Example_S32K144W::TresosProject::Qdec_Example_S32K144W::config::Resource.xdm, category=SWCFG
          short-label=examples::EBT::Qdec_Example_S32K148::generate::epc::Base.xdm, category=SWCFG
          short-label=examples::EBT::Qdec_Example_S32K148::generate::epc::EcuC.xdm, category=SWCFG
          short-label=examples::EBT::Qdec_Example_S32K148::generate::epc::Mcu.xdm, category=SWCFG
          short-label=examples::EBT::Qdec_Example_S32K148::generate::epc::Os.xdm, category=SWCFG
          short-label=examples::EBT::Qdec_Example_S32K148::generate::epc::Platform.xdm, category=SWCFG
          short-label=examples::EBT::Qdec_Example_S32K148::generate::epc::Port.xdm, category=SWCFG
          short-label=examples::EBT::Qdec_Example_S32K148::generate::epc::Qdec.xdm, category=SWCFG
          short-label=examples::EBT::Qdec_Example_S32K148::generate::epc::Resource.xdm, category=SWCFG
          short-label=examples::EBT::Qdec_Example_S32K148::include::check_example.h, category=SWHDR
          short-label=examples::EBT::Qdec_Example_S32K148::src::main.c, category=SWSRC
          short-label=examples::EBT::Qdec_Example_S32K148::TresosProject::Qdec_Example_S32K148::.prefs::preferences.xdm, category=SWCFG
          short-label=examples::EBT::Qdec_Example_S32K148::TresosProject::Qdec_Example_S32K148::config::Base.xdm, category=SWCFG
          short-label=examples::EBT::Qdec_Example_S32K148::TresosProject::Qdec_Example_S32K148::config::EcuC.xdm, category=SWCFG
          short-label=examples::EBT::Qdec_Example_S32K148::TresosProject::Qdec_Example_S32K148::config::Mcu.xdm, category=SWCFG
          short-label=examples::EBT::Qdec_Example_S32K148::TresosProject::Qdec_Example_S32K148::config::Os.xdm, category=SWCFG
          short-label=examples::EBT::Qdec_Example_S32K148::TresosProject::Qdec_Example_S32K148::config::Platform.xdm, category=SWCFG
          short-label=examples::EBT::Qdec_Example_S32K148::TresosProject::Qdec_Example_S32K148::config::Port.xdm, category=SWCFG
          short-label=examples::EBT::Qdec_Example_S32K148::TresosProject::Qdec_Example_S32K148::config::Qdec.xdm, category=SWCFG
          short-label=examples::EBT::Qdec_Example_S32K148::TresosProject::Qdec_Example_S32K148::config::Resource.xdm, category=SWCFG
          short-label=examples::S32DS::Ftm_Qdec_Ip_Example_S32K118::include::check_example.h, category=SWHDR
          short-label=examples::S32DS::Ftm_Qdec_Ip_Example_S32K118::Project_Settings::Startup_Code::exceptions.c, category=SWSRC
          short-label=examples::S32DS::Ftm_Qdec_Ip_Example_S32K118::Project_Settings::Startup_Code::nvic.c, category=SWSRC
          short-label=examples::S32DS::Ftm_Qdec_Ip_Example_S32K118::Project_Settings::Startup_Code::startup.c, category=SWSRC
          short-label=examples::S32DS::Ftm_Qdec_Ip_Example_S32K118::Project_Settings::Startup_Code::system.c, category=SWSRC
          short-label=examples::S32DS::Ftm_Qdec_Ip_Example_S32K118::src::main.c, category=SWSRC
          short-label=examples::S32DS::Ftm_Qdec_Ip_Example_S32K144::include::check_example.h, category=SWHDR
          short-label=examples::S32DS::Ftm_Qdec_Ip_Example_S32K144::Project_Settings::Startup_Code::exceptions.c, category=SWSRC
          short-label=examples::S32DS::Ftm_Qdec_Ip_Example_S32K144::Project_Settings::Startup_Code::nvic.c, category=SWSRC
          short-label=examples::S32DS::Ftm_Qdec_Ip_Example_S32K144::Project_Settings::Startup_Code::startup.c, category=SWSRC
          short-label=examples::S32DS::Ftm_Qdec_Ip_Example_S32K144::Project_Settings::Startup_Code::system.c, category=SWSRC
          short-label=examples::S32DS::Ftm_Qdec_Ip_Example_S32K144::src::main.c, category=SWSRC
          short-label=examples::S32DS::Ftm_Qdec_Ip_Example_S32K144W::include::check_example.h, category=SWHDR
          short-label=examples::S32DS::Ftm_Qdec_Ip_Example_S32K144W::Project_Settings::Startup_Code::exceptions.c, category=SWSRC
          short-label=examples::S32DS::Ftm_Qdec_Ip_Example_S32K144W::Project_Settings::Startup_Code::nvic.c, category=SWSRC
          short-label=examples::S32DS::Ftm_Qdec_Ip_Example_S32K144W::Project_Settings::Startup_Code::startup.c, category=SWSRC
          short-label=examples::S32DS::Ftm_Qdec_Ip_Example_S32K144W::Project_Settings::Startup_Code::system.c, category=SWSRC
          short-label=examples::S32DS::Ftm_Qdec_Ip_Example_S32K144W::src::main.c, category=SWSRC
          short-label=examples::S32DS::Ftm_Qdec_Ip_Example_S32K148::include::check_example.h, category=SWHDR
          short-label=examples::S32DS::Ftm_Qdec_Ip_Example_S32K148::Project_Settings::Startup_Code::exceptions.c, category=SWSRC
          short-label=examples::S32DS::Ftm_Qdec_Ip_Example_S32K148::Project_Settings::Startup_Code::nvic.c, category=SWSRC
          short-label=examples::S32DS::Ftm_Qdec_Ip_Example_S32K148::Project_Settings::Startup_Code::startup.c, category=SWSRC
          short-label=examples::S32DS::Ftm_Qdec_Ip_Example_S32K148::Project_Settings::Startup_Code::system.c, category=SWSRC
          short-label=examples::S32DS::Ftm_Qdec_Ip_Example_S32K148::src::main.c, category=SWSRC
          short-label=examples::S32DS::Qdec_Example_S32K118::include::check_example.h, category=SWHDR
          short-label=examples::S32DS::Qdec_Example_S32K118::Project_Settings::Startup_Code::exceptions.c, category=SWSRC
          short-label=examples::S32DS::Qdec_Example_S32K118::Project_Settings::Startup_Code::nvic.c, category=SWSRC
          short-label=examples::S32DS::Qdec_Example_S32K118::Project_Settings::Startup_Code::startup.c, category=SWSRC
          short-label=examples::S32DS::Qdec_Example_S32K118::Project_Settings::Startup_Code::system.c, category=SWSRC
          short-label=examples::S32DS::Qdec_Example_S32K118::src::main.c, category=SWSRC
          short-label=examples::S32DS::Qdec_Example_S32K144::include::check_example.h, category=SWHDR
          short-label=examples::S32DS::Qdec_Example_S32K144::Project_Settings::Startup_Code::exceptions.c, category=SWSRC
          short-label=examples::S32DS::Qdec_Example_S32K144::Project_Settings::Startup_Code::nvic.c, category=SWSRC
          short-label=examples::S32DS::Qdec_Example_S32K144::Project_Settings::Startup_Code::startup.c, category=SWSRC
          short-label=examples::S32DS::Qdec_Example_S32K144::Project_Settings::Startup_Code::system.c, category=SWSRC
          short-label=examples::S32DS::Qdec_Example_S32K144::src::main.c, category=SWSRC
          short-label=examples::S32DS::Qdec_Example_S32K144W::include::check_example.h, category=SWHDR
          short-label=examples::S32DS::Qdec_Example_S32K144W::Project_Settings::Startup_Code::exceptions.c, category=SWSRC
          short-label=examples::S32DS::Qdec_Example_S32K144W::Project_Settings::Startup_Code::nvic.c, category=SWSRC
          short-label=examples::S32DS::Qdec_Example_S32K144W::Project_Settings::Startup_Code::startup.c, category=SWSRC
          short-label=examples::S32DS::Qdec_Example_S32K144W::Project_Settings::Startup_Code::system.c, category=SWSRC
          short-label=examples::S32DS::Qdec_Example_S32K144W::src::main.c, category=SWSRC
          short-label=examples::S32DS::Qdec_Example_S32K148::include::check_example.h, category=SWHDR
          short-label=examples::S32DS::Qdec_Example_S32K148::Project_Settings::Startup_Code::exceptions.c, category=SWSRC
          short-label=examples::S32DS::Qdec_Example_S32K148::Project_Settings::Startup_Code::nvic.c, category=SWSRC
          short-label=examples::S32DS::Qdec_Example_S32K148::Project_Settings::Startup_Code::startup.c, category=SWSRC
          short-label=examples::S32DS::Qdec_Example_S32K148::Project_Settings::Startup_Code::system.c, category=SWSRC
          short-label=examples::S32DS::Qdec_Example_S32K148::src::main.c, category=SWSRC
          short-label=include::Ftm_Qdec_Ip.h, category=SWHDR
          short-label=include::Ftm_Qdec_Ip_Irq.h, category=SWHDR
          short-label=include::Ftm_Qdec_Ip_TrustedFunctions.h, category=SWHDR
          short-label=include::Ftm_Qdec_Ip_Types.h, category=SWHDR
          short-label=include::Qdec.h, category=SWHDR
          short-label=include::Qdec_EnvCfg.h, category=SWHDR
          short-label=include::Qdec_Ipw.h, category=SWHDR
          short-label=include::Qdec_Ipw_Irq.h, category=SWHDR
          short-label=include::Qdec_Ipw_Types.h, category=SWHDR
          short-label=include::Qdec_Types.h, category=SWHDR
          short-label=src::Ftm_Qdec_Ip.c, category=SWSRC
          short-label=src::Ftm_Qdec_Ip_Irq.c, category=SWSRC
          short-label=src::Qdec.c, category=SWSRC
          short-label=src::Qdec_Ipw.c, category=SWSRC
    compiler GCC_Compiler:
      name=GCC Compiler
      options=-mcpu=cortex-m4 -mcpu=cortex-m0plus -mthumb -mlittle-endian -mfpu=fpv4-sp-d16 -mfloat-abi=hard -mfpu=auto -mfloat-abi=soft -std=c99 -Os -ggdb3 -Wall -Wextra -pedantic -Wstrict-prototypes -Wundef -Wunused -Werror=implicit-function-declaration -Wsign-compare -Wdouble-promotion -fno-short-enums -funsigned-char -funsigned-bitfields -fomit-frame-pointer -fno-common -fstack-usage -fdump-ipa-all -c -DS32K1XX -DS32K148 -DGCC -DUSE_SW_VECTOR_MODE -DI_CACHE_ENABLE -DENABLE_FPU -DMCAL_ENABLE_USER_MODE_SUPPORT
      vendor=GCC Systems
      version=NXP GCC 9.2.0 20190812 (Build 1649 Revision gaf57174)
    compiler GHS_Compiler:
      name=Green Hills
      options=-cpu=cortexm4 -cpu=cortexm0plus -thumb -fpu=vfpv4_d16 -fsingle -fsoft -C99 --ghstd=last -Osize --gnu_asm -dual_debug -G -keeptempfiles -Wimplicit-int -Wshadow -Wtrigraphs -Wundef --unsigned_chars --unsigned_fields --no_commons --no_exceptions --no_slash_comment --prototype_errors --incorrect_pragma_warnings -c -DS32K1XX -DS32K148 -DGHS -DUSE_SW_VECTOR_MODE -DI_CACHE_ENABLE -DENABLE_FPU -DMCAL_ENABLE_USER_MODE_SUPPORT
      vendor=Green Hills
      version=Green Hills Multi 7.1.6d / Compiler 2020.1.4
    compiler IAR_Compiler:
      name=IAR Compiler
      options=--cpu=Cortex-M4 --cpu=Cortex-M0+ --cpu_mode=thumb --endian=little --fpu=FPv4-SP --fpu=none -e -Ohz --debug --no_clustering --no_mem_idioms --no_explicit_zero_opt --require_prototypes --no_wrap_diagnostics --diag_suppress=Pa050 -DS32K1XX -DS32K148 -DIAR -DUSE_SW_VECTOR_MODE -DI_CACHE_ENABLE -DENABLE_FPU -DMCAL_ENABLE_USER_MODE_SUPPORT
      vendor=IAR Systems
      version=IAR ANSI C/C++ Compiler V8.40.3.228/W32 for ARM Functional Safety
    generated-artifacts:
      9 x dependency on artifact:
        Ftm_Qdec_Ip_PBcfg_h: artifact-descriptor={short-label=generate_PB::include::Ftm_Qdec_Ip_PBcfg.h, category=SWHDR}, usages=EXECUTE
        Qdec_Ipw_PBcfg_h: artifact-descriptor={short-label=generate_PB::include::Qdec_Ipw_PBcfg.h, category=SWHDR}, usages=EXECUTE
        Qdec_PBcfg_h: artifact-descriptor={short-label=generate_PB::include::Qdec_PBcfg.h, category=SWHDR}, usages=EXECUTE
        Ftm_Qdec_Ip_PBcfg_c: artifact-descriptor={short-label=generate_PB::src::Ftm_Qdec_Ip_PBcfg.c, category=SWSRC}, usages=EXECUTE
        Qdec_Ipw_PBcfg_c: artifact-descriptor={short-label=generate_PB::src::Qdec_Ipw_PBcfg.c, category=SWSRC}, usages=EXECUTE
        Qdec_PBcfg_c: artifact-descriptor={short-label=generate_PB::src::Qdec_PBcfg.c, category=SWSRC}, usages=EXECUTE
        Ftm_Qdec_Ip_Cfg_h: artifact-descriptor={short-label=generate_PC::include::Ftm_Qdec_Ip_Cfg.h, category=SWHDR}, usages=COMPILE
        Ftm_Qdec_Ip_CfgDefines_h: artifact-descriptor={short-label=generate_PC::include::Ftm_Qdec_Ip_CfgDefines.h, category=SWHDR}, usages=COMPILE
        Qdec_Cfg_h: artifact-descriptor={short-label=generate_PC::include::Qdec_Cfg.h, category=SWHDR}, usages=COMPILE
    linker GCC_Linker: name=GCC Compiler, options=-Wl,-Map,filename -T linkerfile --entry=Reset_Handler -nostartfiles -mcpu=cortex-m4 -mcpu=cortex-m0plus -mthumb -mfpu=fpv4-sp-d16 -mfloat-abi=hard -mfpu=auto -mfloat-abi=soft -mlittle-endian -ggdb3 -lc -lm -lgcc -n, vendor=GCC Systems, version=NXP GCC 9.2.0 20190812 (Build 1649 Revision gaf57174)
    linker GHS_Linker: name=Green Hills, options=-e Reset_Handler -T linker_script_file.ld -map -keepmap -Mn -delete -ignore_debug_references -Llibrary_path -larch -lstartup -lind_sd -lind_sf -v -keep=C40_Ip_AccessCode -nostartfiles, vendor=Green Hills, version=Green Hills Multi 7.1.6d / Compiler 2020.1.4
    linker IAR_Linker: name=IAR Compiler, options=--map filename --config linkerfile --cpu=Cortex-M4 --cpu=Cortex-M0+ --fpu=FPv4-SP --fpu=none --entry _start --enable_stack_usage --skip_dynamic_initialization --no_wrap_diagnostics, vendor=IAR Systems, version=IAR ANSI C/C++ Compiler V8.40.3.228/W32 for ARM Functional Safety
    resource consumption ResourceConsumption
      5 x memory section, all with alignment=UNSPECIFIED:
        QDEC_CODE: sw-addrmethod=CODE, symbol=CODE
        QDEC_CONFIG_DATA_UNSPECIFIED: sw-addrmethod=CONFIG_DATA, symbol=CONFIG_DATA_UNSPECIFIED
        QDEC_CONST_UNSPECIFIED: sw-addrmethod=CONST, symbol=CONST_UNSPECIFIED
        QDEC_VAR_CLEARED_UNSPECIFIED: sw-addrmethod=VAR_CLEARED, symbol=VAR_CLEARED_UNSPECIFIED
        QDEC_VAR_INIT_UNSPECIFIED: sw-addrmethod=VAR_INIT, symbol=VAR_INIT_UNSPECIFIED
