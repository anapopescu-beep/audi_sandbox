AUTOSAR XML (schema 00046)
package /AUTOSAR_Rm/BswModuleDescriptions
  bsw module description Rm: module-id=255
    provided-entrys:
      Rm_GetVersionInfo
      Rm_Init
      Rm_Mpu_EnableRegion
      Rm_Mpu_GetErrorDetails
      Rm_Mpu_SetAccessMode
      Rm_Mpu_SetRegionConfig
    bsw internal behavior InternalBehavior_0
      exclusive area RM_EXCLUSIVE_AREA_{04..06}
      6 x bsw called entity:
        Rm_GetVersionInfo: implemented-entry=Rm_GetVersionInfo
        Rm_Init: can-enter-exclusive-area=RM_EXCLUSIVE_AREA_04, implemented-entry=Rm_Init
        Rm_Mpu_EnableRegion: can-enter-exclusive-area=RM_EXCLUSIVE_AREA_05, implemented-entry=Rm_Mpu_EnableRegion
        Rm_Mpu_GetErrorDetails: implemented-entry=Rm_Mpu_GetErrorDetails
        Rm_Mpu_SetAccessMode: can-enter-exclusive-area=RM_EXCLUSIVE_AREA_06, implemented-entry=Rm_Mpu_SetAccessMode
        Rm_Mpu_SetRegionConfig: implemented-entry=Rm_Mpu_SetRegionConfig
package /AUTOSAR_Rm/BswModuleEntrys
  6 x bsw module entry, all with is-synchronous=true, call-type=REGULAR, execution-context=UNSPECIFIED, sw-service-impl-policy=STANDARD:
    Rm_GetVersionInfo: service-id=0x01, is-reentrant=true
    Rm_Init: service-id=0x00, is-reentrant=false
    Rm_Mpu_EnableRegion: service-id=0x0e, is-reentrant=true
    Rm_Mpu_GetErrorDetails: service-id=0x10, is-reentrant=true
    Rm_Mpu_SetAccessMode: service-id=0x0f, is-reentrant=true
    Rm_Mpu_SetRegionConfig: service-id=0x0d, is-reentrant=true
package /Rm_TS_T40D2M10I1R0/Implementations
  bsw implementation BswImplementation_0: programming-language=C, sw-version=1.0.1, vendor-id=43, ar-release-version=4.4.0, behavior=InternalBehavior_0, vendor-specific-module-def=Rm
    code-descriptors:
      code Files
        artifact-descriptors:
          short-label=config::Rm.xdm, category=SWCFG
          short-label=doc::RTD_RM_IM.pdf, category=SWDOC
          short-label=doc::RTD_RM_UM.pdf, category=SWDOC
          short-label=examples::EBT::Rm_Example_S32K118::generate::epc::Base.xdm, category=SWCFG
          short-label=examples::EBT::Rm_Example_S32K118::generate::epc::Mcl.xdm, category=SWCFG
          short-label=examples::EBT::Rm_Example_S32K118::generate::epc::Resource.xdm, category=SWCFG
          short-label=examples::EBT::Rm_Example_S32K118::generate::epc::Rm.xdm, category=SWCFG
          short-label=examples::EBT::Rm_Example_S32K118::include::check_example.h, category=SWHDR
          short-label=examples::EBT::Rm_Example_S32K118::src::main.c, category=SWSRC
          short-label=examples::EBT::Rm_Example_S32K118::TresosProject::Rm_Example_S32K118::.prefs::preferences.xdm, category=SWCFG
          short-label=examples::EBT::Rm_Example_S32K118::TresosProject::Rm_Example_S32K118::config::Base.xdm, category=SWCFG
          short-label=examples::EBT::Rm_Example_S32K118::TresosProject::Rm_Example_S32K118::config::EcuC.xdm, category=SWCFG
          short-label=examples::EBT::Rm_Example_S32K118::TresosProject::Rm_Example_S32K118::config::Mcl.xdm, category=SWCFG
          short-label=examples::EBT::Rm_Example_S32K118::TresosProject::Rm_Example_S32K118::config::Resource.xdm, category=SWCFG
          short-label=examples::EBT::Rm_Example_S32K118::TresosProject::Rm_Example_S32K118::config::Rm.xdm, category=SWCFG
          short-label=examples::EBT::Rm_Example_S32K144::generate::epc::Base.xdm, category=SWCFG
          short-label=examples::EBT::Rm_Example_S32K144::generate::epc::Mcl.xdm, category=SWCFG
          short-label=examples::EBT::Rm_Example_S32K144::generate::epc::Resource.xdm, category=SWCFG
          short-label=examples::EBT::Rm_Example_S32K144::generate::epc::Rm.xdm, category=SWCFG
          short-label=examples::EBT::Rm_Example_S32K144::include::check_example.h, category=SWHDR
          short-label=examples::EBT::Rm_Example_S32K144::src::main.c, category=SWSRC
          short-label=examples::EBT::Rm_Example_S32K144::TresosProject::Rm_Example_S32K144::.prefs::preferences.xdm, category=SWCFG
          short-label=examples::EBT::Rm_Example_S32K144::TresosProject::Rm_Example_S32K144::config::Base.xdm, category=SWCFG
          short-label=examples::EBT::Rm_Example_S32K144::TresosProject::Rm_Example_S32K144::config::EcuC.xdm, category=SWCFG
          short-label=examples::EBT::Rm_Example_S32K144::TresosProject::Rm_Example_S32K144::config::Mcl.xdm, category=SWCFG
          short-label=examples::EBT::Rm_Example_S32K144::TresosProject::Rm_Example_S32K144::config::Resource.xdm, category=SWCFG
          short-label=examples::EBT::Rm_Example_S32K144::TresosProject::Rm_Example_S32K144::config::Rm.xdm, category=SWCFG
          short-label=examples::EBT::Rm_Example_S32K144W::generate::epc::Base.xdm, category=SWCFG
          short-label=examples::EBT::Rm_Example_S32K144W::generate::epc::Mcl.xdm, category=SWCFG
          short-label=examples::EBT::Rm_Example_S32K144W::generate::epc::Resource.xdm, category=SWCFG
          short-label=examples::EBT::Rm_Example_S32K144W::generate::epc::Rm.xdm, category=SWCFG
          short-label=examples::EBT::Rm_Example_S32K144W::include::check_example.h, category=SWHDR
          short-label=examples::EBT::Rm_Example_S32K144W::src::main.c, category=SWSRC
          short-label=examples::EBT::Rm_Example_S32K144W::TresosProject::Rm_Example_S32K144W::.prefs::preferences.xdm, category=SWCFG
          short-label=examples::EBT::Rm_Example_S32K144W::TresosProject::Rm_Example_S32K144W::config::Base.xdm, category=SWCFG
          short-label=examples::EBT::Rm_Example_S32K144W::TresosProject::Rm_Example_S32K144W::config::EcuC.xdm, category=SWCFG
          short-label=examples::EBT::Rm_Example_S32K144W::TresosProject::Rm_Example_S32K144W::config::Mcl.xdm, category=SWCFG
          short-label=examples::EBT::Rm_Example_S32K144W::TresosProject::Rm_Example_S32K144W::config::Resource.xdm, category=SWCFG
          short-label=examples::EBT::Rm_Example_S32K144W::TresosProject::Rm_Example_S32K144W::config::Rm.xdm, category=SWCFG
          short-label=examples::EBT::Rm_Example_S32K148::generate::epc::Base.xdm, category=SWCFG
          short-label=examples::EBT::Rm_Example_S32K148::generate::epc::Mcl.xdm, category=SWCFG
          short-label=examples::EBT::Rm_Example_S32K148::generate::epc::Resource.xdm, category=SWCFG
          short-label=examples::EBT::Rm_Example_S32K148::generate::epc::Rm.xdm, category=SWCFG
          short-label=examples::EBT::Rm_Example_S32K148::include::check_example.h, category=SWHDR
          short-label=examples::EBT::Rm_Example_S32K148::src::main.c, category=SWSRC
          short-label=examples::EBT::Rm_Example_S32K148::TresosProject::Rm_Example_S32K148::.prefs::preferences.xdm, category=SWCFG
          short-label=examples::EBT::Rm_Example_S32K148::TresosProject::Rm_Example_S32K148::config::Base.xdm, category=SWCFG
          short-label=examples::EBT::Rm_Example_S32K148::TresosProject::Rm_Example_S32K148::config::EcuC.xdm, category=SWCFG
          short-label=examples::EBT::Rm_Example_S32K148::TresosProject::Rm_Example_S32K148::config::Mcl.xdm, category=SWCFG
          short-label=examples::EBT::Rm_Example_S32K148::TresosProject::Rm_Example_S32K148::config::Resource.xdm, category=SWCFG
          short-label=examples::EBT::Rm_Example_S32K148::TresosProject::Rm_Example_S32K148::config::Rm.xdm, category=SWCFG
          short-label=examples::S32DS::Mpu_Ip_Example_S32K118::include::check_example.h, category=SWHDR
          short-label=examples::S32DS::Mpu_Ip_Example_S32K118::Project_Settings::Startup_Code::exceptions.c, category=SWSRC
          short-label=examples::S32DS::Mpu_Ip_Example_S32K118::Project_Settings::Startup_Code::nvic.c, category=SWSRC
          short-label=examples::S32DS::Mpu_Ip_Example_S32K118::Project_Settings::Startup_Code::startup.c, category=SWSRC
          short-label=examples::S32DS::Mpu_Ip_Example_S32K118::Project_Settings::Startup_Code::system.c, category=SWSRC
          short-label=examples::S32DS::Mpu_Ip_Example_S32K118::src::main.c, category=SWSRC
          short-label=examples::S32DS::Mpu_Ip_Example_S32K144::include::check_example.h, category=SWHDR
          short-label=examples::S32DS::Mpu_Ip_Example_S32K144::Project_Settings::Startup_Code::exceptions.c, category=SWSRC
          short-label=examples::S32DS::Mpu_Ip_Example_S32K144::Project_Settings::Startup_Code::nvic.c, category=SWSRC
          short-label=examples::S32DS::Mpu_Ip_Example_S32K144::Project_Settings::Startup_Code::startup.c, category=SWSRC
          short-label=examples::S32DS::Mpu_Ip_Example_S32K144::Project_Settings::Startup_Code::system.c, category=SWSRC
          short-label=examples::S32DS::Mpu_Ip_Example_S32K144::src::main.c, category=SWSRC
          short-label=examples::S32DS::Mpu_Ip_Example_S32K144W::include::check_example.h, category=SWHDR
          short-label=examples::S32DS::Mpu_Ip_Example_S32K144W::Project_Settings::Startup_Code::exceptions.c, category=SWSRC
          short-label=examples::S32DS::Mpu_Ip_Example_S32K144W::Project_Settings::Startup_Code::nvic.c, category=SWSRC
          short-label=examples::S32DS::Mpu_Ip_Example_S32K144W::Project_Settings::Startup_Code::startup.c, category=SWSRC
          short-label=examples::S32DS::Mpu_Ip_Example_S32K144W::Project_Settings::Startup_Code::system.c, category=SWSRC
          short-label=examples::S32DS::Mpu_Ip_Example_S32K144W::src::main.c, category=SWSRC
          short-label=examples::S32DS::Mpu_Ip_Example_S32K148::include::check_example.h, category=SWHDR
          short-label=examples::S32DS::Mpu_Ip_Example_S32K148::Project_Settings::Startup_Code::exceptions.c, category=SWSRC
          short-label=examples::S32DS::Mpu_Ip_Example_S32K148::Project_Settings::Startup_Code::nvic.c, category=SWSRC
          short-label=examples::S32DS::Mpu_Ip_Example_S32K148::Project_Settings::Startup_Code::startup.c, category=SWSRC
          short-label=examples::S32DS::Mpu_Ip_Example_S32K148::Project_Settings::Startup_Code::system.c, category=SWSRC
          short-label=examples::S32DS::Mpu_Ip_Example_S32K148::src::main.c, category=SWSRC
          short-label=examples::S32DS::Rm_Example_S32K118::include::check_example.h, category=SWHDR
          short-label=examples::S32DS::Rm_Example_S32K118::Project_Settings::Startup_Code::exceptions.c, category=SWSRC
          short-label=examples::S32DS::Rm_Example_S32K118::Project_Settings::Startup_Code::nvic.c, category=SWSRC
          short-label=examples::S32DS::Rm_Example_S32K118::Project_Settings::Startup_Code::startup.c, category=SWSRC
          short-label=examples::S32DS::Rm_Example_S32K118::Project_Settings::Startup_Code::system.c, category=SWSRC
          short-label=examples::S32DS::Rm_Example_S32K118::src::main.c, category=SWSRC
          short-label=examples::S32DS::Rm_Example_S32K144::include::check_example.h, category=SWHDR
          short-label=examples::S32DS::Rm_Example_S32K144::Project_Settings::Startup_Code::exceptions.c, category=SWSRC
          short-label=examples::S32DS::Rm_Example_S32K144::Project_Settings::Startup_Code::nvic.c, category=SWSRC
          short-label=examples::S32DS::Rm_Example_S32K144::Project_Settings::Startup_Code::startup.c, category=SWSRC
          short-label=examples::S32DS::Rm_Example_S32K144::Project_Settings::Startup_Code::system.c, category=SWSRC
          short-label=examples::S32DS::Rm_Example_S32K144::src::main.c, category=SWSRC
          short-label=examples::S32DS::Rm_Example_S32K144W::include::check_example.h, category=SWHDR
          short-label=examples::S32DS::Rm_Example_S32K144W::Project_Settings::Startup_Code::exceptions.c, category=SWSRC
          short-label=examples::S32DS::Rm_Example_S32K144W::Project_Settings::Startup_Code::nvic.c, category=SWSRC
          short-label=examples::S32DS::Rm_Example_S32K144W::Project_Settings::Startup_Code::startup.c, category=SWSRC
          short-label=examples::S32DS::Rm_Example_S32K144W::Project_Settings::Startup_Code::system.c, category=SWSRC
          short-label=examples::S32DS::Rm_Example_S32K144W::src::main.c, category=SWSRC
          short-label=examples::S32DS::Rm_Example_S32K148::include::check_example.h, category=SWHDR
          short-label=examples::S32DS::Rm_Example_S32K148::Project_Settings::Startup_Code::exceptions.c, category=SWSRC
          short-label=examples::S32DS::Rm_Example_S32K148::Project_Settings::Startup_Code::nvic.c, category=SWSRC
          short-label=examples::S32DS::Rm_Example_S32K148::Project_Settings::Startup_Code::startup.c, category=SWSRC
          short-label=examples::S32DS::Rm_Example_S32K148::Project_Settings::Startup_Code::system.c, category=SWSRC
          short-label=examples::S32DS::Rm_Example_S32K148::src::main.c, category=SWSRC
          short-label=include::CDD_Rm.h, category=SWHDR
          short-label=include::CDD_Rm_Ipw.h, category=SWHDR
          short-label=include::Mpu_Ip.h, category=SWHDR
          short-label=include::Mpu_Ip_TrustedFunctions.h, category=SWHDR
          short-label=include::Mpu_Ip_TypesDef.h, category=SWHDR
          short-label=src::CDD_Rm.c, category=SWSRC
          short-label=src::CDD_Rm_Ipw.c, category=SWSRC
          short-label=src::Mpu_Ip.c, category=SWSRC
    compiler GCC_Compiler:
      name=GCC Compiler
      options=-mcpu=cortex-m4 -mcpu=cortex-m0plus -mthumb -mlittle-endian -mfpu=fpv4-sp-d16 -mfloat-abi=hard -mfpu=auto -mfloat-abi=soft -std=c99 -Os -ggdb3 -Wall -Wextra -pedantic -Wstrict-prototypes -Wundef -Wunused -Werror=implicit-function-declaration -Wsign-compare -Wdouble-promotion -fno-short-enums -funsigned-char -funsigned-bitfields -fomit-frame-pointer -fno-common -fstack-usage -fdump-ipa-all -c -DS32K1XX -DS32K148 -DGCC -DUSE_SW_VECTOR_MODE -DI_CACHE_ENABLE -DENABLE_FPU -DMCAL_ENABLE_USER_MODE_SUPPORT
      vendor=GCC Systems
      version=NXP GCC 9.2.0 20190812 (Build 1649 Revision gaf57174)
    compiler GHS_Compiler:
      name=Green Hills
      options=-cpu=cortexm4 -cpu=cortexm0plus -thumb -fpu=vfpv4_d16 -fsingle -fsoft -C99 --ghstd=last -Osize --gnu_asm -dual_debug -G -keeptempfiles -Wimplicit-int -Wshadow -Wtrigraphs -Wundef --unsigned_chars --unsigned_fields --no_commons --no_exceptions --no_slash_comment --prototype_errors --incorrect_pragma_warnings -c -DS32K1XX -DS32K148 -DGHS -DUSE_SW_VECTOR_MODE -DI_CACHE_ENABLE -DENABLE_FPU -DMCAL_ENABLE_USER_MODE_SUPPORT
      vendor=Green Hills
      version=Green Hills Multi 7.1.6d / Compiler 2020.1.4
    compiler IAR_Compiler:
      name=IAR Compiler
      options=--cpu=Cortex-M4 --cpu=Cortex-M0+ --cpu_mode=thumb --endian=little --fpu=FPv4-SP --fpu=none -e -Ohz --debug --no_clustering --no_mem_idioms --no_explicit_zero_opt --require_prototypes --no_wrap_diagnostics --diag_suppress=Pa050 -DS32K1XX -DS32K148 -DIAR -DUSE_SW_VECTOR_MODE -DI_CACHE_ENABLE -DENABLE_FPU -DMCAL_ENABLE_USER_MODE_SUPPORT
      vendor=IAR Systems
      version=IAR ANSI C/C++ Compiler V8.40.3.228/W32 for ARM Functional Safety
    generated-artifacts:
      11 x dependency on artifact:
        CDD_Rm_Ipw_PBcfg_h: artifact-descriptor={short-label=generate_PB::include::CDD_Rm_Ipw_PBcfg.h, category=SWHDR}, usages=EXECUTE
        CDD_Rm_PBcfg_h: artifact-descriptor={short-label=generate_PB::include::CDD_Rm_PBcfg.h, category=SWHDR}, usages=EXECUTE
        Mpu_Ip_PBcfg_h: artifact-descriptor={short-label=generate_PB::include::Mpu_Ip_PBcfg.h, category=SWHDR}, usages=EXECUTE
        CDD_Rm_Ipw_PBcfg_c: artifact-descriptor={short-label=generate_PB::src::CDD_Rm_Ipw_PBcfg.c, category=SWSRC}, usages=EXECUTE
        CDD_Rm_PBcfg_c: artifact-descriptor={short-label=generate_PB::src::CDD_Rm_PBcfg.c, category=SWSRC}, usages=EXECUTE
        Mpu_Ip_PBcfg_c: artifact-descriptor={short-label=generate_PB::src::Mpu_Ip_PBcfg.c, category=SWSRC}, usages=EXECUTE
        CDD_Rm_Cfg_h: artifact-descriptor={short-label=generate_PC::include::CDD_Rm_Cfg.h, category=SWHDR}, usages=COMPILE
        CDD_Rm_Ipw_Cfg_h: artifact-descriptor={short-label=generate_PC::include::CDD_Rm_Ipw_Cfg.h, category=SWHDR}, usages=COMPILE
        Mpu_Ip_Cfg_h: artifact-descriptor={short-label=generate_PC::include::Mpu_Ip_Cfg.h, category=SWHDR}, usages=COMPILE
        Mpu_Ip_Cfg_Defines_h: artifact-descriptor={short-label=generate_PC::include::Mpu_Ip_Cfg_Defines.h, category=SWHDR}, usages=COMPILE
        CDD_Rm_Cfg_c: artifact-descriptor={short-label=generate_PC::src::CDD_Rm_Cfg.c, category=SWSRC}, usages=COMPILE
    linker GCC_Linker: name=GCC Compiler, options=-Wl,-Map,filename -T linkerfile --entry=Reset_Handler -nostartfiles -mcpu=cortex-m4 -mcpu=cortex-m0plus -mthumb -mfpu=fpv4-sp-d16 -mfloat-abi=hard -mfpu=auto -mfloat-abi=soft -mlittle-endian -ggdb3 -lc -lm -lgcc -n, vendor=GCC Systems, version=NXP GCC 9.2.0 20190812 (Build 1649 Revision gaf57174)
    linker GHS_Linker: name=Green Hills, options=-e Reset_Handler -T linker_script_file.ld -map -keepmap -Mn -delete -ignore_debug_references -Llibrary_path -larch -lstartup -lind_sd -lind_sf -v -keep=C40_Ip_AccessCode -nostartfiles, vendor=Green Hills, version=Green Hills Multi 7.1.6d / Compiler 2020.1.4
    linker IAR_Linker: name=IAR Compiler, options=--map filename --config linkerfile --cpu=Cortex-M4 --cpu=Cortex-M0+ --fpu=FPv4-SP --fpu=none --entry _start --enable_stack_usage --skip_dynamic_initialization --no_wrap_diagnostics, vendor=IAR Systems, version=IAR ANSI C/C++ Compiler V8.40.3.228/W32 for ARM Functional Safety
    resource consumption ResourceConsumption
      4 x memory section, all with alignment=UNSPECIFIED:
        RM_CODE: sw-addrmethod=CODE, symbol=CODE
        RM_CONFIG_DATA_UNSPECIFIED: sw-addrmethod=CONFIG_DATA, symbol=CONFIG_DATA_UNSPECIFIED
        RM_CONST_UNSPECIFIED: sw-addrmethod=CONST, symbol=CONST_UNSPECIFIED
        RM_VAR_CLEARED_UNSPECIFIED: sw-addrmethod=VAR_CLEARED, symbol=VAR_CLEARED_UNSPECIFIED
