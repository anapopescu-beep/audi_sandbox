<?xml version="1.0" encoding="ISO-8859-1"?>
[!AUTOSPACING!][!//
<AUTOSAR xmlns="http://autosar.org/schema/r4.0"
  xmlns:xsi="http://www.w3.org/2001/XMLSchema-instance"
  xsi:schemaLocation="http://autosar.org/schema/r4.0 AUTOSAR_4-0-3_STRICT_COMPACT.xsd">
  <AR-PACKAGES>
    <AR-PACKAGE>
      <SHORT-NAME>AUTOSAR_Can</SHORT-NAME>
      <AR-PACKAGES>
            <AR-PACKAGE>
              <SHORT-NAME>BswModuleDescriptions</SHORT-NAME>
              <ELEMENTS>
                <BSW-MODULE-DESCRIPTION>
                  <SHORT-NAME>Can</SHORT-NAME>
                  <MODULE-ID>80</MODULE-ID>
                  <PROVIDED-ENTRYS>
                    <BSW-MODULE-ENTRY-REF-CONDITIONAL>
                      <BSW-MODULE-ENTRY-REF DEST="BSW-MODULE-ENTRY">/AUTOSAR_Can/BswModuleEntrys/Can_Init</BSW-MODULE-ENTRY-REF>
                    </BSW-MODULE-ENTRY-REF-CONDITIONAL>
<!-- Start of  Can_MainFunction_Write  -->
[!IF "as:modconf('Can')[1]/CanConfigSet/CanController/*/CanTxProcessing = 'POLLING'"!]
    [!IF "num:i(count(CanGeneral/CanMainFunctionRWPeriods/*/CanMainFunctionPeriod)) > 1"!]
      [!LOOP "CanGeneral/CanMainFunctionRWPeriods/*"!]
        [!IF "node:exists(CanMainFunctionPeriod)"!]
                    <BSW-MODULE-ENTRY-REF-CONDITIONAL>
                      <BSW-MODULE-ENTRY-REF DEST="BSW-MODULE-ENTRY">/AUTOSAR_Can/BswModuleEntrys/Can_MainFunction_Write_[!"@index"!]</BSW-MODULE-ENTRY-REF>
                    </BSW-MODULE-ENTRY-REF-CONDITIONAL>
		[!ENDIF!]
      [!ENDLOOP!]
      [!ELSE!]
      [!IF "node:exists(as:modconf('Can')[1]/CanGeneral/CanMainFunctionRWPeriods/*/CanMainFunctionPeriod)"!]     
                    <BSW-MODULE-ENTRY-REF-CONDITIONAL>
                      <BSW-MODULE-ENTRY-REF DEST="BSW-MODULE-ENTRY">/AUTOSAR_Can/BswModuleEntrys/Can_MainFunction_Write</BSW-MODULE-ENTRY-REF>
                    </BSW-MODULE-ENTRY-REF-CONDITIONAL>
	  [!ENDIF!]
	[!ENDIF!]
[!ENDIF!]
<!--  End of  Can_MainFunction_Write  -->
<!-- Start of  Can_MainFunction_Read -->
[!IF "as:modconf('Can')[1]/CanConfigSet/CanController/*/CanRxProcessing = 'POLLING'"!]
  [!IF "num:i(count(CanGeneral/CanMainFunctionRWPeriods/*/CanMainFunctionPeriod)) > 1"!]
      [!LOOP "CanGeneral/CanMainFunctionRWPeriods/*"!]
        [!IF "node:exists(CanMainFunctionPeriod)"!]
                    <BSW-MODULE-ENTRY-REF-CONDITIONAL>
                      <BSW-MODULE-ENTRY-REF DEST="BSW-MODULE-ENTRY">/AUTOSAR_Can/BswModuleEntrys/Can_MainFunction_Read_[!"@index"!]</BSW-MODULE-ENTRY-REF>
                    </BSW-MODULE-ENTRY-REF-CONDITIONAL>
		[!ENDIF!]
      [!ENDLOOP!]
      [!ELSE!]
      [!IF "node:exists(as:modconf('Can')[1]/CanGeneral/CanMainFunctionRWPeriods/*/CanMainFunctionPeriod)"!]
                    <BSW-MODULE-ENTRY-REF-CONDITIONAL>
                      <BSW-MODULE-ENTRY-REF DEST="BSW-MODULE-ENTRY">/AUTOSAR_Can/BswModuleEntrys/Can_MainFunction_Read</BSW-MODULE-ENTRY-REF>
                    </BSW-MODULE-ENTRY-REF-CONDITIONAL>
      [!ENDIF!]
  [!ENDIF!]
[!ENDIF!]
<!-- End of  Can_MainFunction_Read  -->
<!-- Start of  Can_MainFunction_Wakeup -->
[!IF "as:modconf('Can')[1]/CanConfigSet/CanController/*[1]/CanWakeupSupport = 'true'"!]
  [!IF "as:modconf('Can')[1]/CanConfigSet/CanController/*/CanWakeupProcessing = 'POLLING'"!]  
    [!IF "node:exists(as:modconf('Can')[1]/CanGeneral/CanMainFunctionWakeupPeriod)"!]
                    <BSW-MODULE-ENTRY-REF-CONDITIONAL>
                      <BSW-MODULE-ENTRY-REF DEST="BSW-MODULE-ENTRY">/AUTOSAR_Can/BswModuleEntrys/Can_MainFunction_Wakeup</BSW-MODULE-ENTRY-REF>
                    </BSW-MODULE-ENTRY-REF-CONDITIONAL>
    [!ENDIF!]
  [!ENDIF!]
[!ENDIF!]
<!-- End of  Can_MainFunction_Wakeup -->
<!-- Start of  Can_MainFunction_BusOff -->
[!IF "as:modconf('Can')[1]/CanConfigSet/CanController/*/CanBusoffProcessing = 'POLLING'"!]
  [!IF "node:exists(as:modconf('Can')[1]/CanGeneral/CanMainFunctionBusoffPeriod)"!]
                    <BSW-MODULE-ENTRY-REF-CONDITIONAL>
                      <BSW-MODULE-ENTRY-REF DEST="BSW-MODULE-ENTRY">/AUTOSAR_Can/BswModuleEntrys/Can_MainFunction_BusOff</BSW-MODULE-ENTRY-REF>
                    </BSW-MODULE-ENTRY-REF-CONDITIONAL>
  [!ENDIF!]
[!ENDIF!]
<!-- End of  Can_MainFunction_BusOff -->
<!-- Start of  Can_MainFunction_Mode -->
                  <BSW-MODULE-ENTRY-REF-CONDITIONAL>
                      <BSW-MODULE-ENTRY-REF DEST="BSW-MODULE-ENTRY">/AUTOSAR_Can/BswModuleEntrys/Can_MainFunction_Mode</BSW-MODULE-ENTRY-REF>
                  </BSW-MODULE-ENTRY-REF-CONDITIONAL>
<!-- End of  Can_MainFunction_Mode -->
                  </PROVIDED-ENTRYS>
                  <INTERNAL-BEHAVIORS>
                    <BSW-INTERNAL-BEHAVIOR>
                      <SHORT-NAME>InternalBehavior_0</SHORT-NAME>
                      <EXCLUSIVE-AREAS>
                        <EXCLUSIVE-AREA>
                          <SHORT-NAME>CAN_EXCLUSIVE_AREA_00</SHORT-NAME>
                        </EXCLUSIVE-AREA>
                        <EXCLUSIVE-AREA>
                          <SHORT-NAME>CAN_EXCLUSIVE_AREA_01</SHORT-NAME>
                        </EXCLUSIVE-AREA>
                        <EXCLUSIVE-AREA>
                          <SHORT-NAME>CAN_EXCLUSIVE_AREA_02</SHORT-NAME>
                        </EXCLUSIVE-AREA>
                        <EXCLUSIVE-AREA>
                          <SHORT-NAME>CAN_EXCLUSIVE_AREA_03</SHORT-NAME>
                        </EXCLUSIVE-AREA>
                        <EXCLUSIVE-AREA>
                          <SHORT-NAME>CAN_EXCLUSIVE_AREA_04</SHORT-NAME>
                        </EXCLUSIVE-AREA>
                        <EXCLUSIVE-AREA>
                          <SHORT-NAME>CAN_EXCLUSIVE_AREA_05</SHORT-NAME>
                        </EXCLUSIVE-AREA>
                        <EXCLUSIVE-AREA>
                          <SHORT-NAME>CAN_EXCLUSIVE_AREA_06</SHORT-NAME>
                        </EXCLUSIVE-AREA>
                        <EXCLUSIVE-AREA>
                          <SHORT-NAME>CAN_EXCLUSIVE_AREA_07</SHORT-NAME>
                        </EXCLUSIVE-AREA>
                        <EXCLUSIVE-AREA>
                          <SHORT-NAME>CAN_EXCLUSIVE_AREA_08</SHORT-NAME>
                        </EXCLUSIVE-AREA>
                        <EXCLUSIVE-AREA>
                          <SHORT-NAME>CAN_EXCLUSIVE_AREA_09</SHORT-NAME>
                        </EXCLUSIVE-AREA>
                        <EXCLUSIVE-AREA>
                          <SHORT-NAME>CAN_EXCLUSIVE_AREA_10</SHORT-NAME>
                        </EXCLUSIVE-AREA>
                        <EXCLUSIVE-AREA>
                          <SHORT-NAME>CAN_EXCLUSIVE_AREA_11</SHORT-NAME>
                        </EXCLUSIVE-AREA>
                        <EXCLUSIVE-AREA>
                          <SHORT-NAME>CAN_EXCLUSIVE_AREA_12</SHORT-NAME>
                        </EXCLUSIVE-AREA>
                        <EXCLUSIVE-AREA>
                          <SHORT-NAME>CAN_EXCLUSIVE_AREA_13</SHORT-NAME>
                        </EXCLUSIVE-AREA>
                        <EXCLUSIVE-AREA>
                          <SHORT-NAME>CAN_EXCLUSIVE_AREA_14</SHORT-NAME>
                        </EXCLUSIVE-AREA>
                        <EXCLUSIVE-AREA>
                          <SHORT-NAME>CAN_EXCLUSIVE_AREA_15</SHORT-NAME>
                        </EXCLUSIVE-AREA>
                        <EXCLUSIVE-AREA>
                          <SHORT-NAME>CAN_EXCLUSIVE_AREA_16</SHORT-NAME>
                        </EXCLUSIVE-AREA>
                        <EXCLUSIVE-AREA>
                          <SHORT-NAME>CAN_EXCLUSIVE_AREA_17</SHORT-NAME>
                        </EXCLUSIVE-AREA>
                        <EXCLUSIVE-AREA>
                          <SHORT-NAME>CAN_EXCLUSIVE_AREA_18</SHORT-NAME>
                        </EXCLUSIVE-AREA>
                        <EXCLUSIVE-AREA>
                          <SHORT-NAME>CAN_EXCLUSIVE_AREA_19</SHORT-NAME>
                        </EXCLUSIVE-AREA>
                        <EXCLUSIVE-AREA>
                          <SHORT-NAME>CAN_EXCLUSIVE_AREA_20</SHORT-NAME>
                        </EXCLUSIVE-AREA>
                      </EXCLUSIVE-AREAS>
                      <ENTITYS>
                        <BSW-CALLED-ENTITY>
                          <SHORT-NAME>Can_Init</SHORT-NAME>
                          <CAN-ENTER-EXCLUSIVE-AREA-REFS>
                            <CAN-ENTER-EXCLUSIVE-AREA-REF DEST="EXCLUSIVE-AREA">/AUTOSAR_Can/BswModuleDescriptions/Can/InternalBehavior_0/CAN_EXCLUSIVE_AREA_00</CAN-ENTER-EXCLUSIVE-AREA-REF>
                            <CAN-ENTER-EXCLUSIVE-AREA-REF DEST="EXCLUSIVE-AREA">/AUTOSAR_Can/BswModuleDescriptions/Can/InternalBehavior_0/CAN_EXCLUSIVE_AREA_01</CAN-ENTER-EXCLUSIVE-AREA-REF>
                            <CAN-ENTER-EXCLUSIVE-AREA-REF DEST="EXCLUSIVE-AREA">/AUTOSAR_Can/BswModuleDescriptions/Can/InternalBehavior_0/CAN_EXCLUSIVE_AREA_02</CAN-ENTER-EXCLUSIVE-AREA-REF>
                            <CAN-ENTER-EXCLUSIVE-AREA-REF DEST="EXCLUSIVE-AREA">/AUTOSAR_Can/BswModuleDescriptions/Can/InternalBehavior_0/CAN_EXCLUSIVE_AREA_03</CAN-ENTER-EXCLUSIVE-AREA-REF>
                            <CAN-ENTER-EXCLUSIVE-AREA-REF DEST="EXCLUSIVE-AREA">/AUTOSAR_Can/BswModuleDescriptions/Can/InternalBehavior_0/CAN_EXCLUSIVE_AREA_04</CAN-ENTER-EXCLUSIVE-AREA-REF>
                            <CAN-ENTER-EXCLUSIVE-AREA-REF DEST="EXCLUSIVE-AREA">/AUTOSAR_Can/BswModuleDescriptions/Can/InternalBehavior_0/CAN_EXCLUSIVE_AREA_05</CAN-ENTER-EXCLUSIVE-AREA-REF>
                            <CAN-ENTER-EXCLUSIVE-AREA-REF DEST="EXCLUSIVE-AREA">/AUTOSAR_Can/BswModuleDescriptions/Can/InternalBehavior_0/CAN_EXCLUSIVE_AREA_06</CAN-ENTER-EXCLUSIVE-AREA-REF>
                            <CAN-ENTER-EXCLUSIVE-AREA-REF DEST="EXCLUSIVE-AREA">/AUTOSAR_Can/BswModuleDescriptions/Can/InternalBehavior_0/CAN_EXCLUSIVE_AREA_07</CAN-ENTER-EXCLUSIVE-AREA-REF>
                            <CAN-ENTER-EXCLUSIVE-AREA-REF DEST="EXCLUSIVE-AREA">/AUTOSAR_Can/BswModuleDescriptions/Can/InternalBehavior_0/CAN_EXCLUSIVE_AREA_08</CAN-ENTER-EXCLUSIVE-AREA-REF>
                            <CAN-ENTER-EXCLUSIVE-AREA-REF DEST="EXCLUSIVE-AREA">/AUTOSAR_Can/BswModuleDescriptions/Can/InternalBehavior_0/CAN_EXCLUSIVE_AREA_09</CAN-ENTER-EXCLUSIVE-AREA-REF>
                            <CAN-ENTER-EXCLUSIVE-AREA-REF DEST="EXCLUSIVE-AREA">/AUTOSAR_Can/BswModuleDescriptions/Can/InternalBehavior_0/CAN_EXCLUSIVE_AREA_10</CAN-ENTER-EXCLUSIVE-AREA-REF>
                            <CAN-ENTER-EXCLUSIVE-AREA-REF DEST="EXCLUSIVE-AREA">/AUTOSAR_Can/BswModuleDescriptions/Can/InternalBehavior_0/CAN_EXCLUSIVE_AREA_11</CAN-ENTER-EXCLUSIVE-AREA-REF>
                            <CAN-ENTER-EXCLUSIVE-AREA-REF DEST="EXCLUSIVE-AREA">/AUTOSAR_Can/BswModuleDescriptions/Can/InternalBehavior_0/CAN_EXCLUSIVE_AREA_12</CAN-ENTER-EXCLUSIVE-AREA-REF>
                            <CAN-ENTER-EXCLUSIVE-AREA-REF DEST="EXCLUSIVE-AREA">/AUTOSAR_Can/BswModuleDescriptions/Can/InternalBehavior_0/CAN_EXCLUSIVE_AREA_13</CAN-ENTER-EXCLUSIVE-AREA-REF>
                            <CAN-ENTER-EXCLUSIVE-AREA-REF DEST="EXCLUSIVE-AREA">/AUTOSAR_Can/BswModuleDescriptions/Can/InternalBehavior_0/CAN_EXCLUSIVE_AREA_14</CAN-ENTER-EXCLUSIVE-AREA-REF>
                            <CAN-ENTER-EXCLUSIVE-AREA-REF DEST="EXCLUSIVE-AREA">/AUTOSAR_Can/BswModuleDescriptions/Can/InternalBehavior_0/CAN_EXCLUSIVE_AREA_15</CAN-ENTER-EXCLUSIVE-AREA-REF>
                            <CAN-ENTER-EXCLUSIVE-AREA-REF DEST="EXCLUSIVE-AREA">/AUTOSAR_Can/BswModuleDescriptions/Can/InternalBehavior_0/CAN_EXCLUSIVE_AREA_16</CAN-ENTER-EXCLUSIVE-AREA-REF>
                            <CAN-ENTER-EXCLUSIVE-AREA-REF DEST="EXCLUSIVE-AREA">/AUTOSAR_Can/BswModuleDescriptions/Can/InternalBehavior_0/CAN_EXCLUSIVE_AREA_17</CAN-ENTER-EXCLUSIVE-AREA-REF>
                            <CAN-ENTER-EXCLUSIVE-AREA-REF DEST="EXCLUSIVE-AREA">/AUTOSAR_Can/BswModuleDescriptions/Can/InternalBehavior_0/CAN_EXCLUSIVE_AREA_18</CAN-ENTER-EXCLUSIVE-AREA-REF>
                            <CAN-ENTER-EXCLUSIVE-AREA-REF DEST="EXCLUSIVE-AREA">/AUTOSAR_Can/BswModuleDescriptions/Can/InternalBehavior_0/CAN_EXCLUSIVE_AREA_19</CAN-ENTER-EXCLUSIVE-AREA-REF>
                            <CAN-ENTER-EXCLUSIVE-AREA-REF DEST="EXCLUSIVE-AREA">/AUTOSAR_Can/BswModuleDescriptions/Can/InternalBehavior_0/CAN_EXCLUSIVE_AREA_20</CAN-ENTER-EXCLUSIVE-AREA-REF>
                          </CAN-ENTER-EXCLUSIVE-AREA-REFS>
                          <MINIMUM-START-INTERVAL>0.0</MINIMUM-START-INTERVAL>
                          <IMPLEMENTED-ENTRY-REF DEST="BSW-MODULE-ENTRY">/AUTOSAR_Can/BswModuleEntrys/Can_Init</IMPLEMENTED-ENTRY-REF>
                        </BSW-CALLED-ENTITY>
<!-- Start of  Can_MainFunction_Write  -->
[!IF "as:modconf('Can')[1]/CanConfigSet/CanController/*/CanTxProcessing = 'POLLING'"!]
    [!IF "num:i(count(CanGeneral/CanMainFunctionRWPeriods/*/CanMainFunctionPeriod)) > 1"!]
      [!LOOP "CanGeneral/CanMainFunctionRWPeriods/*"!]
        [!IF "node:exists(CanMainFunctionPeriod)"!]
                        <BSW-SCHEDULABLE-ENTITY>
                          <SHORT-NAME>Can_MainFunction_Write_[!"@index"!]</SHORT-NAME>
                          <MINIMUM-START-INTERVAL>0.0</MINIMUM-START-INTERVAL>
                          <IMPLEMENTED-ENTRY-REF DEST="BSW-MODULE-ENTRY">/AUTOSAR_Can/BswModuleEntrys/Can_MainFunction_Write_[!"@index"!]</IMPLEMENTED-ENTRY-REF>
                          <SCHEDULER-NAME-PREFIX-REF DEST="BSW-SCHEDULER-NAME-PREFIX">/AUTOSAR_Can/BswModuleDescriptions/Can/InternalBehavior_0/Prefix_Can</SCHEDULER-NAME-PREFIX-REF>
                        </BSW-SCHEDULABLE-ENTITY>
		[!ENDIF!]
      [!ENDLOOP!]
    [!ELSE!]
      [!IF "node:exists(as:modconf('Can')[1]/CanGeneral/CanMainFunctionRWPeriods/*/CanMainFunctionPeriod)"!]
                        <BSW-SCHEDULABLE-ENTITY>
                          <SHORT-NAME>Can_MainFunction_Write</SHORT-NAME>
                          <MINIMUM-START-INTERVAL>0.0</MINIMUM-START-INTERVAL>
                          <IMPLEMENTED-ENTRY-REF DEST="BSW-MODULE-ENTRY">/AUTOSAR_Can/BswModuleEntrys/Can_MainFunction_Write</IMPLEMENTED-ENTRY-REF>
                          <SCHEDULER-NAME-PREFIX-REF DEST="BSW-SCHEDULER-NAME-PREFIX">/AUTOSAR_Can/BswModuleDescriptions/Can/InternalBehavior_0/Prefix_Can</SCHEDULER-NAME-PREFIX-REF>
                        </BSW-SCHEDULABLE-ENTITY>
      [!ENDIF!]
    [!ENDIF!]
[!ENDIF!]
<!-- End of  Can_MainFunction_Write  -->
<!-- Start of  Can_MainFunction_Read  -->
[!IF "as:modconf('Can')[1]/CanConfigSet/CanController/*/CanRxProcessing = 'POLLING'"!]   
  [!IF "num:i(count(CanGeneral/CanMainFunctionRWPeriods/*/CanMainFunctionPeriod)) > 1"!]
      [!LOOP "CanGeneral/CanMainFunctionRWPeriods/*"!]
        [!IF "node:exists(CanMainFunctionPeriod)"!]
                        <BSW-SCHEDULABLE-ENTITY>
                          <SHORT-NAME>Can_MainFunction_Read_[!"@index"!]</SHORT-NAME>
                          <MINIMUM-START-INTERVAL>0.0</MINIMUM-START-INTERVAL>
                          <IMPLEMENTED-ENTRY-REF DEST="BSW-MODULE-ENTRY">/AUTOSAR_Can/BswModuleEntrys/Can_MainFunction_Read_[!"@index"!]</IMPLEMENTED-ENTRY-REF>
                          <SCHEDULER-NAME-PREFIX-REF DEST="BSW-SCHEDULER-NAME-PREFIX">/AUTOSAR_Can/BswModuleDescriptions/Can/InternalBehavior_0/Prefix_Can</SCHEDULER-NAME-PREFIX-REF>
                        </BSW-SCHEDULABLE-ENTITY>
		[!ENDIF!]
      [!ENDLOOP!]
    [!ELSE!]
      [!IF "node:exists(as:modconf('Can')[1]/CanGeneral/CanMainFunctionRWPeriods/*/CanMainFunctionPeriod)"!]    
                        <BSW-SCHEDULABLE-ENTITY>
                          <SHORT-NAME>Can_MainFunction_Read</SHORT-NAME>
                          <MINIMUM-START-INTERVAL>0.0</MINIMUM-START-INTERVAL>
                          <IMPLEMENTED-ENTRY-REF DEST="BSW-MODULE-ENTRY">/AUTOSAR_Can/BswModuleEntrys/Can_MainFunction_Read</IMPLEMENTED-ENTRY-REF>
                          <SCHEDULER-NAME-PREFIX-REF DEST="BSW-SCHEDULER-NAME-PREFIX">/AUTOSAR_Can/BswModuleDescriptions/Can/InternalBehavior_0/Prefix_Can</SCHEDULER-NAME-PREFIX-REF>
                        </BSW-SCHEDULABLE-ENTITY>
      [!ENDIF!]
    [!ENDIF!]
[!ENDIF!]
<!-- End of Can_MainFunction_Read -->
<!-- Start of  Can_MainFunction_Wakeup -->
[!IF "as:modconf('Can')[1]/CanConfigSet/CanController/*[1]/CanWakeupSupport = 'true'"!]
  [!IF "as:modconf('Can')[1]/CanConfigSet/CanController/*/CanWakeupProcessing = 'POLLING'"!]  
    [!IF "node:exists(as:modconf('Can')[1]/CanGeneral/CanMainFunctionWakeupPeriod)"!]
                        <BSW-SCHEDULABLE-ENTITY>
                          <SHORT-NAME>Can_MainFunction_Wakeup</SHORT-NAME>
                          <MINIMUM-START-INTERVAL>0.0</MINIMUM-START-INTERVAL>
                          <IMPLEMENTED-ENTRY-REF DEST="BSW-MODULE-ENTRY">/AUTOSAR_Can/BswModuleEntrys/Can_MainFunction_Wakeup</IMPLEMENTED-ENTRY-REF>
                          <SCHEDULER-NAME-PREFIX-REF DEST="BSW-SCHEDULER-NAME-PREFIX">/AUTOSAR_Can/BswModuleDescriptions/Can/InternalBehavior_0/Prefix_Can</SCHEDULER-NAME-PREFIX-REF>
                        </BSW-SCHEDULABLE-ENTITY>
    [!ENDIF!]
  [!ENDIF!]
[!ENDIF!]
<!-- End of  Can_MainFunction_Wakeup -->
<!-- Start of  Can_MainFunction_BusOff -->
[!IF "as:modconf('Can')[1]/CanConfigSet/CanController/*/CanBusoffProcessing = 'POLLING'"!]
  [!IF "node:exists(as:modconf('Can')[1]/CanGeneral/CanMainFunctionBusoffPeriod)"!]
                        <BSW-SCHEDULABLE-ENTITY>
                          <SHORT-NAME>Can_MainFunction_BusOff</SHORT-NAME>
                          <MINIMUM-START-INTERVAL>0.0</MINIMUM-START-INTERVAL>
                          <IMPLEMENTED-ENTRY-REF DEST="BSW-MODULE-ENTRY">/AUTOSAR_Can/BswModuleEntrys/Can_MainFunction_BusOff</IMPLEMENTED-ENTRY-REF>
                          <SCHEDULER-NAME-PREFIX-REF DEST="BSW-SCHEDULER-NAME-PREFIX">/AUTOSAR_Can/BswModuleDescriptions/Can/InternalBehavior_0/Prefix_Can</SCHEDULER-NAME-PREFIX-REF>
                        </BSW-SCHEDULABLE-ENTITY>
  [!ENDIF!]
[!ENDIF!]
<!-- End of  Can_MainFunction_BusOff -->
<!-- Start of  Can_MainFunction_Mode -->
                        <BSW-SCHEDULABLE-ENTITY>
                          <SHORT-NAME>Can_MainFunction_Mode</SHORT-NAME>
                          <MINIMUM-START-INTERVAL>0.0</MINIMUM-START-INTERVAL>
                          <IMPLEMENTED-ENTRY-REF DEST="BSW-MODULE-ENTRY">/AUTOSAR_Can/BswModuleEntrys/Can_MainFunction_Mode</IMPLEMENTED-ENTRY-REF>
                          <SCHEDULER-NAME-PREFIX-REF DEST="BSW-SCHEDULER-NAME-PREFIX">/AUTOSAR_Can/BswModuleDescriptions/Can/InternalBehavior_0/Prefix_Can</SCHEDULER-NAME-PREFIX-REF>
                        </BSW-SCHEDULABLE-ENTITY>
                      </ENTITYS>
                      <EVENTS>
<!-- End of  Can_MainFunction_Mode -->
<!-- Start of  Can_MainFunction_Write  -->
[!IF "as:modconf('Can')[1]/CanConfigSet/CanController/*/CanTxProcessing = 'POLLING'"!]
    [!IF "num:i(count(CanGeneral/CanMainFunctionRWPeriods/*/CanMainFunctionPeriod)) > 1"!]
      [!LOOP "CanGeneral/CanMainFunctionRWPeriods/*"!]
        [!IF "node:exists(CanMainFunctionPeriod)"!]
                        <BSW-TIMING-EVENT>
                          <SHORT-NAME>TimingEvent_MainFunction_Write_[!"@index"!]</SHORT-NAME>
                          <STARTS-ON-EVENT-REF DEST="BSW-SCHEDULABLE-ENTITY">/AUTOSAR_Can/BswModuleDescriptions/Can/InternalBehavior_0/Can_MainFunction_Write_[!"@index"!]</STARTS-ON-EVENT-REF>
                          <PERIOD>[!"CanMainFunctionPeriod/."!]</PERIOD>
                        </BSW-TIMING-EVENT>
		[!ENDIF!]
      [!ENDLOOP!]
    [!ELSE!]
      [!IF "node:exists(as:modconf('Can')[1]/CanGeneral/CanMainFunctionRWPeriods/*/CanMainFunctionPeriod)"!]  
                        <BSW-TIMING-EVENT>
                          <SHORT-NAME>TimingEvent_MainFunction_Write</SHORT-NAME>
                          <STARTS-ON-EVENT-REF DEST="BSW-SCHEDULABLE-ENTITY">/AUTOSAR_Can/BswModuleDescriptions/Can/InternalBehavior_0/Can_MainFunction_Write</STARTS-ON-EVENT-REF>
                          <PERIOD>[!"as:modconf('Can')[1]/CanGeneral/CanMainFunctionRWPeriods/*/CanMainFunctionPeriod/."!]</PERIOD>
                        </BSW-TIMING-EVENT>
      [!ENDIF!]
    [!ENDIF!]
[!ENDIF!]
<!-- End of  Can_MainFunction_Write  -->
<!-- Start of  Can_MainFunction_Read  -->
[!IF "as:modconf('Can')[1]/CanConfigSet/CanController/*/CanRxProcessing = 'POLLING'"!]
    [!IF "num:i(count(CanGeneral/CanMainFunctionRWPeriods/*/CanMainFunctionPeriod)) > 1"!]
      [!LOOP "CanGeneral/CanMainFunctionRWPeriods/*"!]
        [!IF "node:exists(CanMainFunctionPeriod)"!]
                        <BSW-TIMING-EVENT>
                          <SHORT-NAME>TimingEvent_MainFunction_Read_[!"@index"!]</SHORT-NAME>
                          <STARTS-ON-EVENT-REF DEST="BSW-SCHEDULABLE-ENTITY">/AUTOSAR_Can/BswModuleDescriptions/Can/InternalBehavior_0/Can_MainFunction_Read_[!"@index"!]</STARTS-ON-EVENT-REF>
                          <PERIOD>[!"CanMainFunctionPeriod/."!]</PERIOD>
                        </BSW-TIMING-EVENT>
		[!ENDIF!]
      [!ENDLOOP!]
    [!ELSE!]
      [!IF "node:exists(as:modconf('Can')[1]/CanGeneral/CanMainFunctionRWPeriods/*/CanMainFunctionPeriod)"!]
                        <BSW-TIMING-EVENT>
                          <SHORT-NAME>TimingEvent_MainFunction_Read</SHORT-NAME>
                          <STARTS-ON-EVENT-REF DEST="BSW-SCHEDULABLE-ENTITY">/AUTOSAR_Can/BswModuleDescriptions/Can/InternalBehavior_0/Can_MainFunction_Read</STARTS-ON-EVENT-REF>
                          <PERIOD>[!"as:modconf('Can')[1]/CanGeneral/CanMainFunctionRWPeriods/*/CanMainFunctionPeriod/."!]</PERIOD>
                        </BSW-TIMING-EVENT>
      [!ENDIF!]
    [!ENDIF!]
[!ENDIF!]
<!-- End of Can_MainFunction_Read -->
<!-- Start of  Can_MainFunction_Wakeup -->
[!IF "as:modconf('Can')[1]/CanConfigSet/CanController/*[1]/CanWakeupSupport = 'true'"!]
  [!IF "as:modconf('Can')[1]/CanConfigSet/CanController/*/CanWakeupProcessing = 'POLLING'"!]  
    [!IF "node:exists(as:modconf('Can')[1]/CanGeneral/CanMainFunctionWakeupPeriod)"!]
                        <BSW-TIMING-EVENT>
                          <SHORT-NAME>TimingEvent_MainFunction_Wakeup</SHORT-NAME>
                          <STARTS-ON-EVENT-REF DEST="BSW-SCHEDULABLE-ENTITY">/AUTOSAR_Can/BswModuleDescriptions/Can/InternalBehavior_0/Can_MainFunction_Wakeup</STARTS-ON-EVENT-REF>
                          <PERIOD>[!"as:modconf('Can')[1]/CanGeneral/CanMainFunctionWakeupPeriod"!]</PERIOD>
                        </BSW-TIMING-EVENT>
    [!ENDIF!]
  [!ENDIF!]
[!ENDIF!]
<!-- End of  Can_MainFunction_Wakeup -->
<!-- Start of  Can_MainFunction_BusOff -->
[!IF "as:modconf('Can')[1]/CanConfigSet/CanController/*/CanBusoffProcessing = 'POLLING'"!]
  [!IF "node:exists(as:modconf('Can')[1]/CanGeneral/CanMainFunctionBusoffPeriod)"!]
                        <BSW-TIMING-EVENT>
                          <SHORT-NAME>TimingEvent_MainFunction_BusOff</SHORT-NAME>
                          <STARTS-ON-EVENT-REF DEST="BSW-SCHEDULABLE-ENTITY">/AUTOSAR_Can/BswModuleDescriptions/Can/InternalBehavior_0/Can_MainFunction_BusOff</STARTS-ON-EVENT-REF>
                          <PERIOD>[!"as:modconf('Can')[1]/CanGeneral/CanMainFunctionBusoffPeriod"!]</PERIOD>
                        </BSW-TIMING-EVENT>
  [!ENDIF!]
[!ENDIF!]
<!-- End of  Can_MainFunction_BusOff -->
<!-- Start of  Can_MainFunction_Mode -->
                        <BSW-TIMING-EVENT>
                          <SHORT-NAME>TimingEvent_MainFunction_Mode</SHORT-NAME>
                          <STARTS-ON-EVENT-REF DEST="BSW-SCHEDULABLE-ENTITY">/AUTOSAR_Can/BswModuleDescriptions/Can/InternalBehavior_0/Can_MainFunction_Mode</STARTS-ON-EVENT-REF>
                          <PERIOD>[!"as:modconf('Can')[1]/CanGeneral/CanMainFunctionModePeriod"!]</PERIOD>
                        </BSW-TIMING-EVENT>
<!-- End of  Can_MainFunction_Mode -->
                      </EVENTS>
                      <SCHEDULER-NAME-PREFIXS>
                         <BSW-SCHEDULER-NAME-PREFIX>
                           <SHORT-NAME>Prefix_Can</SHORT-NAME>
                           <SYMBOL>Can</SYMBOL>
                         </BSW-SCHEDULER-NAME-PREFIX>
                      </SCHEDULER-NAME-PREFIXS>
                    </BSW-INTERNAL-BEHAVIOR>
                  </INTERNAL-BEHAVIORS>
                </BSW-MODULE-DESCRIPTION>
              </ELEMENTS>
            </AR-PACKAGE>
            <AR-PACKAGE>
              <SHORT-NAME>BswModuleEntrys</SHORT-NAME>
              <ELEMENTS>
                <BSW-MODULE-ENTRY>
                  <SHORT-NAME>Can_Init</SHORT-NAME>
                  <SERVICE-ID>0</SERVICE-ID>
                  <IS-REENTRANT>false</IS-REENTRANT>
                  <IS-SYNCHRONOUS>true</IS-SYNCHRONOUS>
                  <CALL-TYPE>REGULAR</CALL-TYPE>
                  <EXECUTION-CONTEXT>UNSPECIFIED</EXECUTION-CONTEXT>
                  <SW-SERVICE-IMPL-POLICY>STANDARD</SW-SERVICE-IMPL-POLICY>
                </BSW-MODULE-ENTRY>
<!-- Start of  Can_MainFunction_Write  -->
[!IF "as:modconf('Can')[1]/CanConfigSet/CanController/*/CanTxProcessing = 'POLLING'"!]
    [!IF "num:i(count(CanGeneral/CanMainFunctionRWPeriods/*/CanMainFunctionPeriod)) > 1"!]
      [!LOOP "CanGeneral/CanMainFunctionRWPeriods/*"!]
        [!IF "node:exists(CanMainFunctionPeriod)"!]
                <BSW-MODULE-ENTRY>
                  <SHORT-NAME>Can_MainFunction_Write_[!"@index"!]</SHORT-NAME>
                  <SERVICE-ID>1</SERVICE-ID>
                  <IS-REENTRANT>false</IS-REENTRANT>
                  <IS-SYNCHRONOUS>true</IS-SYNCHRONOUS>
                  <CALL-TYPE>SCHEDULED</CALL-TYPE>
                  <EXECUTION-CONTEXT>TASK</EXECUTION-CONTEXT>
                  <SW-SERVICE-IMPL-POLICY>STANDARD</SW-SERVICE-IMPL-POLICY>
                </BSW-MODULE-ENTRY>
		[!ENDIF!]
      [!ENDLOOP!]
    [!ELSE!]
      [!IF "node:exists(as:modconf('Can')[1]/CanGeneral/CanMainFunctionRWPeriods/*/CanMainFunctionPeriod)"!]
                <BSW-MODULE-ENTRY>
                  <SHORT-NAME>Can_MainFunction_Write</SHORT-NAME>
                  <SERVICE-ID>1</SERVICE-ID>
                  <IS-REENTRANT>false</IS-REENTRANT>
                  <IS-SYNCHRONOUS>true</IS-SYNCHRONOUS>
                  <CALL-TYPE>SCHEDULED</CALL-TYPE>
                  <EXECUTION-CONTEXT>TASK</EXECUTION-CONTEXT>
                  <SW-SERVICE-IMPL-POLICY>STANDARD</SW-SERVICE-IMPL-POLICY>
                </BSW-MODULE-ENTRY>
      [!ENDIF!]
    [!ENDIF!]
[!ENDIF!]
<!-- End of  Can_MainFunction_Write  -->
<!-- Start of  Can_MainFunction_Read  -->
[!IF "as:modconf('Can')[1]/CanConfigSet/CanController/*/CanRxProcessing = 'POLLING'"!]
    [!IF "num:i(count(CanGeneral/CanMainFunctionRWPeriods/*/CanMainFunctionPeriod)) > 1"!]
      [!LOOP "CanGeneral/CanMainFunctionRWPeriods/*"!]
        [!IF "node:exists(CanMainFunctionPeriod)"!]   
                <BSW-MODULE-ENTRY>
                  <SHORT-NAME>Can_MainFunction_Read_[!"@index"!]</SHORT-NAME>
                  <SERVICE-ID>8</SERVICE-ID>
                  <IS-REENTRANT>false</IS-REENTRANT>
                  <IS-SYNCHRONOUS>true</IS-SYNCHRONOUS>
                  <CALL-TYPE>SCHEDULED</CALL-TYPE>
                  <EXECUTION-CONTEXT>TASK</EXECUTION-CONTEXT>
                  <SW-SERVICE-IMPL-POLICY>STANDARD</SW-SERVICE-IMPL-POLICY>
                </BSW-MODULE-ENTRY>
		[!ENDIF!]
      [!ENDLOOP!]
    [!ELSE!]
      [!IF "node:exists(as:modconf('Can')[1]/CanGeneral/CanMainFunctionRWPeriods/*/CanMainFunctionPeriod)"!] 
                <BSW-MODULE-ENTRY>
                  <SHORT-NAME>Can_MainFunction_Read</SHORT-NAME>
                  <SERVICE-ID>8</SERVICE-ID>
                  <IS-REENTRANT>false</IS-REENTRANT>
                  <IS-SYNCHRONOUS>true</IS-SYNCHRONOUS>
                  <CALL-TYPE>SCHEDULED</CALL-TYPE>
                  <EXECUTION-CONTEXT>TASK</EXECUTION-CONTEXT>
                  <SW-SERVICE-IMPL-POLICY>STANDARD</SW-SERVICE-IMPL-POLICY>
                </BSW-MODULE-ENTRY>
      [!ENDIF!]
    [!ENDIF!]
[!ENDIF!]
<!-- End of Can_MainFunction_Read -->
<!-- Start of  Can_MainFunction_Wakeup -->
[!IF "as:modconf('Can')[1]/CanConfigSet/CanController/*[1]/CanWakeupSupport = 'true'"!]
  [!IF "as:modconf('Can')[1]/CanConfigSet/CanController/*/CanWakeupProcessing = 'POLLING'"!]
    [!IF "node:exists(as:modconf('Can')[1]/CanGeneral/CanMainFunctionWakeupPeriod)"!]
                <BSW-MODULE-ENTRY>
                  <SHORT-NAME>Can_MainFunction_Wakeup</SHORT-NAME>
                  <SERVICE-ID>10</SERVICE-ID>
                  <IS-REENTRANT>false</IS-REENTRANT>
                  <IS-SYNCHRONOUS>true</IS-SYNCHRONOUS>
                  <CALL-TYPE>SCHEDULED</CALL-TYPE>
                  <EXECUTION-CONTEXT>TASK</EXECUTION-CONTEXT>
                  <SW-SERVICE-IMPL-POLICY>STANDARD</SW-SERVICE-IMPL-POLICY>
                </BSW-MODULE-ENTRY>
    [!ENDIF!]
  [!ENDIF!]
[!ENDIF!]
<!-- End of  Can_MainFunction_Wakeup -->
<!-- Start of  Can_MainFunction_BusOff -->
[!IF "as:modconf('Can')[1]/CanConfigSet/CanController/*/CanBusoffProcessing = 'POLLING'"!]
  [!IF "node:exists(as:modconf('Can')[1]/CanGeneral/CanMainFunctionBusoffPeriod)"!]
                <BSW-MODULE-ENTRY>
                  <SHORT-NAME>Can_MainFunction_BusOff</SHORT-NAME>
                  <SERVICE-ID>9</SERVICE-ID>
                  <IS-REENTRANT>false</IS-REENTRANT>
                  <IS-SYNCHRONOUS>true</IS-SYNCHRONOUS>
                  <CALL-TYPE>SCHEDULED</CALL-TYPE>
                  <EXECUTION-CONTEXT>TASK</EXECUTION-CONTEXT>
                  <SW-SERVICE-IMPL-POLICY>STANDARD</SW-SERVICE-IMPL-POLICY>
                </BSW-MODULE-ENTRY>
  [!ENDIF!]
[!ENDIF!]
<!-- End of  Can_MainFunction_BusOff -->
<!-- Start of  Can_MainFunction_Mode -->
                <BSW-MODULE-ENTRY>
                  <SHORT-NAME>Can_MainFunction_Mode</SHORT-NAME>
                  <SERVICE-ID>12</SERVICE-ID>
                  <IS-REENTRANT>false</IS-REENTRANT>
                  <IS-SYNCHRONOUS>true</IS-SYNCHRONOUS>
                  <CALL-TYPE>SCHEDULED</CALL-TYPE>
                  <EXECUTION-CONTEXT>TASK</EXECUTION-CONTEXT>
                  <SW-SERVICE-IMPL-POLICY>STANDARD</SW-SERVICE-IMPL-POLICY>
                </BSW-MODULE-ENTRY>
<!-- End of  Can_MainFunction_Mode -->
              </ELEMENTS>
            </AR-PACKAGE>
          </AR-PACKAGES>
    </AR-PACKAGE>

    <AR-PACKAGE>
      <SHORT-NAME>Can_TS_T40D2M10I1R0</SHORT-NAME>
      <AR-PACKAGES>
        <AR-PACKAGE>
          <SHORT-NAME>Implementations</SHORT-NAME>
          <ELEMENTS>
            <BSW-IMPLEMENTATION>
              <SHORT-NAME>BswImplementation_0</SHORT-NAME>
              <CODE-DESCRIPTORS>
                <CODE>
                  <SHORT-NAME>Files</SHORT-NAME>
                  <ARTIFACT-DESCRIPTORS>
                    <AUTOSAR-ENGINEERING-OBJECT>
                      <SHORT-LABEL>make::Can_defs.mak</SHORT-LABEL>
                      <CATEGORY>SWMAKE</CATEGORY>
                    </AUTOSAR-ENGINEERING-OBJECT>
                    <AUTOSAR-ENGINEERING-OBJECT>
                      <SHORT-LABEL>make::Can_rules.mak</SHORT-LABEL>
                      <CATEGORY>SWMAKE</CATEGORY>
                    </AUTOSAR-ENGINEERING-OBJECT>
                  </ARTIFACT-DESCRIPTORS>
                </CODE>
              </CODE-DESCRIPTORS>
              <PROGRAMMING-LANGUAGE>C</PROGRAMMING-LANGUAGE>
              <RESOURCE-CONSUMPTION>
                <SHORT-NAME>ResourceConsumption</SHORT-NAME>
                <MEMORY-SECTIONS>
                  <MEMORY-SECTION>
                    <SHORT-NAME>CAN_CODE</SHORT-NAME>
                    <ALIGNMENT>UNSPECIFIED</ALIGNMENT>
                    <SW-ADDRMETHOD-REF DEST="SW-ADDR-METHOD">/AUTOSAR_MemMap/SwAddrMethods/CODE</SW-ADDRMETHOD-REF>
                    <SYMBOL>CODE</SYMBOL>
                  </MEMORY-SECTION>
                  <MEMORY-SECTION>
                    <SHORT-NAME>CAN_CONFIG_DATA_32</SHORT-NAME>
                    <ALIGNMENT>32</ALIGNMENT>
                    <SW-ADDRMETHOD-REF DEST="SW-ADDR-METHOD">/AUTOSAR_MemMap/SwAddrMethods/CONFIG_DATA</SW-ADDRMETHOD-REF>
                    <SYMBOL>CONFIG_DATA_32</SYMBOL>
                  </MEMORY-SECTION>
                  <MEMORY-SECTION>
                    <SHORT-NAME>CAN_CONFIG_DATA_8</SHORT-NAME>
                    <ALIGNMENT>8</ALIGNMENT>
                    <SW-ADDRMETHOD-REF DEST="SW-ADDR-METHOD">/AUTOSAR_MemMap/SwAddrMethods/CONFIG_DATA</SW-ADDRMETHOD-REF>
                    <SYMBOL>CONFIG_DATA_8</SYMBOL>
                  </MEMORY-SECTION>
                  <MEMORY-SECTION>
                    <SHORT-NAME>CAN_CONFIG_DATA_UNSPECIFIED</SHORT-NAME>
                    <ALIGNMENT>UNSPECIFIED</ALIGNMENT>
                    <SW-ADDRMETHOD-REF DEST="SW-ADDR-METHOD">/AUTOSAR_MemMap/SwAddrMethods/CONFIG_DATA</SW-ADDRMETHOD-REF>
                    <SYMBOL>CONFIG_DATA_UNSPECIFIED</SYMBOL>
                  </MEMORY-SECTION>
                  <MEMORY-SECTION>
                    <SHORT-NAME>CAN_CONST_UNSPECIFIED</SHORT-NAME>
                    <ALIGNMENT>UNSPECIFIED</ALIGNMENT>
                    <SW-ADDRMETHOD-REF DEST="SW-ADDR-METHOD">/AUTOSAR_MemMap/SwAddrMethods/CONST</SW-ADDRMETHOD-REF>
                    <SYMBOL>CONST_UNSPECIFIED</SYMBOL>
                  </MEMORY-SECTION>
                  <MEMORY-SECTION>
                    <SHORT-NAME>CAN_VAR_CLEARED_16</SHORT-NAME>
                    <ALIGNMENT>16</ALIGNMENT>
                    <SW-ADDRMETHOD-REF DEST="SW-ADDR-METHOD">/AUTOSAR_MemMap/SwAddrMethods/VAR_CLEARED</SW-ADDRMETHOD-REF>
                    <SYMBOL>VAR_CLEARED_16</SYMBOL>
                  </MEMORY-SECTION>
                  <MEMORY-SECTION>
                    <SHORT-NAME>CAN_VAR_CLEARED_16_NO_CACHEABLE</SHORT-NAME>
                    <ALIGNMENT>UNSPECIFIED</ALIGNMENT>
                    <SW-ADDRMETHOD-REF DEST="SW-ADDR-METHOD">/AUTOSAR_McalExt/SwAddrMethods_McalExt/VAR_CLEARED_16_NO</SW-ADDRMETHOD-REF>
                    <SYMBOL>VAR_CLEARED_16_NO_CACHEABLE</SYMBOL>
                  </MEMORY-SECTION>
                  <MEMORY-SECTION>
                    <SHORT-NAME>CAN_VAR_CLEARED_32</SHORT-NAME>
                    <ALIGNMENT>32</ALIGNMENT>
                    <SW-ADDRMETHOD-REF DEST="SW-ADDR-METHOD">/AUTOSAR_MemMap/SwAddrMethods/VAR_CLEARED</SW-ADDRMETHOD-REF>
                    <SYMBOL>VAR_CLEARED_32</SYMBOL>
                  </MEMORY-SECTION>
                  <MEMORY-SECTION>
                    <SHORT-NAME>CAN_VAR_CLEARED_32_NO_CACHEABLE</SHORT-NAME>
                    <ALIGNMENT>UNSPECIFIED</ALIGNMENT>
                    <SW-ADDRMETHOD-REF DEST="SW-ADDR-METHOD">/AUTOSAR_McalExt/SwAddrMethods_McalExt/VAR_CLEARED_32_NO</SW-ADDRMETHOD-REF>
                    <SYMBOL>VAR_CLEARED_32_NO_CACHEABLE</SYMBOL>
                  </MEMORY-SECTION>
                  <MEMORY-SECTION>
                    <SHORT-NAME>CAN_VAR_CLEARED_8</SHORT-NAME>
                    <ALIGNMENT>8</ALIGNMENT>
                    <SW-ADDRMETHOD-REF DEST="SW-ADDR-METHOD">/AUTOSAR_MemMap/SwAddrMethods/VAR_CLEARED</SW-ADDRMETHOD-REF>
                    <SYMBOL>VAR_CLEARED_8</SYMBOL>
                  </MEMORY-SECTION>
                  <MEMORY-SECTION>
                    <SHORT-NAME>CAN_VAR_CLEARED_8_NO_CACHEABLE</SHORT-NAME>
                    <ALIGNMENT>UNSPECIFIED</ALIGNMENT>
                    <SW-ADDRMETHOD-REF DEST="SW-ADDR-METHOD">/AUTOSAR_McalExt/SwAddrMethods_McalExt/VAR_CLEARED_8_NO</SW-ADDRMETHOD-REF>
                    <SYMBOL>VAR_CLEARED_8_NO_CACHEABLE</SYMBOL>
                  </MEMORY-SECTION>
                  <MEMORY-SECTION>
                    <SHORT-NAME>CAN_VAR_CLEARED_BOOLEAN</SHORT-NAME>
                    <ALIGNMENT>BOOLEAN</ALIGNMENT>
                    <SW-ADDRMETHOD-REF DEST="SW-ADDR-METHOD">/AUTOSAR_MemMap/SwAddrMethods/VAR_CLEARED</SW-ADDRMETHOD-REF>
                    <SYMBOL>VAR_CLEARED_BOOLEAN</SYMBOL>
                  </MEMORY-SECTION>
                  <MEMORY-SECTION>
                    <SHORT-NAME>CAN_VAR_CLEARED_BOOLEAN_NO_CACHEABLE</SHORT-NAME>
                    <ALIGNMENT>UNSPECIFIED</ALIGNMENT>
                    <SW-ADDRMETHOD-REF DEST="SW-ADDR-METHOD">/AUTOSAR_McalExt/SwAddrMethods_McalExt/VAR_CLEARED_BOOLEAN_NO</SW-ADDRMETHOD-REF>
                    <SYMBOL>VAR_CLEARED_BOOLEAN_NO_CACHEABLE</SYMBOL>
                  </MEMORY-SECTION>
                  <MEMORY-SECTION>
                    <SHORT-NAME>CAN_VAR_CLEARED_UNSPECIFIED</SHORT-NAME>
                    <ALIGNMENT>UNSPECIFIED</ALIGNMENT>
                    <SW-ADDRMETHOD-REF DEST="SW-ADDR-METHOD">/AUTOSAR_MemMap/SwAddrMethods/VAR_CLEARED</SW-ADDRMETHOD-REF>
                    <SYMBOL>VAR_CLEARED_UNSPECIFIED</SYMBOL>
                  </MEMORY-SECTION>
                  <MEMORY-SECTION>
                    <SHORT-NAME>CAN_VAR_CLEARED_UNSPECIFIED_NO_CACHEABLE</SHORT-NAME>
                    <ALIGNMENT>UNSPECIFIED</ALIGNMENT>
                    <SW-ADDRMETHOD-REF DEST="SW-ADDR-METHOD">/AUTOSAR_McalExt/SwAddrMethods_McalExt/VAR_CLEARED_UNSPECIFIED_NO</SW-ADDRMETHOD-REF>
                    <SYMBOL>VAR_CLEARED_UNSPECIFIED_NO_CACHEABLE</SYMBOL>
                  </MEMORY-SECTION>
                </MEMORY-SECTIONS>
              </RESOURCE-CONSUMPTION>
              <!-- MODULE_VERSION 1.0.0 != SW-VERSION -->
              <SW-VERSION>1.0.1</SW-VERSION>
              <VENDOR-ID>43</VENDOR-ID>
              <AR-RELEASE-VERSION>4.4.0</AR-RELEASE-VERSION>
              <BEHAVIOR-REF DEST="BSW-INTERNAL-BEHAVIOR">/AUTOSAR_Can/BswModuleDescriptions/Can/InternalBehavior_0</BEHAVIOR-REF>
              <VENDOR-SPECIFIC-MODULE-DEF-REFS>
                <VENDOR-SPECIFIC-MODULE-DEF-REF DEST="ECUC-MODULE-DEF">/Can_TS_T40D2M10I1R0/Can</VENDOR-SPECIFIC-MODULE-DEF-REF>
              </VENDOR-SPECIFIC-MODULE-DEF-REFS>
            </BSW-IMPLEMENTATION>
          </ELEMENTS>
        </AR-PACKAGE>
      </AR-PACKAGES>
    </AR-PACKAGE>
  </AR-PACKAGES>
</AUTOSAR>
