<?xml version="1.0" encoding="ISO-8859-1"?>
[!AUTOSPACING!][!//
<AUTOSAR xmlns="http://autosar.org/schema/r4.0"
  xmlns:xsi="http://www.w3.org/2001/XMLSchema-instance"
  xsi:schemaLocation="http://autosar.org/schema/r4.0 AUTOSAR_4-0-3_STRICT_COMPACT.xsd">
  <AR-PACKAGES>
    <AR-PACKAGE>
      <SHORT-NAME>AUTOSAR_Eep</SHORT-NAME>
      <AR-PACKAGES>
            <AR-PACKAGE>
              <SHORT-NAME>BswModuleDescriptions</SHORT-NAME>
              <ELEMENTS>
                <BSW-MODULE-DESCRIPTION>
                  <SHORT-NAME>Eep</SHORT-NAME>
                  <MODULE-ID>90</MODULE-ID>
                  <PROVIDED-ENTRYS>
                    <BSW-MODULE-ENTRY-REF-CONDITIONAL>
                      <BSW-MODULE-ENTRY-REF DEST="BSW-MODULE-ENTRY">/AUTOSAR_Eep/BswModuleEntrys/Eep_Init</BSW-MODULE-ENTRY-REF>
                    </BSW-MODULE-ENTRY-REF-CONDITIONAL>
                    <BSW-MODULE-ENTRY-REF-CONDITIONAL>
                      <BSW-MODULE-ENTRY-REF DEST="BSW-MODULE-ENTRY">/AUTOSAR_Eep/BswModuleEntrys/Eep_MainFunction</BSW-MODULE-ENTRY-REF>
                    </BSW-MODULE-ENTRY-REF-CONDITIONAL>
                  </PROVIDED-ENTRYS>
                  <INTERNAL-BEHAVIORS>
                    <BSW-INTERNAL-BEHAVIOR>
                      <SHORT-NAME>InternalBehavior_0</SHORT-NAME>
                      <EXCLUSIVE-AREAS>
                        <EXCLUSIVE-AREA>
                          <SHORT-NAME>EEP_EXCLUSIVE_AREA_01</SHORT-NAME>
                        </EXCLUSIVE-AREA>
                        <EXCLUSIVE-AREA>
                          <SHORT-NAME>EEP_EXCLUSIVE_AREA_02</SHORT-NAME>
                        </EXCLUSIVE-AREA>
                        <EXCLUSIVE-AREA>
                          <SHORT-NAME>EEP_EXCLUSIVE_AREA_03</SHORT-NAME>
                        </EXCLUSIVE-AREA>
                        <EXCLUSIVE-AREA>
                          <SHORT-NAME>EEP_EXCLUSIVE_AREA_04</SHORT-NAME>
                        </EXCLUSIVE-AREA>
                        <EXCLUSIVE-AREA>
                          <SHORT-NAME>EEP_EXCLUSIVE_AREA_05</SHORT-NAME>
                        </EXCLUSIVE-AREA>
                        <EXCLUSIVE-AREA>
                          <SHORT-NAME>EEP_EXCLUSIVE_AREA_07</SHORT-NAME>
                        </EXCLUSIVE-AREA>
                        <EXCLUSIVE-AREA>
                          <SHORT-NAME>EEP_EXCLUSIVE_AREA_08</SHORT-NAME>
                        </EXCLUSIVE-AREA>
                        <EXCLUSIVE-AREA>
                          <SHORT-NAME>EEP_EXCLUSIVE_AREA_10</SHORT-NAME>
                        </EXCLUSIVE-AREA>
                        <EXCLUSIVE-AREA>
                          <SHORT-NAME>EEP_EXCLUSIVE_AREA_11</SHORT-NAME>
                        </EXCLUSIVE-AREA>
                      </EXCLUSIVE-AREAS>
                      <ENTITYS>
                        <BSW-CALLED-ENTITY>
                          <SHORT-NAME>Eep_Init</SHORT-NAME>
                          <CAN-ENTER-EXCLUSIVE-AREA-REFS>
                            <CAN-ENTER-EXCLUSIVE-AREA-REF DEST="EXCLUSIVE-AREA">/AUTOSAR_Eep/BswModuleDescriptions/Eep/InternalBehavior_0/EEP_EXCLUSIVE_AREA_01</CAN-ENTER-EXCLUSIVE-AREA-REF>
                            <CAN-ENTER-EXCLUSIVE-AREA-REF DEST="EXCLUSIVE-AREA">/AUTOSAR_Eep/BswModuleDescriptions/Eep/InternalBehavior_0/EEP_EXCLUSIVE_AREA_02</CAN-ENTER-EXCLUSIVE-AREA-REF>
                            <CAN-ENTER-EXCLUSIVE-AREA-REF DEST="EXCLUSIVE-AREA">/AUTOSAR_Eep/BswModuleDescriptions/Eep/InternalBehavior_0/EEP_EXCLUSIVE_AREA_03</CAN-ENTER-EXCLUSIVE-AREA-REF>
                            <CAN-ENTER-EXCLUSIVE-AREA-REF DEST="EXCLUSIVE-AREA">/AUTOSAR_Eep/BswModuleDescriptions/Eep/InternalBehavior_0/EEP_EXCLUSIVE_AREA_04</CAN-ENTER-EXCLUSIVE-AREA-REF>
                            <CAN-ENTER-EXCLUSIVE-AREA-REF DEST="EXCLUSIVE-AREA">/AUTOSAR_Eep/BswModuleDescriptions/Eep/InternalBehavior_0/EEP_EXCLUSIVE_AREA_05</CAN-ENTER-EXCLUSIVE-AREA-REF>
                            <CAN-ENTER-EXCLUSIVE-AREA-REF DEST="EXCLUSIVE-AREA">/AUTOSAR_Eep/BswModuleDescriptions/Eep/InternalBehavior_0/EEP_EXCLUSIVE_AREA_07</CAN-ENTER-EXCLUSIVE-AREA-REF>
                            <CAN-ENTER-EXCLUSIVE-AREA-REF DEST="EXCLUSIVE-AREA">/AUTOSAR_Eep/BswModuleDescriptions/Eep/InternalBehavior_0/EEP_EXCLUSIVE_AREA_08</CAN-ENTER-EXCLUSIVE-AREA-REF>
                            <CAN-ENTER-EXCLUSIVE-AREA-REF DEST="EXCLUSIVE-AREA">/AUTOSAR_Eep/BswModuleDescriptions/Eep/InternalBehavior_0/EEP_EXCLUSIVE_AREA_10</CAN-ENTER-EXCLUSIVE-AREA-REF>
                            <CAN-ENTER-EXCLUSIVE-AREA-REF DEST="EXCLUSIVE-AREA">/AUTOSAR_Eep/BswModuleDescriptions/Eep/InternalBehavior_0/EEP_EXCLUSIVE_AREA_11</CAN-ENTER-EXCLUSIVE-AREA-REF>
                          </CAN-ENTER-EXCLUSIVE-AREA-REFS>
                          <MINIMUM-START-INTERVAL>0.0</MINIMUM-START-INTERVAL>
                          <IMPLEMENTED-ENTRY-REF DEST="BSW-MODULE-ENTRY">/AUTOSAR_Eep/BswModuleEntrys/Eep_Init</IMPLEMENTED-ENTRY-REF>
                          <SCHEDULER-NAME-PREFIX-REF DEST="BSW-SCHEDULER-NAME-PREFIX">/AUTOSAR_Eep/BswModuleDescriptions/Eep/InternalBehavior_0/Prefix_Eep</SCHEDULER-NAME-PREFIX-REF>
                        </BSW-CALLED-ENTITY>
                        <BSW-SCHEDULABLE-ENTITY>
                          <SHORT-NAME>Eep_MainFunction</SHORT-NAME>
                          <MINIMUM-START-INTERVAL>0.0</MINIMUM-START-INTERVAL>
                          <IMPLEMENTED-ENTRY-REF DEST="BSW-MODULE-ENTRY">/AUTOSAR_Eep/BswModuleEntrys/Eep_MainFunction</IMPLEMENTED-ENTRY-REF>
                          <SCHEDULER-NAME-PREFIX-REF DEST="BSW-SCHEDULER-NAME-PREFIX">/AUTOSAR_Eep/BswModuleDescriptions/Eep/InternalBehavior_0/Prefix_Eep</SCHEDULER-NAME-PREFIX-REF>
                        </BSW-SCHEDULABLE-ENTITY>
                      </ENTITYS>
                      <EVENTS>
                        <BSW-TIMING-EVENT>
                          <SHORT-NAME>TimingEvent_MainFunction</SHORT-NAME>
                          <STARTS-ON-EVENT-REF DEST="BSW-SCHEDULABLE-ENTITY">/AUTOSAR_Eep/BswModuleDescriptions/Eep/InternalBehavior_0/Eep_MainFunction</STARTS-ON-EVENT-REF>
[!IF "node:exists(/AUTOSAR/TOP-LEVEL-PACKAGES/Ea/ELEMENTS/Ea/EaGeneral/EaMainFunctionPeriod)"!]
                          <PERIOD>[!"/AUTOSAR/TOP-LEVEL-PACKAGES/Ea/ELEMENTS/Ea/EaGeneral/EaMainFunctionPeriod"!]</PERIOD>
[!ELSE!]
[!IF "node:exists(/AUTOSAR/TOP-LEVEL-PACKAGES/NvM/ELEMENTS/NvM/NvMCommon/NvMMainFunctionCycleTime)"!]
                          <PERIOD>[!"/AUTOSAR/TOP-LEVEL-PACKAGES/NvM/ELEMENTS/NvM/NvMCommon/NvMMainFunctionCycleTime"!]</PERIOD>
[!ELSE!]
                          <PERIOD>0.01</PERIOD>
[!ENDIF!]
[!ENDIF!]
                        </BSW-TIMING-EVENT>
                      </EVENTS>
                      <SCHEDULER-NAME-PREFIXS>
                         <BSW-SCHEDULER-NAME-PREFIX>
                           <SHORT-NAME>Prefix_Eep</SHORT-NAME>
                           <SYMBOL>Eep</SYMBOL>
                         </BSW-SCHEDULER-NAME-PREFIX>
                      </SCHEDULER-NAME-PREFIXS>
                    </BSW-INTERNAL-BEHAVIOR>
                  </INTERNAL-BEHAVIORS>
                </BSW-MODULE-DESCRIPTION>
              </ELEMENTS>
            </AR-PACKAGE>
            <AR-PACKAGE>
              <SHORT-NAME>BswModuleEntrys</SHORT-NAME>
              <ELEMENTS>
                <BSW-MODULE-ENTRY>
                  <SHORT-NAME>Eep_Init</SHORT-NAME>
                  <SERVICE-ID>0</SERVICE-ID>
                  <IS-REENTRANT>false</IS-REENTRANT>
                  <IS-SYNCHRONOUS>true</IS-SYNCHRONOUS>
                  <CALL-TYPE>REGULAR</CALL-TYPE>
                  <EXECUTION-CONTEXT>UNSPECIFIED</EXECUTION-CONTEXT>
                  <SW-SERVICE-IMPL-POLICY>STANDARD</SW-SERVICE-IMPL-POLICY>
                </BSW-MODULE-ENTRY>
                <BSW-MODULE-ENTRY>
                  <SHORT-NAME>Eep_MainFunction</SHORT-NAME>
                  <SERVICE-ID>9</SERVICE-ID>
                  <IS-REENTRANT>false</IS-REENTRANT>
                  <IS-SYNCHRONOUS>true</IS-SYNCHRONOUS>
                  <CALL-TYPE>SCHEDULED</CALL-TYPE>
                  <EXECUTION-CONTEXT>TASK</EXECUTION-CONTEXT>
                  <SW-SERVICE-IMPL-POLICY>STANDARD</SW-SERVICE-IMPL-POLICY>
                </BSW-MODULE-ENTRY>
              </ELEMENTS>
            </AR-PACKAGE>
      </AR-PACKAGES>
    </AR-PACKAGE>

    <AR-PACKAGE>
      <SHORT-NAME>Eep_TS_T40D2M10I1R0</SHORT-NAME>
      <AR-PACKAGES>
        <AR-PACKAGE>
          <SHORT-NAME>Implementations</SHORT-NAME>
          <ELEMENTS>
            <BSW-IMPLEMENTATION>
              <SHORT-NAME>BswImplementation_0</SHORT-NAME>
              <CODE-DESCRIPTORS>
                <CODE>
                  <SHORT-NAME>Files</SHORT-NAME>
                  <ARTIFACT-DESCRIPTORS>
                    <AUTOSAR-ENGINEERING-OBJECT>
                      <SHORT-LABEL>make::Eep_defs.mak</SHORT-LABEL>
                      <CATEGORY>SWMAKE</CATEGORY>
                    </AUTOSAR-ENGINEERING-OBJECT>
                    <AUTOSAR-ENGINEERING-OBJECT>
                      <SHORT-LABEL>make::Eep_rules.mak</SHORT-LABEL>
                      <CATEGORY>SWMAKE</CATEGORY>
                    </AUTOSAR-ENGINEERING-OBJECT>
                  </ARTIFACT-DESCRIPTORS>
                </CODE>
              </CODE-DESCRIPTORS>
              <PROGRAMMING-LANGUAGE>C</PROGRAMMING-LANGUAGE>
              <RESOURCE-CONSUMPTION>
                <SHORT-NAME>ResourceConsumption</SHORT-NAME>
                <MEMORY-SECTIONS>
                  <MEMORY-SECTION>
                    <SHORT-NAME>EEP_CODE</SHORT-NAME>
                    <ALIGNMENT>UNSPECIFIED</ALIGNMENT>
                    <SW-ADDRMETHOD-REF DEST="SW-ADDR-METHOD">/AUTOSAR_MemMap/SwAddrMethods/CODE</SW-ADDRMETHOD-REF>
                    <SYMBOL>CODE</SYMBOL>
                  </MEMORY-SECTION>
                  <MEMORY-SECTION>
                    <SHORT-NAME>EEP_CONFIG_DATA_UNSPECIFIED</SHORT-NAME>
                    <ALIGNMENT>UNSPECIFIED</ALIGNMENT>
                    <SW-ADDRMETHOD-REF DEST="SW-ADDR-METHOD">/AUTOSAR_MemMap/SwAddrMethods/CONFIG_DATA</SW-ADDRMETHOD-REF>
                    <SYMBOL>CONFIG_DATA_UNSPECIFIED</SYMBOL>
                  </MEMORY-SECTION>
                  <MEMORY-SECTION>
                    <SHORT-NAME>EEP_CONST_32</SHORT-NAME>
                    <ALIGNMENT>32</ALIGNMENT>
                    <SW-ADDRMETHOD-REF DEST="SW-ADDR-METHOD">/AUTOSAR_MemMap/SwAddrMethods/CONST</SW-ADDRMETHOD-REF>
                    <SYMBOL>CONST_32</SYMBOL>
                  </MEMORY-SECTION>
                  <MEMORY-SECTION>
                    <SHORT-NAME>EEP_RAMCODE</SHORT-NAME>
                    <ALIGNMENT>UNSPECIFIED</ALIGNMENT>
                    <SW-ADDRMETHOD-REF DEST="SW-ADDR-METHOD">/AUTOSAR_McalExt/SwAddrMethods_McalExt/RAMCODE</SW-ADDRMETHOD-REF>
                    <SYMBOL>RAMCODE</SYMBOL>
                  </MEMORY-SECTION>
                  <MEMORY-SECTION>
                    <SHORT-NAME>EEP_VAR_CLEARED_16</SHORT-NAME>
                    <ALIGNMENT>16</ALIGNMENT>
                    <SW-ADDRMETHOD-REF DEST="SW-ADDR-METHOD">/AUTOSAR_MemMap/SwAddrMethods/VAR_CLEARED</SW-ADDRMETHOD-REF>
                    <SYMBOL>VAR_CLEARED_16</SYMBOL>
                  </MEMORY-SECTION>
                  <MEMORY-SECTION>
                    <SHORT-NAME>EEP_VAR_CLEARED_32</SHORT-NAME>
                    <ALIGNMENT>32</ALIGNMENT>
                    <SW-ADDRMETHOD-REF DEST="SW-ADDR-METHOD">/AUTOSAR_MemMap/SwAddrMethods/VAR_CLEARED</SW-ADDRMETHOD-REF>
                    <SYMBOL>VAR_CLEARED_32</SYMBOL>
                  </MEMORY-SECTION>
                  <MEMORY-SECTION>
                    <SHORT-NAME>EEP_VAR_CLEARED_8</SHORT-NAME>
                    <ALIGNMENT>8</ALIGNMENT>
                    <SW-ADDRMETHOD-REF DEST="SW-ADDR-METHOD">/AUTOSAR_MemMap/SwAddrMethods/VAR_CLEARED</SW-ADDRMETHOD-REF>
                    <SYMBOL>VAR_CLEARED_8</SYMBOL>
                  </MEMORY-SECTION>
                  <MEMORY-SECTION>
                    <SHORT-NAME>EEP_VAR_CLEARED_UNSPECIFIED</SHORT-NAME>
                    <ALIGNMENT>UNSPECIFIED</ALIGNMENT>
                    <SW-ADDRMETHOD-REF DEST="SW-ADDR-METHOD">/AUTOSAR_MemMap/SwAddrMethods/VAR_CLEARED</SW-ADDRMETHOD-REF>
                    <SYMBOL>VAR_CLEARED_UNSPECIFIED</SYMBOL>
                  </MEMORY-SECTION>
                  <MEMORY-SECTION>
                    <SHORT-NAME>EEP_VAR_INIT_8_NO_CACHEABLE</SHORT-NAME>
                    <ALIGNMENT>UNSPECIFIED</ALIGNMENT>
                    <SW-ADDRMETHOD-REF DEST="SW-ADDR-METHOD">/AUTOSAR_MemMap/SwAddrMethods/VAR_INIT</SW-ADDRMETHOD-REF>
                    <SYMBOL>VAR_INIT_8_NO_CACHEABLE</SYMBOL>
                  </MEMORY-SECTION>
                </MEMORY-SECTIONS>
              </RESOURCE-CONSUMPTION>
              <SW-VERSION>1.0.1</SW-VERSION>
              <VENDOR-ID>43</VENDOR-ID>
              <AR-RELEASE-VERSION>4.4.0</AR-RELEASE-VERSION>
              <BEHAVIOR-REF DEST="BSW-INTERNAL-BEHAVIOR">/AUTOSAR_Eep/BswModuleDescriptions/Eep/InternalBehavior_0</BEHAVIOR-REF>
              <VENDOR-SPECIFIC-MODULE-DEF-REFS>
                <VENDOR-SPECIFIC-MODULE-DEF-REF DEST="ECUC-MODULE-DEF">/TS_T40D2M10I1R0/Eep</VENDOR-SPECIFIC-MODULE-DEF-REF>
              </VENDOR-SPECIFIC-MODULE-DEF-REFS>
            </BSW-IMPLEMENTATION>
          </ELEMENTS>
        </AR-PACKAGE>
      </AR-PACKAGES>
    </AR-PACKAGE>
  </AR-PACKAGES>
</AUTOSAR>
