AUTOSAR XML (schema 00046)
package /AUTOSAR_I2s/BswModuleDescriptions
  bsw module description I2s: module-id=255
    provided-entrys:
      I2s_AsyncTransmit
      I2s_DeInit
      I2s_GetStatus
      I2s_GetVersionInfo
      I2s_Init
      I2s_SyncTransmit
      SAI0_IRQHandler
      SAI1_IRQHandler
    bsw internal behavior InternalBehavior_0
      14 x exclusive area:
        I2S_EXCLUSIVE_AREA_{00..04}
        I2S_EXCLUSIVE_AREA_{06..09}
        I2S_EXCLUSIVE_AREA_12
        I2S_EXCLUSIVE_AREA_13
        I2S_EXCLUSIVE_AREA_{15..17}
      6 x bsw called entity:
        I2s_AsyncTransmit: can-enter-exclusive-area=[I2S_EXCLUSIVE_AREA_00, I2S_EXCLUSIVE_AREA_01, I2S_EXCLUSIVE_AREA_02, I2S_EXCLUSIVE_AREA_03, I2S_EXCLUSIVE_AREA_04, I2S_EXCLUSIVE_AREA_06, I2S_EXCLUSIVE_AREA_07, I2S_EXCLUSIVE_AREA_08, I2S_EXCLUSIVE_AREA_09, I2S_EXCLUSIVE_AREA_12, I2S_EXCLUSIVE_AREA_13, I2S_EXCLUSIVE_AREA_15, I2S_EXCLUSIVE_AREA_16, I2S_EXCLUSIVE_AREA_17], implemented-entry=I2s_AsyncTransmit
        I2s_DeInit: implemented-entry=I2s_DeInit
        I2s_GetStatus: implemented-entry=I2s_GetStatus
        I2s_GetVersionInfo: implemented-entry=I2s_GetVersionInfo
        I2s_Init: implemented-entry=I2s_Init
        I2s_SyncTransmit: can-enter-exclusive-area=[I2S_EXCLUSIVE_AREA_00, I2S_EXCLUSIVE_AREA_01, I2S_EXCLUSIVE_AREA_02, I2S_EXCLUSIVE_AREA_03, I2S_EXCLUSIVE_AREA_04, I2S_EXCLUSIVE_AREA_06, I2S_EXCLUSIVE_AREA_07, I2S_EXCLUSIVE_AREA_08, I2S_EXCLUSIVE_AREA_09, I2S_EXCLUSIVE_AREA_12, I2S_EXCLUSIVE_AREA_13, I2S_EXCLUSIVE_AREA_15, I2S_EXCLUSIVE_AREA_16, I2S_EXCLUSIVE_AREA_17], implemented-entry=I2s_SyncTransmit
      bsw interrupt entity SAI0_IRQHandler: implemented-entry=SAI0_IRQHandler, interrupt-category=CAT-2, interrupt-source=Hardware
      bsw interrupt entity SAI1_IRQHandler: implemented-entry=SAI1_IRQHandler, interrupt-category=CAT-2, interrupt-source=Hardware
package /AUTOSAR_I2s/BswModuleEntrys
  8 x bsw module entry, all with is-reentrant=false, is-synchronous=true, sw-service-impl-policy=STANDARD:
    I2s_AsyncTransmit: service-id=0x03, call-type=REGULAR, execution-context=UNSPECIFIED
    I2s_DeInit: service-id=0x01, call-type=REGULAR, execution-context=UNSPECIFIED
    I2s_GetStatus: service-id=0x04, call-type=REGULAR, execution-context=UNSPECIFIED
    I2s_GetVersionInfo: service-id=0x06, call-type=REGULAR, execution-context=UNSPECIFIED
    I2s_Init: service-id=0x00, call-type=REGULAR, execution-context=UNSPECIFIED
    I2s_SyncTransmit: service-id=0x02, call-type=REGULAR, execution-context=UNSPECIFIED
    SAI0_IRQHandler: service-id=0, call-type=INTERRUPT, execution-context=INTERRUPT-CAT-2
    SAI1_IRQHandler: service-id=0, call-type=INTERRUPT, execution-context=INTERRUPT-CAT-2
package /I2s_TS_T40D2M10I1R0/Implementations
  bsw implementation BswImplementation_0: programming-language=C, sw-version=1.0.1, vendor-id=43, ar-release-version=4.4.0, behavior=InternalBehavior_0, vendor-specific-module-def=I2s
    code-descriptors:
      code Files
        artifact-descriptors:
          short-label=config::I2s.xdm, category=SWCFG
          short-label=doc::RTD_I2S_IM.pdf, category=SWDOC
          short-label=doc::RTD_I2S_UM.pdf, category=SWDOC
          short-label=examples::EBT::I2s_Flexio_to_Sai_example_S32K148::generate::epc::Base.xdm, category=SWCFG
          short-label=examples::EBT::I2s_Flexio_to_Sai_example_S32K148::generate::epc::Dem.xdm, category=SWCFG
          short-label=examples::EBT::I2s_Flexio_to_Sai_example_S32K148::generate::epc::EcuC.xdm, category=SWCFG
          short-label=examples::EBT::I2s_Flexio_to_Sai_example_S32K148::generate::epc::I2s.xdm, category=SWCFG
          short-label=examples::EBT::I2s_Flexio_to_Sai_example_S32K148::generate::epc::Mcl.xdm, category=SWCFG
          short-label=examples::EBT::I2s_Flexio_to_Sai_example_S32K148::generate::epc::Mcu.xdm, category=SWCFG
          short-label=examples::EBT::I2s_Flexio_to_Sai_example_S32K148::generate::epc::Platform.xdm, category=SWCFG
          short-label=examples::EBT::I2s_Flexio_to_Sai_example_S32K148::generate::epc::Port.xdm, category=SWCFG
          short-label=examples::EBT::I2s_Flexio_to_Sai_example_S32K148::generate::epc::Resource.xdm, category=SWCFG
          short-label=examples::EBT::I2s_Flexio_to_Sai_example_S32K148::include::check_example.h, category=SWHDR
          short-label=examples::EBT::I2s_Flexio_to_Sai_example_S32K148::src::main.c, category=SWSRC
          short-label=examples::EBT::I2s_Flexio_to_Sai_example_S32K148::TresosProject::I2s_Flexio_to_Sai_example_S32K148::.prefs::preferences.xdm, category=SWCFG
          short-label=examples::EBT::I2s_Flexio_to_Sai_example_S32K148::TresosProject::I2s_Flexio_to_Sai_example_S32K148::config::Base.xdm, category=SWCFG
          short-label=examples::EBT::I2s_Flexio_to_Sai_example_S32K148::TresosProject::I2s_Flexio_to_Sai_example_S32K148::config::Dem.xdm, category=SWCFG
          short-label=examples::EBT::I2s_Flexio_to_Sai_example_S32K148::TresosProject::I2s_Flexio_to_Sai_example_S32K148::config::EcuC.xdm, category=SWCFG
          short-label=examples::EBT::I2s_Flexio_to_Sai_example_S32K148::TresosProject::I2s_Flexio_to_Sai_example_S32K148::config::I2s.xdm, category=SWCFG
          short-label=examples::EBT::I2s_Flexio_to_Sai_example_S32K148::TresosProject::I2s_Flexio_to_Sai_example_S32K148::config::Mcl.xdm, category=SWCFG
          short-label=examples::EBT::I2s_Flexio_to_Sai_example_S32K148::TresosProject::I2s_Flexio_to_Sai_example_S32K148::config::Mcu.xdm, category=SWCFG
          short-label=examples::EBT::I2s_Flexio_to_Sai_example_S32K148::TresosProject::I2s_Flexio_to_Sai_example_S32K148::config::Platform.xdm, category=SWCFG
          short-label=examples::EBT::I2s_Flexio_to_Sai_example_S32K148::TresosProject::I2s_Flexio_to_Sai_example_S32K148::config::Port.xdm, category=SWCFG
          short-label=examples::EBT::I2s_Flexio_to_Sai_example_S32K148::TresosProject::I2s_Flexio_to_Sai_example_S32K148::config::Resource.xdm, category=SWCFG
          short-label=examples::EBT::I2s_Sai_to_Flexio_example_S32K148::generate::epc::Base.xdm, category=SWCFG
          short-label=examples::EBT::I2s_Sai_to_Flexio_example_S32K148::generate::epc::Dem.xdm, category=SWCFG
          short-label=examples::EBT::I2s_Sai_to_Flexio_example_S32K148::generate::epc::EcuC.xdm, category=SWCFG
          short-label=examples::EBT::I2s_Sai_to_Flexio_example_S32K148::generate::epc::I2s.xdm, category=SWCFG
          short-label=examples::EBT::I2s_Sai_to_Flexio_example_S32K148::generate::epc::Mcl.xdm, category=SWCFG
          short-label=examples::EBT::I2s_Sai_to_Flexio_example_S32K148::generate::epc::Mcu.xdm, category=SWCFG
          short-label=examples::EBT::I2s_Sai_to_Flexio_example_S32K148::generate::epc::Platform.xdm, category=SWCFG
          short-label=examples::EBT::I2s_Sai_to_Flexio_example_S32K148::generate::epc::Port.xdm, category=SWCFG
          short-label=examples::EBT::I2s_Sai_to_Flexio_example_S32K148::generate::epc::Resource.xdm, category=SWCFG
          short-label=examples::EBT::I2s_Sai_to_Flexio_example_S32K148::include::check_example.h, category=SWHDR
          short-label=examples::EBT::I2s_Sai_to_Flexio_example_S32K148::src::main.c, category=SWSRC
          short-label=examples::EBT::I2s_Sai_to_Flexio_example_S32K148::TresosProject::I2s_Sai_to_Flexio_example_S32K148::.prefs::preferences.xdm, category=SWCFG
          short-label=examples::EBT::I2s_Sai_to_Flexio_example_S32K148::TresosProject::I2s_Sai_to_Flexio_example_S32K148::config::Base.xdm, category=SWCFG
          short-label=examples::EBT::I2s_Sai_to_Flexio_example_S32K148::TresosProject::I2s_Sai_to_Flexio_example_S32K148::config::Dem.xdm, category=SWCFG
          short-label=examples::EBT::I2s_Sai_to_Flexio_example_S32K148::TresosProject::I2s_Sai_to_Flexio_example_S32K148::config::EcuC.xdm, category=SWCFG
          short-label=examples::EBT::I2s_Sai_to_Flexio_example_S32K148::TresosProject::I2s_Sai_to_Flexio_example_S32K148::config::I2s.xdm, category=SWCFG
          short-label=examples::EBT::I2s_Sai_to_Flexio_example_S32K148::TresosProject::I2s_Sai_to_Flexio_example_S32K148::config::Mcl.xdm, category=SWCFG
          short-label=examples::EBT::I2s_Sai_to_Flexio_example_S32K148::TresosProject::I2s_Sai_to_Flexio_example_S32K148::config::Mcu.xdm, category=SWCFG
          short-label=examples::EBT::I2s_Sai_to_Flexio_example_S32K148::TresosProject::I2s_Sai_to_Flexio_example_S32K148::config::Platform.xdm, category=SWCFG
          short-label=examples::EBT::I2s_Sai_to_Flexio_example_S32K148::TresosProject::I2s_Sai_to_Flexio_example_S32K148::config::Port.xdm, category=SWCFG
          short-label=examples::EBT::I2s_Sai_to_Flexio_example_S32K148::TresosProject::I2s_Sai_to_Flexio_example_S32K148::config::Resource.xdm, category=SWCFG
          short-label=examples::S32DS::Flexio_to_Sai_Ip_example_S32K148::include::check_example.h, category=SWHDR
          short-label=examples::S32DS::Flexio_to_Sai_Ip_example_S32K148::Project_Settings::Startup_Code::exceptions.c, category=SWSRC
          short-label=examples::S32DS::Flexio_to_Sai_Ip_example_S32K148::Project_Settings::Startup_Code::nvic.c, category=SWSRC
          short-label=examples::S32DS::Flexio_to_Sai_Ip_example_S32K148::Project_Settings::Startup_Code::startup.c, category=SWSRC
          short-label=examples::S32DS::Flexio_to_Sai_Ip_example_S32K148::Project_Settings::Startup_Code::system.c, category=SWSRC
          short-label=examples::S32DS::Flexio_to_Sai_Ip_example_S32K148::src::main.c, category=SWSRC
          short-label=examples::S32DS::I2s_Flexio_to_Sai_example_S32K148::include::check_example.h, category=SWHDR
          short-label=examples::S32DS::I2s_Flexio_to_Sai_example_S32K148::Project_Settings::Startup_Code::exceptions.c, category=SWSRC
          short-label=examples::S32DS::I2s_Flexio_to_Sai_example_S32K148::Project_Settings::Startup_Code::nvic.c, category=SWSRC
          short-label=examples::S32DS::I2s_Flexio_to_Sai_example_S32K148::Project_Settings::Startup_Code::startup.c, category=SWSRC
          short-label=examples::S32DS::I2s_Flexio_to_Sai_example_S32K148::Project_Settings::Startup_Code::system.c, category=SWSRC
          short-label=examples::S32DS::I2s_Flexio_to_Sai_example_S32K148::src::main.c, category=SWSRC
          short-label=examples::S32DS::I2s_Sai_to_Flexio_example_S32K148::include::check_example.h, category=SWHDR
          short-label=examples::S32DS::I2s_Sai_to_Flexio_example_S32K148::Project_Settings::Startup_Code::exceptions.c, category=SWSRC
          short-label=examples::S32DS::I2s_Sai_to_Flexio_example_S32K148::Project_Settings::Startup_Code::nvic.c, category=SWSRC
          short-label=examples::S32DS::I2s_Sai_to_Flexio_example_S32K148::Project_Settings::Startup_Code::startup.c, category=SWSRC
          short-label=examples::S32DS::I2s_Sai_to_Flexio_example_S32K148::Project_Settings::Startup_Code::system.c, category=SWSRC
          short-label=examples::S32DS::I2s_Sai_to_Flexio_example_S32K148::src::main.c, category=SWSRC
          short-label=examples::S32DS::Sai_to_Flexio_Ip_example_S32K148::include::check_example.h, category=SWHDR
          short-label=examples::S32DS::Sai_to_Flexio_Ip_example_S32K148::Project_Settings::Startup_Code::exceptions.c, category=SWSRC
          short-label=examples::S32DS::Sai_to_Flexio_Ip_example_S32K148::Project_Settings::Startup_Code::nvic.c, category=SWSRC
          short-label=examples::S32DS::Sai_to_Flexio_Ip_example_S32K148::Project_Settings::Startup_Code::startup.c, category=SWSRC
          short-label=examples::S32DS::Sai_to_Flexio_Ip_example_S32K148::Project_Settings::Startup_Code::system.c, category=SWSRC
          short-label=examples::S32DS::Sai_to_Flexio_Ip_example_S32K148::src::main.c, category=SWSRC
          short-label=include::CDD_I2s.h, category=SWHDR
          short-label=include::CDD_I2s_Types.h, category=SWHDR
          short-label=include::Flexio_I2s_Ip.h, category=SWHDR
          short-label=include::Flexio_I2s_Ip_HwAccess.h, category=SWHDR
          short-label=include::Flexio_I2s_Ip_Irq.h, category=SWHDR
          short-label=include::Flexio_I2s_Ip_Types.h, category=SWHDR
          short-label=include::I2s_Ipw.h, category=SWHDR
          short-label=include::I2s_Ipw_Types.h, category=SWHDR
          short-label=include::Sai_Ip.h, category=SWHDR
          short-label=include::Sai_Ip_DeviceRegisters.h, category=SWHDR
          short-label=include::Sai_Ip_FeatureDefines.h, category=SWHDR
          short-label=include::Sai_Ip_HwAccess.h, category=SWHDR
          short-label=include::Sai_Ip_Types.h, category=SWHDR
          short-label=src::CDD_I2s.c, category=SWSRC
          short-label=src::Flexio_I2s_Ip.c, category=SWSRC
          short-label=src::I2s_Ipw.c, category=SWSRC
          short-label=src::Sai_Ip.c, category=SWSRC
          short-label=src::Sai_Ip_Isr.c, category=SWSRC
    compiler GCC_Compiler:
      name=GCC Compiler
      options=-mcpu=cortex-m4 -mcpu=cortex-m0plus -mthumb -mlittle-endian -mfpu=fpv4-sp-d16 -mfloat-abi=hard -mfpu=auto -mfloat-abi=soft -std=c99 -Os -ggdb3 -Wall -Wextra -pedantic -Wstrict-prototypes -Wundef -Wunused -Werror=implicit-function-declaration -Wsign-compare -Wdouble-promotion -fno-short-enums -funsigned-char -funsigned-bitfields -fomit-frame-pointer -fno-common -fstack-usage -fdump-ipa-all -c -DS32K1XX -DS32K148 -DGCC -DUSE_SW_VECTOR_MODE -DI_CACHE_ENABLE -DENABLE_FPU -DMCAL_ENABLE_USER_MODE_SUPPORT
      vendor=GCC Systems
      version=NXP GCC 9.2.0 20190812 (Build 1649 Revision gaf57174)
    compiler GHS_Compiler:
      name=Green Hills
      options=-cpu=cortexm4 -cpu=cortexm0plus -thumb -fpu=vfpv4_d16 -fsingle -fsoft -C99 --ghstd=last -Osize --gnu_asm -dual_debug -G -keeptempfiles -Wimplicit-int -Wshadow -Wtrigraphs -Wundef --unsigned_chars --unsigned_fields --no_commons --no_exceptions --no_slash_comment --prototype_errors --incorrect_pragma_warnings -c -DS32K1XX -DS32K148 -DGHS -DUSE_SW_VECTOR_MODE -DI_CACHE_ENABLE -DENABLE_FPU -DMCAL_ENABLE_USER_MODE_SUPPORT
      vendor=Green Hills
      version=Green Hills Multi 7.1.6d / Compiler 2020.1.4
    compiler IAR_Compiler:
      name=IAR Compiler
      options=--cpu=Cortex-M4 --cpu=Cortex-M0+ --cpu_mode=thumb --endian=little --fpu=FPv4-SP --fpu=none -e -Ohz --debug --no_clustering --no_mem_idioms --no_explicit_zero_opt --require_prototypes --no_wrap_diagnostics --diag_suppress=Pa050 -DS32K1XX -DS32K148 -DIAR -DUSE_SW_VECTOR_MODE -DI_CACHE_ENABLE -DENABLE_FPU -DMCAL_ENABLE_USER_MODE_SUPPORT
      vendor=IAR Systems
      version=IAR ANSI C/C++ Compiler V8.40.3.228/W32 for ARM Functional Safety
    generated-artifacts:
      16 x dependency on artifact:
        CDD_I2s_PBcfg_h: artifact-descriptor={short-label=generate_PB::include::CDD_I2s_PBcfg.h, category=SWHDR}, usages=EXECUTE
        Flexio_I2s_Ip_PBcfg_h: artifact-descriptor={short-label=generate_PB::include::Flexio_I2s_Ip_PBcfg.h, category=SWHDR}, usages=EXECUTE
        I2s_Ipw_PBcfg_h: artifact-descriptor={short-label=generate_PB::include::I2s_Ipw_PBcfg.h, category=SWHDR}, usages=EXECUTE
        Sai_Ip_PBcfg_h: artifact-descriptor={short-label=generate_PB::include::Sai_Ip_PBcfg.h, category=SWHDR}, usages=EXECUTE
        CDD_I2s_PBcfg_c: artifact-descriptor={short-label=generate_PB::src::CDD_I2s_PBcfg.c, category=SWSRC}, usages=EXECUTE
        Flexio_I2s_Ip_PBcfg_c: artifact-descriptor={short-label=generate_PB::src::Flexio_I2s_Ip_PBcfg.c, category=SWSRC}, usages=EXECUTE
        I2s_Ipw_PBcfg_c: artifact-descriptor={short-label=generate_PB::src::I2s_Ipw_PBcfg.c, category=SWSRC}, usages=EXECUTE
        Sai_Ip_PBcfg_c: artifact-descriptor={short-label=generate_PB::src::Sai_Ip_PBcfg.c, category=SWSRC}, usages=EXECUTE
        CDD_I2s_Cfg_h: artifact-descriptor={short-label=generate_PC::include::CDD_I2s_Cfg.h, category=SWHDR}, usages=COMPILE
        CDD_I2s_CfgDefines_h: artifact-descriptor={short-label=generate_PC::include::CDD_I2s_CfgDefines.h, category=SWHDR}, usages=COMPILE
        Flexio_I2s_Ip_Cfg_h: artifact-descriptor={short-label=generate_PC::include::Flexio_I2s_Ip_Cfg.h, category=SWHDR}, usages=COMPILE
        Flexio_I2s_Ip_CfgDefines_h: artifact-descriptor={short-label=generate_PC::include::Flexio_I2s_Ip_CfgDefines.h, category=SWHDR}, usages=COMPILE
        I2s_Ipw_Cfg_h: artifact-descriptor={short-label=generate_PC::include::I2s_Ipw_Cfg.h, category=SWHDR}, usages=COMPILE
        I2s_Ipw_CfgDefines_h: artifact-descriptor={short-label=generate_PC::include::I2s_Ipw_CfgDefines.h, category=SWHDR}, usages=COMPILE
        Sai_Ip_Cfg_h: artifact-descriptor={short-label=generate_PC::include::Sai_Ip_Cfg.h, category=SWHDR}, usages=COMPILE
        Sai_Ip_CfgDefines_h: artifact-descriptor={short-label=generate_PC::include::Sai_Ip_CfgDefines.h, category=SWHDR}, usages=COMPILE
    linker GCC_Linker: name=GCC Compiler, options=-Wl,-Map,filename -T linkerfile --entry=Reset_Handler -nostartfiles -mcpu=cortex-m4 -mcpu=cortex-m0plus -mthumb -mfpu=fpv4-sp-d16 -mfloat-abi=hard -mfpu=auto -mfloat-abi=soft -mlittle-endian -ggdb3 -lc -lm -lgcc -n, vendor=GCC Systems, version=NXP GCC 9.2.0 20190812 (Build 1649 Revision gaf57174)
    linker GHS_Linker: name=Green Hills, options=-e Reset_Handler -T linker_script_file.ld -map -keepmap -Mn -delete -ignore_debug_references -Llibrary_path -larch -lstartup -lind_sd -lind_sf -v -keep=C40_Ip_AccessCode -nostartfiles, vendor=Green Hills, version=Green Hills Multi 7.1.6d / Compiler 2020.1.4
    linker IAR_Linker: name=IAR Compiler, options=--map filename --config linkerfile --cpu=Cortex-M4 --cpu=Cortex-M0+ --fpu=FPv4-SP --fpu=none --entry _start --enable_stack_usage --skip_dynamic_initialization --no_wrap_diagnostics, vendor=IAR Systems, version=IAR ANSI C/C++ Compiler V8.40.3.228/W32 for ARM Functional Safety
    resource consumption ResourceConsumption
      7 x memory section:
        I2S_CODE: alignment=UNSPECIFIED, sw-addrmethod=CODE, symbol=CODE
        I2S_CONFIG_DATA_UNSPECIFIED: alignment=UNSPECIFIED, sw-addrmethod=CONFIG_DATA, symbol=CONFIG_DATA_UNSPECIFIED
        I2S_CONST_8: alignment=8, sw-addrmethod=CONST, symbol=CONST_8
        I2S_CONST_UNSPECIFIED: alignment=UNSPECIFIED, sw-addrmethod=CONST, symbol=CONST_UNSPECIFIED
        I2S_VAR_CLEARED_8: alignment=8, sw-addrmethod=VAR_CLEARED, symbol=VAR_CLEARED_8
        I2S_VAR_CLEARED_UNSPECIFIED: alignment=UNSPECIFIED, sw-addrmethod=VAR_CLEARED, symbol=VAR_CLEARED_UNSPECIFIED
        I2S_VAR_INIT_UNSPECIFIED: alignment=UNSPECIFIED, sw-addrmethod=VAR_INIT, symbol=VAR_INIT_UNSPECIFIED
