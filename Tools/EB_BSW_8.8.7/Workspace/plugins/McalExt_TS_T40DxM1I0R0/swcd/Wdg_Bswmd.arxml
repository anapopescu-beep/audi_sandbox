AUTOSAR XML (schema 00046)
package /AUTOSAR_Wdg/BswModuleDescriptions
  bsw module description Wdg: module-id=102
    provided-entrys:
      Wdg_43_Instance0_GetVersionInfo
      Wdg_43_Instance0_Init
      Wdg_43_Instance0_Service
      Wdg_43_Instance0_SetMode
      Wdg_43_Instance0_SetTriggerCondition
      Wdg_43_Instance1_GetVersionInfo
      Wdg_43_Instance1_Init
      Wdg_43_Instance1_Service
      Wdg_43_Instance1_SetMode
      Wdg_43_Instance1_SetTriggerCondition
      Wdg_Cbk_GptNotification0
      Wdg_Cbk_GptNotification1
      Ewm_Ip_Isr
      Wdg_Ipw_Isr
      Wdog_Ip_Isr
    bsw internal behavior InternalBehavior_0
      8 x exclusive area:
        WDG_EXCLUSIVE_AREA_{00..07}
      12 x bsw called entity:
        Wdg_43_Instance0_GetVersionInfo: implemented-entry=Wdg_43_Instance0_GetVersionInfo
        Wdg_43_Instance0_Init: can-enter-exclusive-area=[WDG_EXCLUSIVE_AREA_01, WDG_EXCLUSIVE_AREA_02, WDG_EXCLUSIVE_AREA_06, WDG_EXCLUSIVE_AREA_07], implemented-entry=Wdg_43_Instance0_Init
        Wdg_43_Instance0_Service: implemented-entry=Wdg_43_Instance0_Service
        Wdg_43_Instance0_SetMode: can-enter-exclusive-area=[WDG_EXCLUSIVE_AREA_03, WDG_EXCLUSIVE_AREA_04, WDG_EXCLUSIVE_AREA_06, WDG_EXCLUSIVE_AREA_07], implemented-entry=Wdg_43_Instance0_SetMode
        Wdg_43_Instance0_SetTriggerCondition: can-enter-exclusive-area=WDG_EXCLUSIVE_AREA_05, implemented-entry=Wdg_43_Instance0_SetTriggerCondition
        Wdg_43_Instance1_GetVersionInfo: implemented-entry=Wdg_43_Instance1_GetVersionInfo
        Wdg_43_Instance1_Init: can-enter-exclusive-area=[WDG_EXCLUSIVE_AREA_01, WDG_EXCLUSIVE_AREA_02, WDG_EXCLUSIVE_AREA_06, WDG_EXCLUSIVE_AREA_07], implemented-entry=Wdg_43_Instance1_Init
        Wdg_43_Instance1_Service: implemented-entry=Wdg_43_Instance1_Service
        Wdg_43_Instance1_SetMode: can-enter-exclusive-area=[WDG_EXCLUSIVE_AREA_03, WDG_EXCLUSIVE_AREA_04, WDG_EXCLUSIVE_AREA_06, WDG_EXCLUSIVE_AREA_07], implemented-entry=Wdg_43_Instance1_SetMode
        Wdg_43_Instance1_SetTriggerCondition: can-enter-exclusive-area=WDG_EXCLUSIVE_AREA_05, implemented-entry=Wdg_43_Instance1_SetTriggerCondition
        Wdg_Cbk_GptNotification0: can-enter-exclusive-area=WDG_EXCLUSIVE_AREA_00, implemented-entry=Wdg_Cbk_GptNotification0
        Wdg_Cbk_GptNotification1: can-enter-exclusive-area=WDG_EXCLUSIVE_AREA_00, implemented-entry=Wdg_Cbk_GptNotification1
      bsw interrupt entity Ewm_Ip_Isr: implemented-entry=Ewm_Ip_Isr, interrupt-category=CAT-2, interrupt-source=Hardware
      bsw interrupt entity Wdg_Ipw_Isr: implemented-entry=Wdg_Ipw_Isr, interrupt-category=CAT-2, interrupt-source=Hardware
      bsw interrupt entity Wdog_Ip_Isr: implemented-entry=Wdog_Ip_Isr, interrupt-category=CAT-2, interrupt-source=Hardware
package /AUTOSAR_Wdg/BswModuleEntrys
  15 x bsw module entry, all with is-synchronous=true, sw-service-impl-policy=STANDARD:
    Wdg_43_Instance0_GetVersionInfo: service-id=0x04, is-reentrant=true, call-type=REGULAR, execution-context=UNSPECIFIED
    Wdg_43_Instance0_Init: service-id=0x00, is-reentrant=false, call-type=REGULAR, execution-context=UNSPECIFIED
    Wdg_43_Instance0_Service: service-id=0x05, is-reentrant=false, call-type=REGULAR, execution-context=UNSPECIFIED
    Wdg_43_Instance0_SetMode: service-id=0x01, is-reentrant=false, call-type=REGULAR, execution-context=UNSPECIFIED
    Wdg_43_Instance0_SetTriggerCondition: service-id=0x03, is-reentrant=false, call-type=REGULAR, execution-context=UNSPECIFIED
    Wdg_43_Instance1_GetVersionInfo: service-id=0x04, is-reentrant=true, call-type=REGULAR, execution-context=UNSPECIFIED
    Wdg_43_Instance1_Init: service-id=0x00, is-reentrant=false, call-type=REGULAR, execution-context=UNSPECIFIED
    Wdg_43_Instance1_Service: service-id=0x05, is-reentrant=false, call-type=REGULAR, execution-context=UNSPECIFIED
    Wdg_43_Instance1_SetMode: service-id=0x01, is-reentrant=false, call-type=REGULAR, execution-context=UNSPECIFIED
    Wdg_43_Instance1_SetTriggerCondition: service-id=0x03, is-reentrant=false, call-type=REGULAR, execution-context=UNSPECIFIED
    Wdg_Cbk_GptNotification0: service-id=0x07, is-reentrant=false, call-type=REGULAR, execution-context=UNSPECIFIED
    Wdg_Cbk_GptNotification1: service-id=0x07, is-reentrant=false, call-type=REGULAR, execution-context=UNSPECIFIED
    Ewm_Ip_Isr: service-id=0, is-reentrant=false, call-type=INTERRUPT, execution-context=INTERRUPT-CAT-2
    Wdg_Ipw_Isr: service-id=0, is-reentrant=false, call-type=INTERRUPT, execution-context=INTERRUPT-CAT-2
    Wdog_Ip_Isr: service-id=0, is-reentrant=false, call-type=INTERRUPT, execution-context=INTERRUPT-CAT-2
package /Wdg_TS_T40D2M10I1R0/Implementations
  bsw implementation BswImplementation_0: programming-language=C, sw-version=1.0.1, vendor-id=43, ar-release-version=4.4.0, behavior=InternalBehavior_0, vendor-specific-module-def=Wdg
    code-descriptors:
      code Files
        artifact-descriptors:
          short-label=config::Wdg.xdm, category=SWCFG
          short-label=doc::RTD_WDG_IM.pdf, category=SWDOC
          short-label=doc::RTD_WDG_UM.pdf, category=SWDOC
          short-label=examples::EBT::Wdg_example_S32K118::generate::epc::Base.xdm, category=SWCFG
          short-label=examples::EBT::Wdg_example_S32K118::generate::epc::Dem.xdm, category=SWCFG
          short-label=examples::EBT::Wdg_example_S32K118::generate::epc::EcuC.xdm, category=SWCFG
          short-label=examples::EBT::Wdg_example_S32K118::generate::epc::Gpt.xdm, category=SWCFG
          short-label=examples::EBT::Wdg_example_S32K118::generate::epc::Mcu.xdm, category=SWCFG
          short-label=examples::EBT::Wdg_example_S32K118::generate::epc::Platform.xdm, category=SWCFG
          short-label=examples::EBT::Wdg_example_S32K118::generate::epc::Resource.xdm, category=SWCFG
          short-label=examples::EBT::Wdg_example_S32K118::generate::epc::Wdg.xdm, category=SWCFG
          short-label=examples::EBT::Wdg_example_S32K118::include::check_example.h, category=SWHDR
          short-label=examples::EBT::Wdg_example_S32K118::src::main.c, category=SWSRC
          short-label=examples::EBT::Wdg_example_S32K118::TresosProject::Wdg_example_S32K118::.prefs::preferences.xdm, category=SWCFG
          short-label=examples::EBT::Wdg_example_S32K118::TresosProject::Wdg_example_S32K118::config::Base.xdm, category=SWCFG
          short-label=examples::EBT::Wdg_example_S32K118::TresosProject::Wdg_example_S32K118::config::Dem.xdm, category=SWCFG
          short-label=examples::EBT::Wdg_example_S32K118::TresosProject::Wdg_example_S32K118::config::EcuC.xdm, category=SWCFG
          short-label=examples::EBT::Wdg_example_S32K118::TresosProject::Wdg_example_S32K118::config::Gpt.xdm, category=SWCFG
          short-label=examples::EBT::Wdg_example_S32K118::TresosProject::Wdg_example_S32K118::config::Mcu.xdm, category=SWCFG
          short-label=examples::EBT::Wdg_example_S32K118::TresosProject::Wdg_example_S32K118::config::Platform.xdm, category=SWCFG
          short-label=examples::EBT::Wdg_example_S32K118::TresosProject::Wdg_example_S32K118::config::Resource.xdm, category=SWCFG
          short-label=examples::EBT::Wdg_example_S32K118::TresosProject::Wdg_example_S32K118::config::Wdg.xdm, category=SWCFG
          short-label=examples::EBT::Wdg_example_S32K144::generate::epc::Base.xdm, category=SWCFG
          short-label=examples::EBT::Wdg_example_S32K144::generate::epc::Dem.xdm, category=SWCFG
          short-label=examples::EBT::Wdg_example_S32K144::generate::epc::EcuC.xdm, category=SWCFG
          short-label=examples::EBT::Wdg_example_S32K144::generate::epc::Gpt.xdm, category=SWCFG
          short-label=examples::EBT::Wdg_example_S32K144::generate::epc::Mcu.xdm, category=SWCFG
          short-label=examples::EBT::Wdg_example_S32K144::generate::epc::Platform.xdm, category=SWCFG
          short-label=examples::EBT::Wdg_example_S32K144::generate::epc::Resource.xdm, category=SWCFG
          short-label=examples::EBT::Wdg_example_S32K144::generate::epc::Wdg.xdm, category=SWCFG
          short-label=examples::EBT::Wdg_example_S32K144::generate::epc::Wdg_43_Instance1.xdm, category=SWCFG
          short-label=examples::EBT::Wdg_example_S32K144::include::check_example.h, category=SWHDR
          short-label=examples::EBT::Wdg_example_S32K144::src::main.c, category=SWSRC
          short-label=examples::EBT::Wdg_example_S32K144::TresosProject::Wdg_example_S32K144::.prefs::preferences.xdm, category=SWCFG
          short-label=examples::EBT::Wdg_example_S32K144::TresosProject::Wdg_example_S32K144::config::Base.xdm, category=SWCFG
          short-label=examples::EBT::Wdg_example_S32K144::TresosProject::Wdg_example_S32K144::config::Dem.xdm, category=SWCFG
          short-label=examples::EBT::Wdg_example_S32K144::TresosProject::Wdg_example_S32K144::config::EcuC.xdm, category=SWCFG
          short-label=examples::EBT::Wdg_example_S32K144::TresosProject::Wdg_example_S32K144::config::Gpt.xdm, category=SWCFG
          short-label=examples::EBT::Wdg_example_S32K144::TresosProject::Wdg_example_S32K144::config::Mcu.xdm, category=SWCFG
          short-label=examples::EBT::Wdg_example_S32K144::TresosProject::Wdg_example_S32K144::config::Platform.xdm, category=SWCFG
          short-label=examples::EBT::Wdg_example_S32K144::TresosProject::Wdg_example_S32K144::config::Resource.xdm, category=SWCFG
          short-label=examples::EBT::Wdg_example_S32K144::TresosProject::Wdg_example_S32K144::config::Wdg.xdm, category=SWCFG
          short-label=examples::EBT::Wdg_example_S32K144::TresosProject::Wdg_example_S32K144::config::Wdg_43_Instance1.xdm, category=SWCFG
          short-label=examples::EBT::Wdg_example_S32K144W::generate::epc::Base.xdm, category=SWCFG
          short-label=examples::EBT::Wdg_example_S32K144W::generate::epc::Dem.xdm, category=SWCFG
          short-label=examples::EBT::Wdg_example_S32K144W::generate::epc::EcuC.xdm, category=SWCFG
          short-label=examples::EBT::Wdg_example_S32K144W::generate::epc::Gpt.xdm, category=SWCFG
          short-label=examples::EBT::Wdg_example_S32K144W::generate::epc::Mcu.xdm, category=SWCFG
          short-label=examples::EBT::Wdg_example_S32K144W::generate::epc::Platform.xdm, category=SWCFG
          short-label=examples::EBT::Wdg_example_S32K144W::generate::epc::Resource.xdm, category=SWCFG
          short-label=examples::EBT::Wdg_example_S32K144W::generate::epc::Wdg.xdm, category=SWCFG
          short-label=examples::EBT::Wdg_example_S32K144W::generate::epc::Wdg_43_Instance1.xdm, category=SWCFG
          short-label=examples::EBT::Wdg_example_S32K144W::include::check_example.h, category=SWHDR
          short-label=examples::EBT::Wdg_example_S32K144W::src::main.c, category=SWSRC
          short-label=examples::EBT::Wdg_example_S32K144W::TresosProject::Wdg_example_S32K144W::.prefs::preferences.xdm, category=SWCFG
          short-label=examples::EBT::Wdg_example_S32K144W::TresosProject::Wdg_example_S32K144W::config::Base.xdm, category=SWCFG
          short-label=examples::EBT::Wdg_example_S32K144W::TresosProject::Wdg_example_S32K144W::config::Dem.xdm, category=SWCFG
          short-label=examples::EBT::Wdg_example_S32K144W::TresosProject::Wdg_example_S32K144W::config::EcuC.xdm, category=SWCFG
          short-label=examples::EBT::Wdg_example_S32K144W::TresosProject::Wdg_example_S32K144W::config::Gpt.xdm, category=SWCFG
          short-label=examples::EBT::Wdg_example_S32K144W::TresosProject::Wdg_example_S32K144W::config::Mcu.xdm, category=SWCFG
          short-label=examples::EBT::Wdg_example_S32K144W::TresosProject::Wdg_example_S32K144W::config::Platform.xdm, category=SWCFG
          short-label=examples::EBT::Wdg_example_S32K144W::TresosProject::Wdg_example_S32K144W::config::Resource.xdm, category=SWCFG
          short-label=examples::EBT::Wdg_example_S32K144W::TresosProject::Wdg_example_S32K144W::config::Wdg.xdm, category=SWCFG
          short-label=examples::EBT::Wdg_example_S32K144W::TresosProject::Wdg_example_S32K144W::config::Wdg_43_Instance1.xdm, category=SWCFG
          short-label=examples::EBT::Wdg_example_S32K148::generate::epc::Base.xdm, category=SWCFG
          short-label=examples::EBT::Wdg_example_S32K148::generate::epc::Dem.xdm, category=SWCFG
          short-label=examples::EBT::Wdg_example_S32K148::generate::epc::EcuC.xdm, category=SWCFG
          short-label=examples::EBT::Wdg_example_S32K148::generate::epc::Gpt.xdm, category=SWCFG
          short-label=examples::EBT::Wdg_example_S32K148::generate::epc::Mcu.xdm, category=SWCFG
          short-label=examples::EBT::Wdg_example_S32K148::generate::epc::Platform.xdm, category=SWCFG
          short-label=examples::EBT::Wdg_example_S32K148::generate::epc::Resource.xdm, category=SWCFG
          short-label=examples::EBT::Wdg_example_S32K148::generate::epc::Wdg.xdm, category=SWCFG
          short-label=examples::EBT::Wdg_example_S32K148::generate::epc::Wdg_43_Instance1.xdm, category=SWCFG
          short-label=examples::EBT::Wdg_example_S32K148::include::check_example.h, category=SWHDR
          short-label=examples::EBT::Wdg_example_S32K148::src::main.c, category=SWSRC
          short-label=examples::EBT::Wdg_example_S32K148::TresosProject::Wdg_example_S32K148::.prefs::preferences.xdm, category=SWCFG
          short-label=examples::EBT::Wdg_example_S32K148::TresosProject::Wdg_example_S32K148::config::Base.xdm, category=SWCFG
          short-label=examples::EBT::Wdg_example_S32K148::TresosProject::Wdg_example_S32K148::config::Dem.xdm, category=SWCFG
          short-label=examples::EBT::Wdg_example_S32K148::TresosProject::Wdg_example_S32K148::config::EcuC.xdm, category=SWCFG
          short-label=examples::EBT::Wdg_example_S32K148::TresosProject::Wdg_example_S32K148::config::Gpt.xdm, category=SWCFG
          short-label=examples::EBT::Wdg_example_S32K148::TresosProject::Wdg_example_S32K148::config::Mcu.xdm, category=SWCFG
          short-label=examples::EBT::Wdg_example_S32K148::TresosProject::Wdg_example_S32K148::config::Platform.xdm, category=SWCFG
          short-label=examples::EBT::Wdg_example_S32K148::TresosProject::Wdg_example_S32K148::config::Resource.xdm, category=SWCFG
          short-label=examples::EBT::Wdg_example_S32K148::TresosProject::Wdg_example_S32K148::config::Wdg.xdm, category=SWCFG
          short-label=examples::EBT::Wdg_example_S32K148::TresosProject::Wdg_example_S32K148::config::Wdg_43_Instance1.xdm, category=SWCFG
          short-label=examples::S32DS::Ewm_Ip_Example_S32K144::include::check_example.h, category=SWHDR
          short-label=examples::S32DS::Ewm_Ip_Example_S32K144::Project_Settings::Startup_Code::exceptions.c, category=SWSRC
          short-label=examples::S32DS::Ewm_Ip_Example_S32K144::Project_Settings::Startup_Code::nvic.c, category=SWSRC
          short-label=examples::S32DS::Ewm_Ip_Example_S32K144::Project_Settings::Startup_Code::startup.c, category=SWSRC
          short-label=examples::S32DS::Ewm_Ip_Example_S32K144::Project_Settings::Startup_Code::system.c, category=SWSRC
          short-label=examples::S32DS::Ewm_Ip_Example_S32K144::src::main.c, category=SWSRC
          short-label=examples::S32DS::Ewm_Ip_Example_S32K144W::include::check_example.h, category=SWHDR
          short-label=examples::S32DS::Ewm_Ip_Example_S32K144W::Project_Settings::Startup_Code::exceptions.c, category=SWSRC
          short-label=examples::S32DS::Ewm_Ip_Example_S32K144W::Project_Settings::Startup_Code::nvic.c, category=SWSRC
          short-label=examples::S32DS::Ewm_Ip_Example_S32K144W::Project_Settings::Startup_Code::startup.c, category=SWSRC
          short-label=examples::S32DS::Ewm_Ip_Example_S32K144W::Project_Settings::Startup_Code::system.c, category=SWSRC
          short-label=examples::S32DS::Ewm_Ip_Example_S32K144W::src::main.c, category=SWSRC
          short-label=examples::S32DS::Ewm_Ip_Example_S32K148::include::check_example.h, category=SWHDR
          short-label=examples::S32DS::Ewm_Ip_Example_S32K148::Project_Settings::Startup_Code::exceptions.c, category=SWSRC
          short-label=examples::S32DS::Ewm_Ip_Example_S32K148::Project_Settings::Startup_Code::nvic.c, category=SWSRC
          short-label=examples::S32DS::Ewm_Ip_Example_S32K148::Project_Settings::Startup_Code::startup.c, category=SWSRC
          short-label=examples::S32DS::Ewm_Ip_Example_S32K148::Project_Settings::Startup_Code::system.c, category=SWSRC
          short-label=examples::S32DS::Ewm_Ip_Example_S32K148::src::main.c, category=SWSRC
          short-label=examples::S32DS::Wdg_Example_S32K118::include::check_example.h, category=SWHDR
          short-label=examples::S32DS::Wdg_Example_S32K118::Project_Settings::Startup_Code::exceptions.c, category=SWSRC
          short-label=examples::S32DS::Wdg_Example_S32K118::Project_Settings::Startup_Code::nvic.c, category=SWSRC
          short-label=examples::S32DS::Wdg_Example_S32K118::Project_Settings::Startup_Code::startup.c, category=SWSRC
          short-label=examples::S32DS::Wdg_Example_S32K118::Project_Settings::Startup_Code::system.c, category=SWSRC
          short-label=examples::S32DS::Wdg_Example_S32K118::src::main.c, category=SWSRC
          short-label=examples::S32DS::Wdg_Example_S32K144::include::check_example.h, category=SWHDR
          short-label=examples::S32DS::Wdg_Example_S32K144::Project_Settings::Startup_Code::exceptions.c, category=SWSRC
          short-label=examples::S32DS::Wdg_Example_S32K144::Project_Settings::Startup_Code::nvic.c, category=SWSRC
          short-label=examples::S32DS::Wdg_Example_S32K144::Project_Settings::Startup_Code::startup.c, category=SWSRC
          short-label=examples::S32DS::Wdg_Example_S32K144::Project_Settings::Startup_Code::system.c, category=SWSRC
          short-label=examples::S32DS::Wdg_Example_S32K144::src::main.c, category=SWSRC
          short-label=examples::S32DS::Wdg_Example_S32K144W::include::check_example.h, category=SWHDR
          short-label=examples::S32DS::Wdg_Example_S32K144W::Project_Settings::Startup_Code::exceptions.c, category=SWSRC
          short-label=examples::S32DS::Wdg_Example_S32K144W::Project_Settings::Startup_Code::nvic.c, category=SWSRC
          short-label=examples::S32DS::Wdg_Example_S32K144W::Project_Settings::Startup_Code::startup.c, category=SWSRC
          short-label=examples::S32DS::Wdg_Example_S32K144W::Project_Settings::Startup_Code::system.c, category=SWSRC
          short-label=examples::S32DS::Wdg_Example_S32K144W::src::main.c, category=SWSRC
          short-label=examples::S32DS::Wdg_Example_S32K148::include::check_example.h, category=SWHDR
          short-label=examples::S32DS::Wdg_Example_S32K148::Project_Settings::Startup_Code::exceptions.c, category=SWSRC
          short-label=examples::S32DS::Wdg_Example_S32K148::Project_Settings::Startup_Code::nvic.c, category=SWSRC
          short-label=examples::S32DS::Wdg_Example_S32K148::Project_Settings::Startup_Code::startup.c, category=SWSRC
          short-label=examples::S32DS::Wdg_Example_S32K148::Project_Settings::Startup_Code::system.c, category=SWSRC
          short-label=examples::S32DS::Wdg_Example_S32K148::src::main.c, category=SWSRC
          short-label=examples::S32DS::Wdog_Ip_Example_S32K118::include::check_example.h, category=SWHDR
          short-label=examples::S32DS::Wdog_Ip_Example_S32K118::Project_Settings::Startup_Code::exceptions.c, category=SWSRC
          short-label=examples::S32DS::Wdog_Ip_Example_S32K118::Project_Settings::Startup_Code::nvic.c, category=SWSRC
          short-label=examples::S32DS::Wdog_Ip_Example_S32K118::Project_Settings::Startup_Code::startup.c, category=SWSRC
          short-label=examples::S32DS::Wdog_Ip_Example_S32K118::Project_Settings::Startup_Code::system.c, category=SWSRC
          short-label=examples::S32DS::Wdog_Ip_Example_S32K118::src::main.c, category=SWSRC
          short-label=examples::S32DS::Wdog_Ip_Example_S32K144::include::check_example.h, category=SWHDR
          short-label=examples::S32DS::Wdog_Ip_Example_S32K144::Project_Settings::Startup_Code::exceptions.c, category=SWSRC
          short-label=examples::S32DS::Wdog_Ip_Example_S32K144::Project_Settings::Startup_Code::nvic.c, category=SWSRC
          short-label=examples::S32DS::Wdog_Ip_Example_S32K144::Project_Settings::Startup_Code::startup.c, category=SWSRC
          short-label=examples::S32DS::Wdog_Ip_Example_S32K144::Project_Settings::Startup_Code::system.c, category=SWSRC
          short-label=examples::S32DS::Wdog_Ip_Example_S32K144::src::main.c, category=SWSRC
          short-label=examples::S32DS::Wdog_Ip_Example_S32K144W::include::check_example.h, category=SWHDR
          short-label=examples::S32DS::Wdog_Ip_Example_S32K144W::Project_Settings::Startup_Code::exceptions.c, category=SWSRC
          short-label=examples::S32DS::Wdog_Ip_Example_S32K144W::Project_Settings::Startup_Code::nvic.c, category=SWSRC
          short-label=examples::S32DS::Wdog_Ip_Example_S32K144W::Project_Settings::Startup_Code::startup.c, category=SWSRC
          short-label=examples::S32DS::Wdog_Ip_Example_S32K144W::Project_Settings::Startup_Code::system.c, category=SWSRC
          short-label=examples::S32DS::Wdog_Ip_Example_S32K144W::src::main.c, category=SWSRC
          short-label=examples::S32DS::Wdog_Ip_Example_S32K148::include::check_example.h, category=SWHDR
          short-label=examples::S32DS::Wdog_Ip_Example_S32K148::Project_Settings::Startup_Code::exceptions.c, category=SWSRC
          short-label=examples::S32DS::Wdog_Ip_Example_S32K148::Project_Settings::Startup_Code::nvic.c, category=SWSRC
          short-label=examples::S32DS::Wdog_Ip_Example_S32K148::Project_Settings::Startup_Code::startup.c, category=SWSRC
          short-label=examples::S32DS::Wdog_Ip_Example_S32K148::Project_Settings::Startup_Code::system.c, category=SWSRC
          short-label=examples::S32DS::Wdog_Ip_Example_S32K148::src::main.c, category=SWSRC
          short-label=include::Ewm_Ip.h, category=SWHDR
          short-label=include::Ewm_Ip_Types.h, category=SWHDR
          short-label=include::Wdg_43_Instance0.h, category=SWHDR
          short-label=include::Wdg_43_Instance1.h, category=SWHDR
          short-label=include::Wdg_Channel.h, category=SWHDR
          short-label=include::Wdg_ChannelTypes.h, category=SWHDR
          short-label=include::Wdg_EnvCfg.h, category=SWHDR
          short-label=include::Wdg_Ipw.h, category=SWHDR
          short-label=include::Wdg_Ipw_Types.h, category=SWHDR
          short-label=include::Wdog_Ip.h, category=SWHDR
          short-label=include::Wdog_Ip_Types.h, category=SWHDR
          short-label=src::Ewm_Ip.c, category=SWSRC
          short-label=src::Ewm_Ip_Irq.c, category=SWSRC
          short-label=src::Wdg_43_Instance0.c, category=SWSRC
          short-label=src::Wdg_43_Instance1.c, category=SWSRC
          short-label=src::Wdg_Channel.c, category=SWSRC
          short-label=src::Wdg_Ipw.c, category=SWSRC
          short-label=src::Wdg_Ipw_Irq.c, category=SWSRC
          short-label=src::Wdog_Ip.c, category=SWSRC
          short-label=src::Wdog_Ip_Irq.c, category=SWSRC
    compiler GCC_Compiler:
      name=GCC Compiler
      options=-mcpu=cortex-m4 -mcpu=cortex-m0plus -mthumb -mlittle-endian -mfpu=fpv4-sp-d16 -mfloat-abi=hard -mfpu=auto -mfloat-abi=soft -std=c99 -Os -ggdb3 -Wall -Wextra -pedantic -Wstrict-prototypes -Wundef -Wunused -Werror=implicit-function-declaration -Wsign-compare -Wdouble-promotion -fno-short-enums -funsigned-char -funsigned-bitfields -fomit-frame-pointer -fno-common -fstack-usage -fdump-ipa-all -c -DS32K1XX -DS32K148 -DGCC -DUSE_SW_VECTOR_MODE -DI_CACHE_ENABLE -DENABLE_FPU -DMCAL_ENABLE_USER_MODE_SUPPORT
      vendor=GCC Systems
      version=NXP GCC 9.2.0 20190812 (Build 1649 Revision gaf57174)
    compiler GHS_Compiler:
      name=Green Hills
      options=-cpu=cortexm4 -cpu=cortexm0plus -thumb -fpu=vfpv4_d16 -fsingle -fsoft -C99 --ghstd=last -Osize --gnu_asm -dual_debug -G -keeptempfiles -Wimplicit-int -Wshadow -Wtrigraphs -Wundef --unsigned_chars --unsigned_fields --no_commons --no_exceptions --no_slash_comment --prototype_errors --incorrect_pragma_warnings -c -DS32K1XX -DS32K148 -DGHS -DUSE_SW_VECTOR_MODE -DI_CACHE_ENABLE -DENABLE_FPU -DMCAL_ENABLE_USER_MODE_SUPPORT
      vendor=Green Hills
      version=Green Hills Multi 7.1.6d / Compiler 2020.1.4
    compiler IAR_Compiler:
      name=IAR Compiler
      options=--cpu=Cortex-M4 --cpu=Cortex-M0+ --cpu_mode=thumb --endian=little --fpu=FPv4-SP --fpu=none -e -Ohz --debug --no_clustering --no_mem_idioms --no_explicit_zero_opt --require_prototypes --no_wrap_diagnostics --diag_suppress=Pa050 -DS32K1XX -DS32K148 -DIAR -DUSE_SW_VECTOR_MODE -DI_CACHE_ENABLE -DENABLE_FPU -DMCAL_ENABLE_USER_MODE_SUPPORT
      vendor=IAR Systems
      version=IAR ANSI C/C++ Compiler V8.40.3.228/W32 for ARM Functional Safety
    generated-artifacts:
      33 x dependency on artifact:
        Ewm_Ip_Cfg_Defines_h: artifact-descriptor={short-label=generate::include::Ewm_Ip_Cfg_Defines.h, category=SWHDR}, usages=COMPILE
        Ewm_Ip_DeviceRegisters_h: artifact-descriptor={short-label=generate::include::Ewm_Ip_DeviceRegisters.h, category=SWHDR}, usages=COMPILE
        Wdg_Cfg_h: artifact-descriptor={short-label=generate::include::Wdg_Cfg.h, category=SWHDR}, usages=COMPILE
        Wdg_CfgExt_h: artifact-descriptor={short-label=generate::include::Wdg_CfgExt.h, category=SWHDR}, usages=COMPILE
        Wdg_Cfg_Defines_h: artifact-descriptor={short-label=generate::include::Wdg_Cfg_Defines.h, category=SWHDR}, usages=COMPILE
        Wdg_Ipw_Cfg_Defines_h: artifact-descriptor={short-label=generate::include::Wdg_Ipw_Cfg_Defines.h, category=SWHDR}, usages=COMPILE
        Wdog_Ip_Cfg_Defines_h: artifact-descriptor={short-label=generate::include::Wdog_Ip_Cfg_Defines.h, category=SWHDR}, usages=COMPILE
        Wdog_Ip_DeviceRegisters_h: artifact-descriptor={short-label=generate::include::Wdog_Ip_DeviceRegisters.h, category=SWHDR}, usages=COMPILE
        Wdg_CfgExt_c: artifact-descriptor={short-label=generate::src::Wdg_CfgExt.c, category=SWSRC}, usages=COMPILE
        Ewm_Ip_PBcfg_h: artifact-descriptor={short-label=generate_LT::include::Ewm_Ip_PBcfg.h, category=SWHDR}, usages=LINK
        Wdog_Ip_PBcfg_h: artifact-descriptor={short-label=generate_LT::include::Wdog_Ip_PBcfg.h, category=SWHDR}, usages=LINK
        Ewm_Ip_PBcfg_c: artifact-descriptor={short-label=generate_LT::src::Ewm_Ip_PBcfg.c, category=SWSRC}, usages=LINK
        Wdg_43_Instance0_Lcfg_c: artifact-descriptor={short-label=generate_LT::src::Wdg_43_Instance0_Lcfg.c, category=SWSRC}, usages=LINK
        Wdg_43_Instance1_Lcfg_c: artifact-descriptor={short-label=generate_LT::src::Wdg_43_Instance1_Lcfg.c, category=SWSRC}, usages=LINK
        Wdog_Ip_PBcfg_c: artifact-descriptor={short-label=generate_LT::src::Wdog_Ip_PBcfg.c, category=SWSRC}, usages=LINK
        Ewm_Ip_PBcfg_h: artifact-descriptor={short-label=generate_PB::include::Ewm_Ip_PBcfg.h, category=SWHDR}, usages=EXECUTE
        Wdg_43_Instance0_Ipw_PBcfg_h: artifact-descriptor={short-label=generate_PB::include::Wdg_43_Instance0_Ipw_PBcfg.h, category=SWHDR}, usages=EXECUTE
        Wdg_43_Instance0_PBcfg_h: artifact-descriptor={short-label=generate_PB::include::Wdg_43_Instance0_PBcfg.h, category=SWHDR}, usages=EXECUTE
        Wdg_43_Instance1_Ipw_PBcfg_h: artifact-descriptor={short-label=generate_PB::include::Wdg_43_Instance1_Ipw_PBcfg.h, category=SWHDR}, usages=EXECUTE
        Wdg_43_Instance1_PBcfg_h: artifact-descriptor={short-label=generate_PB::include::Wdg_43_Instance1_PBcfg.h, category=SWHDR}, usages=EXECUTE
        Wdog_Ip_PBcfg_h: artifact-descriptor={short-label=generate_PB::include::Wdog_Ip_PBcfg.h, category=SWHDR}, usages=EXECUTE
        Ewm_Ip_PBcfg_c: artifact-descriptor={short-label=generate_PB::src::Ewm_Ip_PBcfg.c, category=SWSRC}, usages=EXECUTE
        Wdg_43_Instance0_Ipw_PBcfg_c: artifact-descriptor={short-label=generate_PB::src::Wdg_43_Instance0_Ipw_PBcfg.c, category=SWSRC}, usages=EXECUTE
        Wdg_43_Instance0_PBcfg_c: artifact-descriptor={short-label=generate_PB::src::Wdg_43_Instance0_PBcfg.c, category=SWSRC}, usages=EXECUTE
        Wdg_43_Instance1_Ipw_PBcfg_c: artifact-descriptor={short-label=generate_PB::src::Wdg_43_Instance1_Ipw_PBcfg.c, category=SWSRC}, usages=EXECUTE
        Wdg_43_Instance1_PBcfg_c: artifact-descriptor={short-label=generate_PB::src::Wdg_43_Instance1_PBcfg.c, category=SWSRC}, usages=EXECUTE
        Wdog_Ip_PBcfg_c: artifact-descriptor={short-label=generate_PB::src::Wdog_Ip_PBcfg.c, category=SWSRC}, usages=EXECUTE
        Ewm_Ip_PBcfg_h: artifact-descriptor={short-label=generate_PC::include::Ewm_Ip_PBcfg.h, category=SWHDR}, usages=COMPILE
        Wdog_Ip_PBcfg_h: artifact-descriptor={short-label=generate_PC::include::Wdog_Ip_PBcfg.h, category=SWHDR}, usages=COMPILE
        Ewm_Ip_PBcfg_c: artifact-descriptor={short-label=generate_PC::src::Ewm_Ip_PBcfg.c, category=SWSRC}, usages=COMPILE
        Wdg_43_Instance0_Cfg_c: artifact-descriptor={short-label=generate_PC::src::Wdg_43_Instance0_Cfg.c, category=SWSRC}, usages=COMPILE
        Wdg_43_Instance1_Cfg_c: artifact-descriptor={short-label=generate_PC::src::Wdg_43_Instance1_Cfg.c, category=SWSRC}, usages=COMPILE
        Wdog_Ip_PBcfg_c: artifact-descriptor={short-label=generate_PC::src::Wdog_Ip_PBcfg.c, category=SWSRC}, usages=COMPILE
    linker GCC_Linker: name=GCC Compiler, options=-Wl,-Map,filename -T linkerfile --entry=Reset_Handler -nostartfiles -mcpu=cortex-m4 -mcpu=cortex-m0plus -mthumb -mfpu=fpv4-sp-d16 -mfloat-abi=hard -mfpu=auto -mfloat-abi=soft -mlittle-endian -ggdb3 -lc -lm -lgcc -n, vendor=GCC Systems, version=NXP GCC 9.2.0 20190812 (Build 1649 Revision gaf57174)
    linker GHS_Linker: name=Green Hills, options=-e Reset_Handler -T linker_script_file.ld -map -keepmap -Mn -delete -ignore_debug_references -Llibrary_path -larch -lstartup -lind_sd -lind_sf -v -keep=C40_Ip_AccessCode -nostartfiles, vendor=Green Hills, version=Green Hills Multi 7.1.6d / Compiler 2020.1.4
    linker IAR_Linker: name=IAR Compiler, options=--map filename --config linkerfile --cpu=Cortex-M4 --cpu=Cortex-M0+ --fpu=FPv4-SP --fpu=none --entry _start --enable_stack_usage --skip_dynamic_initialization --no_wrap_diagnostics, vendor=IAR Systems, version=IAR ANSI C/C++ Compiler V8.40.3.228/W32 for ARM Functional Safety
    resource consumption ResourceConsumption
      9 x memory section:
        WDG_CODE: alignment=UNSPECIFIED, sw-addrmethod=CODE, symbol=CODE
        WDG_CONFIG_DATA_16: alignment=16, sw-addrmethod=CONFIG_DATA, symbol=CONFIG_DATA_16
        WDG_CONFIG_DATA_32: alignment=32, sw-addrmethod=CONFIG_DATA, symbol=CONFIG_DATA_32
        WDG_CONFIG_DATA_UNSPECIFIED: alignment=UNSPECIFIED, sw-addrmethod=CONFIG_DATA, symbol=CONFIG_DATA_UNSPECIFIED
        WDG_CONST_UNSPECIFIED: alignment=UNSPECIFIED, sw-addrmethod=CONST, symbol=CONST_UNSPECIFIED
        WDG_RAMCODE: alignment=UNSPECIFIED, sw-addrmethod=RAMCODE, symbol=RAMCODE
        WDG_VAR_CLEARED_32: alignment=32, sw-addrmethod=VAR_CLEARED, symbol=VAR_CLEARED_32
        WDG_VAR_CLEARED_UNSPECIFIED: alignment=UNSPECIFIED, sw-addrmethod=VAR_CLEARED, symbol=VAR_CLEARED_UNSPECIFIED
        WDG_VAR_INIT_UNSPECIFIED: alignment=UNSPECIFIED, sw-addrmethod=VAR_INIT, symbol=VAR_INIT_UNSPECIFIED
