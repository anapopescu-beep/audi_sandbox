<?xml version="1.0" encoding="ISO-8859-1"?>
[!AUTOSPACING!][!//
<AUTOSAR xmlns="http://autosar.org/schema/r4.0"
  xmlns:xsi="http://www.w3.org/2001/XMLSchema-instance"
  xsi:schemaLocation="http://autosar.org/schema/r4.0 AUTOSAR_4-2-1_STRICT_COMPACT.xsd">
[!INCLUDE "Nm_Functions.m"!][!//  
[!CALL "SetupSynchronizedPncShutdownVariables"!]
  <AR-PACKAGES>
    <AR-PACKAGE>
      <SHORT-NAME>AUTOSAR_Nm</SHORT-NAME>
      <AR-PACKAGES>
        <AR-PACKAGE>
          <SHORT-NAME>BswModuleDescriptions</SHORT-NAME>
          <ELEMENTS>
            <BSW-MODULE-DESCRIPTION>
              <SHORT-NAME>Nm</SHORT-NAME>
              <MODULE-ID>29</MODULE-ID>
              <PROVIDED-ENTRYS>


                <BSW-MODULE-ENTRY-REF-CONDITIONAL>
                  <BSW-MODULE-ENTRY-REF DEST="BSW-MODULE-ENTRY">/AUTOSAR_Nm/BswModuleEntrys/Nm_MainFunction</BSW-MODULE-ENTRY-REF>
                </BSW-MODULE-ENTRY-REF-CONDITIONAL>
[!IF "NmGlobalConfig/NmGlobalFeatures/NmMultiCoreSupport = 'true'"!][!//
                <BSW-MODULE-ENTRY-REF-CONDITIONAL>
                  <BSW-MODULE-ENTRY-REF DEST="BSW-MODULE-ENTRY">/AUTOSAR_Nm/BswModuleEntrys/Nm_Dummy_ComMContext</BSW-MODULE-ENTRY-REF>
                </BSW-MODULE-ENTRY-REF-CONDITIONAL>
  [!IF "as:modconf('Nm')[1]/NmGlobalConfig/NmGlobalFeatures/NmCarWakeUpRxEnabled = 'true'"!][!//
                <BSW-MODULE-ENTRY-REF-CONDITIONAL>
                  <BSW-MODULE-ENTRY-REF DEST="BSW-MODULE-ENTRY">/AUTOSAR_Nm/BswModuleEntrys/Nm_CarWakeUpIndication</BSW-MODULE-ENTRY-REF>
                </BSW-MODULE-ENTRY-REF-CONDITIONAL>
  [!ENDIF!][!//
                <BSW-MODULE-ENTRY-REF-CONDITIONAL>
                  <BSW-MODULE-ENTRY-REF DEST="BSW-MODULE-ENTRY">/AUTOSAR_Nm/BswModuleEntrys/Nm_TxTimeoutException</BSW-MODULE-ENTRY-REF>
                </BSW-MODULE-ENTRY-REF-CONDITIONAL>
  [!IF "as:modconf('Nm')[1]/NmGlobalConfig/NmGlobalFeatures/NmCoordinatorSupportEnabled = 'true'"!][!//
                <BSW-MODULE-ENTRY-REF-CONDITIONAL>
                  <BSW-MODULE-ENTRY-REF DEST="BSW-MODULE-ENTRY">/AUTOSAR_Nm/BswModuleEntrys/Nm_SynchronizationPoint</BSW-MODULE-ENTRY-REF>
                </BSW-MODULE-ENTRY-REF-CONDITIONAL>
  [!ENDIF!][!//
  [!IF "(as:modconf('Nm')[1]/NmGlobalConfig/NmGlobalFeatures/NmCoordinatorSupportEnabled = 'true') or (as:modconf('Nm')[1]/NmGlobalConfig/NmGlobalFeatures/NmProvideRemoteSleepCallbacks = 'true')"!][!//
                <BSW-MODULE-ENTRY-REF-CONDITIONAL>
                  <BSW-MODULE-ENTRY-REF DEST="BSW-MODULE-ENTRY">/AUTOSAR_Nm/BswModuleEntrys/Nm_RemoteSleepCancellation</BSW-MODULE-ENTRY-REF>
                </BSW-MODULE-ENTRY-REF-CONDITIONAL>
                <BSW-MODULE-ENTRY-REF-CONDITIONAL>
                  <BSW-MODULE-ENTRY-REF DEST="BSW-MODULE-ENTRY">/AUTOSAR_Nm/BswModuleEntrys/Nm_RemoteSleepIndication</BSW-MODULE-ENTRY-REF>
                </BSW-MODULE-ENTRY-REF-CONDITIONAL>
  [!ENDIF!][!//
                <BSW-MODULE-ENTRY-REF-CONDITIONAL>
                  <BSW-MODULE-ENTRY-REF DEST="BSW-MODULE-ENTRY">/AUTOSAR_Nm/BswModuleEntrys/Nm_PrepareBusSleepMode</BSW-MODULE-ENTRY-REF>
                </BSW-MODULE-ENTRY-REF-CONDITIONAL>
                <BSW-MODULE-ENTRY-REF-CONDITIONAL>
                  <BSW-MODULE-ENTRY-REF DEST="BSW-MODULE-ENTRY">/AUTOSAR_Nm/BswModuleEntrys/Nm_BusSleepMode</BSW-MODULE-ENTRY-REF>
                </BSW-MODULE-ENTRY-REF-CONDITIONAL>
                <BSW-MODULE-ENTRY-REF-CONDITIONAL>
                  <BSW-MODULE-ENTRY-REF DEST="BSW-MODULE-ENTRY">/AUTOSAR_Nm/BswModuleEntrys/Nm_NetworkMode</BSW-MODULE-ENTRY-REF>
                </BSW-MODULE-ENTRY-REF-CONDITIONAL>
                <BSW-MODULE-ENTRY-REF-CONDITIONAL>
                  <BSW-MODULE-ENTRY-REF DEST="BSW-MODULE-ENTRY">/AUTOSAR_Nm/BswModuleEntrys/Nm_NetworkStartIndication</BSW-MODULE-ENTRY-REF>
                </BSW-MODULE-ENTRY-REF-CONDITIONAL>
  [!IF "count(as:modconf('Nm')[1]/NmChannelConfig/*[NmRepeatMsgIndEnabled = 'true']) > 0"!][!//
                <BSW-MODULE-ENTRY-REF-CONDITIONAL>
                  <BSW-MODULE-ENTRY-REF DEST="BSW-MODULE-ENTRY">/AUTOSAR_Nm/BswModuleEntrys/Nm_RepeatMessageIndication</BSW-MODULE-ENTRY-REF>
                </BSW-MODULE-ENTRY-REF-CONDITIONAL>
  [!ENDIF!][!//
  [!IF "as:modconf('Nm')[1]/NmGlobalConfig/NmGlobalFeatures/NmStateChangeIndEnabled = 'true'"!][!//
                <BSW-MODULE-ENTRY-REF-CONDITIONAL>
                  <BSW-MODULE-ENTRY-REF DEST="BSW-MODULE-ENTRY">/AUTOSAR_Nm/BswModuleEntrys/Nm_StateChangeNotification</BSW-MODULE-ENTRY-REF>
                </BSW-MODULE-ENTRY-REF-CONDITIONAL>
  [!ENDIF!][!//
  [!IF "as:modconf('Nm')[1]/NmGlobalConfig/NmGlobalFeatures/NmPduRxIndicationEnabled = 'true'"!][!//
                <BSW-MODULE-ENTRY-REF-CONDITIONAL>
                  <BSW-MODULE-ENTRY-REF DEST="BSW-MODULE-ENTRY">/AUTOSAR_Nm/BswModuleEntrys/Nm_PduRxIndication</BSW-MODULE-ENTRY-REF>
                </BSW-MODULE-ENTRY-REF-CONDITIONAL>
  [!ENDIF!][!//
  [!IF "as:modconf('Nm')[1]/NmGlobalConfig/NmGlobalFeatures/NmBusSynchronizationEnabled = 'true'"!][!//
                <BSW-MODULE-ENTRY-REF-CONDITIONAL>
                  <BSW-MODULE-ENTRY-REF DEST="BSW-MODULE-ENTRY">/AUTOSAR_Nm/BswModuleEntrys/Nm_CoordReadyToSleepIndication</BSW-MODULE-ENTRY-REF>
                </BSW-MODULE-ENTRY-REF-CONDITIONAL>
  [!ENDIF!][!//
  [!IF "node:exists(as:modconf('Nm')[1]/NmGlobalConfig/NmGlobalFeatures/NmSynchronizedPncShutdownEnabled) and 
       (as:modconf('Nm')[1]/NmGlobalConfig/NmGlobalFeatures/NmSynchronizedPncShutdownEnabled = 'true')"!]
    [!FOR "BusId" = "1" TO "count(text:split($BusNames,' '))"!]
      [!VAR "CurrentBusName" = "text:split($BusNames,' ')[position() = $BusId]"!] 
                <BSW-MODULE-ENTRY-REF-CONDITIONAL>
                  <BSW-MODULE-ENTRY-REF DEST="BSW-MODULE-ENTRY">/AUTOSAR_Nm/BswModuleEntrys/Nm_RequestSynchronizedPncShutdown_Nm_To_[!"$CurrentBusName"!]_DataSntFnct</BSW-MODULE-ENTRY-REF>
                </BSW-MODULE-ENTRY-REF-CONDITIONAL>  
    [!ENDFOR!] [!/* [!FOR "BusId" = "1" TO "count(text:split($BusNames,' '))"!] */!]

    [!FOR "BusId" = "1" TO "count(text:split($BusNames,' '))"!]
      [!VAR "CurrentBusName" = "text:split($BusNames,' ')[position() = $BusId]"!]
      [!VAR "QueueSize" = "text:split($BusNrOfPassiveChannels,' ')[position() = $BusId]"!]
      [!IF "num:i($QueueSize) > 0"!]        
            <BSW-MODULE-ENTRY-REF-CONDITIONAL>
              <BSW-MODULE-ENTRY-REF DEST="BSW-MODULE-ENTRY">/AUTOSAR_Nm/BswModuleEntrys/Nm_ForwardSynchronizedPncShutdown_[!"$CurrentBusName"!]_To_Nm_RcvFnct</BSW-MODULE-ENTRY-REF>
            </BSW-MODULE-ENTRY-REF-CONDITIONAL>
      [!ENDIF!] [!/*[!IF "num:i($QueueSize) > 0"!]*/!]
    [!ENDFOR!] [!/* [!FOR "BusId" = "1" TO "count(text:split($BusNames,' '))"!] */!]
  [!ENDIF!] [!/* [!IF "node:exists(as:modconf('Nm')[1]/NmGlobalConfig/NmGlobalFeatures/NmSynchronizedPncShutdownEnabled) and 
               *  (as:modconf('Nm')[1]/NmGlobalConfig/NmGlobalFeatures/NmSynchronizedPncShutdownEnabled = 'true')"!]  
               */!]                          
[!ENDIF!][!//

              </PROVIDED-ENTRYS>

[!IF "NmGlobalConfig/NmGlobalFeatures/NmMultiCoreSupport = 'true'"!][!//
              <PROVIDED-CLIENT-SERVER-ENTRYS>
  [!LOOP "as:modconf('Nm')[1]/NmChannelConfig/*[(node:exists(NmBusType/NmStandardBusType)) and
                                                (NmBusType/NmStandardBusType='NM_BUSNM_CANNM' or
                                                 NmBusType/NmStandardBusType='NM_BUSNM_FRNM' or
                                                 NmBusType/NmStandardBusType='NM_BUSNM_UDPNM')]"!][!//
    [!VAR "GenerateCarwakeup"="0"!][!//
    [!IF "NmBusType/NmStandardBusType='NM_BUSNM_CANNM'"!][!//
      [!IF "(count(as:modconf('CanNm')[1]/CanNmGlobalConfig/*[1]/CanNmChannelConfig/*[(node:exists(CanNmComMNetworkHandleRef)) and (CanNmComMNetworkHandleRef=node:current()/NmComMChannelRef)]/CanNmCarWakeUpRxEnabled) = 1) and
            (as:modconf('CanNm')[1]/CanNmGlobalConfig/*[1]/CanNmChannelConfig/*[(node:exists(CanNmComMNetworkHandleRef)) and (CanNmComMNetworkHandleRef=node:current()/NmComMChannelRef)]/CanNmCarWakeUpRxEnabled='true')"!][!//
        [!VAR "GenerateCarwakeup"="1"!][!//
      [!ENDIF!][!//
    [!ENDIF!][!//
    [!IF "NmBusType/NmStandardBusType='NM_BUSNM_FRNM'"!][!//
      [!IF "(count(as:modconf('FrNm')[1]/FrNmChannelConfig/*[1]/FrNmChannel/*/FrNmChannelIdentifiers[(node:exists(FrNmComMNetworkHandleRef)) and (FrNmComMNetworkHandleRef=node:current()/NmComMChannelRef)]/FrNmCarWakeUpRxEnabled) = 1) and
            (as:modconf('FrNm')[1]/FrNmChannelConfig/*[1]/FrNmChannel/*/FrNmChannelIdentifiers[(node:exists(FrNmComMNetworkHandleRef)) and (FrNmComMNetworkHandleRef=node:current()/NmComMChannelRef)]/FrNmCarWakeUpRxEnabled='true')"!][!//
        [!VAR "GenerateCarwakeup"="1"!][!//
      [!ENDIF!][!//
    [!ENDIF!][!//
    [!IF "NmBusType/NmStandardBusType='NM_BUSNM_UDPNM'"!][!//
      [!IF "(count(as:modconf('UdpNm')[1]/UdpNmGlobalConfig/*[1]/UdpNmChannelConfig/*[(node:exists(UdpNmComMNetworkHandleRef)) and (UdpNmComMNetworkHandleRef=node:current()/NmComMChannelRef)]/UdpNmCarWakeUpRxEnabled) = 1) and
            (as:modconf('UdpNm')[1]/UdpNmGlobalConfig/*[1]/UdpNmChannelConfig/*[(node:exists(UdpNmComMNetworkHandleRef)) and (UdpNmComMNetworkHandleRef=node:current()/NmComMChannelRef)]/UdpNmCarWakeUpRxEnabled='true')"!][!//
        [!VAR "GenerateCarwakeup"="1"!][!//
      [!ENDIF!][!//
    [!ENDIF!][!//

                <BSW-MODULE-CLIENT-SERVER-ENTRY>
                  <SHORT-NAME>ProvidedCSEntry_Nm_NetworkStartIndication_[!"node:name(.)"!]</SHORT-NAME>
                  <ENCAPSULATED-ENTRY-REF DEST="BSW-MODULE-ENTRY">/AUTOSAR_Nm/BswModuleEntrys/Nm_NetworkStartIndication</ENCAPSULATED-ENTRY-REF>
                  <IS-SYNCHRONOUS>false</IS-SYNCHRONOUS>
                </BSW-MODULE-CLIENT-SERVER-ENTRY>

                <BSW-MODULE-CLIENT-SERVER-ENTRY>
                  <SHORT-NAME>ProvidedCSEntry_Nm_NetworkMode_[!"node:name(.)"!]</SHORT-NAME>
                  <ENCAPSULATED-ENTRY-REF DEST="BSW-MODULE-ENTRY">/AUTOSAR_Nm/BswModuleEntrys/Nm_NetworkMode</ENCAPSULATED-ENTRY-REF>
                  <IS-SYNCHRONOUS>false</IS-SYNCHRONOUS>
                </BSW-MODULE-CLIENT-SERVER-ENTRY>

                <BSW-MODULE-CLIENT-SERVER-ENTRY>
                  <SHORT-NAME>ProvidedCSEntry_Nm_BusSleepMode_[!"node:name(.)"!]</SHORT-NAME>
                  <ENCAPSULATED-ENTRY-REF DEST="BSW-MODULE-ENTRY">/AUTOSAR_Nm/BswModuleEntrys/Nm_BusSleepMode</ENCAPSULATED-ENTRY-REF>
                  <IS-SYNCHRONOUS>false</IS-SYNCHRONOUS>
                </BSW-MODULE-CLIENT-SERVER-ENTRY>
    [!IF "(NmBusType/NmStandardBusType='NM_BUSNM_CANNM') or (NmBusType/NmStandardBusType='NM_BUSNM_UDPNM')"!][!//

                <BSW-MODULE-CLIENT-SERVER-ENTRY>
                  <SHORT-NAME>ProvidedCSEntry_Nm_PrepareBusSleepMode_[!"node:name(.)"!]</SHORT-NAME>
                  <ENCAPSULATED-ENTRY-REF DEST="BSW-MODULE-ENTRY">/AUTOSAR_Nm/BswModuleEntrys/Nm_PrepareBusSleepMode</ENCAPSULATED-ENTRY-REF>
                  <IS-SYNCHRONOUS>false</IS-SYNCHRONOUS>
                </BSW-MODULE-CLIENT-SERVER-ENTRY>
    [!ENDIF!][!//
    [!IF "(as:modconf('Nm')[1]/NmGlobalConfig/NmGlobalFeatures/NmCoordinatorSupportEnabled = 'true') or (as:modconf('Nm')[1]/NmGlobalConfig/NmGlobalFeatures/NmProvideRemoteSleepCallbacks = 'true')"!][!//[!//
      [!IF "((NmBusType/NmStandardBusType='NM_BUSNM_CANNM') and
             (node:exists(as:modconf('CanNm')[1]/CanNmGlobalConfig/*[1]/CanNmRemoteSleepIndEnabled)) and
             (as:modconf('CanNm')[1]/CanNmGlobalConfig/*[1]/CanNmRemoteSleepIndEnabled='true'))
            or
            ((NmBusType/NmStandardBusType='NM_BUSNM_FRNM') and
             (node:exists(as:modconf('FrNm')[1]/FrNmGlobalConfig/FrNmGlobalFeatures/FrNmRemoteSleepIndicationEnabled)) and
             (as:modconf('FrNm')[1]/FrNmGlobalConfig/FrNmGlobalFeatures/FrNmRemoteSleepIndicationEnabled = 'true'))
            or
            ((NmBusType/NmStandardBusType='NM_BUSNM_UDPNM') and
             (node:exists(as:modconf('UdpNm')[1]/UdpNmGlobalConfig/*[1]/UdpNmRemoteSleepIndEnabled)) and
             (as:modconf('UdpNm')[1]/UdpNmGlobalConfig/*[1]/UdpNmRemoteSleepIndEnabled='true'))"!][!//

                <BSW-MODULE-CLIENT-SERVER-ENTRY>
                  <SHORT-NAME>ProvidedCSEntry_Nm_RemoteSleepIndication_[!"node:name(.)"!]</SHORT-NAME>
                  <ENCAPSULATED-ENTRY-REF DEST="BSW-MODULE-ENTRY">/AUTOSAR_Nm/BswModuleEntrys/Nm_RemoteSleepIndication</ENCAPSULATED-ENTRY-REF>
                  <IS-SYNCHRONOUS>false</IS-SYNCHRONOUS>
                </BSW-MODULE-CLIENT-SERVER-ENTRY>

                <BSW-MODULE-CLIENT-SERVER-ENTRY>
                  <SHORT-NAME>ProvidedCSEntry_Nm_RemoteSleepCancellation_[!"node:name(.)"!]</SHORT-NAME>
                  <ENCAPSULATED-ENTRY-REF DEST="BSW-MODULE-ENTRY">/AUTOSAR_Nm/BswModuleEntrys/Nm_RemoteSleepCancellation</ENCAPSULATED-ENTRY-REF>
                  <IS-SYNCHRONOUS>false</IS-SYNCHRONOUS>
                </BSW-MODULE-CLIENT-SERVER-ENTRY>
      [!ENDIF!][!//
    [!ENDIF!][!//
    [!IF "as:modconf('Nm')[1]/NmGlobalConfig/NmGlobalFeatures/NmCoordinatorSupportEnabled = 'true'"!][!//
      [!IF "NmBusType/NmStandardBusType='NM_BUSNM_FRNM'"!][!//

                <BSW-MODULE-CLIENT-SERVER-ENTRY>
                  <SHORT-NAME>ProvidedCSEntry_Nm_SynchronizationPoint_[!"node:name(.)"!]</SHORT-NAME>
                  <ENCAPSULATED-ENTRY-REF DEST="BSW-MODULE-ENTRY">/AUTOSAR_Nm/BswModuleEntrys/Nm_SynchronizationPoint</ENCAPSULATED-ENTRY-REF>
                  <IS-SYNCHRONOUS>false</IS-SYNCHRONOUS>
                </BSW-MODULE-CLIENT-SERVER-ENTRY>
      [!ENDIF!][!//
    [!ENDIF!][!//
    [!IF "as:modconf('Nm')[1]/NmGlobalConfig/NmGlobalFeatures/NmBusSynchronizationEnabled = 'true'"!][!//
      [!IF "NmBusType/NmStandardBusType='NM_BUSNM_FRNM'"!][!//

                <BSW-MODULE-CLIENT-SERVER-ENTRY>
                  <SHORT-NAME>ProvidedCSEntry_Nm_CoordReadyToSleepIndication_[!"node:name(.)"!]</SHORT-NAME>
                  <ENCAPSULATED-ENTRY-REF DEST="BSW-MODULE-ENTRY">/AUTOSAR_Nm/BswModuleEntrys/Nm_CoordReadyToSleepIndication</ENCAPSULATED-ENTRY-REF>
                  <IS-SYNCHRONOUS>false</IS-SYNCHRONOUS>
                </BSW-MODULE-CLIENT-SERVER-ENTRY>
      [!ENDIF!][!//
    [!ENDIF!][!//
    [!IF "as:modconf('Nm')[1]/NmGlobalConfig/NmGlobalFeatures/NmPduRxIndicationEnabled = 'true'"!][!//
      [!IF "((NmBusType/NmStandardBusType='NM_BUSNM_CANNM') and
             (node:exists(as:modconf('CanNm')[1]/CanNmGlobalConfig/*[1]/CanNmPduRxIndicationEnabled)) and
             (as:modconf('CanNm')[1]/CanNmGlobalConfig/*[1]/CanNmPduRxIndicationEnabled='true'))
            or
            ((NmBusType/NmStandardBusType='NM_BUSNM_FRNM') and
             (node:exists(as:modconf('FrNm')[1]/FrNmGlobalConfig/FrNmGlobalFeatures/FrNmPduRxIndicationEnabled)) and
             (as:modconf('FrNm')[1]/FrNmGlobalConfig/FrNmGlobalFeatures/FrNmPduRxIndicationEnabled='true'))
            or
            ((NmBusType/NmStandardBusType='NM_BUSNM_UDPNM') and
             (node:exists(as:modconf('UdpNm')[1]/UdpNmGlobalConfig/*[1]/UdpNmPduRxIndicationEnabled)) and
             (as:modconf('UdpNm')[1]/UdpNmGlobalConfig/*[1]/UdpNmPduRxIndicationEnabled='true'))"!][!//

                <BSW-MODULE-CLIENT-SERVER-ENTRY>
                  <SHORT-NAME>ProvidedCSEntry_Nm_PduRxIndication_[!"node:name(.)"!]</SHORT-NAME>
                  <ENCAPSULATED-ENTRY-REF DEST="BSW-MODULE-ENTRY">/AUTOSAR_Nm/BswModuleEntrys/Nm_PduRxIndication</ENCAPSULATED-ENTRY-REF>
                  <IS-SYNCHRONOUS>false</IS-SYNCHRONOUS>
                </BSW-MODULE-CLIENT-SERVER-ENTRY>
      [!ENDIF!][!//
    [!ENDIF!][!//
    [!IF "as:modconf('Nm')[1]/NmGlobalConfig/NmGlobalFeatures/NmStateChangeIndEnabled = 'true'"!][!//
      [!IF "((NmBusType/NmStandardBusType='NM_BUSNM_CANNM') and
             (node:exists(as:modconf('CanNm')[1]/CanNmGlobalConfig/*[1]/CanNmStateChangeIndEnabled)) and
             (as:modconf('CanNm')[1]/CanNmGlobalConfig/*[1]/CanNmStateChangeIndEnabled='true'))
            or
            ((NmBusType/NmStandardBusType='NM_BUSNM_FRNM') and
             (node:exists(as:modconf('FrNm')[1]/FrNmGlobalConfig/FrNmGlobalFeatures/FrNmStateChangeIndicationEnabled)) and
             (as:modconf('FrNm')[1]/FrNmGlobalConfig/FrNmGlobalFeatures/FrNmStateChangeIndicationEnabled = 'true'))
            or
            ((NmBusType/NmStandardBusType='NM_BUSNM_UDPNM') and
             (node:exists(as:modconf('UdpNm')[1]/UdpNmGlobalConfig/*[1]/UdpNmStateChangeIndEnabled)) and
             (as:modconf('UdpNm')[1]/UdpNmGlobalConfig/*[1]/UdpNmStateChangeIndEnabled='true'))"!][!//

                <BSW-MODULE-CLIENT-SERVER-ENTRY>
                  <SHORT-NAME>ProvidedCSEntry_Nm_StateChangeNotification_[!"node:name(.)"!]</SHORT-NAME>
                  <ENCAPSULATED-ENTRY-REF DEST="BSW-MODULE-ENTRY">/AUTOSAR_Nm/BswModuleEntrys/Nm_StateChangeNotification</ENCAPSULATED-ENTRY-REF>
                  <IS-SYNCHRONOUS>false</IS-SYNCHRONOUS>
                </BSW-MODULE-CLIENT-SERVER-ENTRY>
      [!ENDIF!][!//
    [!ENDIF!][!//
    [!IF "NmRepeatMsgIndEnabled='true'"!][!//

                <BSW-MODULE-CLIENT-SERVER-ENTRY>
                  <SHORT-NAME>ProvidedCSEntry_Nm_RepeatMessageIndication_[!"node:name(.)"!]</SHORT-NAME>
                  <ENCAPSULATED-ENTRY-REF DEST="BSW-MODULE-ENTRY">/AUTOSAR_Nm/BswModuleEntrys/Nm_RepeatMessageIndication</ENCAPSULATED-ENTRY-REF>
                  <IS-SYNCHRONOUS>false</IS-SYNCHRONOUS>
                </BSW-MODULE-CLIENT-SERVER-ENTRY>
    [!ENDIF!][!//
    [!IF "((NmBusType/NmStandardBusType='NM_BUSNM_CANNM') and
           (node:exists(as:modconf('CanNm')[1]/CanNmGlobalConfig/*[1]/CanNmPassiveModeEnabled)) and (as:modconf('CanNm')[1]/CanNmGlobalConfig/*[1]/CanNmPassiveModeEnabled='false') and
           (node:exists(as:modconf('CanNm')[1]/CanNmGlobalConfig/*[1]/CanNmImmediateTxconfEnabled)) and (as:modconf('CanNm')[1]/CanNmGlobalConfig/*[1]/CanNmImmediateTxconfEnabled='false'))
          or
          (NmBusType/NmStandardBusType='NM_BUSNM_FRNM')"!][!//

                <BSW-MODULE-CLIENT-SERVER-ENTRY>
                  <SHORT-NAME>ProvidedCSEntry_Nm_TxTimeoutException_[!"node:name(.)"!]</SHORT-NAME>
                  <ENCAPSULATED-ENTRY-REF DEST="BSW-MODULE-ENTRY">/AUTOSAR_Nm/BswModuleEntrys/Nm_TxTimeoutException</ENCAPSULATED-ENTRY-REF>
                  <IS-SYNCHRONOUS>false</IS-SYNCHRONOUS>
                </BSW-MODULE-CLIENT-SERVER-ENTRY>
    [!ENDIF!][!//
    [!IF "as:modconf('Nm')[1]/NmGlobalConfig/NmGlobalFeatures/NmCarWakeUpRxEnabled = 'true'"!][!//
      [!IF "$GenerateCarwakeup=1"!][!//

                <BSW-MODULE-CLIENT-SERVER-ENTRY>
                  <SHORT-NAME>ProvidedCSEntry_Nm_CarWakeUpIndication_[!"node:name(.)"!]</SHORT-NAME>
                  <ENCAPSULATED-ENTRY-REF DEST="BSW-MODULE-ENTRY">/AUTOSAR_Nm/BswModuleEntrys/Nm_CarWakeUpIndication</ENCAPSULATED-ENTRY-REF>
                  <IS-SYNCHRONOUS>false</IS-SYNCHRONOUS>
                </BSW-MODULE-CLIENT-SERVER-ENTRY>
      [!ENDIF!][!//
    [!ENDIF!][!//
  [!ENDLOOP!][!//

              </PROVIDED-CLIENT-SERVER-ENTRYS>
[!ENDIF!][!//

[!IF "NmGlobalConfig/NmGlobalFeatures/NmMultiCoreSupport = 'true'"!][!//
              <REQUIRED-CLIENT-SERVER-ENTRYS>
  [!LOOP "as:modconf('Nm')[1]/NmChannelConfig/*[(node:exists(NmBusType/NmStandardBusType)) and
                                                (NmBusType/NmStandardBusType='NM_BUSNM_CANNM' or
                                                 NmBusType/NmStandardBusType='NM_BUSNM_FRNM' or
                                                 NmBusType/NmStandardBusType='NM_BUSNM_UDPNM')]"!][!//

                <BSW-MODULE-CLIENT-SERVER-ENTRY>
                  <SHORT-NAME>RequiredCSEntry_Nm_PassiveStartUp_[!"node:name(.)"!]</SHORT-NAME>
                  <ENCAPSULATED-ENTRY-REF DEST="BSW-MODULE-ENTRY">/AUTOSAR_Nm/BswModuleEntrys/Nm_Dummy_ComMContext</ENCAPSULATED-ENTRY-REF>
                  <IS-SYNCHRONOUS>false</IS-SYNCHRONOUS>
                </BSW-MODULE-CLIENT-SERVER-ENTRY>
    [!IF "NmPassiveModeEnabled = 'false'"!][!//

                <BSW-MODULE-CLIENT-SERVER-ENTRY>
                  <SHORT-NAME>RequiredCSEntry_Nm_NetworkRequest_[!"node:name(.)"!]</SHORT-NAME>
                  <ENCAPSULATED-ENTRY-REF DEST="BSW-MODULE-ENTRY">/AUTOSAR_Nm/BswModuleEntrys/Nm_Dummy_ComMContext</ENCAPSULATED-ENTRY-REF>
                  <IS-SYNCHRONOUS>false</IS-SYNCHRONOUS>
                </BSW-MODULE-CLIENT-SERVER-ENTRY>

                <BSW-MODULE-CLIENT-SERVER-ENTRY>
                  <SHORT-NAME>RequiredCSEntry_Nm_NetworkRelease_[!"node:name(.)"!]</SHORT-NAME>
                  <ENCAPSULATED-ENTRY-REF DEST="BSW-MODULE-ENTRY">/AUTOSAR_Nm/BswModuleEntrys/Nm_Dummy_ComMContext</ENCAPSULATED-ENTRY-REF>
                  <IS-SYNCHRONOUS>false</IS-SYNCHRONOUS>
                </BSW-MODULE-CLIENT-SERVER-ENTRY>

                <BSW-MODULE-CLIENT-SERVER-ENTRY>
                  <SHORT-NAME>RequiredCSEntry_Nm_NetworkGwEraRequest_[!"node:name(.)"!]</SHORT-NAME>
                  <ENCAPSULATED-ENTRY-REF DEST="BSW-MODULE-ENTRY">/AUTOSAR_Nm/BswModuleEntrys/Nm_Dummy_ComMContext</ENCAPSULATED-ENTRY-REF>
                  <IS-SYNCHRONOUS>false</IS-SYNCHRONOUS>
                </BSW-MODULE-CLIENT-SERVER-ENTRY>
    [!ENDIF!][!//
    [!IF "as:modconf('Nm')[1]/NmGlobalConfig/NmGlobalFeatures/NmBusSynchronizationEnabled='true'"!][!//
      [!IF "NmPassiveModeEnabled = 'false'"!][!//
        [!IF "(NmBusType/NmStandardBusType='NM_BUSNM_CANNM') or
              (NmBusType/NmStandardBusType='NM_BUSNM_UDPNM') or
              ((NmBusType/NmStandardBusType='NM_BUSNM_FRNM') and
               (as:modconf('FrNm')[1]/FrNmGlobalConfig/FrNmGlobalFeatures/FrNmBusSynchronizationEnabled='true'))"!][!//

                <BSW-MODULE-CLIENT-SERVER-ENTRY>
                  <SHORT-NAME>RequiredCSEntry_Nm_BusNm_RequestBusSynchronization_[!"node:name(.)"!]</SHORT-NAME>
                  <ENCAPSULATED-ENTRY-REF DEST="BSW-MODULE-ENTRY">/AUTOSAR_Nm/BswModuleEntrys/Nm_Dummy_ComMContext</ENCAPSULATED-ENTRY-REF>
                  <IS-SYNCHRONOUS>false</IS-SYNCHRONOUS>
                </BSW-MODULE-CLIENT-SERVER-ENTRY>
        [!ENDIF!][!//
      [!ENDIF!][!//
    [!ENDIF!][!//
  [!ENDLOOP!][!//
              </REQUIRED-CLIENT-SERVER-ENTRYS>
  [!IF "node:exists(as:modconf('Nm')[1]/NmGlobalConfig/NmGlobalFeatures/NmSynchronizedPncShutdownEnabled) and 
       (as:modconf('Nm')[1]/NmGlobalConfig/NmGlobalFeatures/NmSynchronizedPncShutdownEnabled = 'true')"!]  
              <PROVIDED-DATAS>       
    [!FOR "BusId" = "1" TO "count(text:split($BusNames,' '))"!]
      [!VAR "CurrentBusName" = "text:split($BusNames,' ')[position() = $BusId]"!] 
                <VARIABLE-DATA-PROTOTYPE>
                  <SHORT-NAME>Nm_RequestSynchronizedPncShutdown_Nm_To_[!"$CurrentBusName"!]_DataSet</SHORT-NAME>
                  <TYPE-TREF DEST="IMPLEMENTATION-DATA-TYPE">/AUTOSAR_Nm/ImplementationDataTypes/Nm_PnSyncShutdown_Nm_To_BusNm_DataType</TYPE-TREF>
                </VARIABLE-DATA-PROTOTYPE>              
    [!ENDFOR!] [!/* [!FOR "BusId" = "1" TO "count(text:split($BusNames,' '))"!] */!]
              </PROVIDED-DATAS>                  
  [!ENDIF!] [!/* [!IF "node:exists(as:modconf('Nm')[1]/NmGlobalConfig/NmGlobalFeatures/NmSynchronizedPncShutdownEnabled) and 
               *  (as:modconf('Nm')[1]/NmGlobalConfig/NmGlobalFeatures/NmSynchronizedPncShutdownEnabled = 'true')"!]  
               */!]
  [!IF "node:exists(as:modconf('Nm')[1]/NmGlobalConfig/NmGlobalFeatures/NmSynchronizedPncShutdownEnabled) and 
       (as:modconf('Nm')[1]/NmGlobalConfig/NmGlobalFeatures/NmSynchronizedPncShutdownEnabled = 'true')"!]  
              <REQUIRED-DATAS>       
    [!FOR "BusId" = "1" TO "count(text:split($BusNames,' '))"!]
      [!VAR "CurrentBusName" = "text:split($BusNames,' ')[position() = $BusId]"!] 
      [!VAR "QueueSize" = "text:split($BusNrOfPassiveChannels,' ')[position() = $BusId]"!]
      [!IF "num:i($QueueSize) > 0"!]
                <VARIABLE-DATA-PROTOTYPE>
                  <SHORT-NAME>Nm_ForwardSynchronizedPncShutdown_[!"$CurrentBusName"!]_To_Nm_DataGet</SHORT-NAME>
                  <TYPE-TREF DEST="IMPLEMENTATION-DATA-TYPE">/AUTOSAR_Nm/ImplementationDataTypes/Nm_PnSyncShutdown_BusNm_To_Nm_DataType</TYPE-TREF>
                </VARIABLE-DATA-PROTOTYPE>
      [!ENDIF!] [!/*[!IF "num:i($QueueSize) > 0"!]*/!]                
    [!ENDFOR!] [!/* [!FOR "BusId" = "1" TO "count(text:split($BusNames,' '))"!] */!]
              </REQUIRED-DATAS>                  
  [!ENDIF!] [!/* [!IF "node:exists(as:modconf('Nm')[1]/NmGlobalConfig/NmGlobalFeatures/NmSynchronizedPncShutdownEnabled) and 
               *  (as:modconf('Nm')[1]/NmGlobalConfig/NmGlobalFeatures/NmSynchronizedPncShutdownEnabled = 'true')"!]  
               */!]               
               
[!ENDIF!][!//

              <INTERNAL-BEHAVIORS>
                <BSW-INTERNAL-BEHAVIOR>
                  <SHORT-NAME>InternalBehavior_0</SHORT-NAME>
                  <EXCLUSIVE-AREAS>
                    <EXCLUSIVE-AREA>
                      <SHORT-NAME>SCHM_NM_EXCLUSIVE_AREA_0</SHORT-NAME>
                    </EXCLUSIVE-AREA>
                  </EXCLUSIVE-AREAS>
[!IF "NmGlobalConfig/NmGlobalFeatures/NmMultiCoreSupport = 'true'"!][!//

                  <INTERNAL-TRIGGERING-POINTS>
  [!LOOP "as:modconf('Nm')[1]/NmChannelConfig/*[(node:exists(NmBusType/NmStandardBusType)) and
                                                (NmBusType/NmStandardBusType='NM_BUSNM_CANNM' or
                                                 NmBusType/NmStandardBusType='NM_BUSNM_FRNM' or
                                                 NmBusType/NmStandardBusType='NM_BUSNM_UDPNM')]"!][!//

                    <BSW-INTERNAL-TRIGGERING-POINT>
                      <SHORT-NAME>TriggeringPoint_ComMContext_[!"node:name(.)"!]</SHORT-NAME>
                    </BSW-INTERNAL-TRIGGERING-POINT>
  [!ENDLOOP!][!//

                  </INTERNAL-TRIGGERING-POINTS>
[!ENDIF!][!//
                  <ENTITYS>

                    <BSW-SCHEDULABLE-ENTITY>
                      <SHORT-NAME>Nm_MainFunction</SHORT-NAME>
                      <CAN-ENTER-EXCLUSIVE-AREA-REFS>
                        <CAN-ENTER-EXCLUSIVE-AREA-REF DEST="EXCLUSIVE-AREA">/AUTOSAR_Nm/BswModuleDescriptions/Nm/InternalBehavior_0/SCHM_NM_EXCLUSIVE_AREA_0</CAN-ENTER-EXCLUSIVE-AREA-REF>
                      </CAN-ENTER-EXCLUSIVE-AREA-REFS>
                      <MINIMUM-START-INTERVAL>0.0</MINIMUM-START-INTERVAL>
                      <IMPLEMENTED-ENTRY-REF DEST="BSW-MODULE-ENTRY">/AUTOSAR_Nm/BswModuleEntrys/Nm_MainFunction</IMPLEMENTED-ENTRY-REF>
                    </BSW-SCHEDULABLE-ENTITY>
[!IF "NmGlobalConfig/NmGlobalFeatures/NmMultiCoreSupport = 'true'"!][!//
  [!IF "node:exists(as:modconf('Nm')[1]/NmGlobalConfig/NmGlobalFeatures/NmSynchronizedPncShutdownEnabled) and 
       (as:modconf('Nm')[1]/NmGlobalConfig/NmGlobalFeatures/NmSynchronizedPncShutdownEnabled = 'true')"!]  
    [!FOR "BusId" = "1" TO "count(text:split($BusNames,' '))"!]
      [!VAR "CurrentBusName" = "text:split($BusNames,' ')[position() = $BusId]"!] 
      [!VAR "QueueSize" = "text:split($BusNrOfPassiveChannels,' ')[position() = $BusId]"!]
      [!IF "num:i($QueueSize) > 0"!]
                    <BSW-SCHEDULABLE-ENTITY>
                      <SHORT-NAME>BswSchEnt_Nm_ForwardSynchronizedPncShutdown_[!"$CurrentBusName"!]_To_Nm_RcvFnct</SHORT-NAME>
                      <CAN-ENTER-EXCLUSIVE-AREA-REFS>
                        <CAN-ENTER-EXCLUSIVE-AREA-REF DEST="EXCLUSIVE-AREA">/AUTOSAR_Nm/BswModuleDescriptions/Nm/InternalBehavior_0/SCHM_NM_EXCLUSIVE_AREA_0</CAN-ENTER-EXCLUSIVE-AREA-REF>
                      </CAN-ENTER-EXCLUSIVE-AREA-REFS>
                      <MINIMUM-START-INTERVAL>0.0</MINIMUM-START-INTERVAL>
                      <DATA-RECEIVE-POINTS>
                        <!-- MasterPnc core only -->
                        <BSW-VARIABLE-ACCESS>
                          <SHORT-NAME>BswVarAccess_Nm_ForwardSynchronizedPncShutdown_[!"$CurrentBusName"!]_To_Nm_DataGet</SHORT-NAME>
                          <ACCESSED-VARIABLE-REF DEST="VARIABLE-DATA-PROTOTYPE">/AUTOSAR_Nm/BswModuleDescriptions/Nm/Nm_ForwardSynchronizedPncShutdown_[!"$CurrentBusName"!]_To_Nm_DataGet</ACCESSED-VARIABLE-REF>
                        </BSW-VARIABLE-ACCESS>
                      </DATA-RECEIVE-POINTS>
                      <IMPLEMENTED-ENTRY-REF DEST="BSW-MODULE-ENTRY">/AUTOSAR_Nm/BswModuleEntrys/Nm_ForwardSynchronizedPncShutdown_[!"$CurrentBusName"!]_To_Nm_RcvFnct</IMPLEMENTED-ENTRY-REF>
                    </BSW-SCHEDULABLE-ENTITY>
      [!ENDIF!] [!/*[!IF "num:i($QueueSize) > 0"!]*/!]
    [!ENDFOR!] [!/* [!FOR "BusId" = "1" TO "count(text:split($BusNames,' '))"!] */!]
  [!ENDIF!] [!/* [!IF "node:exists(as:modconf('Nm')[1]/NmGlobalConfig/NmGlobalFeatures/NmSynchronizedPncShutdownEnabled) and 
               *  (as:modconf('Nm')[1]/NmGlobalConfig/NmGlobalFeatures/NmSynchronizedPncShutdownEnabled = 'true')"!]  
               */!]                    

  [!LOOP "as:modconf('Nm')[1]/NmChannelConfig/*[(node:exists(NmBusType/NmStandardBusType)) and
                                                (NmBusType/NmStandardBusType='NM_BUSNM_CANNM' or
                                                 NmBusType/NmStandardBusType='NM_BUSNM_FRNM' or
                                                 NmBusType/NmStandardBusType='NM_BUSNM_UDPNM')]"!][!//
    [!VAR "GenerateCarwakeup"="0"!][!//
    [!IF "NmBusType/NmStandardBusType='NM_BUSNM_CANNM'"!][!//
      [!IF "(count(as:modconf('CanNm')[1]/CanNmGlobalConfig/*[1]/CanNmChannelConfig/*[(node:exists(CanNmComMNetworkHandleRef)) and (CanNmComMNetworkHandleRef=node:current()/NmComMChannelRef)]/CanNmCarWakeUpRxEnabled) = 1) and
            (as:modconf('CanNm')[1]/CanNmGlobalConfig/*[1]/CanNmChannelConfig/*[(node:exists(CanNmComMNetworkHandleRef)) and (CanNmComMNetworkHandleRef=node:current()/NmComMChannelRef)]/CanNmCarWakeUpRxEnabled='true')"!][!//
        [!VAR "GenerateCarwakeup"="1"!][!//
      [!ENDIF!][!//
    [!ENDIF!][!//
    [!IF "NmBusType/NmStandardBusType='NM_BUSNM_FRNM'"!][!//
      [!IF "(count(as:modconf('FrNm')[1]/FrNmChannelConfig/*[1]/FrNmChannel/*/FrNmChannelIdentifiers[(node:exists(FrNmComMNetworkHandleRef)) and (FrNmComMNetworkHandleRef=node:current()/NmComMChannelRef)]/FrNmCarWakeUpRxEnabled) = 1) and
            (as:modconf('FrNm')[1]/FrNmChannelConfig/*[1]/FrNmChannel/*/FrNmChannelIdentifiers[(node:exists(FrNmComMNetworkHandleRef)) and (FrNmComMNetworkHandleRef=node:current()/NmComMChannelRef)]/FrNmCarWakeUpRxEnabled='true')"!][!//
        [!VAR "GenerateCarwakeup"="1"!][!//
      [!ENDIF!][!//
    [!ENDIF!][!//
    [!IF "NmBusType/NmStandardBusType='NM_BUSNM_UDPNM'"!][!//
      [!IF "(count(as:modconf('UdpNm')[1]/UdpNmGlobalConfig/*[1]/UdpNmChannelConfig/*[(node:exists(UdpNmComMNetworkHandleRef)) and (UdpNmComMNetworkHandleRef=node:current()/NmComMChannelRef)]/UdpNmCarWakeUpRxEnabled) = 1) and
            (as:modconf('UdpNm')[1]/UdpNmGlobalConfig/*[1]/UdpNmChannelConfig/*[(node:exists(UdpNmComMNetworkHandleRef)) and (UdpNmComMNetworkHandleRef=node:current()/NmComMChannelRef)]/UdpNmCarWakeUpRxEnabled='true')"!][!//
        [!VAR "GenerateCarwakeup"="1"!][!//
      [!ENDIF!][!//
    [!ENDIF!][!//

                    <BSW-SCHEDULABLE-ENTITY>
                      <SHORT-NAME>Entity_Nm_ComMContext_[!"node:name(.)"!]</SHORT-NAME>
                      <MINIMUM-START-INTERVAL>0.0</MINIMUM-START-INTERVAL>
                      <CALL-POINTS>
                        <BSW-ASYNCHRONOUS-SERVER-CALL-POINT>
                          <SHORT-NAME>AsynchCallPoint_Nm_PassiveStartUp_[!"node:name(.)"!]</SHORT-NAME>
                          <CALLED-ENTRY-REF DEST="BSW-MODULE-CLIENT-SERVER-ENTRY">/AUTOSAR_Nm/BswModuleDescriptions/Nm/RequiredCSEntry_Nm_PassiveStartUp_[!"node:name(.)"!]</CALLED-ENTRY-REF>
                        </BSW-ASYNCHRONOUS-SERVER-CALL-POINT>
    [!IF "NmPassiveModeEnabled = 'false'"!][!//
                        <BSW-ASYNCHRONOUS-SERVER-CALL-POINT>
                          <SHORT-NAME>AsynchCallPoint_Nm_NetworkRequest_[!"node:name(.)"!]</SHORT-NAME>
                          <CALLED-ENTRY-REF DEST="BSW-MODULE-CLIENT-SERVER-ENTRY">/AUTOSAR_Nm/BswModuleDescriptions/Nm/RequiredCSEntry_Nm_NetworkRequest_[!"node:name(.)"!]</CALLED-ENTRY-REF>
                        </BSW-ASYNCHRONOUS-SERVER-CALL-POINT>
                        <BSW-ASYNCHRONOUS-SERVER-CALL-POINT>
                          <SHORT-NAME>AsynchCallPoint_Nm_NetworkRelease_[!"node:name(.)"!]</SHORT-NAME>
                          <CALLED-ENTRY-REF DEST="BSW-MODULE-CLIENT-SERVER-ENTRY">/AUTOSAR_Nm/BswModuleDescriptions/Nm/RequiredCSEntry_Nm_NetworkRelease_[!"node:name(.)"!]</CALLED-ENTRY-REF>
                        </BSW-ASYNCHRONOUS-SERVER-CALL-POINT>
                        <BSW-ASYNCHRONOUS-SERVER-CALL-POINT>
                          <SHORT-NAME>AsynchCallPoint_Nm_NetworkGwEraRequest_[!"node:name(.)"!]</SHORT-NAME>
                          <CALLED-ENTRY-REF DEST="BSW-MODULE-CLIENT-SERVER-ENTRY">/AUTOSAR_Nm/BswModuleDescriptions/Nm/RequiredCSEntry_Nm_NetworkGwEraRequest_[!"node:name(.)"!]</CALLED-ENTRY-REF>
                        </BSW-ASYNCHRONOUS-SERVER-CALL-POINT>
    [!ENDIF!][!//
    [!IF "as:modconf('Nm')[1]/NmGlobalConfig/NmGlobalFeatures/NmBusSynchronizationEnabled='true'"!][!//
      [!IF "NmPassiveModeEnabled = 'false'"!][!//
        [!IF "(NmBusType/NmStandardBusType='NM_BUSNM_CANNM') or
              (NmBusType/NmStandardBusType='NM_BUSNM_UDPNM') or
              ((NmBusType/NmStandardBusType='NM_BUSNM_FRNM') and
               (as:modconf('FrNm')[1]/FrNmGlobalConfig/FrNmGlobalFeatures/FrNmBusSynchronizationEnabled='true'))"!][!//

                        <BSW-ASYNCHRONOUS-SERVER-CALL-POINT>
                          <SHORT-NAME>AsynchCallPoint_Nm_BusNm_RequestBusSynchronization_[!"node:name(.)"!]</SHORT-NAME>
                          <CALLED-ENTRY-REF DEST="BSW-MODULE-CLIENT-SERVER-ENTRY">/AUTOSAR_Nm/BswModuleDescriptions/Nm/RequiredCSEntry_Nm_BusNm_RequestBusSynchronization_[!"node:name(.)"!]</CALLED-ENTRY-REF>
                        </BSW-ASYNCHRONOUS-SERVER-CALL-POINT>
        [!ENDIF!][!//
      [!ENDIF!][!//
    [!ENDIF!][!//
                      </CALL-POINTS>
                      <IMPLEMENTED-ENTRY-REF DEST="BSW-MODULE-ENTRY">/AUTOSAR_Nm/BswModuleEntrys/Nm_Dummy_ComMContext</IMPLEMENTED-ENTRY-REF>
                    </BSW-SCHEDULABLE-ENTITY>

                    <BSW-CALLED-ENTITY>
                      <SHORT-NAME>Nm_NetworkStartIndication_CalledEntity_[!"node:name(.)"!]</SHORT-NAME>
                      <MINIMUM-START-INTERVAL>0.0</MINIMUM-START-INTERVAL>
                      <IMPLEMENTED-ENTRY-REF DEST="BSW-MODULE-ENTRY">/AUTOSAR_Nm/BswModuleEntrys/Nm_NetworkStartIndication</IMPLEMENTED-ENTRY-REF>
                    </BSW-CALLED-ENTITY>

                    <BSW-CALLED-ENTITY>
                      <SHORT-NAME>Nm_NetworkMode_CalledEntity_[!"node:name(.)"!]</SHORT-NAME>
                      <MINIMUM-START-INTERVAL>0.0</MINIMUM-START-INTERVAL>
                      <IMPLEMENTED-ENTRY-REF DEST="BSW-MODULE-ENTRY">/AUTOSAR_Nm/BswModuleEntrys/Nm_NetworkMode</IMPLEMENTED-ENTRY-REF>
                    </BSW-CALLED-ENTITY>

                    <BSW-CALLED-ENTITY>
                      <SHORT-NAME>Nm_BusSleepMode_CalledEntity_[!"node:name(.)"!]</SHORT-NAME>
                      <MINIMUM-START-INTERVAL>0.0</MINIMUM-START-INTERVAL>
                      <IMPLEMENTED-ENTRY-REF DEST="BSW-MODULE-ENTRY">/AUTOSAR_Nm/BswModuleEntrys/Nm_BusSleepMode</IMPLEMENTED-ENTRY-REF>
                    </BSW-CALLED-ENTITY>
    [!IF "(NmBusType/NmStandardBusType='NM_BUSNM_CANNM') or (NmBusType/NmStandardBusType='NM_BUSNM_UDPNM')"!][!//

                    <BSW-CALLED-ENTITY>
                      <SHORT-NAME>Nm_PrepareBusSleepMode_CalledEntity_[!"node:name(.)"!]</SHORT-NAME>
                      <MINIMUM-START-INTERVAL>0.0</MINIMUM-START-INTERVAL>
                      <IMPLEMENTED-ENTRY-REF DEST="BSW-MODULE-ENTRY">/AUTOSAR_Nm/BswModuleEntrys/Nm_PrepareBusSleepMode</IMPLEMENTED-ENTRY-REF>
                    </BSW-CALLED-ENTITY>
    [!ENDIF!][!//
    [!IF "(as:modconf('Nm')[1]/NmGlobalConfig/NmGlobalFeatures/NmCoordinatorSupportEnabled = 'true') or (as:modconf('Nm')[1]/NmGlobalConfig/NmGlobalFeatures/NmProvideRemoteSleepCallbacks = 'true')"!][!//[!//
      [!IF "((NmBusType/NmStandardBusType='NM_BUSNM_CANNM') and
             (node:exists(as:modconf('CanNm')[1]/CanNmGlobalConfig/*[1]/CanNmRemoteSleepIndEnabled)) and
             (as:modconf('CanNm')[1]/CanNmGlobalConfig/*[1]/CanNmRemoteSleepIndEnabled='true'))
            or
            ((NmBusType/NmStandardBusType='NM_BUSNM_FRNM') and
             (node:exists(as:modconf('FrNm')[1]/FrNmGlobalConfig/FrNmGlobalFeatures/FrNmRemoteSleepIndicationEnabled)) and
             (as:modconf('FrNm')[1]/FrNmGlobalConfig/FrNmGlobalFeatures/FrNmRemoteSleepIndicationEnabled = 'true'))
            or
            ((NmBusType/NmStandardBusType='NM_BUSNM_UDPNM') and
             (node:exists(as:modconf('UdpNm')[1]/UdpNmGlobalConfig/*[1]/UdpNmRemoteSleepIndEnabled)) and
             (as:modconf('UdpNm')[1]/UdpNmGlobalConfig/*[1]/UdpNmRemoteSleepIndEnabled='true'))"!][!//

                    <BSW-CALLED-ENTITY>
                      <SHORT-NAME>Nm_RemoteSleepIndication_CalledEntity_[!"node:name(.)"!]</SHORT-NAME>
                      <MINIMUM-START-INTERVAL>0.0</MINIMUM-START-INTERVAL>
                      <IMPLEMENTED-ENTRY-REF DEST="BSW-MODULE-ENTRY">/AUTOSAR_Nm/BswModuleEntrys/Nm_RemoteSleepIndication</IMPLEMENTED-ENTRY-REF>
                    </BSW-CALLED-ENTITY>

                    <BSW-CALLED-ENTITY>
                      <SHORT-NAME>Nm_RemoteSleepCancellation_CalledEntity_[!"node:name(.)"!]</SHORT-NAME>
                      <MINIMUM-START-INTERVAL>0.0</MINIMUM-START-INTERVAL>
                      <IMPLEMENTED-ENTRY-REF DEST="BSW-MODULE-ENTRY">/AUTOSAR_Nm/BswModuleEntrys/Nm_RemoteSleepCancellation</IMPLEMENTED-ENTRY-REF>
                    </BSW-CALLED-ENTITY>
      [!ENDIF!][!//
    [!ENDIF!][!//
    [!IF "as:modconf('Nm')[1]/NmGlobalConfig/NmGlobalFeatures/NmCoordinatorSupportEnabled = 'true'"!][!//
      [!IF "NmBusType/NmStandardBusType='NM_BUSNM_FRNM'"!][!//

                    <BSW-CALLED-ENTITY>
                      <SHORT-NAME>Nm_SynchronizationPoint_CalledEntity_[!"node:name(.)"!]</SHORT-NAME>
                      <MINIMUM-START-INTERVAL>0.0</MINIMUM-START-INTERVAL>
                      <IMPLEMENTED-ENTRY-REF DEST="BSW-MODULE-ENTRY">/AUTOSAR_Nm/BswModuleEntrys/Nm_SynchronizationPoint</IMPLEMENTED-ENTRY-REF>
                    </BSW-CALLED-ENTITY>
      [!ENDIF!][!//
    [!ENDIF!][!//
    [!IF "as:modconf('Nm')[1]/NmGlobalConfig/NmGlobalFeatures/NmBusSynchronizationEnabled = 'true'"!][!//
      [!IF "NmBusType/NmStandardBusType='NM_BUSNM_FRNM'"!][!//

                    <BSW-CALLED-ENTITY>
                      <SHORT-NAME>Nm_CoordReadyToSleepIndication_CalledEntity_[!"node:name(.)"!]</SHORT-NAME>
                      <MINIMUM-START-INTERVAL>0.0</MINIMUM-START-INTERVAL>
                      <IMPLEMENTED-ENTRY-REF DEST="BSW-MODULE-ENTRY">/AUTOSAR_Nm/BswModuleEntrys/Nm_CoordReadyToSleepIndication</IMPLEMENTED-ENTRY-REF>
                    </BSW-CALLED-ENTITY>
      [!ENDIF!][!//
    [!ENDIF!][!//
    [!IF "as:modconf('Nm')[1]/NmGlobalConfig/NmGlobalFeatures/NmPduRxIndicationEnabled = 'true'"!][!//
      [!IF "((NmBusType/NmStandardBusType='NM_BUSNM_CANNM') and
             (node:exists(as:modconf('CanNm')[1]/CanNmGlobalConfig/*[1]/CanNmPduRxIndicationEnabled)) and
             (as:modconf('CanNm')[1]/CanNmGlobalConfig/*[1]/CanNmPduRxIndicationEnabled='true'))
            or
            ((NmBusType/NmStandardBusType='NM_BUSNM_FRNM') and
             (node:exists(as:modconf('FrNm')[1]/FrNmGlobalConfig/FrNmGlobalFeatures/FrNmPduRxIndicationEnabled)) and
             (as:modconf('FrNm')[1]/FrNmGlobalConfig/FrNmGlobalFeatures/FrNmPduRxIndicationEnabled='true'))
            or
            ((NmBusType/NmStandardBusType='NM_BUSNM_UDPNM') and
             (node:exists(as:modconf('UdpNm')[1]/UdpNmGlobalConfig/*[1]/UdpNmPduRxIndicationEnabled)) and
             (as:modconf('UdpNm')[1]/UdpNmGlobalConfig/*[1]/UdpNmPduRxIndicationEnabled='true'))"!][!//

                    <BSW-CALLED-ENTITY>
                      <SHORT-NAME>Nm_PduRxIndication_CalledEntity_[!"node:name(.)"!]</SHORT-NAME>
                      <MINIMUM-START-INTERVAL>0.0</MINIMUM-START-INTERVAL>
                      <IMPLEMENTED-ENTRY-REF DEST="BSW-MODULE-ENTRY">/AUTOSAR_Nm/BswModuleEntrys/Nm_PduRxIndication</IMPLEMENTED-ENTRY-REF>
                    </BSW-CALLED-ENTITY>
      [!ENDIF!][!//
    [!ENDIF!][!//
    [!IF "as:modconf('Nm')[1]/NmGlobalConfig/NmGlobalFeatures/NmStateChangeIndEnabled = 'true'"!][!//
      [!IF "((NmBusType/NmStandardBusType='NM_BUSNM_CANNM') and
             (node:exists(as:modconf('CanNm')[1]/CanNmGlobalConfig/*[1]/CanNmStateChangeIndEnabled)) and
             (as:modconf('CanNm')[1]/CanNmGlobalConfig/*[1]/CanNmStateChangeIndEnabled='true'))
            or
            ((NmBusType/NmStandardBusType='NM_BUSNM_FRNM') and
             (node:exists(as:modconf('FrNm')[1]/FrNmGlobalConfig/FrNmGlobalFeatures/FrNmStateChangeIndicationEnabled)) and
             (as:modconf('FrNm')[1]/FrNmGlobalConfig/FrNmGlobalFeatures/FrNmStateChangeIndicationEnabled = 'true'))
            or
            ((NmBusType/NmStandardBusType='NM_BUSNM_UDPNM') and
             (node:exists(as:modconf('UdpNm')[1]/UdpNmGlobalConfig/*[1]/UdpNmStateChangeIndEnabled)) and
             (as:modconf('UdpNm')[1]/UdpNmGlobalConfig/*[1]/UdpNmStateChangeIndEnabled='true'))"!][!//

                    <BSW-CALLED-ENTITY>
                      <SHORT-NAME>Nm_StateChangeNotification_CalledEntity_[!"node:name(.)"!]</SHORT-NAME>
                      <MINIMUM-START-INTERVAL>0.0</MINIMUM-START-INTERVAL>
                      <IMPLEMENTED-ENTRY-REF DEST="BSW-MODULE-ENTRY">/AUTOSAR_Nm/BswModuleEntrys/Nm_StateChangeNotification</IMPLEMENTED-ENTRY-REF>
                    </BSW-CALLED-ENTITY>
      [!ENDIF!][!//
    [!ENDIF!][!//
    [!IF "NmRepeatMsgIndEnabled='true'"!][!//

                    <BSW-CALLED-ENTITY>
                      <SHORT-NAME>Nm_RepeatMessageIndication_CalledEntity_[!"node:name(.)"!]</SHORT-NAME>
                      <MINIMUM-START-INTERVAL>0.0</MINIMUM-START-INTERVAL>
                      <IMPLEMENTED-ENTRY-REF DEST="BSW-MODULE-ENTRY">/AUTOSAR_Nm/BswModuleEntrys/Nm_RepeatMessageIndication</IMPLEMENTED-ENTRY-REF>
                    </BSW-CALLED-ENTITY>
    [!ENDIF!][!//
    [!IF "((NmBusType/NmStandardBusType='NM_BUSNM_CANNM') and
           (node:exists(as:modconf('CanNm')[1]/CanNmGlobalConfig/*[1]/CanNmPassiveModeEnabled)) and (as:modconf('CanNm')[1]/CanNmGlobalConfig/*[1]/CanNmPassiveModeEnabled='false') and
           (node:exists(as:modconf('CanNm')[1]/CanNmGlobalConfig/*[1]/CanNmImmediateTxconfEnabled)) and (as:modconf('CanNm')[1]/CanNmGlobalConfig/*[1]/CanNmImmediateTxconfEnabled='false'))
          or
          (NmBusType/NmStandardBusType='NM_BUSNM_FRNM')"!][!//

                    <BSW-CALLED-ENTITY>
                      <SHORT-NAME>Nm_TxTimeoutException_CalledEntity_[!"node:name(.)"!]</SHORT-NAME>
                      <MINIMUM-START-INTERVAL>0.0</MINIMUM-START-INTERVAL>
                      <IMPLEMENTED-ENTRY-REF DEST="BSW-MODULE-ENTRY">/AUTOSAR_Nm/BswModuleEntrys/Nm_TxTimeoutException</IMPLEMENTED-ENTRY-REF>
                    </BSW-CALLED-ENTITY>
    [!ENDIF!][!//
    [!IF "as:modconf('Nm')[1]/NmGlobalConfig/NmGlobalFeatures/NmCarWakeUpRxEnabled = 'true'"!][!//
      [!IF "$GenerateCarwakeup=1"!][!//

                    <BSW-CALLED-ENTITY>
                      <SHORT-NAME>Nm_CarWakeUpIndication_CalledEntity_[!"node:name(.)"!]</SHORT-NAME>
                      <MINIMUM-START-INTERVAL>0.0</MINIMUM-START-INTERVAL>
                      <IMPLEMENTED-ENTRY-REF DEST="BSW-MODULE-ENTRY">/AUTOSAR_Nm/BswModuleEntrys/Nm_CarWakeUpIndication</IMPLEMENTED-ENTRY-REF>
                    </BSW-CALLED-ENTITY>
      [!ENDIF!][!//
    [!ENDIF!][!//
  [!ENDLOOP!][!//
  [!IF "node:exists(as:modconf('Nm')[1]/NmGlobalConfig/NmGlobalFeatures/NmSynchronizedPncShutdownEnabled) and 
        (as:modconf('Nm')[1]/NmGlobalConfig/NmGlobalFeatures/NmSynchronizedPncShutdownEnabled = 'true')"!] 
    [!FOR "BusId" = "1" TO "count(text:split($BusNames,' '))"!]
      [!VAR "CurrentBusName" = "text:split($BusNames,' ')[position() = $BusId]"!] 
                  <BSW-CALLED-ENTITY>
                    <SHORT-NAME>BswCalledEnt_Nm_RequestSynchronizedPncShutdown_Nm_To_[!"$CurrentBusName"!]_DataSntFnct</SHORT-NAME>
                    <MINIMUM-START-INTERVAL>0.0</MINIMUM-START-INTERVAL>
                    <DATA-SEND-POINTS>
                      <BSW-VARIABLE-ACCESS>
                        <SHORT-NAME>BswVarAccess_Nm_To_RequestSynchronizedPncShutdown_Nm_To_[!"$CurrentBusName"!]_DataSet</SHORT-NAME>
                        <ACCESSED-VARIABLE-REF DEST="VARIABLE-DATA-PROTOTYPE">/AUTOSAR_Nm/BswModuleDescriptions/Nm/Nm_RequestSynchronizedPncShutdown_Nm_To_[!"$CurrentBusName"!]_DataSet</ACCESSED-VARIABLE-REF>
                      </BSW-VARIABLE-ACCESS>
                    </DATA-SEND-POINTS>
                    <IMPLEMENTED-ENTRY-REF DEST="BSW-MODULE-ENTRY">/AUTOSAR_Nm/BswModuleEntrys/Nm_RequestSynchronizedPncShutdown_Nm_To_[!"$CurrentBusName"!]_DataSntFnct</IMPLEMENTED-ENTRY-REF>
                  </BSW-CALLED-ENTITY>  
    [!ENDFOR!] [!/* [!FOR "BusId" = "1" TO "count(text:split($BusNames,' '))"!] */!]
  [!ENDIF!] [!/* [!IF "node:exists(as:modconf('Nm')[1]/NmGlobalConfig/NmGlobalFeatures/NmSynchronizedPncShutdownEnabled) and 
               *      (as:modconf('Nm')[1]/NmGlobalConfig/NmGlobalFeatures/NmSynchronizedPncShutdownEnabled = 'true')"!]  
               */!]
[!ENDIF!][!//
                  </ENTITYS>

                  <EVENTS>
                    <BSW-TIMING-EVENT>
                      <SHORT-NAME>TimingEvent_MainFunction</SHORT-NAME>
                      <STARTS-ON-EVENT-REF DEST="BSW-SCHEDULABLE-ENTITY">/AUTOSAR_Nm/BswModuleDescriptions/Nm/InternalBehavior_0/Nm_MainFunction</STARTS-ON-EVENT-REF>
                      <PERIOD>[!"NmGlobalConfig/NmGlobalProperties/NmCycletimeMainFunction"!]</PERIOD>
                    </BSW-TIMING-EVENT>
[!IF "NmGlobalConfig/NmGlobalFeatures/NmMultiCoreSupport = 'true'"!][!//
  [!LOOP "as:modconf('Nm')[1]/NmChannelConfig/*[(node:exists(NmBusType/NmStandardBusType)) and
                                                (NmBusType/NmStandardBusType='NM_BUSNM_CANNM' or
                                                 NmBusType/NmStandardBusType='NM_BUSNM_FRNM' or
                                                 NmBusType/NmStandardBusType='NM_BUSNM_UDPNM')]"!][!//
    [!VAR "GenerateCarwakeup"="0"!][!//
    [!IF "NmBusType/NmStandardBusType='NM_BUSNM_CANNM'"!][!//
      [!IF "(count(as:modconf('CanNm')[1]/CanNmGlobalConfig/*[1]/CanNmChannelConfig/*[(node:exists(CanNmComMNetworkHandleRef)) and (CanNmComMNetworkHandleRef=node:current()/NmComMChannelRef)]/CanNmCarWakeUpRxEnabled) = 1) and
            (as:modconf('CanNm')[1]/CanNmGlobalConfig/*[1]/CanNmChannelConfig/*[(node:exists(CanNmComMNetworkHandleRef)) and (CanNmComMNetworkHandleRef=node:current()/NmComMChannelRef)]/CanNmCarWakeUpRxEnabled='true')"!][!//
        [!VAR "GenerateCarwakeup"="1"!][!//
      [!ENDIF!][!//
    [!ENDIF!][!//
    [!IF "NmBusType/NmStandardBusType='NM_BUSNM_FRNM'"!][!//
      [!IF "(count(as:modconf('FrNm')[1]/FrNmChannelConfig/*[1]/FrNmChannel/*/FrNmChannelIdentifiers[(node:exists(FrNmComMNetworkHandleRef)) and (FrNmComMNetworkHandleRef=node:current()/NmComMChannelRef)]/FrNmCarWakeUpRxEnabled) = 1) and
            (as:modconf('FrNm')[1]/FrNmChannelConfig/*[1]/FrNmChannel/*/FrNmChannelIdentifiers[(node:exists(FrNmComMNetworkHandleRef)) and (FrNmComMNetworkHandleRef=node:current()/NmComMChannelRef)]/FrNmCarWakeUpRxEnabled='true')"!][!//
        [!VAR "GenerateCarwakeup"="1"!][!//
      [!ENDIF!][!//
    [!ENDIF!][!//
    [!IF "NmBusType/NmStandardBusType='NM_BUSNM_UDPNM'"!][!//
      [!IF "(count(as:modconf('UdpNm')[1]/UdpNmGlobalConfig/*[1]/UdpNmChannelConfig/*[(node:exists(UdpNmComMNetworkHandleRef)) and (UdpNmComMNetworkHandleRef=node:current()/NmComMChannelRef)]/UdpNmCarWakeUpRxEnabled) = 1) and
            (as:modconf('UdpNm')[1]/UdpNmGlobalConfig/*[1]/UdpNmChannelConfig/*[(node:exists(UdpNmComMNetworkHandleRef)) and (UdpNmComMNetworkHandleRef=node:current()/NmComMChannelRef)]/UdpNmCarWakeUpRxEnabled='true')"!][!//
        [!VAR "GenerateCarwakeup"="1"!][!//
      [!ENDIF!][!//
    [!ENDIF!][!//

                    <BSW-INTERNAL-TRIGGER-OCCURRED-EVENT>
                      <SHORT-NAME>IntTrigggering_ComMContext_Event_[!"node:name(.)"!]</SHORT-NAME>
                      <STARTS-ON-EVENT-REF DEST="BSW-SCHEDULABLE-ENTITY">/AUTOSAR_Nm/BswModuleDescriptions/Nm/InternalBehavior_0/Entity_Nm_ComMContext_[!"node:name(.)"!]</STARTS-ON-EVENT-REF>
                      <EVENT-SOURCE-REF DEST="BSW-INTERNAL-TRIGGERING-POINT">/AUTOSAR_Nm/BswModuleDescriptions/Nm/InternalBehavior_0/TriggeringPoint_ComMContext_[!"node:name(.)"!]</EVENT-SOURCE-REF>
                    </BSW-INTERNAL-TRIGGER-OCCURRED-EVENT>
                    <BSW-OPERATION-INVOKED-EVENT>
                      <SHORT-NAME>OpInokedEv_Nm_NetworkStartIndication_[!"node:name(.)"!]</SHORT-NAME>
                      <STARTS-ON-EVENT-REF DEST="BSW-CALLED-ENTITY">/AUTOSAR_Nm/BswModuleDescriptions/Nm/InternalBehavior_0/Nm_NetworkStartIndication_CalledEntity_[!"node:name(.)"!]</STARTS-ON-EVENT-REF>
                      <ENTRY-REF DEST="BSW-MODULE-CLIENT-SERVER-ENTRY">/AUTOSAR_Nm/BswModuleDescriptions/Nm/ProvidedCSEntry_Nm_NetworkStartIndication_[!"node:name(.)"!]</ENTRY-REF>
                    </BSW-OPERATION-INVOKED-EVENT>

                    <BSW-OPERATION-INVOKED-EVENT>
                      <SHORT-NAME>OpInokedEv_Nm_NetworkMode_[!"node:name(.)"!]</SHORT-NAME>
                      <STARTS-ON-EVENT-REF DEST="BSW-CALLED-ENTITY">/AUTOSAR_Nm/BswModuleDescriptions/Nm/InternalBehavior_0/Nm_NetworkMode_CalledEntity_[!"node:name(.)"!]</STARTS-ON-EVENT-REF>
                      <ENTRY-REF DEST="BSW-MODULE-CLIENT-SERVER-ENTRY">/AUTOSAR_Nm/BswModuleDescriptions/Nm/ProvidedCSEntry_Nm_NetworkMode_[!"node:name(.)"!]</ENTRY-REF>
                    </BSW-OPERATION-INVOKED-EVENT>

                    <BSW-OPERATION-INVOKED-EVENT>
                      <SHORT-NAME>OpInokedEv_Nm_BusSleepMode_[!"node:name(.)"!]</SHORT-NAME>
                      <STARTS-ON-EVENT-REF DEST="BSW-CALLED-ENTITY">/AUTOSAR_Nm/BswModuleDescriptions/Nm/InternalBehavior_0/Nm_BusSleepMode_CalledEntity_[!"node:name(.)"!]</STARTS-ON-EVENT-REF>
                      <ENTRY-REF DEST="BSW-MODULE-CLIENT-SERVER-ENTRY">/AUTOSAR_Nm/BswModuleDescriptions/Nm/ProvidedCSEntry_Nm_BusSleepMode_[!"node:name(.)"!]</ENTRY-REF>
                    </BSW-OPERATION-INVOKED-EVENT>
    [!IF "(NmBusType/NmStandardBusType='NM_BUSNM_CANNM') or (NmBusType/NmStandardBusType='NM_BUSNM_UDPNM')"!][!//

                    <BSW-OPERATION-INVOKED-EVENT>
                      <SHORT-NAME>OpInokedEv_Nm_PrepareBusSleepMode_[!"node:name(.)"!]</SHORT-NAME>
                      <STARTS-ON-EVENT-REF DEST="BSW-CALLED-ENTITY">/AUTOSAR_Nm/BswModuleDescriptions/Nm/InternalBehavior_0/Nm_PrepareBusSleepMode_CalledEntity_[!"node:name(.)"!]</STARTS-ON-EVENT-REF>
                      <ENTRY-REF DEST="BSW-MODULE-CLIENT-SERVER-ENTRY">/AUTOSAR_Nm/BswModuleDescriptions/Nm/ProvidedCSEntry_Nm_PrepareBusSleepMode_[!"node:name(.)"!]</ENTRY-REF>
                    </BSW-OPERATION-INVOKED-EVENT>
    [!ENDIF!][!//
    [!IF "(as:modconf('Nm')[1]/NmGlobalConfig/NmGlobalFeatures/NmCoordinatorSupportEnabled = 'true') or (as:modconf('Nm')[1]/NmGlobalConfig/NmGlobalFeatures/NmProvideRemoteSleepCallbacks = 'true')"!][!//[!//
      [!IF "((NmBusType/NmStandardBusType='NM_BUSNM_CANNM') and
             (node:exists(as:modconf('CanNm')[1]/CanNmGlobalConfig/*[1]/CanNmRemoteSleepIndEnabled)) and
             (as:modconf('CanNm')[1]/CanNmGlobalConfig/*[1]/CanNmRemoteSleepIndEnabled='true'))
            or
            ((NmBusType/NmStandardBusType='NM_BUSNM_FRNM') and
             (node:exists(as:modconf('FrNm')[1]/FrNmGlobalConfig/FrNmGlobalFeatures/FrNmRemoteSleepIndicationEnabled)) and
             (as:modconf('FrNm')[1]/FrNmGlobalConfig/FrNmGlobalFeatures/FrNmRemoteSleepIndicationEnabled = 'true'))
            or
            ((NmBusType/NmStandardBusType='NM_BUSNM_UDPNM') and
             (node:exists(as:modconf('UdpNm')[1]/UdpNmGlobalConfig/*[1]/UdpNmRemoteSleepIndEnabled)) and
             (as:modconf('UdpNm')[1]/UdpNmGlobalConfig/*[1]/UdpNmRemoteSleepIndEnabled='true'))"!][!//

                    <BSW-OPERATION-INVOKED-EVENT>
                      <SHORT-NAME>OpInokedEv_Nm_RemoteSleepIndication_[!"node:name(.)"!]</SHORT-NAME>
                      <STARTS-ON-EVENT-REF DEST="BSW-CALLED-ENTITY">/AUTOSAR_Nm/BswModuleDescriptions/Nm/InternalBehavior_0/Nm_RemoteSleepIndication_CalledEntity_[!"node:name(.)"!]</STARTS-ON-EVENT-REF>
                      <ENTRY-REF DEST="BSW-MODULE-CLIENT-SERVER-ENTRY">/AUTOSAR_Nm/BswModuleDescriptions/Nm/ProvidedCSEntry_Nm_RemoteSleepIndication_[!"node:name(.)"!]</ENTRY-REF>
                    </BSW-OPERATION-INVOKED-EVENT>

                    <BSW-OPERATION-INVOKED-EVENT>
                      <SHORT-NAME>OpInokedEv_Nm_RemoteSleepCancellation_[!"node:name(.)"!]</SHORT-NAME>
                      <STARTS-ON-EVENT-REF DEST="BSW-CALLED-ENTITY">/AUTOSAR_Nm/BswModuleDescriptions/Nm/InternalBehavior_0/Nm_RemoteSleepCancellation_CalledEntity_[!"node:name(.)"!]</STARTS-ON-EVENT-REF>
                      <ENTRY-REF DEST="BSW-MODULE-CLIENT-SERVER-ENTRY">/AUTOSAR_Nm/BswModuleDescriptions/Nm/ProvidedCSEntry_Nm_RemoteSleepCancellation_[!"node:name(.)"!]</ENTRY-REF>
                    </BSW-OPERATION-INVOKED-EVENT>
      [!ENDIF!][!//
    [!ENDIF!][!//
    [!IF "as:modconf('Nm')[1]/NmGlobalConfig/NmGlobalFeatures/NmCoordinatorSupportEnabled = 'true'"!][!//
      [!IF "NmBusType/NmStandardBusType='NM_BUSNM_FRNM'"!][!//

                    <BSW-OPERATION-INVOKED-EVENT>
                      <SHORT-NAME>OpInokedEv_Nm_SynchronizationPoint_[!"node:name(.)"!]</SHORT-NAME>
                      <STARTS-ON-EVENT-REF DEST="BSW-CALLED-ENTITY">/AUTOSAR_Nm/BswModuleDescriptions/Nm/InternalBehavior_0/Nm_SynchronizationPoint_CalledEntity_[!"node:name(.)"!]</STARTS-ON-EVENT-REF>
                      <ENTRY-REF DEST="BSW-MODULE-CLIENT-SERVER-ENTRY">/AUTOSAR_Nm/BswModuleDescriptions/Nm/ProvidedCSEntry_Nm_SynchronizationPoint_[!"node:name(.)"!]</ENTRY-REF>
                    </BSW-OPERATION-INVOKED-EVENT>
      [!ENDIF!][!//
    [!ENDIF!][!//
    [!IF "as:modconf('Nm')[1]/NmGlobalConfig/NmGlobalFeatures/NmBusSynchronizationEnabled = 'true'"!][!//
      [!IF "NmBusType/NmStandardBusType='NM_BUSNM_FRNM'"!][!//

                    <BSW-OPERATION-INVOKED-EVENT>
                      <SHORT-NAME>OpInokedEv_Nm_CoordReadyToSleepIndication_[!"node:name(.)"!]</SHORT-NAME>
                      <STARTS-ON-EVENT-REF DEST="BSW-CALLED-ENTITY">/AUTOSAR_Nm/BswModuleDescriptions/Nm/InternalBehavior_0/Nm_CoordReadyToSleepIndication_CalledEntity_[!"node:name(.)"!]</STARTS-ON-EVENT-REF>
                      <ENTRY-REF DEST="BSW-MODULE-CLIENT-SERVER-ENTRY">/AUTOSAR_Nm/BswModuleDescriptions/Nm/ProvidedCSEntry_Nm_CoordReadyToSleepIndication_[!"node:name(.)"!]</ENTRY-REF>
                    </BSW-OPERATION-INVOKED-EVENT>
      [!ENDIF!][!//
    [!ENDIF!][!//
    [!IF "as:modconf('Nm')[1]/NmGlobalConfig/NmGlobalFeatures/NmPduRxIndicationEnabled = 'true'"!][!//
      [!IF "((NmBusType/NmStandardBusType='NM_BUSNM_CANNM') and
             (node:exists(as:modconf('CanNm')[1]/CanNmGlobalConfig/*[1]/CanNmPduRxIndicationEnabled)) and
             (as:modconf('CanNm')[1]/CanNmGlobalConfig/*[1]/CanNmPduRxIndicationEnabled='true'))
            or
            ((NmBusType/NmStandardBusType='NM_BUSNM_FRNM') and
             (node:exists(as:modconf('FrNm')[1]/FrNmGlobalConfig/FrNmGlobalFeatures/FrNmPduRxIndicationEnabled)) and
             (as:modconf('FrNm')[1]/FrNmGlobalConfig/FrNmGlobalFeatures/FrNmPduRxIndicationEnabled='true'))
            or
            ((NmBusType/NmStandardBusType='NM_BUSNM_UDPNM') and
             (node:exists(as:modconf('UdpNm')[1]/UdpNmGlobalConfig/*[1]/UdpNmPduRxIndicationEnabled)) and
             (as:modconf('UdpNm')[1]/UdpNmGlobalConfig/*[1]/UdpNmPduRxIndicationEnabled='true'))"!][!//

                    <BSW-OPERATION-INVOKED-EVENT>
                      <SHORT-NAME>OpInokedEv_Nm_PduRxIndication_[!"node:name(.)"!]</SHORT-NAME>
                      <STARTS-ON-EVENT-REF DEST="BSW-CALLED-ENTITY">/AUTOSAR_Nm/BswModuleDescriptions/Nm/InternalBehavior_0/Nm_PduRxIndication_CalledEntity_[!"node:name(.)"!]</STARTS-ON-EVENT-REF>
                      <ENTRY-REF DEST="BSW-MODULE-CLIENT-SERVER-ENTRY">/AUTOSAR_Nm/BswModuleDescriptions/Nm/ProvidedCSEntry_Nm_PduRxIndication_[!"node:name(.)"!]</ENTRY-REF>
                    </BSW-OPERATION-INVOKED-EVENT>
      [!ENDIF!][!//
    [!ENDIF!][!//
    [!IF "as:modconf('Nm')[1]/NmGlobalConfig/NmGlobalFeatures/NmStateChangeIndEnabled = 'true'"!][!//
      [!IF "((NmBusType/NmStandardBusType='NM_BUSNM_CANNM') and
             (node:exists(as:modconf('CanNm')[1]/CanNmGlobalConfig/*[1]/CanNmStateChangeIndEnabled)) and
             (as:modconf('CanNm')[1]/CanNmGlobalConfig/*[1]/CanNmStateChangeIndEnabled='true'))
            or
            ((NmBusType/NmStandardBusType='NM_BUSNM_FRNM') and
             (node:exists(as:modconf('FrNm')[1]/FrNmGlobalConfig/FrNmGlobalFeatures/FrNmStateChangeIndicationEnabled)) and
             (as:modconf('FrNm')[1]/FrNmGlobalConfig/FrNmGlobalFeatures/FrNmStateChangeIndicationEnabled = 'true'))
            or
            ((NmBusType/NmStandardBusType='NM_BUSNM_UDPNM') and
             (node:exists(as:modconf('UdpNm')[1]/UdpNmGlobalConfig/*[1]/UdpNmStateChangeIndEnabled)) and
             (as:modconf('UdpNm')[1]/UdpNmGlobalConfig/*[1]/UdpNmStateChangeIndEnabled='true'))"!][!//

                    <BSW-OPERATION-INVOKED-EVENT>
                      <SHORT-NAME>OpInokedEv_Nm_StateChangeNotification_[!"node:name(.)"!]</SHORT-NAME>
                      <STARTS-ON-EVENT-REF DEST="BSW-CALLED-ENTITY">/AUTOSAR_Nm/BswModuleDescriptions/Nm/InternalBehavior_0/Nm_StateChangeNotification_CalledEntity_[!"node:name(.)"!]</STARTS-ON-EVENT-REF>
                      <ENTRY-REF DEST="BSW-MODULE-CLIENT-SERVER-ENTRY">/AUTOSAR_Nm/BswModuleDescriptions/Nm/ProvidedCSEntry_Nm_StateChangeNotification_[!"node:name(.)"!]</ENTRY-REF>
                    </BSW-OPERATION-INVOKED-EVENT>
      [!ENDIF!][!//
    [!ENDIF!][!//
    [!IF "NmRepeatMsgIndEnabled='true'"!][!//

                    <BSW-OPERATION-INVOKED-EVENT>
                      <SHORT-NAME>OpInokedEv_Nm_RepeatMessageIndication_[!"node:name(.)"!]</SHORT-NAME>
                      <STARTS-ON-EVENT-REF DEST="BSW-CALLED-ENTITY">/AUTOSAR_Nm/BswModuleDescriptions/Nm/InternalBehavior_0/Nm_RepeatMessageIndication_CalledEntity_[!"node:name(.)"!]</STARTS-ON-EVENT-REF>
                      <ENTRY-REF DEST="BSW-MODULE-CLIENT-SERVER-ENTRY">/AUTOSAR_Nm/BswModuleDescriptions/Nm/ProvidedCSEntry_Nm_RepeatMessageIndication_[!"node:name(.)"!]</ENTRY-REF>
                    </BSW-OPERATION-INVOKED-EVENT>
    [!ENDIF!][!//
    [!IF "((NmBusType/NmStandardBusType='NM_BUSNM_CANNM') and
           (node:exists(as:modconf('CanNm')[1]/CanNmGlobalConfig/*[1]/CanNmPassiveModeEnabled)) and (as:modconf('CanNm')[1]/CanNmGlobalConfig/*[1]/CanNmPassiveModeEnabled='false') and
           (node:exists(as:modconf('CanNm')[1]/CanNmGlobalConfig/*[1]/CanNmImmediateTxconfEnabled)) and (as:modconf('CanNm')[1]/CanNmGlobalConfig/*[1]/CanNmImmediateTxconfEnabled='false'))
          or
          (NmBusType/NmStandardBusType='NM_BUSNM_FRNM')"!][!//

                    <BSW-OPERATION-INVOKED-EVENT>
                      <SHORT-NAME>OpInokedEv_Nm_TxTimeoutException_[!"node:name(.)"!]</SHORT-NAME>
                      <STARTS-ON-EVENT-REF DEST="BSW-CALLED-ENTITY">/AUTOSAR_Nm/BswModuleDescriptions/Nm/InternalBehavior_0/Nm_TxTimeoutException_CalledEntity_[!"node:name(.)"!]</STARTS-ON-EVENT-REF>
                      <ENTRY-REF DEST="BSW-MODULE-CLIENT-SERVER-ENTRY">/AUTOSAR_Nm/BswModuleDescriptions/Nm/ProvidedCSEntry_Nm_TxTimeoutException_[!"node:name(.)"!]</ENTRY-REF>
                    </BSW-OPERATION-INVOKED-EVENT>
    [!ENDIF!][!//
    [!IF "as:modconf('Nm')[1]/NmGlobalConfig/NmGlobalFeatures/NmCarWakeUpRxEnabled = 'true'"!][!//
      [!IF "$GenerateCarwakeup=1"!][!//

                    <BSW-OPERATION-INVOKED-EVENT>
                      <SHORT-NAME>OpInokedEv_Nm_CarWakeUpIndication_[!"node:name(.)"!]</SHORT-NAME>
                      <STARTS-ON-EVENT-REF DEST="BSW-CALLED-ENTITY">/AUTOSAR_Nm/BswModuleDescriptions/Nm/InternalBehavior_0/Nm_CarWakeUpIndication_CalledEntity_[!"node:name(.)"!]</STARTS-ON-EVENT-REF>
                      <ENTRY-REF DEST="BSW-MODULE-CLIENT-SERVER-ENTRY">/AUTOSAR_Nm/BswModuleDescriptions/Nm/ProvidedCSEntry_Nm_CarWakeUpIndication_[!"node:name(.)"!]</ENTRY-REF>
                    </BSW-OPERATION-INVOKED-EVENT>
      [!ENDIF!][!//
    [!ENDIF!][!//
  [!ENDLOOP!][!//
  [!IF "node:exists(as:modconf('Nm')[1]/NmGlobalConfig/NmGlobalFeatures/NmSynchronizedPncShutdownEnabled) and 
       (as:modconf('Nm')[1]/NmGlobalConfig/NmGlobalFeatures/NmSynchronizedPncShutdownEnabled = 'true')"!]  
    [!FOR "BusId" = "1" TO "count(text:split($BusNames,' '))"!]
      [!VAR "CurrentBusName" = "text:split($BusNames,' ')[position() = $BusId]"!]
      [!VAR "QueueSize" = "text:split($BusNrOfPassiveChannels,' ')[position() = $BusId]"!]
      [!IF "num:i($QueueSize) > 0"!]        
                    <BSW-DATA-RECEIVED-EVENT>
                        <SHORT-NAME>Nm_ForwardSynchronizedPncShutdown_[!"$CurrentBusName"!]_To_Nm_RecEv</SHORT-NAME>
                        <STARTS-ON-EVENT-REF DEST="BSW-SCHEDULABLE-ENTITY">/AUTOSAR_Nm/BswModuleDescriptions/Nm/InternalBehavior_0/BswSchEnt_Nm_ForwardSynchronizedPncShutdown_[!"$CurrentBusName"!]_To_Nm_RcvFnct</STARTS-ON-EVENT-REF>
                        <DATA-REF DEST="VARIABLE-DATA-PROTOTYPE">/AUTOSAR_Nm/BswModuleDescriptions/Nm/Nm_ForwardSynchronizedPncShutdown_[!"$CurrentBusName"!]_To_Nm_DataGet</DATA-REF>
                    </BSW-DATA-RECEIVED-EVENT>
      [!ENDIF!] [!/*[!IF "num:i($QueueSize) > 0"!]*/!]                    
    [!ENDFOR!] [!/* [!FOR "BusId" = "1" TO "count(text:split($BusNames,' '))"!] */!]                    
  [!ENDIF!] [!/* [!IF "node:exists(as:modconf('Nm')[1]/NmGlobalConfig/NmGlobalFeatures/NmSynchronizedPncShutdownEnabled) and 
               *  (as:modconf('Nm')[1]/NmGlobalConfig/NmGlobalFeatures/NmSynchronizedPncShutdownEnabled = 'true')"!]  
               */!]                    
[!ENDIF!][!//

                  </EVENTS>
[!IF "NmGlobalConfig/NmGlobalFeatures/NmMultiCoreSupport = 'true'"!][!//                  
  [!IF "node:exists(as:modconf('Nm')[1]/NmGlobalConfig/NmGlobalFeatures/NmSynchronizedPncShutdownEnabled) and 
       (as:modconf('Nm')[1]/NmGlobalConfig/NmGlobalFeatures/NmSynchronizedPncShutdownEnabled = 'true')"!]  
                  <RECEPTION-POLICYS>                  
    [!FOR "BusId" = "1" TO "count(text:split($BusNames,' '))"!]
      [!VAR "CurrentBusName" = "text:split($BusNames,' ')[position() = $BusId]"!] 
      [!VAR "QueueSize" = "text:split($BusNrOfPassiveChannels,' ')[position() = $BusId]"!]
      [!IF "num:i($QueueSize) > 0"!]
                    <BSW-QUEUED-DATA-RECEPTION-POLICY>
                      <ENABLE-TAKE-ADDRESS>true</ENABLE-TAKE-ADDRESS>
                      <RECEIVED-DATA-REF DEST="VARIABLE-DATA-PROTOTYPE">/AUTOSAR_Nm/BswModuleDescriptions/Nm/Nm_ForwardSynchronizedPncShutdown_[!"$CurrentBusName"!]_To_Nm_DataGet</RECEIVED-DATA-REF>
                      <QUEUE-LENGTH>[!"num:i($QueueSize)"!]</QUEUE-LENGTH>
                    </BSW-QUEUED-DATA-RECEPTION-POLICY>        
      [!ENDIF!] [!/*[!IF "num:i($QueueSize) > 0"!]*/!]
    [!ENDFOR!] [!/*[!FOR "BusId" = "1" TO "count(text:split($BusNames,' '))"!]*/!]
                  </RECEPTION-POLICYS>      
  [!ENDIF!] [!/*[!IF "node:exists(as:modconf('Nm')[1]/NmGlobalConfig/NmGlobalFeatures/NmSynchronizedPncShutdownEnabled) and 
               *      (as:modconf('Nm')[1]/NmGlobalConfig/NmGlobalFeatures/NmSynchronizedPncShutdownEnabled = 'true')"!]  
               */!]
[!ENDIF!] [!/*[!IF "NmGlobalConfig/NmGlobalFeatures/NmMultiCoreSupport = 'true'"!]*/!]                  

                </BSW-INTERNAL-BEHAVIOR>

              </INTERNAL-BEHAVIORS>

            </BSW-MODULE-DESCRIPTION>
          </ELEMENTS>

        </AR-PACKAGE>
        <AR-PACKAGE>
          <SHORT-NAME>BswModuleEntrys</SHORT-NAME>
          <ELEMENTS>
            <BSW-MODULE-ENTRY>
              <SHORT-NAME>Nm_MainFunction</SHORT-NAME>
              <SERVICE-ID>0x10</SERVICE-ID>
              <IS-REENTRANT>false</IS-REENTRANT>
              <IS-SYNCHRONOUS>true</IS-SYNCHRONOUS>
              <CALL-TYPE>SCHEDULED</CALL-TYPE>
              <EXECUTION-CONTEXT>TASK</EXECUTION-CONTEXT>
              <SW-SERVICE-IMPL-POLICY>STANDARD</SW-SERVICE-IMPL-POLICY>
              <ARGUMENTS>
              </ARGUMENTS>
            </BSW-MODULE-ENTRY>
[!IF "NmGlobalConfig/NmGlobalFeatures/NmMultiCoreSupport = 'true'"!][!//

            <BSW-MODULE-ENTRY>
              <SHORT-NAME>Nm_Dummy_ComMContext</SHORT-NAME>
              <ADMIN-DATA>
                <SDGS>
                  <SDG GID="EB:DnT">
                    <SD GID="FunctionGroup">Extern</SD>
                    <SD GID="EnableTracing">true</SD>
                  </SDG>
                 </SDGS>
              </ADMIN-DATA>
              <SERVICE-ID>255</SERVICE-ID>
              <IS-REENTRANT>true</IS-REENTRANT>
              <IS-SYNCHRONOUS>false</IS-SYNCHRONOUS>
              <CALL-TYPE>SCHEDULED</CALL-TYPE>
              <EXECUTION-CONTEXT>TASK</EXECUTION-CONTEXT>
              <SW-SERVICE-IMPL-POLICY>STANDARD</SW-SERVICE-IMPL-POLICY>
              <ARGUMENTS>
              </ARGUMENTS>
            </BSW-MODULE-ENTRY>

            <BSW-MODULE-ENTRY>
              <SHORT-NAME>Nm_NetworkStartIndication</SHORT-NAME>
              <ADMIN-DATA>
                <SDGS>
                  <SDG GID="EB:DnT">
                    <SD GID="FunctionGroup">Extern</SD>
                    <SD GID="EnableTracing">true</SD>
                  </SDG>
                 </SDGS>
              </ADMIN-DATA>
              <SERVICE-ID>17</SERVICE-ID>
              <IS-REENTRANT>true</IS-REENTRANT>
              <IS-SYNCHRONOUS>false</IS-SYNCHRONOUS>
              <CALL-TYPE>REGULAR</CALL-TYPE>
              <EXECUTION-CONTEXT>TASK</EXECUTION-CONTEXT>
              <SW-SERVICE-IMPL-POLICY>STANDARD</SW-SERVICE-IMPL-POLICY>
              <ARGUMENTS>
                <SW-SERVICE-ARG>
                  <SHORT-NAME>nmNetworkHandle</SHORT-NAME>
                  <DIRECTION>IN</DIRECTION>
                  <SW-DATA-DEF-PROPS>
                    <SW-DATA-DEF-PROPS-VARIANTS>
                      <SW-DATA-DEF-PROPS-CONDITIONAL>
                        <IMPLEMENTATION-DATA-TYPE-REF DEST="IMPLEMENTATION-DATA-TYPE">/AUTOSAR_Platform/ImplementationDataTypes/uint8</IMPLEMENTATION-DATA-TYPE-REF>
                      </SW-DATA-DEF-PROPS-CONDITIONAL>
                    </SW-DATA-DEF-PROPS-VARIANTS>
                  </SW-DATA-DEF-PROPS>
                </SW-SERVICE-ARG>
              </ARGUMENTS>
            </BSW-MODULE-ENTRY>

            <BSW-MODULE-ENTRY>
              <SHORT-NAME>Nm_NetworkMode</SHORT-NAME>
              <ADMIN-DATA>
                <SDGS>
                  <SDG GID="EB:DnT">
                    <SD GID="FunctionGroup">Extern</SD>
                    <SD GID="EnableTracing">true</SD>
                  </SDG>
                 </SDGS>
              </ADMIN-DATA>
              <SERVICE-ID>18</SERVICE-ID>
              <IS-REENTRANT>true</IS-REENTRANT>
              <IS-SYNCHRONOUS>false</IS-SYNCHRONOUS>
              <CALL-TYPE>REGULAR</CALL-TYPE>
              <EXECUTION-CONTEXT>TASK</EXECUTION-CONTEXT>
              <SW-SERVICE-IMPL-POLICY>STANDARD</SW-SERVICE-IMPL-POLICY>
              <ARGUMENTS>
                <SW-SERVICE-ARG>
                  <SHORT-NAME>nmNetworkHandle</SHORT-NAME>
                  <DIRECTION>IN</DIRECTION>
                  <SW-DATA-DEF-PROPS>
                    <SW-DATA-DEF-PROPS-VARIANTS>
                      <SW-DATA-DEF-PROPS-CONDITIONAL>
                        <IMPLEMENTATION-DATA-TYPE-REF DEST="IMPLEMENTATION-DATA-TYPE">/AUTOSAR_Platform/ImplementationDataTypes/uint8</IMPLEMENTATION-DATA-TYPE-REF>
                      </SW-DATA-DEF-PROPS-CONDITIONAL>
                    </SW-DATA-DEF-PROPS-VARIANTS>
                  </SW-DATA-DEF-PROPS>
                </SW-SERVICE-ARG>
              </ARGUMENTS>
            </BSW-MODULE-ENTRY>

            <BSW-MODULE-ENTRY>
              <SHORT-NAME>Nm_BusSleepMode</SHORT-NAME>
              <ADMIN-DATA>
                <SDGS>
                  <SDG GID="EB:DnT">
                    <SD GID="FunctionGroup">Extern</SD>
                    <SD GID="EnableTracing">true</SD>
                  </SDG>
                 </SDGS>
              </ADMIN-DATA>
              <SERVICE-ID>20</SERVICE-ID>
              <IS-REENTRANT>true</IS-REENTRANT>
              <IS-SYNCHRONOUS>false</IS-SYNCHRONOUS>
              <CALL-TYPE>REGULAR</CALL-TYPE>
              <EXECUTION-CONTEXT>TASK</EXECUTION-CONTEXT>
              <SW-SERVICE-IMPL-POLICY>STANDARD</SW-SERVICE-IMPL-POLICY>
              <ARGUMENTS>
                <SW-SERVICE-ARG>
                  <SHORT-NAME>nmNetworkHandle</SHORT-NAME>
                  <DIRECTION>IN</DIRECTION>
                  <SW-DATA-DEF-PROPS>
                    <SW-DATA-DEF-PROPS-VARIANTS>
                      <SW-DATA-DEF-PROPS-CONDITIONAL>
                        <IMPLEMENTATION-DATA-TYPE-REF DEST="IMPLEMENTATION-DATA-TYPE">/AUTOSAR_Platform/ImplementationDataTypes/uint8</IMPLEMENTATION-DATA-TYPE-REF>
                      </SW-DATA-DEF-PROPS-CONDITIONAL>
                    </SW-DATA-DEF-PROPS-VARIANTS>
                  </SW-DATA-DEF-PROPS>
                </SW-SERVICE-ARG>
              </ARGUMENTS>
            </BSW-MODULE-ENTRY>

            <BSW-MODULE-ENTRY>
              <SHORT-NAME>Nm_PrepareBusSleepMode</SHORT-NAME>
              <ADMIN-DATA>
                <SDGS>
                  <SDG GID="EB:DnT">
                    <SD GID="FunctionGroup">Extern</SD>
                    <SD GID="EnableTracing">true</SD>
                  </SDG>
                 </SDGS>
              </ADMIN-DATA>
              <SERVICE-ID>19</SERVICE-ID>
              <IS-REENTRANT>true</IS-REENTRANT>
              <IS-SYNCHRONOUS>false</IS-SYNCHRONOUS>
              <CALL-TYPE>REGULAR</CALL-TYPE>
              <EXECUTION-CONTEXT>TASK</EXECUTION-CONTEXT>
              <SW-SERVICE-IMPL-POLICY>STANDARD</SW-SERVICE-IMPL-POLICY>
              <ARGUMENTS>
                <SW-SERVICE-ARG>
                  <SHORT-NAME>nmNetworkHandle</SHORT-NAME>
                  <DIRECTION>IN</DIRECTION>
                  <SW-DATA-DEF-PROPS>
                    <SW-DATA-DEF-PROPS-VARIANTS>
                      <SW-DATA-DEF-PROPS-CONDITIONAL>
                        <IMPLEMENTATION-DATA-TYPE-REF DEST="IMPLEMENTATION-DATA-TYPE">/AUTOSAR_Platform/ImplementationDataTypes/uint8</IMPLEMENTATION-DATA-TYPE-REF>
                      </SW-DATA-DEF-PROPS-CONDITIONAL>
                    </SW-DATA-DEF-PROPS-VARIANTS>
                  </SW-DATA-DEF-PROPS>
                </SW-SERVICE-ARG>
              </ARGUMENTS>
            </BSW-MODULE-ENTRY>
  [!IF "(as:modconf('Nm')[1]/NmGlobalConfig/NmGlobalFeatures/NmCoordinatorSupportEnabled = 'true') or (as:modconf('Nm')[1]/NmGlobalConfig/NmGlobalFeatures/NmProvideRemoteSleepCallbacks = 'true')"!][!//[!//
            <BSW-MODULE-ENTRY>
              <SHORT-NAME>Nm_RemoteSleepIndication</SHORT-NAME>
              <ADMIN-DATA>
                <SDGS>
                  <SDG GID="EB:DnT">
                    <SD GID="FunctionGroup">Extern</SD>
                    <SD GID="EnableTracing">true</SD>
                  </SDG>
                 </SDGS>
              </ADMIN-DATA>
              <SERVICE-ID>23</SERVICE-ID>
              <IS-REENTRANT>true</IS-REENTRANT>
              <IS-SYNCHRONOUS>false</IS-SYNCHRONOUS>
              <CALL-TYPE>REGULAR</CALL-TYPE>
              <EXECUTION-CONTEXT>TASK</EXECUTION-CONTEXT>
              <SW-SERVICE-IMPL-POLICY>STANDARD</SW-SERVICE-IMPL-POLICY>
              <ARGUMENTS>
                <SW-SERVICE-ARG>
                  <SHORT-NAME>nmNetworkHandle</SHORT-NAME>
                  <DIRECTION>IN</DIRECTION>
                  <SW-DATA-DEF-PROPS>
                    <SW-DATA-DEF-PROPS-VARIANTS>
                      <SW-DATA-DEF-PROPS-CONDITIONAL>
                        <IMPLEMENTATION-DATA-TYPE-REF DEST="IMPLEMENTATION-DATA-TYPE">/AUTOSAR_Platform/ImplementationDataTypes/uint8</IMPLEMENTATION-DATA-TYPE-REF>
                      </SW-DATA-DEF-PROPS-CONDITIONAL>
                    </SW-DATA-DEF-PROPS-VARIANTS>
                  </SW-DATA-DEF-PROPS>
                </SW-SERVICE-ARG>
              </ARGUMENTS>
            </BSW-MODULE-ENTRY>

            <BSW-MODULE-ENTRY>
              <SHORT-NAME>Nm_RemoteSleepCancellation</SHORT-NAME>
              <ADMIN-DATA>
                <SDGS>
                  <SDG GID="EB:DnT">
                    <SD GID="FunctionGroup">Extern</SD>
                    <SD GID="EnableTracing">true</SD>
                  </SDG>
                 </SDGS>
              </ADMIN-DATA>
              <SERVICE-ID>24</SERVICE-ID>
              <IS-REENTRANT>true</IS-REENTRANT>
              <IS-SYNCHRONOUS>false</IS-SYNCHRONOUS>
              <CALL-TYPE>REGULAR</CALL-TYPE>
              <EXECUTION-CONTEXT>TASK</EXECUTION-CONTEXT>
              <SW-SERVICE-IMPL-POLICY>STANDARD</SW-SERVICE-IMPL-POLICY>
              <ARGUMENTS>
                <SW-SERVICE-ARG>
                  <SHORT-NAME>nmNetworkHandle</SHORT-NAME>
                  <DIRECTION>IN</DIRECTION>
                  <SW-DATA-DEF-PROPS>
                    <SW-DATA-DEF-PROPS-VARIANTS>
                      <SW-DATA-DEF-PROPS-CONDITIONAL>
                        <IMPLEMENTATION-DATA-TYPE-REF DEST="IMPLEMENTATION-DATA-TYPE">/AUTOSAR_Platform/ImplementationDataTypes/uint8</IMPLEMENTATION-DATA-TYPE-REF>
                      </SW-DATA-DEF-PROPS-CONDITIONAL>
                    </SW-DATA-DEF-PROPS-VARIANTS>
                  </SW-DATA-DEF-PROPS>
                </SW-SERVICE-ARG>
              </ARGUMENTS>
            </BSW-MODULE-ENTRY>
  [!ENDIF!][!//
  [!IF "as:modconf('Nm')[1]/NmGlobalConfig/NmGlobalFeatures/NmCoordinatorSupportEnabled = 'true'"!][!//

            <BSW-MODULE-ENTRY>
              <SHORT-NAME>Nm_SynchronizationPoint</SHORT-NAME>
              <ADMIN-DATA>
                <SDGS>
                  <SDG GID="EB:DnT">
                    <SD GID="FunctionGroup">Extern</SD>
                    <SD GID="EnableTracing">true</SD>
                  </SDG>
                 </SDGS>
              </ADMIN-DATA>
              <SERVICE-ID>25</SERVICE-ID>
              <IS-REENTRANT>true</IS-REENTRANT>
              <IS-SYNCHRONOUS>false</IS-SYNCHRONOUS>
              <CALL-TYPE>REGULAR</CALL-TYPE>
              <EXECUTION-CONTEXT>TASK</EXECUTION-CONTEXT>
              <SW-SERVICE-IMPL-POLICY>STANDARD</SW-SERVICE-IMPL-POLICY>
              <ARGUMENTS>
                <SW-SERVICE-ARG>
                  <SHORT-NAME>nmNetworkHandle</SHORT-NAME>
                  <DIRECTION>IN</DIRECTION>
                  <SW-DATA-DEF-PROPS>
                    <SW-DATA-DEF-PROPS-VARIANTS>
                      <SW-DATA-DEF-PROPS-CONDITIONAL>
                        <IMPLEMENTATION-DATA-TYPE-REF DEST="IMPLEMENTATION-DATA-TYPE">/AUTOSAR_Platform/ImplementationDataTypes/uint8</IMPLEMENTATION-DATA-TYPE-REF>
                      </SW-DATA-DEF-PROPS-CONDITIONAL>
                    </SW-DATA-DEF-PROPS-VARIANTS>
                  </SW-DATA-DEF-PROPS>
                </SW-SERVICE-ARG>
              </ARGUMENTS>
            </BSW-MODULE-ENTRY>
  [!ENDIF!][!//
  [!IF "as:modconf('Nm')[1]/NmGlobalConfig/NmGlobalFeatures/NmBusSynchronizationEnabled = 'true'"!][!//

            <BSW-MODULE-ENTRY>
              <SHORT-NAME>Nm_CoordReadyToSleepIndication</SHORT-NAME>
              <ADMIN-DATA>
                <SDGS>
                  <SDG GID="EB:DnT">
                    <SD GID="FunctionGroup">Extern</SD>
                    <SD GID="EnableTracing">true</SD>
                  </SDG>
                 </SDGS>
              </ADMIN-DATA>
              <SERVICE-ID>30</SERVICE-ID>
              <IS-REENTRANT>false</IS-REENTRANT>
              <IS-SYNCHRONOUS>false</IS-SYNCHRONOUS>
              <CALL-TYPE>REGULAR</CALL-TYPE>
              <EXECUTION-CONTEXT>TASK</EXECUTION-CONTEXT>
              <SW-SERVICE-IMPL-POLICY>STANDARD</SW-SERVICE-IMPL-POLICY>
              <ARGUMENTS>
                <SW-SERVICE-ARG>
                  <SHORT-NAME>nmNetworkHandle</SHORT-NAME>
                  <DIRECTION>IN</DIRECTION>
                  <SW-DATA-DEF-PROPS>
                    <SW-DATA-DEF-PROPS-VARIANTS>
                      <SW-DATA-DEF-PROPS-CONDITIONAL>
                        <IMPLEMENTATION-DATA-TYPE-REF DEST="IMPLEMENTATION-DATA-TYPE">/AUTOSAR_Platform/ImplementationDataTypes/uint8</IMPLEMENTATION-DATA-TYPE-REF>
                      </SW-DATA-DEF-PROPS-CONDITIONAL>
                    </SW-DATA-DEF-PROPS-VARIANTS>
                  </SW-DATA-DEF-PROPS>
                </SW-SERVICE-ARG>
              </ARGUMENTS>
            </BSW-MODULE-ENTRY>
  [!ENDIF!][!//
  [!IF "as:modconf('Nm')[1]/NmGlobalConfig/NmGlobalFeatures/NmPduRxIndicationEnabled = 'true'"!][!//

            <BSW-MODULE-ENTRY>
              <SHORT-NAME>Nm_PduRxIndication</SHORT-NAME>
              <ADMIN-DATA>
                <SDGS>
                  <SDG GID="EB:DnT">
                    <SD GID="FunctionGroup">Extern</SD>
                    <SD GID="EnableTracing">true</SD>
                  </SDG>
                 </SDGS>
              </ADMIN-DATA>
              <SERVICE-ID>21</SERVICE-ID>
              <IS-REENTRANT>true</IS-REENTRANT>
              <IS-SYNCHRONOUS>false</IS-SYNCHRONOUS>
              <CALL-TYPE>REGULAR</CALL-TYPE>
              <EXECUTION-CONTEXT>TASK</EXECUTION-CONTEXT>
              <SW-SERVICE-IMPL-POLICY>STANDARD</SW-SERVICE-IMPL-POLICY>
              <ARGUMENTS>
                <SW-SERVICE-ARG>
                  <SHORT-NAME>nmNetworkHandle</SHORT-NAME>
                  <DIRECTION>IN</DIRECTION>
                  <SW-DATA-DEF-PROPS>
                    <SW-DATA-DEF-PROPS-VARIANTS>
                      <SW-DATA-DEF-PROPS-CONDITIONAL>
                        <IMPLEMENTATION-DATA-TYPE-REF DEST="IMPLEMENTATION-DATA-TYPE">/AUTOSAR_Platform/ImplementationDataTypes/uint8</IMPLEMENTATION-DATA-TYPE-REF>
                      </SW-DATA-DEF-PROPS-CONDITIONAL>
                    </SW-DATA-DEF-PROPS-VARIANTS>
                  </SW-DATA-DEF-PROPS>
                </SW-SERVICE-ARG>
              </ARGUMENTS>
            </BSW-MODULE-ENTRY>
  [!ENDIF!][!//
  [!IF "count(as:modconf('Nm')[1]/NmChannelConfig/*[NmRepeatMsgIndEnabled = 'true']) > 0"!][!//

            <BSW-MODULE-ENTRY>
              <SHORT-NAME>Nm_RepeatMessageIndication</SHORT-NAME>
              <ADMIN-DATA>
                <SDGS>
                  <SDG GID="EB:DnT">
                    <SD GID="FunctionGroup">Extern</SD>
                    <SD GID="EnableTracing">true</SD>
                  </SDG>
                 </SDGS>
              </ADMIN-DATA>
              <SERVICE-ID>26</SERVICE-ID>
              <IS-REENTRANT>true</IS-REENTRANT>
              <IS-SYNCHRONOUS>false</IS-SYNCHRONOUS>
              <CALL-TYPE>REGULAR</CALL-TYPE>
              <EXECUTION-CONTEXT>TASK</EXECUTION-CONTEXT>
              <SW-SERVICE-IMPL-POLICY>STANDARD</SW-SERVICE-IMPL-POLICY>
              <ARGUMENTS>
                <SW-SERVICE-ARG>
                  <SHORT-NAME>nmNetworkHandle</SHORT-NAME>
                  <DIRECTION>IN</DIRECTION>
                  <SW-DATA-DEF-PROPS>
                    <SW-DATA-DEF-PROPS-VARIANTS>
                      <SW-DATA-DEF-PROPS-CONDITIONAL>
                        <IMPLEMENTATION-DATA-TYPE-REF DEST="IMPLEMENTATION-DATA-TYPE">/AUTOSAR_Platform/ImplementationDataTypes/uint8</IMPLEMENTATION-DATA-TYPE-REF>
                      </SW-DATA-DEF-PROPS-CONDITIONAL>
                    </SW-DATA-DEF-PROPS-VARIANTS>
                  </SW-DATA-DEF-PROPS>
                </SW-SERVICE-ARG>
              </ARGUMENTS>
            </BSW-MODULE-ENTRY>
  [!ENDIF!][!//

            <BSW-MODULE-ENTRY>
              <SHORT-NAME>Nm_TxTimeoutException</SHORT-NAME>
              <ADMIN-DATA>
                <SDGS>
                  <SDG GID="EB:DnT">
                    <SD GID="FunctionGroup">Extern</SD>
                    <SD GID="EnableTracing">true</SD>
                  </SDG>
                 </SDGS>
              </ADMIN-DATA>
              <SERVICE-ID>27</SERVICE-ID>
              <IS-REENTRANT>true</IS-REENTRANT>
              <IS-SYNCHRONOUS>false</IS-SYNCHRONOUS>
              <CALL-TYPE>REGULAR</CALL-TYPE>
              <EXECUTION-CONTEXT>TASK</EXECUTION-CONTEXT>
              <SW-SERVICE-IMPL-POLICY>STANDARD</SW-SERVICE-IMPL-POLICY>
              <ARGUMENTS>
                <SW-SERVICE-ARG>
                  <SHORT-NAME>nmNetworkHandle</SHORT-NAME>
                  <DIRECTION>IN</DIRECTION>
                  <SW-DATA-DEF-PROPS>
                    <SW-DATA-DEF-PROPS-VARIANTS>
                      <SW-DATA-DEF-PROPS-CONDITIONAL>
                        <IMPLEMENTATION-DATA-TYPE-REF DEST="IMPLEMENTATION-DATA-TYPE">/AUTOSAR_Platform/ImplementationDataTypes/uint8</IMPLEMENTATION-DATA-TYPE-REF>
                      </SW-DATA-DEF-PROPS-CONDITIONAL>
                    </SW-DATA-DEF-PROPS-VARIANTS>
                  </SW-DATA-DEF-PROPS>
                </SW-SERVICE-ARG>
              </ARGUMENTS>
            </BSW-MODULE-ENTRY>
  [!IF "as:modconf('Nm')[1]/NmGlobalConfig/NmGlobalFeatures/NmCarWakeUpRxEnabled = 'true'"!][!//

            <BSW-MODULE-ENTRY>
              <SHORT-NAME>Nm_CarWakeUpIndication</SHORT-NAME>
              <ADMIN-DATA>
                <SDGS>
                  <SDG GID="EB:DnT">
                    <SD GID="FunctionGroup">Extern</SD>
                    <SD GID="EnableTracing">true</SD>
                  </SDG>
                 </SDGS>
              </ADMIN-DATA>
              <SERVICE-ID>29</SERVICE-ID>
              <IS-REENTRANT>true</IS-REENTRANT>
              <IS-SYNCHRONOUS>false</IS-SYNCHRONOUS>
              <CALL-TYPE>REGULAR</CALL-TYPE>
              <EXECUTION-CONTEXT>TASK</EXECUTION-CONTEXT>
              <SW-SERVICE-IMPL-POLICY>STANDARD</SW-SERVICE-IMPL-POLICY>
              <ARGUMENTS>
                <SW-SERVICE-ARG>
                  <SHORT-NAME>nmNetworkHandle</SHORT-NAME>
                  <DIRECTION>IN</DIRECTION>
                  <SW-DATA-DEF-PROPS>
                    <SW-DATA-DEF-PROPS-VARIANTS>
                      <SW-DATA-DEF-PROPS-CONDITIONAL>
                        <IMPLEMENTATION-DATA-TYPE-REF DEST="IMPLEMENTATION-DATA-TYPE">/AUTOSAR_Platform/ImplementationDataTypes/uint8</IMPLEMENTATION-DATA-TYPE-REF>
                      </SW-DATA-DEF-PROPS-CONDITIONAL>
                    </SW-DATA-DEF-PROPS-VARIANTS>
                  </SW-DATA-DEF-PROPS>
                </SW-SERVICE-ARG>
              </ARGUMENTS>
            </BSW-MODULE-ENTRY>
  [!ENDIF!][!//
  [!IF "as:modconf('Nm')[1]/NmGlobalConfig/NmGlobalFeatures/NmStateChangeIndEnabled = 'true'"!][!//

            <BSW-MODULE-ENTRY>
              <SHORT-NAME>Nm_StateChangeNotification</SHORT-NAME>
              <ADMIN-DATA>
                <SDGS>
                  <SDG GID="EB:DnT">
                    <SD GID="FunctionGroup">Extern</SD>
                    <SD GID="EnableTracing">true</SD>
                  </SDG>
                 </SDGS>
              </ADMIN-DATA>
              <SERVICE-ID>22</SERVICE-ID>
              <IS-REENTRANT>true</IS-REENTRANT>
              <IS-SYNCHRONOUS>false</IS-SYNCHRONOUS>
              <CALL-TYPE>REGULAR</CALL-TYPE>
              <EXECUTION-CONTEXT>TASK</EXECUTION-CONTEXT>
              <SW-SERVICE-IMPL-POLICY>STANDARD</SW-SERVICE-IMPL-POLICY>
              <ARGUMENTS>
                <SW-SERVICE-ARG>
                  <SHORT-NAME>nmNetworkHandle</SHORT-NAME>
                  <DIRECTION>IN</DIRECTION>
                  <SW-DATA-DEF-PROPS>
                    <SW-DATA-DEF-PROPS-VARIANTS>
                      <SW-DATA-DEF-PROPS-CONDITIONAL>
                        <IMPLEMENTATION-DATA-TYPE-REF DEST="IMPLEMENTATION-DATA-TYPE">/AUTOSAR_Platform/ImplementationDataTypes/uint8</IMPLEMENTATION-DATA-TYPE-REF>
                      </SW-DATA-DEF-PROPS-CONDITIONAL>
                    </SW-DATA-DEF-PROPS-VARIANTS>
                  </SW-DATA-DEF-PROPS>
                </SW-SERVICE-ARG>
                <SW-SERVICE-ARG>
                  <SHORT-NAME>nmPreviousState</SHORT-NAME>
                  <DIRECTION>IN</DIRECTION>
                  <SW-DATA-DEF-PROPS>
                    <SW-DATA-DEF-PROPS-VARIANTS>
                      <SW-DATA-DEF-PROPS-CONDITIONAL>
                        <IMPLEMENTATION-DATA-TYPE-REF DEST="IMPLEMENTATION-DATA-TYPE">/AUTOSAR_Nm/ImplementationDataTypes/Nm_StateType</IMPLEMENTATION-DATA-TYPE-REF>
                      </SW-DATA-DEF-PROPS-CONDITIONAL>
                    </SW-DATA-DEF-PROPS-VARIANTS>
                  </SW-DATA-DEF-PROPS>
                </SW-SERVICE-ARG>
                <SW-SERVICE-ARG>
                  <SHORT-NAME>nmCurrentState</SHORT-NAME>
                  <DIRECTION>IN</DIRECTION>
                  <SW-DATA-DEF-PROPS>
                    <SW-DATA-DEF-PROPS-VARIANTS>
                      <SW-DATA-DEF-PROPS-CONDITIONAL>
                        <IMPLEMENTATION-DATA-TYPE-REF DEST="IMPLEMENTATION-DATA-TYPE">/AUTOSAR_Nm/ImplementationDataTypes/Nm_StateType</IMPLEMENTATION-DATA-TYPE-REF>
                      </SW-DATA-DEF-PROPS-CONDITIONAL>
                    </SW-DATA-DEF-PROPS-VARIANTS>
                  </SW-DATA-DEF-PROPS>
                </SW-SERVICE-ARG>
              </ARGUMENTS>
            </BSW-MODULE-ENTRY>
  [!ENDIF!][!//
  [!IF "node:exists(as:modconf('Nm')[1]/NmGlobalConfig/NmGlobalFeatures/NmSynchronizedPncShutdownEnabled) and 
        (as:modconf('Nm')[1]/NmGlobalConfig/NmGlobalFeatures/NmSynchronizedPncShutdownEnabled = 'true')"!]  
    [!FOR "BusId" = "1" TO "count(text:split($BusNames,' '))"!]
      [!VAR "CurrentBusName" = "text:split($BusNames,' ')[position() = $BusId]"!] 
      [!VAR "QueueSize" = "text:split($BusNrOfPassiveChannels,' ')[position() = $BusId]"!]
            <BSW-MODULE-ENTRY>
              <SHORT-NAME>Nm_RequestSynchronizedPncShutdown_Nm_To_[!"$CurrentBusName"!]_DataSntFnct</SHORT-NAME>
              <ADMIN-DATA>
                <SDGS>
                  <SDG GID="EB:DnT">
                    <SD GID="FunctionGroup">Extern</SD>
                    <SD GID="EnableTracing">true</SD>
                  </SDG>
                 </SDGS>
              </ADMIN-DATA>
              <SERVICE-ID>255</SERVICE-ID>
              <IS-REENTRANT>true</IS-REENTRANT>
              <IS-SYNCHRONOUS>false</IS-SYNCHRONOUS>
              <CALL-TYPE>REGULAR</CALL-TYPE>
              <EXECUTION-CONTEXT>TASK</EXECUTION-CONTEXT>
              <SW-SERVICE-IMPL-POLICY>STANDARD</SW-SERVICE-IMPL-POLICY>
              <ARGUMENTS>
                <SW-SERVICE-ARG>
                  <SHORT-NAME>inData</SHORT-NAME>
                  <DIRECTION>IN</DIRECTION>
                  <SW-DATA-DEF-PROPS>
                    <SW-DATA-DEF-PROPS-VARIANTS>
                      <SW-DATA-DEF-PROPS-CONDITIONAL>
                        <IMPLEMENTATION-DATA-TYPE-REF DEST="IMPLEMENTATION-DATA-TYPE">/AUTOSAR_Nm/ImplementationDataTypes/Nm_PnSyncShutdown_Nm_To_BusNm_DataType</IMPLEMENTATION-DATA-TYPE-REF>
                      </SW-DATA-DEF-PROPS-CONDITIONAL>
                    </SW-DATA-DEF-PROPS-VARIANTS>
                  </SW-DATA-DEF-PROPS>
                </SW-SERVICE-ARG>
              </ARGUMENTS>
            </BSW-MODULE-ENTRY>  
      [!IF "num:i($QueueSize) > 0"!]
            <BSW-MODULE-ENTRY>
              <SHORT-NAME>Nm_ForwardSynchronizedPncShutdown_[!"$CurrentBusName"!]_To_Nm_RcvFnct</SHORT-NAME>
              <ADMIN-DATA>
                <SDGS>
                  <SDG GID="EB:DnT">
                    <SD GID="FunctionGroup">Extern</SD>
                    <SD GID="EnableTracing">true</SD>
                  </SDG>
                 </SDGS>
              </ADMIN-DATA>
              <SERVICE-ID>255</SERVICE-ID>
              <IS-REENTRANT>true</IS-REENTRANT>
              <IS-SYNCHRONOUS>false</IS-SYNCHRONOUS>
              <CALL-TYPE>SCHEDULED</CALL-TYPE>
              <EXECUTION-CONTEXT>TASK</EXECUTION-CONTEXT>
              <SW-SERVICE-IMPL-POLICY>STANDARD</SW-SERVICE-IMPL-POLICY>
              <ARGUMENTS>
              </ARGUMENTS>
            </BSW-MODULE-ENTRY>      
      [!ENDIF!] [!/*[!IF "num:i($QueueSize) > 0"!]*/!]
    [!ENDFOR!] [!/* [!FOR "BusId" = "1" TO "count(text:split($BusNames,' '))"!] */!]
  [!ENDIF!] [!/* [!IF "node:exists(as:modconf('Nm')[1]/NmGlobalConfig/NmGlobalFeatures/NmSynchronizedPncShutdownEnabled) and 
               *      (as:modconf('Nm')[1]/NmGlobalConfig/NmGlobalFeatures/NmSynchronizedPncShutdownEnabled = 'true')"!]              
               */!]
[!ENDIF!][!//
          </ELEMENTS>
        </AR-PACKAGE>
[!IF "NmGlobalConfig/NmGlobalFeatures/NmMultiCoreSupport = 'true'"!][!//

        <AR-PACKAGE>
          <SHORT-NAME>ImplementationDataTypes</SHORT-NAME>
          <ELEMENTS>
            <IMPLEMENTATION-DATA-TYPE>
              <SHORT-NAME>Nm_StateType</SHORT-NAME>
              <CATEGORY>TYPE_REFERENCE</CATEGORY>
              <ADMIN-DATA>
                <SDGS>
                  <SDG GID="EB:DnT">
                    <SD GID="TypeGroup">Nm_Types</SD>
                  </SDG>
                </SDGS>
              </ADMIN-DATA>
              <SW-DATA-DEF-PROPS>
                <SW-DATA-DEF-PROPS-VARIANTS>
                  <SW-DATA-DEF-PROPS-CONDITIONAL>
                    <IMPLEMENTATION-DATA-TYPE-REF
                      DEST="IMPLEMENTATION-DATA-TYPE">/AUTOSAR_Platform/ImplementationDataTypes/uint8</IMPLEMENTATION-DATA-TYPE-REF>
                  </SW-DATA-DEF-PROPS-CONDITIONAL>
                </SW-DATA-DEF-PROPS-VARIANTS>
              </SW-DATA-DEF-PROPS>
            </IMPLEMENTATION-DATA-TYPE>
  [!IF "node:exists(as:modconf('Nm')[1]/NmGlobalConfig/NmGlobalFeatures/NmSynchronizedPncShutdownEnabled) and 
        (as:modconf('Nm')[1]/NmGlobalConfig/NmGlobalFeatures/NmSynchronizedPncShutdownEnabled = 'true')"!]
            <IMPLEMENTATION-DATA-TYPE>
              <SHORT-NAME>Nm_PnSyncShutdown_Nm_To_BusNm_DataType</SHORT-NAME>
              <CATEGORY>STRUCTURE</CATEGORY>
              <SUB-ELEMENTS>
                <IMPLEMENTATION-DATA-TYPE-ELEMENT>
                  <SHORT-NAME>PncId</SHORT-NAME>
                  <CATEGORY>TYPE_REFERENCE</CATEGORY>
                  <SW-DATA-DEF-PROPS>
                    <SW-DATA-DEF-PROPS-VARIANTS>
                      <SW-DATA-DEF-PROPS-CONDITIONAL>
                        <IMPLEMENTATION-DATA-TYPE-REF DEST="IMPLEMENTATION-DATA-TYPE">/AUTOSAR_ComStack_Types/ImplementationDataTypes/PNCHandleType</IMPLEMENTATION-DATA-TYPE-REF>
                      </SW-DATA-DEF-PROPS-CONDITIONAL>
                    </SW-DATA-DEF-PROPS-VARIANTS>
                  </SW-DATA-DEF-PROPS>
                </IMPLEMENTATION-DATA-TYPE-ELEMENT>
                <IMPLEMENTATION-DATA-TYPE-ELEMENT>
                  <SHORT-NAME>Channel</SHORT-NAME>
                  <CATEGORY>TYPE_REFERENCE</CATEGORY>
                  <SW-DATA-DEF-PROPS>
                    <SW-DATA-DEF-PROPS-VARIANTS>
                      <SW-DATA-DEF-PROPS-CONDITIONAL>
                        <IMPLEMENTATION-DATA-TYPE-REF DEST="IMPLEMENTATION-DATA-TYPE">/AUTOSAR_Platform/ImplementationDataTypes/uint8</IMPLEMENTATION-DATA-TYPE-REF>
                      </SW-DATA-DEF-PROPS-CONDITIONAL>
                    </SW-DATA-DEF-PROPS-VARIANTS>
                  </SW-DATA-DEF-PROPS>
                </IMPLEMENTATION-DATA-TYPE-ELEMENT>
              </SUB-ELEMENTS>
            </IMPLEMENTATION-DATA-TYPE>

            <IMPLEMENTATION-DATA-TYPE>
              <SHORT-NAME>Nm_PnInfoArray</SHORT-NAME>
              <CATEGORY>ARRAY</CATEGORY>
              <SUB-ELEMENTS>
                <IMPLEMENTATION-DATA-TYPE-ELEMENT>
                  <SHORT-NAME>Nm_PnInfoArray</SHORT-NAME>
                  <CATEGORY>TYPE_REFERENCE</CATEGORY>
                  <ARRAY-SIZE>[!"$PnInfoLength"!]</ARRAY-SIZE>
                  <ARRAY-SIZE-SEMANTICS>FIXED-SIZE</ARRAY-SIZE-SEMANTICS>
                  <SW-DATA-DEF-PROPS>
                    <SW-DATA-DEF-PROPS-VARIANTS>
                      <SW-DATA-DEF-PROPS-CONDITIONAL>
                        <IMPLEMENTATION-DATA-TYPE-REF DEST="IMPLEMENTATION-DATA-TYPE">/AUTOSAR_Platform/ImplementationDataTypes/uint8</IMPLEMENTATION-DATA-TYPE-REF>
                      </SW-DATA-DEF-PROPS-CONDITIONAL>
                    </SW-DATA-DEF-PROPS-VARIANTS>
                  </SW-DATA-DEF-PROPS>
                </IMPLEMENTATION-DATA-TYPE-ELEMENT>
              </SUB-ELEMENTS>
            </IMPLEMENTATION-DATA-TYPE>    

            <IMPLEMENTATION-DATA-TYPE>
              <SHORT-NAME>Nm_PnSyncShutdown_BusNm_To_Nm_DataType</SHORT-NAME>
              <CATEGORY>STRUCTURE</CATEGORY>
              <SUB-ELEMENTS>
                <IMPLEMENTATION-DATA-TYPE-ELEMENT>
                  <SHORT-NAME>PnInfo</SHORT-NAME>
                  <CATEGORY>TYPE_REFERENCE</CATEGORY>
                  <SW-DATA-DEF-PROPS>
                    <SW-DATA-DEF-PROPS-VARIANTS>
                      <SW-DATA-DEF-PROPS-CONDITIONAL>
                        <IMPLEMENTATION-DATA-TYPE-REF DEST="IMPLEMENTATION-DATA-TYPE">/AUTOSAR_Nm/ImplementationDataTypes/Nm_PnInfoArray</IMPLEMENTATION-DATA-TYPE-REF>
                      </SW-DATA-DEF-PROPS-CONDITIONAL>
                    </SW-DATA-DEF-PROPS-VARIANTS>
                  </SW-DATA-DEF-PROPS>
                </IMPLEMENTATION-DATA-TYPE-ELEMENT>             
                <IMPLEMENTATION-DATA-TYPE-ELEMENT>
                  <SHORT-NAME>Channel</SHORT-NAME>
                  <CATEGORY>TYPE_REFERENCE</CATEGORY>
                  <SW-DATA-DEF-PROPS>
                    <SW-DATA-DEF-PROPS-VARIANTS>
                      <SW-DATA-DEF-PROPS-CONDITIONAL>
                        <IMPLEMENTATION-DATA-TYPE-REF DEST="IMPLEMENTATION-DATA-TYPE">/AUTOSAR_Platform/ImplementationDataTypes/uint8</IMPLEMENTATION-DATA-TYPE-REF>
                      </SW-DATA-DEF-PROPS-CONDITIONAL>
                    </SW-DATA-DEF-PROPS-VARIANTS>
                  </SW-DATA-DEF-PROPS>
                </IMPLEMENTATION-DATA-TYPE-ELEMENT>
              </SUB-ELEMENTS>
            </IMPLEMENTATION-DATA-TYPE>          
  [!ENDIF!] [!/*[!IF "node:exists(as:modconf('Nm')[1]/NmGlobalConfig/NmGlobalFeatures/NmSynchronizedPncShutdownEnabled) and 
               *     (as:modconf('Nm')[1]/NmGlobalConfig/NmGlobalFeatures/NmSynchronizedPncShutdownEnabled = 'true')"!]  
               */!]
          </ELEMENTS>
        </AR-PACKAGE>
[!ENDIF!][!//
      </AR-PACKAGES>
    </AR-PACKAGE>

    <AR-PACKAGE>
      <SHORT-NAME>EB_Nm</SHORT-NAME>
      <AR-PACKAGES>
        <AR-PACKAGE>
          <SHORT-NAME>Implementations</SHORT-NAME>
          <ELEMENTS>
            <BSW-IMPLEMENTATION>
              <SHORT-NAME>BswImplementation_0</SHORT-NAME>
              <CODE-DESCRIPTORS>
                <CODE>
                  <SHORT-NAME>Files</SHORT-NAME>
                  <ARTIFACT-DESCRIPTORS>
                    <AUTOSAR-ENGINEERING-OBJECT>
                      <SHORT-LABEL>Autosar::include::Nm.h</SHORT-LABEL>
                      <CATEGORY>SWHDR</CATEGORY>
                    </AUTOSAR-ENGINEERING-OBJECT>
                    <AUTOSAR-ENGINEERING-OBJECT>
                      <SHORT-LABEL>Autosar::include::Nm_Cbk.h</SHORT-LABEL>
                      <CATEGORY>SWHDR</CATEGORY>
                    </AUTOSAR-ENGINEERING-OBJECT>
                    <AUTOSAR-ENGINEERING-OBJECT>
                      <SHORT-LABEL>Autosar::include::Nm_Int.h</SHORT-LABEL>
                      <CATEGORY>SWHDR</CATEGORY>
                    </AUTOSAR-ENGINEERING-OBJECT>
                    <AUTOSAR-ENGINEERING-OBJECT>
                      <SHORT-LABEL>Autosar::include::Nm_Trace.h</SHORT-LABEL>
                      <CATEGORY>SWHDR</CATEGORY>
                    </AUTOSAR-ENGINEERING-OBJECT>
                    <AUTOSAR-ENGINEERING-OBJECT>
                      <SHORT-LABEL>Autosar::include::Nm_Trace_Internal.h</SHORT-LABEL>
                      <CATEGORY>SWHDR</CATEGORY>
                    </AUTOSAR-ENGINEERING-OBJECT>
                    <AUTOSAR-ENGINEERING-OBJECT>
                      <SHORT-LABEL>Autosar::include::Nm_Version.h</SHORT-LABEL>
                      <CATEGORY>SWHDR</CATEGORY>
                    </AUTOSAR-ENGINEERING-OBJECT>
                    <AUTOSAR-ENGINEERING-OBJECT>
                      <SHORT-LABEL>Autosar::src::Nm.c</SHORT-LABEL>
                      <CATEGORY>SWSRC</CATEGORY>
                    </AUTOSAR-ENGINEERING-OBJECT>
                    <AUTOSAR-ENGINEERING-OBJECT>
                      <SHORT-LABEL>make::Nm_defs.mak</SHORT-LABEL>
                      <CATEGORY>SWMAKE</CATEGORY>
                    </AUTOSAR-ENGINEERING-OBJECT>
                    <AUTOSAR-ENGINEERING-OBJECT>
                      <SHORT-LABEL>make::Nm_rules.mak</SHORT-LABEL>
                      <CATEGORY>SWMAKE</CATEGORY>
                    </AUTOSAR-ENGINEERING-OBJECT>
                  </ARTIFACT-DESCRIPTORS>
                </CODE>
              </CODE-DESCRIPTORS>
              <PROGRAMMING-LANGUAGE>C</PROGRAMMING-LANGUAGE>
              <RESOURCE-CONSUMPTION>
                <SHORT-NAME>ResourceConsumption</SHORT-NAME>
                <MEMORY-SECTIONS>
                  <MEMORY-SECTION>
                    <SHORT-NAME>CODE</SHORT-NAME>
                    <SW-ADDRMETHOD-REF DEST="SW-ADDR-METHOD">/AUTOSAR_MemMap/SwAddrMethods/CODE</SW-ADDRMETHOD-REF>
                  </MEMORY-SECTION>
                  <MEMORY-SECTION>
                    <SHORT-NAME>CONST_UNSPECIFIED</SHORT-NAME>
                    <ALIGNMENT>UNSPECIFIED</ALIGNMENT>
                    <SW-ADDRMETHOD-REF DEST="SW-ADDR-METHOD">/AUTOSAR_MemMap/SwAddrMethods/CONST</SW-ADDRMETHOD-REF>
                  </MEMORY-SECTION>
                  <MEMORY-SECTION>
                    <SHORT-NAME>CONST_8</SHORT-NAME>
                    <ALIGNMENT>8</ALIGNMENT>
                    <SW-ADDRMETHOD-REF DEST="SW-ADDR-METHOD">/AUTOSAR_MemMap/SwAddrMethods/CONST</SW-ADDRMETHOD-REF>
                  </MEMORY-SECTION>
                  <MEMORY-SECTION>
                    <SHORT-NAME>VAR_CLEARED_UNSPECIFIED</SHORT-NAME>
                    <ALIGNMENT>UNSPECIFIED</ALIGNMENT>
                    <SW-ADDRMETHOD-REF DEST="SW-ADDR-METHOD">/AUTOSAR_MemMap/SwAddrMethods/VAR_CLEARED</SW-ADDRMETHOD-REF>
                  </MEMORY-SECTION>
                  <MEMORY-SECTION>
                    <SHORT-NAME>VAR_CLEARED_16</SHORT-NAME>
                    <ALIGNMENT>16</ALIGNMENT>
                    <SW-ADDRMETHOD-REF DEST="SW-ADDR-METHOD">/AUTOSAR_MemMap/SwAddrMethods/VAR_CLEARED</SW-ADDRMETHOD-REF>
                  </MEMORY-SECTION>
                  <MEMORY-SECTION>
                    <SHORT-NAME>VAR_INIT_8</SHORT-NAME>
                    <ALIGNMENT>8</ALIGNMENT>
                    <SW-ADDRMETHOD-REF DEST="SW-ADDR-METHOD">/AUTOSAR_MemMap/SwAddrMethods/VAR_INIT</SW-ADDRMETHOD-REF>
                  </MEMORY-SECTION>
                  <MEMORY-SECTION>
                    <SHORT-NAME>VAR_CLEARED_8</SHORT-NAME>
                    <ALIGNMENT>8</ALIGNMENT>
                    <SW-ADDRMETHOD-REF DEST="SW-ADDR-METHOD">/AUTOSAR_MemMap/SwAddrMethods/VAR_CLEARED</SW-ADDRMETHOD-REF>
                  </MEMORY-SECTION>
                </MEMORY-SECTIONS>
              </RESOURCE-CONSUMPTION>
              <SW-VERSION>5.12.12</SW-VERSION>
              <VENDOR-ID>1</VENDOR-ID>
              <AR-RELEASE-VERSION>4.0.3</AR-RELEASE-VERSION>
              <BEHAVIOR-REF DEST="BSW-INTERNAL-BEHAVIOR">/AUTOSAR_Nm/BswModuleDescriptions/Nm/InternalBehavior_0</BEHAVIOR-REF>
              <VENDOR-SPECIFIC-MODULE-DEF-REFS>
                <VENDOR-SPECIFIC-MODULE-DEF-REF DEST="ECUC-MODULE-DEF">/TS_TxDxM5I12R0/Nm</VENDOR-SPECIFIC-MODULE-DEF-REF>
              </VENDOR-SPECIFIC-MODULE-DEF-REFS>
            </BSW-IMPLEMENTATION>
          </ELEMENTS>
        </AR-PACKAGE>
      </AR-PACKAGES>
    </AR-PACKAGE>
  </AR-PACKAGES>
</AUTOSAR>
