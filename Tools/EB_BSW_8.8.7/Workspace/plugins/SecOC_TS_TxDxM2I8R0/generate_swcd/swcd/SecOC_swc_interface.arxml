<?xml version="1.0" encoding="UTF-8"?>
<AUTOSAR xmlns="http://autosar.org/schema/r4.0"
         xmlns:xsi="http://www.w3.org/2001/XMLSchema-instance"
         xsi:schemaLocation="http://autosar.org/schema/r4.0 AUTOSAR_4-0-3_STRICT_COMPACT.xsd">
[!/* do not generate this file if RTE is not used */!]
[!IF "SecOCEbGeneral/SecOCRteUsage = 'false'"!]
  [!SKIPFILE!][!//
[!ELSE!]
[!AUTOSPACING!]
  <AR-PACKAGES>
    <AR-PACKAGE>
      <SHORT-NAME>AUTOSAR_SecOC</SHORT-NAME>
      <ELEMENTS/>
      <AR-PACKAGES>
        <AR-PACKAGE>
          <SHORT-NAME>DataConstrs</SHORT-NAME>
          <ELEMENTS>
            <!-- !LINKSTO SecOC.ASR430.RxTx.SWS_SecOC_00162,1 -->
            <DATA-CONSTR>
              <SHORT-NAME>CONSTR_SecOC_StateType</SHORT-NAME>
              <DATA-CONSTR-RULES>
                <DATA-CONSTR-RULE>
                  <INTERNAL-CONSTRS>
                    <LOWER-LIMIT INTERVAL-TYPE="CLOSED">0</LOWER-LIMIT>
                    <UPPER-LIMIT INTERVAL-TYPE="CLOSED">1</UPPER-LIMIT>
                  </INTERNAL-CONSTRS>
                </DATA-CONSTR-RULE>
              </DATA-CONSTR-RULES>
            </DATA-CONSTR>
[!IF "node:value(SecOCEbGeneral/SecOCEbPropagateVerificationStatusApiVersion) != 'NONE' or node:value(SecOCEbGeneral/SecOCEbClientServerPropagateVerificationStatusApiVersion) != 'NONE'"!]
            <DATA-CONSTR>
              <SHORT-NAME>CONSTR_SecOC_VerificationResultType</SHORT-NAME>
              <DATA-CONSTR-RULES>
                <DATA-CONSTR-RULE>
                  <INTERNAL-CONSTRS>
                    <LOWER-LIMIT INTERVAL-TYPE="CLOSED">0</LOWER-LIMIT>
                    <UPPER-LIMIT INTERVAL-TYPE="CLOSED">8</UPPER-LIMIT>
                  </INTERNAL-CONSTRS>
                </DATA-CONSTR-RULE>
              </DATA-CONSTR-RULES>
            </DATA-CONSTR>
[!ENDIF!]
[!IF "node:value(SecOCEbGeneral/SecOCEbVerifyStatusOverrideApiVersion)= 'SECOC_API_VERSION_20_11'"!]
            <DATA-CONSTR>
              <SHORT-NAME>CONSTR_SecOC_OverrideStatusType</SHORT-NAME>
              <DATA-CONSTR-RULES>
                <DATA-CONSTR-RULE>
                  <INTERNAL-CONSTRS>
                    <LOWER-LIMIT INTERVAL-TYPE="CLOSED">0</LOWER-LIMIT>
                    <UPPER-LIMIT INTERVAL-TYPE="CLOSED">0x43</UPPER-LIMIT>
                  </INTERNAL-CONSTRS>
                </DATA-CONSTR-RULE>
              </DATA-CONSTR-RULES>
            </DATA-CONSTR>
[!ENDIF!]
          </ELEMENTS>
        </AR-PACKAGE>
        <AR-PACKAGE>
          <SHORT-NAME>CompuMethods</SHORT-NAME>
          <ELEMENTS>
            <!-- !LINKSTO SecOC.ASR430.RxTx.SWS_SecOC_00162,1 -->
            <COMPU-METHOD>
              <SHORT-NAME>CM_SecOC_StateType</SHORT-NAME>
              <CATEGORY>TEXTTABLE</CATEGORY>
              <COMPU-INTERNAL-TO-PHYS>
                <COMPU-SCALES>
                  <COMPU-SCALE>
                    <LOWER-LIMIT INTERVAL-TYPE="CLOSED">0</LOWER-LIMIT>
                    <UPPER-LIMIT INTERVAL-TYPE="CLOSED">0</UPPER-LIMIT>
                    <COMPU-CONST>
                      <VT>SECOC_UNINIT</VT>
                    </COMPU-CONST>
                  </COMPU-SCALE>
                  <COMPU-SCALE>
                    <LOWER-LIMIT INTERVAL-TYPE="CLOSED">1</LOWER-LIMIT>
                    <UPPER-LIMIT INTERVAL-TYPE="CLOSED">1</UPPER-LIMIT>
                    <COMPU-CONST>
                      <VT>SECOC_INIT</VT>
                    </COMPU-CONST>
                  </COMPU-SCALE>
                </COMPU-SCALES>
              </COMPU-INTERNAL-TO-PHYS>
            </COMPU-METHOD>
[!IF "node:value(SecOCEbGeneral/SecOCEbPropagateVerificationStatusApiVersion) != 'NONE' or node:value(SecOCEbGeneral/SecOCEbClientServerPropagateVerificationStatusApiVersion) != 'NONE'"!]
            <COMPU-METHOD>
              <SHORT-NAME>CM_SecOC_VerificationResultType</SHORT-NAME>
              <CATEGORY>TEXTTABLE</CATEGORY>
              <COMPU-INTERNAL-TO-PHYS>
                <COMPU-SCALES>
                  <COMPU-SCALE>
                    <LOWER-LIMIT INTERVAL-TYPE="CLOSED">0</LOWER-LIMIT>
                    <UPPER-LIMIT INTERVAL-TYPE="CLOSED">0</UPPER-LIMIT>
                    <COMPU-CONST>
                      <VT>SECOC_VERIFICATIONSUCCESS</VT>
                    </COMPU-CONST>
                  </COMPU-SCALE>
                  <COMPU-SCALE>
                    <LOWER-LIMIT INTERVAL-TYPE="CLOSED">1</LOWER-LIMIT>
                    <UPPER-LIMIT INTERVAL-TYPE="CLOSED">1</UPPER-LIMIT>
                    <COMPU-CONST>
                      <VT>SECOC_VERIFICATIONFAILURE</VT>
                    </COMPU-CONST>
                  </COMPU-SCALE>
                  <COMPU-SCALE>
                    <LOWER-LIMIT INTERVAL-TYPE="CLOSED">2</LOWER-LIMIT>
                    <UPPER-LIMIT INTERVAL-TYPE="CLOSED">2</UPPER-LIMIT>
                    <COMPU-CONST>
                      <VT>SECOC_FRESHNESSFAILURE</VT>
                    </COMPU-CONST>
                  </COMPU-SCALE>
  [!IF "node:value(SecOCEbGeneral/SecOCEbPropagateVerificationStatusApiVersion) = 'SECOC_API_VERSION_20_11' or node:value(SecOCEbGeneral/SecOCEbClientServerPropagateVerificationStatusApiVersion) = 'SECOC_API_VERSION_20_11'"!]
                  <COMPU-SCALE>
                    <LOWER-LIMIT INTERVAL-TYPE="CLOSED">3</LOWER-LIMIT>
                    <UPPER-LIMIT INTERVAL-TYPE="CLOSED">3</UPPER-LIMIT>
                    <COMPU-CONST>
                      <VT>SECOC_AUTHENTICATIONBUILDFAILURE</VT>
                    </COMPU-CONST>
                  </COMPU-SCALE>
  [!ENDIF!]
                  <COMPU-SCALE>
                    <LOWER-LIMIT INTERVAL-TYPE="CLOSED">4</LOWER-LIMIT>
                    <UPPER-LIMIT INTERVAL-TYPE="CLOSED">4</UPPER-LIMIT>
                    <COMPU-CONST>
                      <VT>SECOC_NO_VERIFICATION</VT>
                    </COMPU-CONST>
                  </COMPU-SCALE>
  [!IF "node:value(SecOCEbGeneral/SecOCEbPropagateVerificationStatusApiVersion) = 'SECOC_API_VERSION_20_11' or node:value(SecOCEbGeneral/SecOCEbClientServerPropagateVerificationStatusApiVersion) = 'SECOC_API_VERSION_20_11'"!]
                  <COMPU-SCALE>
                    <LOWER-LIMIT INTERVAL-TYPE="CLOSED">5</LOWER-LIMIT>
                    <UPPER-LIMIT INTERVAL-TYPE="CLOSED">5</UPPER-LIMIT>
                    <COMPU-CONST>
                      <VT>SECOC_VERIFICATIONFAILURE_OVERWRITTEN</VT>
                    </COMPU-CONST>
                  </COMPU-SCALE>
  [!ENDIF!]
  [!IF "node:value(SecOCEbGeneral/SecOCEbPropagateVerificationStatusApiVersion) = 'EB_CUSTOM'"!]
                  <COMPU-SCALE>
                    <LOWER-LIMIT INTERVAL-TYPE="CLOSED">8</LOWER-LIMIT>
                    <UPPER-LIMIT INTERVAL-TYPE="CLOSED">8</UPPER-LIMIT>
                    <COMPU-CONST>
                      <VT>SECOC_MACSERVICEFAILURE</VT>
                    </COMPU-CONST>
                  </COMPU-SCALE>
  [!ENDIF!]
                </COMPU-SCALES>
              </COMPU-INTERNAL-TO-PHYS>
            </COMPU-METHOD>
[!ENDIF!]
[!IF "node:value(SecOCEbGeneral/SecOCEbVerifyStatusOverrideApiVersion)= 'SECOC_API_VERSION_20_11'"!]
            <COMPU-METHOD>
              <SHORT-NAME>CM_SecOC_OverrideStatusType</SHORT-NAME>
              <CATEGORY>TEXTTABLE</CATEGORY>
              <COMPU-INTERNAL-TO-PHYS>
                <COMPU-SCALES>
                  <COMPU-SCALE>
                    <LOWER-LIMIT INTERVAL-TYPE="CLOSED">0x00</LOWER-LIMIT>
                    <UPPER-LIMIT INTERVAL-TYPE="CLOSED">0x00</UPPER-LIMIT>
                    <COMPU-CONST>
                      <VT>SECOC_OVERRIDE_DROP_UNTIL_NOTICE</VT>
                    </COMPU-CONST>
                  </COMPU-SCALE>
                  <COMPU-SCALE>
                    <LOWER-LIMIT INTERVAL-TYPE="CLOSED">0x01</LOWER-LIMIT>
                    <UPPER-LIMIT INTERVAL-TYPE="CLOSED">0x01</UPPER-LIMIT>
                    <COMPU-CONST>
                      <VT>SECOC_OVERRIDE_DROP_UNTIL_LIMIT</VT>
                    </COMPU-CONST>
                  </COMPU-SCALE>
                  <COMPU-SCALE>
                    <LOWER-LIMIT INTERVAL-TYPE="CLOSED">0x02</LOWER-LIMIT>
                    <UPPER-LIMIT INTERVAL-TYPE="CLOSED">0x02</UPPER-LIMIT>
                    <COMPU-CONST>
                      <VT>SECOC_OVERRIDE_CANCEL</VT>
                    </COMPU-CONST>
                  </COMPU-SCALE>
                  <COMPU-SCALE>
                    <LOWER-LIMIT INTERVAL-TYPE="CLOSED">0x40</LOWER-LIMIT>
                    <UPPER-LIMIT INTERVAL-TYPE="CLOSED">0x40</UPPER-LIMIT>
                    <COMPU-CONST>
                      <VT>SECOC_OVERRIDE_PASS_UNTIL_NOTICE</VT>
                    </COMPU-CONST>
                  </COMPU-SCALE>
                  <COMPU-SCALE>
                    <LOWER-LIMIT INTERVAL-TYPE="CLOSED">0x41</LOWER-LIMIT>
                    <UPPER-LIMIT INTERVAL-TYPE="CLOSED">0x41</UPPER-LIMIT>
                    <COMPU-CONST>
                      <VT>SECOC_OVERRIDE_SKIP_UNTIL_LIMIT</VT>
                    </COMPU-CONST>
                  </COMPU-SCALE>
                  <COMPU-SCALE>
                    <LOWER-LIMIT INTERVAL-TYPE="CLOSED">0x42</LOWER-LIMIT>
                    <UPPER-LIMIT INTERVAL-TYPE="CLOSED">0x42</UPPER-LIMIT>
                    <COMPU-CONST>
                      <VT>SECOC_OVERRIDE_PASS_UNTIL_LIMIT</VT>
                    </COMPU-CONST>
                  </COMPU-SCALE>
                  <COMPU-SCALE>
                    <LOWER-LIMIT INTERVAL-TYPE="CLOSED">0x43</LOWER-LIMIT>
                    <UPPER-LIMIT INTERVAL-TYPE="CLOSED">0x43</UPPER-LIMIT>
                    <COMPU-CONST>
                      <VT>SECOC_OVERRIDE_SKIP_UNTIL_NOTICE</VT>
                    </COMPU-CONST>
                  </COMPU-SCALE>
                </COMPU-SCALES>
              </COMPU-INTERNAL-TO-PHYS>
            </COMPU-METHOD>
[!ENDIF!]
          </ELEMENTS>
        </AR-PACKAGE>
        <AR-PACKAGE>
          <SHORT-NAME>ImplementationDataTypes</SHORT-NAME>
          <ELEMENTS>
            <!-- !LINKSTO SecOC.ASR430.RxTx.SWS_SecOC_00162,1 -->
            <IMPLEMENTATION-DATA-TYPE>
              <SHORT-NAME>SecOC_StateType</SHORT-NAME>
              <CATEGORY>TYPE_REFERENCE</CATEGORY>
              <SW-DATA-DEF-PROPS>
                <SW-DATA-DEF-PROPS-VARIANTS>
                  <SW-DATA-DEF-PROPS-CONDITIONAL>
                    <COMPU-METHOD-REF DEST="COMPU-METHOD">/AUTOSAR_SecOC/CompuMethods/CM_SecOC_StateType</COMPU-METHOD-REF>
                    <DATA-CONSTR-REF DEST="DATA-CONSTR">/AUTOSAR_SecOC/DataConstrs/CONSTR_SecOC_StateType</DATA-CONSTR-REF>
                    <!-- !LINKSTO SecOC.EB.RxTx.SWS_SecOC_00001,1 -->
                    <IMPLEMENTATION-DATA-TYPE-REF DEST="IMPLEMENTATION-DATA-TYPE">/AUTOSAR_Platform/ImplementationDataTypes/uint32</IMPLEMENTATION-DATA-TYPE-REF>
                  </SW-DATA-DEF-PROPS-CONDITIONAL>
                </SW-DATA-DEF-PROPS-VARIANTS>
              </SW-DATA-DEF-PROPS>
            </IMPLEMENTATION-DATA-TYPE>
[!IF "node:value(SecOCEbGeneral/SecOCEbPropagateVerificationStatusApiVersion) != 'NONE' or node:value(SecOCEbGeneral/SecOCEbClientServerPropagateVerificationStatusApiVersion) != 'NONE'"!]
            <!-- !LINKSTO SecOC.ASR20-11.Rx.SWS_SecOC_00149,1 -->
            <IMPLEMENTATION-DATA-TYPE>
              <SHORT-NAME>SecOC_VerificationResultType</SHORT-NAME>
              <CATEGORY>TYPE_REFERENCE</CATEGORY>
              <SW-DATA-DEF-PROPS>
                <SW-DATA-DEF-PROPS-VARIANTS>
                  <SW-DATA-DEF-PROPS-CONDITIONAL>
                    <COMPU-METHOD-REF DEST="COMPU-METHOD">/AUTOSAR_SecOC/CompuMethods/CM_SecOC_VerificationResultType</COMPU-METHOD-REF>
                    <DATA-CONSTR-REF DEST="DATA-CONSTR">/AUTOSAR_SecOC/DataConstrs/CONSTR_SecOC_VerificationResultType</DATA-CONSTR-REF>
                    <!-- !LINKSTO SecOC.EB.RxTx.SWS_SecOC_00001,1 -->
                    <IMPLEMENTATION-DATA-TYPE-REF DEST="IMPLEMENTATION-DATA-TYPE">/AUTOSAR_Platform/ImplementationDataTypes/uint8</IMPLEMENTATION-DATA-TYPE-REF>
                  </SW-DATA-DEF-PROPS-CONDITIONAL>
                </SW-DATA-DEF-PROPS-VARIANTS>
              </SW-DATA-DEF-PROPS>
            </IMPLEMENTATION-DATA-TYPE>
            <!-- !LINKSTO SecOC.ASR430.Rx.SWS_SecOC_00160,4, SecOC.ASR20-11.Rx.SWS_SecOC_00160,1 -->
            <IMPLEMENTATION-DATA-TYPE>
              <SHORT-NAME>SecOC_VerificationStatusType</SHORT-NAME>
              <CATEGORY>STRUCTURE</CATEGORY>
              <SUB-ELEMENTS>
                <IMPLEMENTATION-DATA-TYPE-ELEMENT>
                  <SHORT-NAME>freshnessValueID</SHORT-NAME>
                  <CATEGORY>TYPE_REFERENCE</CATEGORY>
                  <SW-DATA-DEF-PROPS>
                    <SW-DATA-DEF-PROPS-VARIANTS>
                      <SW-DATA-DEF-PROPS-CONDITIONAL>
                        <IMPLEMENTATION-DATA-TYPE-REF DEST="IMPLEMENTATION-DATA-TYPE">/AUTOSAR_Platform/ImplementationDataTypes/uint16</IMPLEMENTATION-DATA-TYPE-REF>
                      </SW-DATA-DEF-PROPS-CONDITIONAL>
                    </SW-DATA-DEF-PROPS-VARIANTS>
                  </SW-DATA-DEF-PROPS>
                </IMPLEMENTATION-DATA-TYPE-ELEMENT>
                <IMPLEMENTATION-DATA-TYPE-ELEMENT>
                  <SHORT-NAME>verificationStatus</SHORT-NAME>
                  <CATEGORY>TYPE_REFERENCE</CATEGORY>
                  <SW-DATA-DEF-PROPS>
                    <SW-DATA-DEF-PROPS-VARIANTS>
                      <SW-DATA-DEF-PROPS-CONDITIONAL>
                        <IMPLEMENTATION-DATA-TYPE-REF DEST="IMPLEMENTATION-DATA-TYPE">/AUTOSAR_SecOC/ImplementationDataTypes/SecOC_VerificationResultType</IMPLEMENTATION-DATA-TYPE-REF>
                      </SW-DATA-DEF-PROPS-CONDITIONAL>
                    </SW-DATA-DEF-PROPS-VARIANTS>
                  </SW-DATA-DEF-PROPS>
                </IMPLEMENTATION-DATA-TYPE-ELEMENT>
                <IMPLEMENTATION-DATA-TYPE-ELEMENT>
                  <SHORT-NAME>secOCDataId</SHORT-NAME>
                  <CATEGORY>TYPE_REFERENCE</CATEGORY>
                  <SW-DATA-DEF-PROPS>
                    <SW-DATA-DEF-PROPS-VARIANTS>
                      <SW-DATA-DEF-PROPS-CONDITIONAL>
  [!IF "node:value(SecOCEbGeneral/SecOCDataIdLength) = 'UINT8'"!]
                        <IMPLEMENTATION-DATA-TYPE-REF DEST="IMPLEMENTATION-DATA-TYPE">/AUTOSAR_Platform/ImplementationDataTypes/uint8</IMPLEMENTATION-DATA-TYPE-REF>
  [!ELSEIF "node:value(SecOCEbGeneral/SecOCDataIdLength) = 'UINT16'"!]
                        <IMPLEMENTATION-DATA-TYPE-REF DEST="IMPLEMENTATION-DATA-TYPE">/AUTOSAR_Platform/ImplementationDataTypes/uint16</IMPLEMENTATION-DATA-TYPE-REF>
  [!ELSE!]
                        <IMPLEMENTATION-DATA-TYPE-REF DEST="IMPLEMENTATION-DATA-TYPE">/AUTOSAR_Platform/ImplementationDataTypes/uint32</IMPLEMENTATION-DATA-TYPE-REF>
  [!ENDIF!]
                      </SW-DATA-DEF-PROPS-CONDITIONAL>
                    </SW-DATA-DEF-PROPS-VARIANTS>
                  </SW-DATA-DEF-PROPS>
                </IMPLEMENTATION-DATA-TYPE-ELEMENT>
  [!IF "node:value(SecOCEbGeneral/SecOCEbPropagateVerificationStatusApiVersion) = 'EB_CUSTOM'"!]
                <IMPLEMENTATION-DATA-TYPE-ELEMENT>
                  <SHORT-NAME>verificationReturn</SHORT-NAME>
                  <CATEGORY>TYPE_REFERENCE</CATEGORY>
                  <SW-DATA-DEF-PROPS>
                    <SW-DATA-DEF-PROPS-VARIANTS>
                      <SW-DATA-DEF-PROPS-CONDITIONAL>
                        <IMPLEMENTATION-DATA-TYPE-REF DEST="IMPLEMENTATION-DATA-TYPE">/AUTOSAR_Std/ImplementationDataTypes/Std_ReturnType</IMPLEMENTATION-DATA-TYPE-REF>
                      </SW-DATA-DEF-PROPS-CONDITIONAL>
                    </SW-DATA-DEF-PROPS-VARIANTS>
                  </SW-DATA-DEF-PROPS>
                </IMPLEMENTATION-DATA-TYPE-ELEMENT>
  [!ENDIF!]
              </SUB-ELEMENTS>
            </IMPLEMENTATION-DATA-TYPE>
[!ENDIF!]
[!IF "count(SecOCTxPduProcessing/*[node:value(SecOCMacGenerateStatusPropagationMode) != 'NONE']) > 0"!]
            <!-- !LINKSTO SecOC.EB.Tx.SWS_SecOC_00014,2 -->
            <IMPLEMENTATION-DATA-TYPE>
              <SHORT-NAME>SecOC_MacGenerateStatusType</SHORT-NAME>
              <CATEGORY>STRUCTURE</CATEGORY>
              <SUB-ELEMENTS>
                <IMPLEMENTATION-DATA-TYPE-ELEMENT>
                  <SHORT-NAME>freshnessValueID</SHORT-NAME>
                  <CATEGORY>TYPE_REFERENCE</CATEGORY>
                  <SW-DATA-DEF-PROPS>
                    <SW-DATA-DEF-PROPS-VARIANTS>
                      <SW-DATA-DEF-PROPS-CONDITIONAL>
                        <IMPLEMENTATION-DATA-TYPE-REF DEST="IMPLEMENTATION-DATA-TYPE">/AUTOSAR_Platform/ImplementationDataTypes/uint16</IMPLEMENTATION-DATA-TYPE-REF>
                      </SW-DATA-DEF-PROPS-CONDITIONAL>
                    </SW-DATA-DEF-PROPS-VARIANTS>
                  </SW-DATA-DEF-PROPS>
                </IMPLEMENTATION-DATA-TYPE-ELEMENT>
                <IMPLEMENTATION-DATA-TYPE-ELEMENT>
                  <SHORT-NAME>macGenerateStatus</SHORT-NAME>
                  <CATEGORY>TYPE_REFERENCE</CATEGORY>
                  <SW-DATA-DEF-PROPS>
                    <SW-DATA-DEF-PROPS-VARIANTS>
                      <SW-DATA-DEF-PROPS-CONDITIONAL>
                        <IMPLEMENTATION-DATA-TYPE-REF DEST="IMPLEMENTATION-DATA-TYPE">/AUTOSAR_Std/ImplementationDataTypes/Std_ReturnType</IMPLEMENTATION-DATA-TYPE-REF>
                      </SW-DATA-DEF-PROPS-CONDITIONAL>
                    </SW-DATA-DEF-PROPS-VARIANTS>
                  </SW-DATA-DEF-PROPS>
                </IMPLEMENTATION-DATA-TYPE-ELEMENT>
                <IMPLEMENTATION-DATA-TYPE-ELEMENT>
                  <SHORT-NAME>secOCDataId</SHORT-NAME>
                  <CATEGORY>TYPE_REFERENCE</CATEGORY>
                  <SW-DATA-DEF-PROPS>
                    <SW-DATA-DEF-PROPS-VARIANTS>
                      <SW-DATA-DEF-PROPS-CONDITIONAL>
  [!IF "node:value(SecOCEbGeneral/SecOCDataIdLength) = 'UINT8'"!]
                        <IMPLEMENTATION-DATA-TYPE-REF DEST="IMPLEMENTATION-DATA-TYPE">/AUTOSAR_Platform/ImplementationDataTypes/uint8</IMPLEMENTATION-DATA-TYPE-REF>
  [!ELSEIF "node:value(SecOCEbGeneral/SecOCDataIdLength) = 'UINT16'"!]
                        <IMPLEMENTATION-DATA-TYPE-REF DEST="IMPLEMENTATION-DATA-TYPE">/AUTOSAR_Platform/ImplementationDataTypes/uint16</IMPLEMENTATION-DATA-TYPE-REF>
  [!ELSE!]
                        <IMPLEMENTATION-DATA-TYPE-REF DEST="IMPLEMENTATION-DATA-TYPE">/AUTOSAR_Platform/ImplementationDataTypes/uint32</IMPLEMENTATION-DATA-TYPE-REF>
  [!ENDIF!]
                      </SW-DATA-DEF-PROPS-CONDITIONAL>
                    </SW-DATA-DEF-PROPS-VARIANTS>
                  </SW-DATA-DEF-PROPS>
                </IMPLEMENTATION-DATA-TYPE-ELEMENT>
              </SUB-ELEMENTS>
            </IMPLEMENTATION-DATA-TYPE>
[!ENDIF!]
[!IF "node:value(SecOCGeneral/SecOCQueryFreshnessValue) = 'RTE'"!]
            <!-- !LINKSTO SecOC.ASR430.RxTx.SWS_SecOC_91012,1 -->
            <IMPLEMENTATION-DATA-TYPE>
              <SHORT-NAME>SecOC_FreshnessArrayType</SHORT-NAME>
              <CATEGORY>ARRAY</CATEGORY>
              <SW-DATA-DEF-PROPS>
                <SW-DATA-DEF-PROPS-VARIANTS>
                  <SW-DATA-DEF-PROPS-CONDITIONAL>
                    <SW-CALIBRATION-ACCESS>READ-ONLY</SW-CALIBRATION-ACCESS>
                  </SW-DATA-DEF-PROPS-CONDITIONAL>
                </SW-DATA-DEF-PROPS-VARIANTS>
              </SW-DATA-DEF-PROPS>
              <SUB-ELEMENTS>
                <IMPLEMENTATION-DATA-TYPE-ELEMENT>
                  <SHORT-NAME>freshnessValueTypeElement</SHORT-NAME>
                  <CATEGORY>TYPE_REFERENCE</CATEGORY>
                  <ARRAY-SIZE>8</ARRAY-SIZE>
                  <ARRAY-SIZE-SEMANTICS>FIXED-SIZE</ARRAY-SIZE-SEMANTICS>
                  <SW-DATA-DEF-PROPS>
                    <SW-DATA-DEF-PROPS-VARIANTS>
                      <SW-DATA-DEF-PROPS-CONDITIONAL>
                        <IMPLEMENTATION-DATA-TYPE-REF DEST="IMPLEMENTATION-DATA-TYPE">/AUTOSAR_Platform/ImplementationDataTypes/uint8</IMPLEMENTATION-DATA-TYPE-REF>
                      </SW-DATA-DEF-PROPS-CONDITIONAL>
                    </SW-DATA-DEF-PROPS-VARIANTS>
                  </SW-DATA-DEF-PROPS>
                </IMPLEMENTATION-DATA-TYPE-ELEMENT>
              </SUB-ELEMENTS>
            </IMPLEMENTATION-DATA-TYPE>
[!ENDIF!]
[!IF "node:value(SecOCEbGeneral/SecOCEbVerifyStatusOverrideApiVersion)= 'SECOC_API_VERSION_20_11'"!]
            <!-- !LINKSTO SecOC.ASR20-11.Rx.SWS_SecOC_00991,1 -->
            <IMPLEMENTATION-DATA-TYPE>
              <SHORT-NAME>SecOC_OverrideStatusType</SHORT-NAME>
              <CATEGORY>TYPE_REFERENCE</CATEGORY>
              <SW-DATA-DEF-PROPS>
                <SW-DATA-DEF-PROPS-VARIANTS>
                  <SW-DATA-DEF-PROPS-CONDITIONAL>
                    <COMPU-METHOD-REF DEST="COMPU-METHOD">/AUTOSAR_SecOC/CompuMethods/CM_SecOC_OverrideStatusType</COMPU-METHOD-REF>
                    <DATA-CONSTR-REF DEST="DATA-CONSTR">/AUTOSAR_SecOC/DataConstrs/CONSTR_SecOC_OverrideStatusType</DATA-CONSTR-REF>
                    <IMPLEMENTATION-DATA-TYPE-REF DEST="IMPLEMENTATION-DATA-TYPE">/AUTOSAR_Platform/ImplementationDataTypes/uint8</IMPLEMENTATION-DATA-TYPE-REF>
                  </SW-DATA-DEF-PROPS-CONDITIONAL>
                </SW-DATA-DEF-PROPS-VARIANTS>
              </SW-DATA-DEF-PROPS>
            </IMPLEMENTATION-DATA-TYPE>
[!ENDIF!]
          </ELEMENTS>
        </AR-PACKAGE>
        <AR-PACKAGE>
          <SHORT-NAME>PortInterfaces</SHORT-NAME>
          <ELEMENTS>
[!IF "num:i(count(SecOCMainFunctionRx/*)) = 0 and num:i(count(SecOCMainFunctionTx/*)) = 0"!]
  [!IF "count(SecOCRxPduProcessing/*) > 0"!]
            <!-- !LINKSTO SecOC.ASR430.Rx.SWS_SecOC_00142,4, SecOC.ASR20-11.Rx.SWS_SecOC_00142,1 -->
            <CLIENT-SERVER-INTERFACE>
              <SHORT-NAME>VerifyStatusConfiguration</SHORT-NAME>
              <IS-SERVICE>true</IS-SERVICE>
              <OPERATIONS>
                <CLIENT-SERVER-OPERATION>
                  <SHORT-NAME>VerifyStatusOverride</SHORT-NAME>
                  <ARGUMENTS>
    [!IF "node:value(SecOCEbGeneral/SecOCEbVerifyStatusOverrideApiVersion)= 'SECOC_API_VERSION_20_11'"!]
                    <ARGUMENT-DATA-PROTOTYPE>
                      <SHORT-NAME>ValueId</SHORT-NAME>
                      <TYPE-TREF DEST="IMPLEMENTATION-DATA-TYPE">/AUTOSAR_Platform/ImplementationDataTypes/uint16</TYPE-TREF>
                      <DIRECTION>IN</DIRECTION>
                    </ARGUMENT-DATA-PROTOTYPE>
                    <ARGUMENT-DATA-PROTOTYPE>
                      <SHORT-NAME>overrideStatus</SHORT-NAME>
                      <TYPE-TREF DEST="IMPLEMENTATION-DATA-TYPE">/AUTOSAR_SecOC/ImplementationDataTypes/SecOC_OverrideStatusType</TYPE-TREF>
                      <DIRECTION>IN</DIRECTION>
                    </ARGUMENT-DATA-PROTOTYPE>
    [!ELSE!]
                    <ARGUMENT-DATA-PROTOTYPE>
                      <SHORT-NAME>freshnessValueId</SHORT-NAME>
                      <TYPE-TREF DEST="IMPLEMENTATION-DATA-TYPE">/AUTOSAR_Platform/ImplementationDataTypes/uint16</TYPE-TREF>
                      <DIRECTION>IN</DIRECTION>
                    </ARGUMENT-DATA-PROTOTYPE>
                    <ARGUMENT-DATA-PROTOTYPE>
                      <SHORT-NAME>overrideStatus</SHORT-NAME>
                      <TYPE-TREF DEST="IMPLEMENTATION-DATA-TYPE">/AUTOSAR_Platform/ImplementationDataTypes/uint8</TYPE-TREF>
                      <DIRECTION>IN</DIRECTION>
                    </ARGUMENT-DATA-PROTOTYPE>
    [!ENDIF!]
                    <ARGUMENT-DATA-PROTOTYPE>
                      <SHORT-NAME>numberOfMessagesToOverride</SHORT-NAME>
                      <TYPE-TREF DEST="IMPLEMENTATION-DATA-TYPE">/AUTOSAR_Platform/ImplementationDataTypes/uint8</TYPE-TREF>
                      <DIRECTION>IN</DIRECTION>
                    </ARGUMENT-DATA-PROTOTYPE>
                  </ARGUMENTS>
                  <POSSIBLE-ERROR-REFS>
                    <POSSIBLE-ERROR-REF DEST="APPLICATION-ERROR">/AUTOSAR_SecOC/PortInterfaces/VerifyStatusConfiguration/E_OK</POSSIBLE-ERROR-REF>
                    <POSSIBLE-ERROR-REF DEST="APPLICATION-ERROR">/AUTOSAR_SecOC/PortInterfaces/VerifyStatusConfiguration/E_NOT_OK</POSSIBLE-ERROR-REF>
                  </POSSIBLE-ERROR-REFS>
                </CLIENT-SERVER-OPERATION>
              </OPERATIONS>
              <POSSIBLE-ERRORS>
                <APPLICATION-ERROR>
                  <SHORT-NAME>E_OK</SHORT-NAME>
                  <ERROR-CODE>0</ERROR-CODE>
                </APPLICATION-ERROR>
                <APPLICATION-ERROR>
                  <SHORT-NAME>E_NOT_OK</SHORT-NAME>
                  <ERROR-CODE>1</ERROR-CODE>
                </APPLICATION-ERROR>
              </POSSIBLE-ERRORS>
            </CLIENT-SERVER-INTERFACE>
  [!ENDIF!]
  [!IF "'true' = node:exists(SecOCGeneral/SecOCDefaultAuthenticationInformationPattern)"!]
            <!-- !LINKSTO SecOC.ASR20-11.Tx.SWS_SecOC_00002,1 -->
            <CLIENT-SERVER-INTERFACE>
              <SHORT-NAME>SendDefaultAuthenticationInformation</SHORT-NAME>
              <IS-SERVICE>true</IS-SERVICE>
              <OPERATIONS>
                <CLIENT-SERVER-OPERATION>
                  <SHORT-NAME>SendDefaultAuthenticationInformation</SHORT-NAME>
                  <ARGUMENTS>
                    <ARGUMENT-DATA-PROTOTYPE>
                      <SHORT-NAME>FreshnessValueID</SHORT-NAME>
                      <TYPE-TREF DEST="IMPLEMENTATION-DATA-TYPE">/AUTOSAR_Platform/ImplementationDataTypes/uint16</TYPE-TREF>
                      <DIRECTION>IN</DIRECTION>
                    </ARGUMENT-DATA-PROTOTYPE>
                    <ARGUMENT-DATA-PROTOTYPE>
                      <SHORT-NAME>sendDefaultAuthenticationInformation</SHORT-NAME>
                      <TYPE-TREF DEST="IMPLEMENTATION-DATA-TYPE">/AUTOSAR_Platform/ImplementationDataTypes/boolean</TYPE-TREF>
                      <DIRECTION>IN</DIRECTION>
                    </ARGUMENT-DATA-PROTOTYPE>
                  </ARGUMENTS>
                  <POSSIBLE-ERROR-REFS>
                    <POSSIBLE-ERROR-REF DEST="APPLICATION-ERROR">/AUTOSAR_SecOC/PortInterfaces/SendDefaultAuthenticationInformation/E_OK</POSSIBLE-ERROR-REF>
                    <POSSIBLE-ERROR-REF DEST="APPLICATION-ERROR">/AUTOSAR_SecOC/PortInterfaces/SendDefaultAuthenticationInformation/E_NOT_OK</POSSIBLE-ERROR-REF>
                  </POSSIBLE-ERROR-REFS>
                </CLIENT-SERVER-OPERATION>
              </OPERATIONS>
              <POSSIBLE-ERRORS>
                <APPLICATION-ERROR>
                  <SHORT-NAME>E_OK</SHORT-NAME>
                  <ERROR-CODE>0</ERROR-CODE>
                </APPLICATION-ERROR>
                <APPLICATION-ERROR>
                  <SHORT-NAME>E_NOT_OK</SHORT-NAME>
                  <ERROR-CODE>1</ERROR-CODE>
                </APPLICATION-ERROR>
              </POSSIBLE-ERRORS>
            </CLIENT-SERVER-INTERFACE>
  [!ENDIF!]
  [!IF "node:value(SecOCGeneral/SecOCQueryFreshnessValue) = 'RTE'"!]
    [!IF "count(SecOCTxPduProcessing/*) > 0"!]
            <!-- !LINKSTO SecOC.ASR430.Tx.SWS_SecOC_91002_3,1 -->
            <CLIENT-SERVER-INTERFACE>
              <SHORT-NAME>TxFreshnessManagement</SHORT-NAME>
              <IS-SERVICE>true</IS-SERVICE>
              <OPERATIONS>
      [!IF "count(SecOCTxPduProcessing/*[SecOCProvideTxTruncatedFreshnessValue = 'false']) > 0"!]
                <CLIENT-SERVER-OPERATION>
                  <!-- !LINKSTO SecOC.ASR430.Tx.SWS_SecOC_91002,3 -->
                  <SHORT-NAME>GetTxFreshness</SHORT-NAME>
                  <ARGUMENTS>
                    <ARGUMENT-DATA-PROTOTYPE>
                      <SHORT-NAME>freshnessValueId</SHORT-NAME>
                      <TYPE-TREF DEST="IMPLEMENTATION-DATA-TYPE">/AUTOSAR_Platform/ImplementationDataTypes/uint16</TYPE-TREF>
                      <DIRECTION>IN</DIRECTION>
                    </ARGUMENT-DATA-PROTOTYPE>
                    <ARGUMENT-DATA-PROTOTYPE>
                      <SHORT-NAME>freshnessValue</SHORT-NAME>
                      <TYPE-TREF DEST="IMPLEMENTATION-DATA-TYPE">/AUTOSAR_SecOC/ImplementationDataTypes/SecOC_FreshnessArrayType</TYPE-TREF>
                      <DIRECTION>OUT</DIRECTION>
                    </ARGUMENT-DATA-PROTOTYPE>
                    <ARGUMENT-DATA-PROTOTYPE>
                      <SHORT-NAME>freshnessValueLength</SHORT-NAME>
                      <TYPE-TREF DEST="IMPLEMENTATION-DATA-TYPE">/AUTOSAR_Platform/ImplementationDataTypes/uint32</TYPE-TREF>
                      <DIRECTION>INOUT</DIRECTION>
                    </ARGUMENT-DATA-PROTOTYPE>
                  </ARGUMENTS>
                  <POSSIBLE-ERROR-REFS>
                    <POSSIBLE-ERROR-REF DEST="APPLICATION-ERROR">/AUTOSAR_SecOC/PortInterfaces/TxFreshnessManagement/E_OK</POSSIBLE-ERROR-REF>
                    <POSSIBLE-ERROR-REF DEST="APPLICATION-ERROR">/AUTOSAR_SecOC/PortInterfaces/TxFreshnessManagement/E_NOT_OK</POSSIBLE-ERROR-REF>
                    <POSSIBLE-ERROR-REF DEST="APPLICATION-ERROR">/AUTOSAR_SecOC/PortInterfaces/TxFreshnessManagement/E_BUSY</POSSIBLE-ERROR-REF>
                  </POSSIBLE-ERROR-REFS>
                </CLIENT-SERVER-OPERATION>
      [!ENDIF!]
      [!IF "count(SecOCTxPduProcessing/*[SecOCProvideTxTruncatedFreshnessValue = 'true']) > 0"!]
                <CLIENT-SERVER-OPERATION>
                  <!-- !LINKSTO SecOC.ASR430.Tx.SWS_SecOC_91002_2,1 -->
                  <SHORT-NAME>GetTxFreshnessTruncData</SHORT-NAME>
                  <ARGUMENTS>
                    <ARGUMENT-DATA-PROTOTYPE>
                      <SHORT-NAME>freshnessValueId</SHORT-NAME>
                      <TYPE-TREF DEST="IMPLEMENTATION-DATA-TYPE">/AUTOSAR_Platform/ImplementationDataTypes/uint16</TYPE-TREF>
                      <DIRECTION>IN</DIRECTION>
                    </ARGUMENT-DATA-PROTOTYPE>
                    <ARGUMENT-DATA-PROTOTYPE>
                      <SHORT-NAME>freshnessValue</SHORT-NAME>
                      <TYPE-TREF DEST="IMPLEMENTATION-DATA-TYPE">/AUTOSAR_SecOC/ImplementationDataTypes/SecOC_FreshnessArrayType</TYPE-TREF>
                      <DIRECTION>OUT</DIRECTION>
                    </ARGUMENT-DATA-PROTOTYPE>
                    <ARGUMENT-DATA-PROTOTYPE>
                      <SHORT-NAME>freshnessValueLength</SHORT-NAME>
                      <TYPE-TREF DEST="IMPLEMENTATION-DATA-TYPE">/AUTOSAR_Platform/ImplementationDataTypes/uint32</TYPE-TREF>
                      <DIRECTION>INOUT</DIRECTION>
                    </ARGUMENT-DATA-PROTOTYPE>
                    <ARGUMENT-DATA-PROTOTYPE>
                      <SHORT-NAME>truncatedFreshnessValue</SHORT-NAME>
                      <TYPE-TREF DEST="IMPLEMENTATION-DATA-TYPE">/AUTOSAR_SecOC/ImplementationDataTypes/SecOC_FreshnessArrayType</TYPE-TREF>
                      <DIRECTION>OUT</DIRECTION>
                    </ARGUMENT-DATA-PROTOTYPE>
                    <ARGUMENT-DATA-PROTOTYPE>
                      <SHORT-NAME>truncatedFreshnessValueLength</SHORT-NAME>
                      <TYPE-TREF DEST="IMPLEMENTATION-DATA-TYPE">/AUTOSAR_Platform/ImplementationDataTypes/uint32</TYPE-TREF>
                      <DIRECTION>INOUT</DIRECTION>
                    </ARGUMENT-DATA-PROTOTYPE>
                  </ARGUMENTS>
                  <POSSIBLE-ERROR-REFS>
                    <POSSIBLE-ERROR-REF DEST="APPLICATION-ERROR">/AUTOSAR_SecOC/PortInterfaces/TxFreshnessManagement/E_OK</POSSIBLE-ERROR-REF>
                    <POSSIBLE-ERROR-REF DEST="APPLICATION-ERROR">/AUTOSAR_SecOC/PortInterfaces/TxFreshnessManagement/E_NOT_OK</POSSIBLE-ERROR-REF>
                    <POSSIBLE-ERROR-REF DEST="APPLICATION-ERROR">/AUTOSAR_SecOC/PortInterfaces/TxFreshnessManagement/E_BUSY</POSSIBLE-ERROR-REF>
                  </POSSIBLE-ERROR-REFS>
                </CLIENT-SERVER-OPERATION>
      [!ENDIF!]
                <CLIENT-SERVER-OPERATION>
                  <!-- !LINKSTO SecOC.ASR430.Tx.SWS_SecOC_00233,1 -->
                  <SHORT-NAME>SPduTxConfirmation</SHORT-NAME>
                  <ARGUMENTS>
                    <ARGUMENT-DATA-PROTOTYPE>
                      <SHORT-NAME>freshnessValueId</SHORT-NAME>
                      <TYPE-TREF DEST="IMPLEMENTATION-DATA-TYPE">/AUTOSAR_Platform/ImplementationDataTypes/uint16</TYPE-TREF>
                      <DIRECTION>IN</DIRECTION>
                    </ARGUMENT-DATA-PROTOTYPE>
                  </ARGUMENTS>
                  <POSSIBLE-ERROR-REFS>
                    <POSSIBLE-ERROR-REF DEST="APPLICATION-ERROR">/AUTOSAR_SecOC/PortInterfaces/TxFreshnessManagement/E_OK</POSSIBLE-ERROR-REF>
                  </POSSIBLE-ERROR-REFS>
                </CLIENT-SERVER-OPERATION>
              </OPERATIONS>
              <POSSIBLE-ERRORS>
                <APPLICATION-ERROR>
                  <SHORT-NAME>E_OK</SHORT-NAME>
                  <ERROR-CODE>0</ERROR-CODE>
                </APPLICATION-ERROR>
                <APPLICATION-ERROR>
                  <SHORT-NAME>E_NOT_OK</SHORT-NAME>
                  <ERROR-CODE>1</ERROR-CODE>
                </APPLICATION-ERROR>
                <APPLICATION-ERROR>
                  <SHORT-NAME>E_BUSY</SHORT-NAME>
                  <ERROR-CODE>2</ERROR-CODE>
                </APPLICATION-ERROR>
              </POSSIBLE-ERRORS>
            </CLIENT-SERVER-INTERFACE>
    [!ENDIF!]
    [!IF "count(SecOCRxPduProcessing/*) > 0"!]
            <!-- !LINKSTO SecOC.ASR430.Rx.SWS_SecOC_91002_3,1 -->
            <CLIENT-SERVER-INTERFACE>
              <SHORT-NAME>RxFreshnessManagement</SHORT-NAME>
              <IS-SERVICE>true</IS-SERVICE>
              <OPERATIONS>
      [!IF "count(SecOCRxPduProcessing/*[SecOCUseAuthDataFreshness = 'false']) > 0"!]
                <CLIENT-SERVER-OPERATION>
                  <!-- !LINKSTO SecOC.ASR430.Rx.SWS_SecOC_91002,3 -->
                  <SHORT-NAME>GetRxFreshness</SHORT-NAME>
                  <ARGUMENTS>
                    <ARGUMENT-DATA-PROTOTYPE>
                      <SHORT-NAME>freshnessValueId</SHORT-NAME>
                      <TYPE-TREF DEST="IMPLEMENTATION-DATA-TYPE">/AUTOSAR_Platform/ImplementationDataTypes/uint16</TYPE-TREF>
                      <DIRECTION>IN</DIRECTION>
                    </ARGUMENT-DATA-PROTOTYPE>
                    <ARGUMENT-DATA-PROTOTYPE>
                      <SHORT-NAME>truncatedFreshnessValue</SHORT-NAME>
                      <TYPE-TREF DEST="IMPLEMENTATION-DATA-TYPE">/AUTOSAR_SecOC/ImplementationDataTypes/SecOC_FreshnessArrayType</TYPE-TREF>
                      <DIRECTION>IN</DIRECTION>
                    </ARGUMENT-DATA-PROTOTYPE>
                    <ARGUMENT-DATA-PROTOTYPE>
                      <SHORT-NAME>truncatedFreshnessLength</SHORT-NAME>
                      <TYPE-TREF DEST="IMPLEMENTATION-DATA-TYPE">/AUTOSAR_Platform/ImplementationDataTypes/uint32</TYPE-TREF>
                      <DIRECTION>IN</DIRECTION>
                    </ARGUMENT-DATA-PROTOTYPE>
                    <ARGUMENT-DATA-PROTOTYPE>
                      <SHORT-NAME>authVerifyAttempts</SHORT-NAME>
                      <TYPE-TREF DEST="IMPLEMENTATION-DATA-TYPE">/AUTOSAR_Platform/ImplementationDataTypes/uint16</TYPE-TREF>
                      <DIRECTION>IN</DIRECTION>
                    </ARGUMENT-DATA-PROTOTYPE>
                    <ARGUMENT-DATA-PROTOTYPE>
                      <SHORT-NAME>freshnessValue</SHORT-NAME>
                      <TYPE-TREF DEST="IMPLEMENTATION-DATA-TYPE">/AUTOSAR_SecOC/ImplementationDataTypes/SecOC_FreshnessArrayType</TYPE-TREF>
                      <DIRECTION>OUT</DIRECTION>
                    </ARGUMENT-DATA-PROTOTYPE>
                    <ARGUMENT-DATA-PROTOTYPE>
                      <SHORT-NAME>freshnessValueLength</SHORT-NAME>
                      <TYPE-TREF DEST="IMPLEMENTATION-DATA-TYPE">/AUTOSAR_Platform/ImplementationDataTypes/uint32</TYPE-TREF>
                      <DIRECTION>INOUT</DIRECTION>
                    </ARGUMENT-DATA-PROTOTYPE>
                  </ARGUMENTS>
                  <POSSIBLE-ERROR-REFS>
                    <POSSIBLE-ERROR-REF DEST="APPLICATION-ERROR">/AUTOSAR_SecOC/PortInterfaces/RxFreshnessManagement/E_OK</POSSIBLE-ERROR-REF>
                    <POSSIBLE-ERROR-REF DEST="APPLICATION-ERROR">/AUTOSAR_SecOC/PortInterfaces/RxFreshnessManagement/E_NOT_OK</POSSIBLE-ERROR-REF>
                    <POSSIBLE-ERROR-REF DEST="APPLICATION-ERROR">/AUTOSAR_SecOC/PortInterfaces/RxFreshnessManagement/E_BUSY</POSSIBLE-ERROR-REF>
                  </POSSIBLE-ERROR-REFS>
                </CLIENT-SERVER-OPERATION>
      [!ENDIF!]
      [!IF "count(SecOCRxPduProcessing/*[SecOCUseAuthDataFreshness = 'true']) > 0"!]
                <CLIENT-SERVER-OPERATION>
                  <!-- !LINKSTO SecOC.ASR430.Rx.SWS_SecOC_91002_2,1 -->
                  <SHORT-NAME>GetRxFreshnessAuthData</SHORT-NAME>
                  <ARGUMENTS>
                    <ARGUMENT-DATA-PROTOTYPE>
                      <SHORT-NAME>freshnessValueId</SHORT-NAME>
                      <TYPE-TREF DEST="IMPLEMENTATION-DATA-TYPE">/AUTOSAR_Platform/ImplementationDataTypes/uint16</TYPE-TREF>
                      <DIRECTION>IN</DIRECTION>
                    </ARGUMENT-DATA-PROTOTYPE>
                    <ARGUMENT-DATA-PROTOTYPE>
                      <SHORT-NAME>truncatedFreshnessValue</SHORT-NAME>
                      <TYPE-TREF DEST="IMPLEMENTATION-DATA-TYPE">/AUTOSAR_SecOC/ImplementationDataTypes/SecOC_FreshnessArrayType</TYPE-TREF>
                      <DIRECTION>IN</DIRECTION>
                    </ARGUMENT-DATA-PROTOTYPE>
                    <ARGUMENT-DATA-PROTOTYPE>
                      <SHORT-NAME>truncatedFreshnessLength</SHORT-NAME>
                      <TYPE-TREF DEST="IMPLEMENTATION-DATA-TYPE">/AUTOSAR_Platform/ImplementationDataTypes/uint32</TYPE-TREF>
                      <DIRECTION>IN</DIRECTION>
                    </ARGUMENT-DATA-PROTOTYPE>
                    <ARGUMENT-DATA-PROTOTYPE>
                      <SHORT-NAME>authenticDataFreshnessValue</SHORT-NAME>
                      <TYPE-TREF DEST="IMPLEMENTATION-DATA-TYPE">/AUTOSAR_SecOC/ImplementationDataTypes/SecOC_FreshnessArrayType</TYPE-TREF>
                      <DIRECTION>IN</DIRECTION>
                    </ARGUMENT-DATA-PROTOTYPE>
                    <ARGUMENT-DATA-PROTOTYPE>
                      <SHORT-NAME>authenticDataFreshnessValueLength</SHORT-NAME>
                      <TYPE-TREF DEST="IMPLEMENTATION-DATA-TYPE">/AUTOSAR_Platform/ImplementationDataTypes/uint16</TYPE-TREF>
                      <DIRECTION>IN</DIRECTION>
                    </ARGUMENT-DATA-PROTOTYPE>
                    <ARGUMENT-DATA-PROTOTYPE>
                      <SHORT-NAME>authVerifyAttempts</SHORT-NAME>
                      <TYPE-TREF DEST="IMPLEMENTATION-DATA-TYPE">/AUTOSAR_Platform/ImplementationDataTypes/uint16</TYPE-TREF>
                      <DIRECTION>IN</DIRECTION>
                    </ARGUMENT-DATA-PROTOTYPE>
                    <ARGUMENT-DATA-PROTOTYPE>
                      <SHORT-NAME>freshnessValue</SHORT-NAME>
                      <TYPE-TREF DEST="IMPLEMENTATION-DATA-TYPE">/AUTOSAR_SecOC/ImplementationDataTypes/SecOC_FreshnessArrayType</TYPE-TREF>
                      <DIRECTION>OUT</DIRECTION>
                    </ARGUMENT-DATA-PROTOTYPE>
                    <ARGUMENT-DATA-PROTOTYPE>
                      <SHORT-NAME>freshnessValueLength</SHORT-NAME>
                      <TYPE-TREF DEST="IMPLEMENTATION-DATA-TYPE">/AUTOSAR_Platform/ImplementationDataTypes/uint32</TYPE-TREF>
                      <DIRECTION>INOUT</DIRECTION>
                    </ARGUMENT-DATA-PROTOTYPE>
                  </ARGUMENTS>
                  <POSSIBLE-ERROR-REFS>
                    <POSSIBLE-ERROR-REF DEST="APPLICATION-ERROR">/AUTOSAR_SecOC/PortInterfaces/RxFreshnessManagement/E_OK</POSSIBLE-ERROR-REF>
                    <POSSIBLE-ERROR-REF DEST="APPLICATION-ERROR">/AUTOSAR_SecOC/PortInterfaces/RxFreshnessManagement/E_NOT_OK</POSSIBLE-ERROR-REF>
                    <POSSIBLE-ERROR-REF DEST="APPLICATION-ERROR">/AUTOSAR_SecOC/PortInterfaces/RxFreshnessManagement/E_BUSY</POSSIBLE-ERROR-REF>
                  </POSSIBLE-ERROR-REFS>
                </CLIENT-SERVER-OPERATION>
      [!ENDIF!]
              </OPERATIONS>
              <POSSIBLE-ERRORS>
                <APPLICATION-ERROR>
                  <SHORT-NAME>E_OK</SHORT-NAME>
                  <ERROR-CODE>0</ERROR-CODE>
                </APPLICATION-ERROR>
                <APPLICATION-ERROR>
                  <SHORT-NAME>E_NOT_OK</SHORT-NAME>
                  <ERROR-CODE>1</ERROR-CODE>
                </APPLICATION-ERROR>
                <APPLICATION-ERROR>
                  <SHORT-NAME>E_BUSY</SHORT-NAME>
                  <ERROR-CODE>2</ERROR-CODE>
                </APPLICATION-ERROR>
              </POSSIBLE-ERRORS>
            </CLIENT-SERVER-INTERFACE>
    [!ENDIF!]
  [!ENDIF!]
            <!-- !LINKSTO SecOC.ASR430.Rx.SWS_SecOC_00141,1, SecOC.ASR430.Rx.SWS_SecOC_00148,3, SecOC.ASR20-11.Rx.SWS_SecOC_91021,1 -->
  [!IF "node:value(SecOCEbGeneral/SecOCEbPropagateVerificationStatusApiVersion) != 'NONE'"!]
            <SENDER-RECEIVER-INTERFACE>
              <SHORT-NAME>VerificationStatus</SHORT-NAME>
              <IS-SERVICE>true</IS-SERVICE>
              <DATA-ELEMENTS>
                <VARIABLE-DATA-PROTOTYPE>
                  <SHORT-NAME>verificationStatus</SHORT-NAME>
                  <TYPE-TREF DEST="IMPLEMENTATION-DATA-TYPE">/AUTOSAR_SecOC/ImplementationDataTypes/SecOC_VerificationStatusType</TYPE-TREF>
                </VARIABLE-DATA-PROTOTYPE>
              </DATA-ELEMENTS>
            </SENDER-RECEIVER-INTERFACE>
  [!ENDIF!]
            <!-- !LINKSTO SecOC.EB.Tx.SWS_SecOC_00015,1 -->
  [!IF "count(SecOCTxPduProcessing/*[node:value(SecOCMacGenerateStatusPropagationMode) != 'NONE']) > 0"!]
            <SENDER-RECEIVER-INTERFACE>
              <SHORT-NAME>MacGenerateStatus</SHORT-NAME>
              <IS-SERVICE>true</IS-SERVICE>
              <DATA-ELEMENTS>
                <VARIABLE-DATA-PROTOTYPE>
                  <SHORT-NAME>macGenerateStatus</SHORT-NAME>
                  <TYPE-TREF DEST="IMPLEMENTATION-DATA-TYPE">/AUTOSAR_SecOC/ImplementationDataTypes/SecOC_MacGenerateStatusType</TYPE-TREF>
                </VARIABLE-DATA-PROTOTYPE>
              </DATA-ELEMENTS>
            </SENDER-RECEIVER-INTERFACE>
  [!ENDIF!]
  [!IF "node:value(SecOCEbGeneral/SecOCEbClientServerPropagateVerificationStatusApiVersion) != 'NONE'"!]
            <CLIENT-SERVER-INTERFACE>
              <SHORT-NAME>VerificationStatusIndication</SHORT-NAME>
              <IS-SERVICE>true</IS-SERVICE>
              <OPERATIONS>
                <CLIENT-SERVER-OPERATION>
                  <SHORT-NAME>VerifyStatus</SHORT-NAME>
                  <ARGUMENTS>
                    <ARGUMENT-DATA-PROTOTYPE>
                      <SHORT-NAME>verificationStatus</SHORT-NAME>
                      <TYPE-TREF DEST="IMPLEMENTATION-DATA-TYPE">/AUTOSAR_SecOC/ImplementationDataTypes/SecOC_VerificationStatusType</TYPE-TREF>
                      <DIRECTION>IN</DIRECTION>
                    </ARGUMENT-DATA-PROTOTYPE>
                  </ARGUMENTS>
                  <POSSIBLE-ERROR-REFS>
                    <POSSIBLE-ERROR-REF DEST="APPLICATION-ERROR">/AUTOSAR_SecOC/PortInterfaces/VerificationStatusIndication/E_OK</POSSIBLE-ERROR-REF>
                    <POSSIBLE-ERROR-REF DEST="APPLICATION-ERROR">/AUTOSAR_SecOC/PortInterfaces/VerificationStatusIndication/E_NOT_OK</POSSIBLE-ERROR-REF>
                  </POSSIBLE-ERROR-REFS>
                </CLIENT-SERVER-OPERATION>
              </OPERATIONS>
              <POSSIBLE-ERRORS>
                <APPLICATION-ERROR>
                  <SHORT-NAME>E_OK</SHORT-NAME>
                  <ERROR-CODE>0</ERROR-CODE>
                </APPLICATION-ERROR>
                <APPLICATION-ERROR>
                  <SHORT-NAME>E_NOT_OK</SHORT-NAME>
                  <ERROR-CODE>1</ERROR-CODE>
                </APPLICATION-ERROR>
              </POSSIBLE-ERRORS>
            </CLIENT-SERVER-INTERFACE>
  [!ENDIF!]
[!ENDIF!]
[!LOOP "node:refs(as:modconf('SecOC')/SecOCMainFunctionRx/*/SecOCMainFunctionRxPartitionRef | as:modconf('SecOC')/SecOCMainFunctionTx/*/SecOCMainFunctionTxPartitionRef)"!]
  [!VAR "ecucPartition" = "node:name(.)"!]
  [!LOOP "as:modconf('SecOC')/SecOCMainFunctionRx/*[node:name(node:ref(./SecOCMainFunctionRxPartitionRef)) = $ecucPartition]"!]
    [!VAR "mainFuncName" = "node:name(.)"!]
            <!-- !LINKSTO SecOC.ASR430.Rx.SWS_SecOC_00142,4, SecOC.ASR20-11.Rx.SWS_SecOC_00142,1 -->
            <CLIENT-SERVER-INTERFACE>
              <SHORT-NAME>VerifyStatusConfiguration_[!"string($mainFuncName)"!]</SHORT-NAME>
              <IS-SERVICE>true</IS-SERVICE>
              <OPERATIONS>
                <CLIENT-SERVER-OPERATION>
                  <SHORT-NAME>VerifyStatusOverride</SHORT-NAME>
                  <ARGUMENTS>
    [!IF "node:value(../../SecOCEbGeneral/SecOCEbVerifyStatusOverrideApiVersion)= 'SECOC_API_VERSION_20_11'"!]
                    <ARGUMENT-DATA-PROTOTYPE>
                      <SHORT-NAME>ValueId</SHORT-NAME>
                      <TYPE-TREF DEST="IMPLEMENTATION-DATA-TYPE">/AUTOSAR_Platform/ImplementationDataTypes/uint16</TYPE-TREF>
                      <DIRECTION>IN</DIRECTION>
                    </ARGUMENT-DATA-PROTOTYPE>
                    <ARGUMENT-DATA-PROTOTYPE>
                      <SHORT-NAME>overrideStatus</SHORT-NAME>
                      <TYPE-TREF DEST="IMPLEMENTATION-DATA-TYPE">/AUTOSAR_SecOC/ImplementationDataTypes/SecOC_OverrideStatusType</TYPE-TREF>
                      <DIRECTION>IN</DIRECTION>
                    </ARGUMENT-DATA-PROTOTYPE>
    [!ELSE!]
                    <ARGUMENT-DATA-PROTOTYPE>
                      <SHORT-NAME>freshnessValueId</SHORT-NAME>
                      <TYPE-TREF DEST="IMPLEMENTATION-DATA-TYPE">/AUTOSAR_Platform/ImplementationDataTypes/uint16</TYPE-TREF>
                      <DIRECTION>IN</DIRECTION>
                    </ARGUMENT-DATA-PROTOTYPE>
                    <ARGUMENT-DATA-PROTOTYPE>
                      <SHORT-NAME>overrideStatus</SHORT-NAME>
                      <TYPE-TREF DEST="IMPLEMENTATION-DATA-TYPE">/AUTOSAR_Platform/ImplementationDataTypes/uint8</TYPE-TREF>
                      <DIRECTION>IN</DIRECTION>
                    </ARGUMENT-DATA-PROTOTYPE>
    [!ENDIF!]
                    <ARGUMENT-DATA-PROTOTYPE>
                      <SHORT-NAME>numberOfMessagesToOverride</SHORT-NAME>
                      <TYPE-TREF DEST="IMPLEMENTATION-DATA-TYPE">/AUTOSAR_Platform/ImplementationDataTypes/uint8</TYPE-TREF>
                      <DIRECTION>IN</DIRECTION>
                    </ARGUMENT-DATA-PROTOTYPE>
                  </ARGUMENTS>
                  <POSSIBLE-ERROR-REFS>
                    <POSSIBLE-ERROR-REF DEST="APPLICATION-ERROR">/AUTOSAR_SecOC/PortInterfaces/VerifyStatusConfiguration_[!"string($mainFuncName)"!]/E_OK</POSSIBLE-ERROR-REF>
                    <POSSIBLE-ERROR-REF DEST="APPLICATION-ERROR">/AUTOSAR_SecOC/PortInterfaces/VerifyStatusConfiguration_[!"string($mainFuncName)"!]/E_NOT_OK</POSSIBLE-ERROR-REF>
                  </POSSIBLE-ERROR-REFS>
                </CLIENT-SERVER-OPERATION>
              </OPERATIONS>
              <POSSIBLE-ERRORS>
                <APPLICATION-ERROR>
                  <SHORT-NAME>E_OK</SHORT-NAME>
                  <ERROR-CODE>0</ERROR-CODE>
                </APPLICATION-ERROR>
                <APPLICATION-ERROR>
                  <SHORT-NAME>E_NOT_OK</SHORT-NAME>
                  <ERROR-CODE>1</ERROR-CODE>
                </APPLICATION-ERROR>
              </POSSIBLE-ERRORS>
            </CLIENT-SERVER-INTERFACE>
    [!IF "node:value(../../SecOCGeneral/SecOCQueryFreshnessValue) = 'RTE'"!]
            <!-- !LINKSTO SecOC.ASR430.Rx.SWS_SecOC_91002_3,1 -->
            <CLIENT-SERVER-INTERFACE>
              <SHORT-NAME>RxFreshnessManagement_[!"string($mainFuncName)"!]</SHORT-NAME>
              <IS-SERVICE>true</IS-SERVICE>
              <OPERATIONS>
      [!IF "count(../../SecOCRxPduProcessing/*[node:name(node:ref(./SecOCRxPduMainFunctionRef)) = $mainFuncName and node:value(./SecOCUseAuthDataFreshness) = 'false']) > 0"!]
                <CLIENT-SERVER-OPERATION>
                  <!-- !LINKSTO SecOC.ASR430.Rx.SWS_SecOC_91002,3 -->
                  <SHORT-NAME>GetRxFreshness</SHORT-NAME>
                  <ARGUMENTS>
                    <ARGUMENT-DATA-PROTOTYPE>
                      <SHORT-NAME>freshnessValueId</SHORT-NAME>
                      <TYPE-TREF DEST="IMPLEMENTATION-DATA-TYPE">/AUTOSAR_Platform/ImplementationDataTypes/uint16</TYPE-TREF>
                      <DIRECTION>IN</DIRECTION>
                    </ARGUMENT-DATA-PROTOTYPE>
                    <ARGUMENT-DATA-PROTOTYPE>
                      <SHORT-NAME>truncatedFreshnessValue</SHORT-NAME>
                      <TYPE-TREF DEST="IMPLEMENTATION-DATA-TYPE">/AUTOSAR_SecOC/ImplementationDataTypes/SecOC_FreshnessArrayType</TYPE-TREF>
                      <DIRECTION>IN</DIRECTION>
                    </ARGUMENT-DATA-PROTOTYPE>
                    <ARGUMENT-DATA-PROTOTYPE>
                      <SHORT-NAME>truncatedFreshnessLength</SHORT-NAME>
                      <TYPE-TREF DEST="IMPLEMENTATION-DATA-TYPE">/AUTOSAR_Platform/ImplementationDataTypes/uint32</TYPE-TREF>
                      <DIRECTION>IN</DIRECTION>
                    </ARGUMENT-DATA-PROTOTYPE>
                    <ARGUMENT-DATA-PROTOTYPE>
                      <SHORT-NAME>authVerifyAttempts</SHORT-NAME>
                      <TYPE-TREF DEST="IMPLEMENTATION-DATA-TYPE">/AUTOSAR_Platform/ImplementationDataTypes/uint16</TYPE-TREF>
                      <DIRECTION>IN</DIRECTION>
                    </ARGUMENT-DATA-PROTOTYPE>
                    <ARGUMENT-DATA-PROTOTYPE>
                      <SHORT-NAME>freshnessValue</SHORT-NAME>
                      <TYPE-TREF DEST="IMPLEMENTATION-DATA-TYPE">/AUTOSAR_SecOC/ImplementationDataTypes/SecOC_FreshnessArrayType</TYPE-TREF>
                      <DIRECTION>OUT</DIRECTION>
                    </ARGUMENT-DATA-PROTOTYPE>
                    <ARGUMENT-DATA-PROTOTYPE>
                      <SHORT-NAME>freshnessValueLength</SHORT-NAME>
                      <TYPE-TREF DEST="IMPLEMENTATION-DATA-TYPE">/AUTOSAR_Platform/ImplementationDataTypes/uint32</TYPE-TREF>
                      <DIRECTION>INOUT</DIRECTION>
                    </ARGUMENT-DATA-PROTOTYPE>
                  </ARGUMENTS>
                  <POSSIBLE-ERROR-REFS>
                    <POSSIBLE-ERROR-REF DEST="APPLICATION-ERROR">/AUTOSAR_SecOC/PortInterfaces/RxFreshnessManagement_[!"string($mainFuncName)"!]/E_OK</POSSIBLE-ERROR-REF>
                    <POSSIBLE-ERROR-REF DEST="APPLICATION-ERROR">/AUTOSAR_SecOC/PortInterfaces/RxFreshnessManagement_[!"string($mainFuncName)"!]/E_NOT_OK</POSSIBLE-ERROR-REF>
                    <POSSIBLE-ERROR-REF DEST="APPLICATION-ERROR">/AUTOSAR_SecOC/PortInterfaces/RxFreshnessManagement_[!"string($mainFuncName)"!]/E_BUSY</POSSIBLE-ERROR-REF>
                  </POSSIBLE-ERROR-REFS>
                </CLIENT-SERVER-OPERATION>
      [!ENDIF!]
      [!IF "count(../../SecOCRxPduProcessing/*[node:name(node:ref(./SecOCRxPduMainFunctionRef)) = $mainFuncName and node:value(./SecOCUseAuthDataFreshness) = 'true']) > 0"!]
                <CLIENT-SERVER-OPERATION>
                  <!-- !LINKSTO SecOC.ASR430.Rx.SWS_SecOC_91002_2,1 -->
                  <SHORT-NAME>GetRxFreshnessAuthData</SHORT-NAME>
                  <ARGUMENTS>
                    <ARGUMENT-DATA-PROTOTYPE>
                      <SHORT-NAME>freshnessValueId</SHORT-NAME>
                      <TYPE-TREF DEST="IMPLEMENTATION-DATA-TYPE">/AUTOSAR_Platform/ImplementationDataTypes/uint16</TYPE-TREF>
                      <DIRECTION>IN</DIRECTION>
                    </ARGUMENT-DATA-PROTOTYPE>
                    <ARGUMENT-DATA-PROTOTYPE>
                      <SHORT-NAME>truncatedFreshnessValue</SHORT-NAME>
                      <TYPE-TREF DEST="IMPLEMENTATION-DATA-TYPE">/AUTOSAR_SecOC/ImplementationDataTypes/SecOC_FreshnessArrayType</TYPE-TREF>
                      <DIRECTION>IN</DIRECTION>
                    </ARGUMENT-DATA-PROTOTYPE>
                    <ARGUMENT-DATA-PROTOTYPE>
                      <SHORT-NAME>truncatedFreshnessLength</SHORT-NAME>
                      <TYPE-TREF DEST="IMPLEMENTATION-DATA-TYPE">/AUTOSAR_Platform/ImplementationDataTypes/uint32</TYPE-TREF>
                      <DIRECTION>IN</DIRECTION>
                    </ARGUMENT-DATA-PROTOTYPE>
                    <ARGUMENT-DATA-PROTOTYPE>
                      <SHORT-NAME>authenticDataFreshnessValue</SHORT-NAME>
                      <TYPE-TREF DEST="IMPLEMENTATION-DATA-TYPE">/AUTOSAR_SecOC/ImplementationDataTypes/SecOC_FreshnessArrayType</TYPE-TREF>
                      <DIRECTION>IN</DIRECTION>
                    </ARGUMENT-DATA-PROTOTYPE>
                    <ARGUMENT-DATA-PROTOTYPE>
                      <SHORT-NAME>authenticDataFreshnessValueLength</SHORT-NAME>
                      <TYPE-TREF DEST="IMPLEMENTATION-DATA-TYPE">/AUTOSAR_Platform/ImplementationDataTypes/uint16</TYPE-TREF>
                      <DIRECTION>IN</DIRECTION>
                    </ARGUMENT-DATA-PROTOTYPE>
                    <ARGUMENT-DATA-PROTOTYPE>
                      <SHORT-NAME>authVerifyAttempts</SHORT-NAME>
                      <TYPE-TREF DEST="IMPLEMENTATION-DATA-TYPE">/AUTOSAR_Platform/ImplementationDataTypes/uint16</TYPE-TREF>
                      <DIRECTION>IN</DIRECTION>
                    </ARGUMENT-DATA-PROTOTYPE>
                    <ARGUMENT-DATA-PROTOTYPE>
                      <SHORT-NAME>freshnessValue</SHORT-NAME>
                      <TYPE-TREF DEST="IMPLEMENTATION-DATA-TYPE">/AUTOSAR_SecOC/ImplementationDataTypes/SecOC_FreshnessArrayType</TYPE-TREF>
                      <DIRECTION>OUT</DIRECTION>
                    </ARGUMENT-DATA-PROTOTYPE>
                    <ARGUMENT-DATA-PROTOTYPE>
                      <SHORT-NAME>freshnessValueLength</SHORT-NAME>
                      <TYPE-TREF DEST="IMPLEMENTATION-DATA-TYPE">/AUTOSAR_Platform/ImplementationDataTypes/uint32</TYPE-TREF>
                      <DIRECTION>INOUT</DIRECTION>
                    </ARGUMENT-DATA-PROTOTYPE>
                  </ARGUMENTS>
                  <POSSIBLE-ERROR-REFS>
                    <POSSIBLE-ERROR-REF DEST="APPLICATION-ERROR">/AUTOSAR_SecOC/PortInterfaces/RxFreshnessManagement_[!"string($mainFuncName)"!]/E_OK</POSSIBLE-ERROR-REF>
                    <POSSIBLE-ERROR-REF DEST="APPLICATION-ERROR">/AUTOSAR_SecOC/PortInterfaces/RxFreshnessManagement_[!"string($mainFuncName)"!]/E_NOT_OK</POSSIBLE-ERROR-REF>
                    <POSSIBLE-ERROR-REF DEST="APPLICATION-ERROR">/AUTOSAR_SecOC/PortInterfaces/RxFreshnessManagement_[!"string($mainFuncName)"!]/E_BUSY</POSSIBLE-ERROR-REF>
                  </POSSIBLE-ERROR-REFS>
                </CLIENT-SERVER-OPERATION>
      [!ENDIF!]
              </OPERATIONS>
              <POSSIBLE-ERRORS>
                <APPLICATION-ERROR>
                  <SHORT-NAME>E_OK</SHORT-NAME>
                  <ERROR-CODE>0</ERROR-CODE>
                </APPLICATION-ERROR>
                <APPLICATION-ERROR>
                  <SHORT-NAME>E_NOT_OK</SHORT-NAME>
                  <ERROR-CODE>1</ERROR-CODE>
                </APPLICATION-ERROR>
                <APPLICATION-ERROR>
                  <SHORT-NAME>E_BUSY</SHORT-NAME>
                  <ERROR-CODE>2</ERROR-CODE>
                </APPLICATION-ERROR>
              </POSSIBLE-ERRORS>
            </CLIENT-SERVER-INTERFACE>
    [!ENDIF!]
            <!-- !LINKSTO SecOC.ASR430.Rx.SWS_SecOC_00141,1, SecOC.ASR430.Rx.SWS_SecOC_00148,3 -->
    [!IF "node:value(../../SecOCEbGeneral/SecOCEbPropagateVerificationStatusApiVersion) != 'NONE'"!]
            <SENDER-RECEIVER-INTERFACE>
              <SHORT-NAME>VerificationStatus_[!"string($mainFuncName)"!]</SHORT-NAME>
              <IS-SERVICE>true</IS-SERVICE>
              <DATA-ELEMENTS>
                <VARIABLE-DATA-PROTOTYPE>
                  <SHORT-NAME>verificationStatus</SHORT-NAME>
                  <TYPE-TREF DEST="IMPLEMENTATION-DATA-TYPE">/AUTOSAR_SecOC/ImplementationDataTypes/SecOC_VerificationStatusType</TYPE-TREF>
                </VARIABLE-DATA-PROTOTYPE>
              </DATA-ELEMENTS>
            </SENDER-RECEIVER-INTERFACE>
    [!ENDIF!]
    [!IF "node:value(../../SecOCEbGeneral/SecOCEbClientServerPropagateVerificationStatusApiVersion) != 'NONE'"!]
            <!-- !LINKSTO SecOC.ASR20-11.Rx.SWS_SecOC_91016,1 -->
            <CLIENT-SERVER-INTERFACE>
              <SHORT-NAME>VerificationStatusIndication_[!"string($mainFuncName)"!]</SHORT-NAME>
              <IS-SERVICE>true</IS-SERVICE>
              <OPERATIONS>
                <CLIENT-SERVER-OPERATION>
                  <SHORT-NAME>VerifyStatus</SHORT-NAME>
                  <ARGUMENTS>
                    <ARGUMENT-DATA-PROTOTYPE>
                      <SHORT-NAME>verificationStatus</SHORT-NAME>
                      <TYPE-TREF DEST="IMPLEMENTATION-DATA-TYPE">/AUTOSAR_SecOC/ImplementationDataTypes/SecOC_VerificationStatusType</TYPE-TREF>
                      <DIRECTION>IN</DIRECTION>
                    </ARGUMENT-DATA-PROTOTYPE>
                  </ARGUMENTS>
                  <POSSIBLE-ERROR-REFS>
                    <POSSIBLE-ERROR-REF DEST="APPLICATION-ERROR">/AUTOSAR_SecOC/PortInterfaces/VerificationStatusIndication_[!"string($mainFuncName)"!]/E_OK</POSSIBLE-ERROR-REF>
                    <POSSIBLE-ERROR-REF DEST="APPLICATION-ERROR">/AUTOSAR_SecOC/PortInterfaces/VerificationStatusIndication_[!"string($mainFuncName)"!]/E_NOT_OK</POSSIBLE-ERROR-REF>
                  </POSSIBLE-ERROR-REFS>
                </CLIENT-SERVER-OPERATION>
              </OPERATIONS>
              <POSSIBLE-ERRORS>
                <APPLICATION-ERROR>
                  <SHORT-NAME>E_OK</SHORT-NAME>
                  <ERROR-CODE>0</ERROR-CODE>
                </APPLICATION-ERROR>
                <APPLICATION-ERROR>
                  <SHORT-NAME>E_NOT_OK</SHORT-NAME>
                  <ERROR-CODE>1</ERROR-CODE>
                </APPLICATION-ERROR>
              </POSSIBLE-ERRORS>
            </CLIENT-SERVER-INTERFACE>
    [!ENDIF!]
  [!ENDLOOP!]
  [!LOOP "as:modconf('SecOC')/SecOCMainFunctionTx/*[node:name(node:ref(./SecOCMainFunctionTxPartitionRef)) = $ecucPartition]"!]
    [!VAR "mainFuncName" = "node:name(.)"!]
    [!IF "node:value(../../SecOCGeneral/SecOCQueryFreshnessValue) = 'RTE'"!]
            <!-- !LINKSTO SecOC.ASR430.Tx.SWS_SecOC_91002_3,1 -->
            <CLIENT-SERVER-INTERFACE>
              <SHORT-NAME>TxFreshnessManagement_[!"string($mainFuncName)"!]</SHORT-NAME>
              <IS-SERVICE>true</IS-SERVICE>
              <OPERATIONS>
      [!IF "count(../../SecOCTxPduProcessing/*[node:name(node:ref(./SecOCTxPduMainFunctionRef)) = $mainFuncName and node:value(./SecOCProvideTxTruncatedFreshnessValue) = 'false']) > 0"!]
                <CLIENT-SERVER-OPERATION>
                  <!-- !LINKSTO SecOC.ASR430.Tx.SWS_SecOC_91002,3 -->
                  <SHORT-NAME>GetTxFreshness</SHORT-NAME>
                  <ARGUMENTS>
                    <ARGUMENT-DATA-PROTOTYPE>
                      <SHORT-NAME>freshnessValueId</SHORT-NAME>
                      <TYPE-TREF DEST="IMPLEMENTATION-DATA-TYPE">/AUTOSAR_Platform/ImplementationDataTypes/uint16</TYPE-TREF>
                      <DIRECTION>IN</DIRECTION>
                    </ARGUMENT-DATA-PROTOTYPE>
                    <ARGUMENT-DATA-PROTOTYPE>
                      <SHORT-NAME>freshnessValue</SHORT-NAME>
                      <TYPE-TREF DEST="IMPLEMENTATION-DATA-TYPE">/AUTOSAR_SecOC/ImplementationDataTypes/SecOC_FreshnessArrayType</TYPE-TREF>
                      <DIRECTION>OUT</DIRECTION>
                    </ARGUMENT-DATA-PROTOTYPE>
                    <ARGUMENT-DATA-PROTOTYPE>
                      <SHORT-NAME>freshnessValueLength</SHORT-NAME>
                      <TYPE-TREF DEST="IMPLEMENTATION-DATA-TYPE">/AUTOSAR_Platform/ImplementationDataTypes/uint32</TYPE-TREF>
                      <DIRECTION>INOUT</DIRECTION>
                    </ARGUMENT-DATA-PROTOTYPE>
                  </ARGUMENTS>
                  <POSSIBLE-ERROR-REFS>
                    <POSSIBLE-ERROR-REF DEST="APPLICATION-ERROR">/AUTOSAR_SecOC/PortInterfaces/TxFreshnessManagement_[!"string($mainFuncName)"!]/E_OK</POSSIBLE-ERROR-REF>
                    <POSSIBLE-ERROR-REF DEST="APPLICATION-ERROR">/AUTOSAR_SecOC/PortInterfaces/TxFreshnessManagement_[!"string($mainFuncName)"!]/E_NOT_OK</POSSIBLE-ERROR-REF>
                    <POSSIBLE-ERROR-REF DEST="APPLICATION-ERROR">/AUTOSAR_SecOC/PortInterfaces/TxFreshnessManagement_[!"string($mainFuncName)"!]/E_BUSY</POSSIBLE-ERROR-REF>
                  </POSSIBLE-ERROR-REFS>
                </CLIENT-SERVER-OPERATION>
      [!ENDIF!]
      [!IF "count(../../SecOCTxPduProcessing/*[node:name(node:ref(./SecOCTxPduMainFunctionRef)) = $mainFuncName and node:value(./SecOCProvideTxTruncatedFreshnessValue) = 'true']) > 0"!]
                <CLIENT-SERVER-OPERATION>
                  <!-- !LINKSTO SecOC.ASR430.Tx.SWS_SecOC_91002_2,1 -->
                  <SHORT-NAME>GetTxFreshnessTruncData</SHORT-NAME>
                  <ARGUMENTS>
                    <ARGUMENT-DATA-PROTOTYPE>
                      <SHORT-NAME>freshnessValueId</SHORT-NAME>
                      <TYPE-TREF DEST="IMPLEMENTATION-DATA-TYPE">/AUTOSAR_Platform/ImplementationDataTypes/uint16</TYPE-TREF>
                      <DIRECTION>IN</DIRECTION>
                    </ARGUMENT-DATA-PROTOTYPE>
                    <ARGUMENT-DATA-PROTOTYPE>
                      <SHORT-NAME>freshnessValue</SHORT-NAME>
                      <TYPE-TREF DEST="IMPLEMENTATION-DATA-TYPE">/AUTOSAR_SecOC/ImplementationDataTypes/SecOC_FreshnessArrayType</TYPE-TREF>
                      <DIRECTION>OUT</DIRECTION>
                    </ARGUMENT-DATA-PROTOTYPE>
                    <ARGUMENT-DATA-PROTOTYPE>
                      <SHORT-NAME>freshnessValueLength</SHORT-NAME>
                      <TYPE-TREF DEST="IMPLEMENTATION-DATA-TYPE">/AUTOSAR_Platform/ImplementationDataTypes/uint32</TYPE-TREF>
                      <DIRECTION>INOUT</DIRECTION>
                    </ARGUMENT-DATA-PROTOTYPE>
                    <ARGUMENT-DATA-PROTOTYPE>
                      <SHORT-NAME>truncatedFreshnessValue</SHORT-NAME>
                      <TYPE-TREF DEST="IMPLEMENTATION-DATA-TYPE">/AUTOSAR_SecOC/ImplementationDataTypes/SecOC_FreshnessArrayType</TYPE-TREF>
                      <DIRECTION>OUT</DIRECTION>
                    </ARGUMENT-DATA-PROTOTYPE>
                    <ARGUMENT-DATA-PROTOTYPE>
                      <SHORT-NAME>truncatedFreshnessValueLength</SHORT-NAME>
                      <TYPE-TREF DEST="IMPLEMENTATION-DATA-TYPE">/AUTOSAR_Platform/ImplementationDataTypes/uint32</TYPE-TREF>
                      <DIRECTION>INOUT</DIRECTION>
                    </ARGUMENT-DATA-PROTOTYPE>
                  </ARGUMENTS>
                  <POSSIBLE-ERROR-REFS>
                    <POSSIBLE-ERROR-REF DEST="APPLICATION-ERROR">/AUTOSAR_SecOC/PortInterfaces/TxFreshnessManagement_[!"string($mainFuncName)"!]/E_OK</POSSIBLE-ERROR-REF>
                    <POSSIBLE-ERROR-REF DEST="APPLICATION-ERROR">/AUTOSAR_SecOC/PortInterfaces/TxFreshnessManagement_[!"string($mainFuncName)"!]/E_NOT_OK</POSSIBLE-ERROR-REF>
                    <POSSIBLE-ERROR-REF DEST="APPLICATION-ERROR">/AUTOSAR_SecOC/PortInterfaces/TxFreshnessManagement_[!"string($mainFuncName)"!]/E_BUSY</POSSIBLE-ERROR-REF>
                  </POSSIBLE-ERROR-REFS>
                </CLIENT-SERVER-OPERATION>
      [!ENDIF!]
                <CLIENT-SERVER-OPERATION>
                  <!-- !LINKSTO SecOC.ASR430.Tx.SWS_SecOC_00233,1 -->
                  <SHORT-NAME>SPduTxConfirmation</SHORT-NAME>
                  <ARGUMENTS>
                    <ARGUMENT-DATA-PROTOTYPE>
                      <SHORT-NAME>freshnessValueId</SHORT-NAME>
                      <TYPE-TREF DEST="IMPLEMENTATION-DATA-TYPE">/AUTOSAR_Platform/ImplementationDataTypes/uint16</TYPE-TREF>
                      <DIRECTION>IN</DIRECTION>
                    </ARGUMENT-DATA-PROTOTYPE>
                  </ARGUMENTS>
                  <POSSIBLE-ERROR-REFS>
                    <POSSIBLE-ERROR-REF DEST="APPLICATION-ERROR">/AUTOSAR_SecOC/PortInterfaces/TxFreshnessManagement_[!"string($mainFuncName)"!]/E_OK</POSSIBLE-ERROR-REF>
                  </POSSIBLE-ERROR-REFS>
                </CLIENT-SERVER-OPERATION>
              </OPERATIONS>
              <POSSIBLE-ERRORS>
                <APPLICATION-ERROR>
                  <SHORT-NAME>E_OK</SHORT-NAME>
                  <ERROR-CODE>0</ERROR-CODE>
                </APPLICATION-ERROR>
                <APPLICATION-ERROR>
                  <SHORT-NAME>E_NOT_OK</SHORT-NAME>
                  <ERROR-CODE>1</ERROR-CODE>
                </APPLICATION-ERROR>
                <APPLICATION-ERROR>
                  <SHORT-NAME>E_BUSY</SHORT-NAME>
                  <ERROR-CODE>2</ERROR-CODE>
                </APPLICATION-ERROR>
              </POSSIBLE-ERRORS>
            </CLIENT-SERVER-INTERFACE>
    [!ENDIF!]
            <!-- !LINKSTO SecOC.EB.Tx.SWS_SecOC_00015,1 -->
    [!IF "count(../../SecOCTxPduProcessing/*[node:name(node:ref(./SecOCTxPduMainFunctionRef)) = $mainFuncName and node:value(SecOCMacGenerateStatusPropagationMode) != 'NONE']) > 0"!]
            <SENDER-RECEIVER-INTERFACE>
              <SHORT-NAME>MacGenerateStatus_[!"string($mainFuncName)"!]</SHORT-NAME>
              <IS-SERVICE>true</IS-SERVICE>
              <DATA-ELEMENTS>
                <VARIABLE-DATA-PROTOTYPE>
                  <SHORT-NAME>macGenerateStatus</SHORT-NAME>
                  <TYPE-TREF DEST="IMPLEMENTATION-DATA-TYPE">/AUTOSAR_SecOC/ImplementationDataTypes/SecOC_MacGenerateStatusType</TYPE-TREF>
                </VARIABLE-DATA-PROTOTYPE>
              </DATA-ELEMENTS>
            </SENDER-RECEIVER-INTERFACE>
    [!ENDIF!]
  [!IF "'true' = node:exists(../../SecOCGeneral/SecOCDefaultAuthenticationInformationPattern)"!]
            <!-- !LINKSTO SecOC.ASR20-11.Tx.SWS_SecOC_00002,1 -->
            <CLIENT-SERVER-INTERFACE>
              <SHORT-NAME>SendDefaultAuthenticationInformation_[!"string($mainFuncName)"!]</SHORT-NAME>
              <IS-SERVICE>true</IS-SERVICE>
              <OPERATIONS>
                <CLIENT-SERVER-OPERATION>
                  <SHORT-NAME>SendDefaultAuthenticationInformation</SHORT-NAME>
                  <ARGUMENTS>
                    <ARGUMENT-DATA-PROTOTYPE>
                      <SHORT-NAME>FreshnessValueID</SHORT-NAME>
                      <TYPE-TREF DEST="IMPLEMENTATION-DATA-TYPE">/AUTOSAR_Platform/ImplementationDataTypes/uint16</TYPE-TREF>
                      <DIRECTION>IN</DIRECTION>
                    </ARGUMENT-DATA-PROTOTYPE>
                    <ARGUMENT-DATA-PROTOTYPE>
                      <SHORT-NAME>sendDefaultAuthenticationInformation</SHORT-NAME>
                      <TYPE-TREF DEST="IMPLEMENTATION-DATA-TYPE">/AUTOSAR_Platform/ImplementationDataTypes/boolean</TYPE-TREF>
                      <DIRECTION>IN</DIRECTION>
                    </ARGUMENT-DATA-PROTOTYPE>
                  </ARGUMENTS>
                  <POSSIBLE-ERROR-REFS>
                    <POSSIBLE-ERROR-REF DEST="APPLICATION-ERROR">/AUTOSAR_SecOC/PortInterfaces/SendDefaultAuthenticationInformation_[!"string($mainFuncName)"!]/E_OK</POSSIBLE-ERROR-REF>
                    <POSSIBLE-ERROR-REF DEST="APPLICATION-ERROR">/AUTOSAR_SecOC/PortInterfaces/SendDefaultAuthenticationInformation_[!"string($mainFuncName)"!]/E_NOT_OK</POSSIBLE-ERROR-REF>
                  </POSSIBLE-ERROR-REFS>
                </CLIENT-SERVER-OPERATION>
              </OPERATIONS>
              <POSSIBLE-ERRORS>
                <APPLICATION-ERROR>
                  <SHORT-NAME>E_OK</SHORT-NAME>
                  <ERROR-CODE>0</ERROR-CODE>
                </APPLICATION-ERROR>
                <APPLICATION-ERROR>
                  <SHORT-NAME>E_NOT_OK</SHORT-NAME>
                  <ERROR-CODE>1</ERROR-CODE>
                </APPLICATION-ERROR>
              </POSSIBLE-ERRORS>
            </CLIENT-SERVER-INTERFACE>
  [!ENDIF!]
  [!ENDLOOP!]
[!ENDLOOP!]
          </ELEMENTS>
        </AR-PACKAGE>
      </AR-PACKAGES>
    </AR-PACKAGE>
  </AR-PACKAGES>
</AUTOSAR>
[!ENDIF!]
