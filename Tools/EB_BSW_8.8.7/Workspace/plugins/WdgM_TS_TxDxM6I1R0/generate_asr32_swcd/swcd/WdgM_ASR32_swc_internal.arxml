<?xml version="1.0" encoding="UTF-8"?>
[!AUTOSPACING!]
<AUTOSAR xmlns="http://autosar.org/3.2.2"
  xmlns:xsi="http://www.w3.org/2001/XMLSchema-instance"
  xsi:schemaLocation="http://autosar.org/3.2.2 AUTOSAR_STRICT_COMPACT.xsd">
  [!/* do not generate this file if RTE is not used */!]
  [!SKIPFILE "WdgMGeneral/WdgMRteUsage = 'false'"!][!//
  [!IF "node:exists(WdgMGeneral/WdgMServiceAPI) and WdgMGeneral/WdgMServiceAPI/WdgMDefaultASRServiceAPI = 'AUTOSAR_32'"!][!//
  [!VAR "swComponentTypePackageName" = "'ComponentTypes'"!][!//
  [!VAR "swcImplementationPackageName" = "'Implementations'"!][!//
  [!VAR "swcImplementationDataTypesPackageName" = "'Datatypes'"!][!//
  [!ELSE!][!//
  [!VAR "swComponentTypePackageName" = "'SwComponentTypes'"!][!//
  [!VAR "swcImplementationPackageName" = "'SwcImplementations'"!][!//
  [!VAR "swcImplementationDataTypesPackageName" = "'ImplementationDataTypes'"!][!//
  [!ENDIF!][!//
  <TOP-LEVEL-PACKAGES>
    <AR-PACKAGE>
      <SHORT-NAME>AUTOSAR_WdgM</SHORT-NAME>
      <ELEMENTS/>
        <SUB-PACKAGES>
          <AR-PACKAGE>
            <SHORT-NAME>[!"$swComponentTypePackageName"!]</SHORT-NAME>
            <ELEMENTS>
              <SERVICE-COMPONENT-TYPE>
                <SHORT-NAME>WdgM</SHORT-NAME>
                <PORTS>
[!IF "node:exists(WdgMGeneral/WdgMServiceAPI) and (WdgMGeneral/WdgMServiceAPI/WdgMEnableASR32ServiceAPI = 'true')"!]
<!-- Provide AUTOSAR 3.2 service -->
  [!/* global mode port */!]
                  <P-PORT-PROTOTYPE>
                    <SHORT-NAME>WdgM_ASR32_globalMode</SHORT-NAME>
                    <PROVIDED-INTERFACE-TREF DEST="SENDER-RECEIVER-INTERFACE">/AUTOSAR_WdgM/ASR32/PortInterfaces/WdgM_ASR32_GlobalMode</PROVIDED-INTERFACE-TREF>
                  </P-PORT-PROTOTYPE>
  [!LOOP "WdgMGeneral/WdgMSupervisedEntity/*"!]
  [!/* ports for alive supervision per SE */!]
                  <P-PORT-PROTOTYPE>
                    <SHORT-NAME>alive_ASR32_[!"name(.)"!]</SHORT-NAME>
                    <PROVIDED-COM-SPECS>
                      <SERVER-COM-SPEC>
                        <OPERATION-REF DEST="OPERATION-PROTOTYPE">/AUTOSAR_WdgM/ASR32/PortInterfaces/WdgM_ASR32_AliveSupervision/UpdateAliveCounter</OPERATION-REF>
                        <QUEUE-LENGTH>1</QUEUE-LENGTH>
                      </SERVER-COM-SPEC>
    [!IF "node:exists(../../WdgMServiceAPI/WdgMEnableASR32ActivateAliveSupervisionAPI)"!]
                      <SERVER-COM-SPEC>
                        <OPERATION-REF DEST="OPERATION-PROTOTYPE">/AUTOSAR_WdgM/ASR32/PortInterfaces/WdgM_ASR32_AliveSupervision/ActivateAliveSupervision</OPERATION-REF>
                        <QUEUE-LENGTH>1</QUEUE-LENGTH>
                      </SERVER-COM-SPEC>
    [!ENDIF!]
    [!IF "node:exists(../../WdgMServiceAPI/WdgMEnableASR32DeactivateAliveSupervisionAPI)"!]
                      <SERVER-COM-SPEC>
                        <OPERATION-REF DEST="OPERATION-PROTOTYPE">/AUTOSAR_WdgM/ASR32/PortInterfaces/WdgM_ASR32_AliveSupervision/DeactivateAliveSupervision</OPERATION-REF>
                        <QUEUE-LENGTH>1</QUEUE-LENGTH>
                      </SERVER-COM-SPEC>
    [!ENDIF!]
                    </PROVIDED-COM-SPECS>
                    <PROVIDED-INTERFACE-TREF DEST="CLIENT-SERVER-INTERFACE">/AUTOSAR_WdgM/ASR32/PortInterfaces/WdgM_ASR32_AliveSupervision</PROVIDED-INTERFACE-TREF>
                  </P-PORT-PROTOTYPE>
  [!/* individual mode port per SE */!]
                  <P-PORT-PROTOTYPE>
                    <SHORT-NAME>mode_ASR32_[!"name(.)"!]</SHORT-NAME>
                    <PROVIDED-INTERFACE-TREF DEST="SENDER-RECEIVER-INTERFACE">/AUTOSAR_WdgM/ASR32/PortInterfaces/WdgM_ASR32_IndividualMode</PROVIDED-INTERFACE-TREF>
                  </P-PORT-PROTOTYPE>
  [!ENDLOOP!]
[!ENDIF!]
[!IF "node:exists(WdgMGeneral/WdgMServiceAPI) and (WdgMGeneral/WdgMServiceAPI/WdgMEnableASR40ServiceAPI = 'true')"!]
<!-- Provide AUTOSAR 4.0 service -->
  [!/* global mode port */!]
                  <P-PORT-PROTOTYPE>
                    <SHORT-NAME>WdgM_ASR40_globalMode</SHORT-NAME>
                    <PROVIDED-INTERFACE-TREF DEST="SENDER-RECEIVER-INTERFACE">/AUTOSAR_WdgM/ASR40/PortInterfaces/WdgM_ASR40_GlobalMode</PROVIDED-INTERFACE-TREF>
                  </P-PORT-PROTOTYPE>
  [!LOOP "WdgMGeneral/WdgMSupervisedEntity/*"!]
  [!/* ports for alive supervision per SE */!]
                  <P-PORT-PROTOTYPE>
                    <SHORT-NAME>alive_ASR40_[!"name(.)"!]</SHORT-NAME>
                    <PROVIDED-COM-SPECS>
                      <SERVER-COM-SPEC>
                        <OPERATION-REF DEST="OPERATION-PROTOTYPE">/AUTOSAR_WdgM/ASR40/PortInterfaces/WdgM_ASR40_AliveSupervision/UpdateAliveCounter</OPERATION-REF>
                        <QUEUE-LENGTH>1</QUEUE-LENGTH>
                      </SERVER-COM-SPEC>
                      <SERVER-COM-SPEC>
                        <OPERATION-REF DEST="OPERATION-PROTOTYPE">/AUTOSAR_WdgM/ASR40/PortInterfaces/WdgM_ASR40_AliveSupervision/CheckpointReached</OPERATION-REF>
                        <QUEUE-LENGTH>1</QUEUE-LENGTH>
                      </SERVER-COM-SPEC>
                    </PROVIDED-COM-SPECS>
                    <PROVIDED-INTERFACE-TREF DEST="CLIENT-SERVER-INTERFACE">/AUTOSAR_WdgM/ASR40/PortInterfaces/WdgM_ASR40_AliveSupervision</PROVIDED-INTERFACE-TREF>
                  </P-PORT-PROTOTYPE>
  [!/* individual mode port per SE */!]
                  <P-PORT-PROTOTYPE>
                    <SHORT-NAME>mode_ASR40_[!"name(.)"!]</SHORT-NAME>
                    <PROVIDED-INTERFACE-TREF DEST="SENDER-RECEIVER-INTERFACE">/AUTOSAR_WdgM/ASR40/PortInterfaces/WdgM_ASR40_IndividualMode</PROVIDED-INTERFACE-TREF>
                  </P-PORT-PROTOTYPE>
  [!ENDLOOP!]
[!ENDIF!]
[!IF "node:exists(WdgMGeneral/WdgMServiceAPI) and WdgMGeneral/WdgMServiceAPI/WdgMDefaultASRServiceAPI = 'AUTOSAR_32'"!]
<!-- Provide default service -->
  [!/* global mode port */!]
                  <P-PORT-PROTOTYPE>
                    <SHORT-NAME>globalMode</SHORT-NAME>
                    <PROVIDED-INTERFACE-TREF DEST="SENDER-RECEIVER-INTERFACE">/AUTOSAR_WdgM/PortInterfaces/WdgM_GlobalMode</PROVIDED-INTERFACE-TREF>
                  </P-PORT-PROTOTYPE>
  [!LOOP "WdgMGeneral/WdgMSupervisedEntity/*"!]
  [!/* ports for alive supervision per SE */!]
                  <P-PORT-PROTOTYPE>
                    <SHORT-NAME>alive_[!"name(.)"!]</SHORT-NAME>
                    <PROVIDED-COM-SPECS>
                      <SERVER-COM-SPEC>
                        <OPERATION-REF DEST="OPERATION-PROTOTYPE">/AUTOSAR_WdgM/PortInterfaces/WdgM_AliveSupervision/UpdateAliveCounter</OPERATION-REF>
                        <QUEUE-LENGTH>1</QUEUE-LENGTH>
                      </SERVER-COM-SPEC>
    [!IF "node:exists(../../WdgMServiceAPI/WdgMEnableASR32ActivateAliveSupervisionAPI)"!]
                      <SERVER-COM-SPEC>
                        <OPERATION-REF DEST="OPERATION-PROTOTYPE">/AUTOSAR_WdgM/PortInterfaces/WdgM_AliveSupervision/ActivateAliveSupervision</OPERATION-REF>
                        <QUEUE-LENGTH>1</QUEUE-LENGTH>
                      </SERVER-COM-SPEC>
    [!ENDIF!]
    [!IF "node:exists(../../WdgMServiceAPI/WdgMEnableASR32DeactivateAliveSupervisionAPI)"!]
                      <SERVER-COM-SPEC>
                        <OPERATION-REF DEST="OPERATION-PROTOTYPE">/AUTOSAR_WdgM/PortInterfaces/WdgM_AliveSupervision/DeactivateAliveSupervision</OPERATION-REF>
                        <QUEUE-LENGTH>1</QUEUE-LENGTH>
                      </SERVER-COM-SPEC>
    [!ENDIF!]
                    </PROVIDED-COM-SPECS>
                    <PROVIDED-INTERFACE-TREF DEST="CLIENT-SERVER-INTERFACE">/AUTOSAR_WdgM/PortInterfaces/WdgM_AliveSupervision</PROVIDED-INTERFACE-TREF>
                  </P-PORT-PROTOTYPE>
  [!/* individual mode port per SE */!]
                  <P-PORT-PROTOTYPE>
                    <SHORT-NAME>mode_[!"name(.)"!]</SHORT-NAME>
                    <PROVIDED-INTERFACE-TREF DEST="SENDER-RECEIVER-INTERFACE">/AUTOSAR_WdgM/PortInterfaces/WdgM_IndividualMode</PROVIDED-INTERFACE-TREF>
                  </P-PORT-PROTOTYPE>
  [!ENDLOOP!]
[!ENDIF!]
[!IF "node:exists(WdgMGeneral/WdgMServiceAPI) and WdgMGeneral/WdgMServiceAPI/WdgMDefaultASRServiceAPI = 'AUTOSAR_40'"!]
<!-- Provide default service -->
[!/* global mode port */!]
                  <P-PORT-PROTOTYPE>
                    <SHORT-NAME>globalMode</SHORT-NAME>
                    <PROVIDED-INTERFACE-TREF DEST="SENDER-RECEIVER-INTERFACE">/AUTOSAR_WdgM/PortInterfaces/WdgM_GlobalMode</PROVIDED-INTERFACE-TREF>
                  </P-PORT-PROTOTYPE>
  [!LOOP "WdgMGeneral/WdgMSupervisedEntity/*"!]
  [!/* ports for alive supervision per SE */!]
                  <P-PORT-PROTOTYPE>
                    <SHORT-NAME>alive_[!"name(.)"!]</SHORT-NAME>
                    <PROVIDED-COM-SPECS>
                      <SERVER-COM-SPEC>
                        <OPERATION-REF DEST="OPERATION-PROTOTYPE">/AUTOSAR_WdgM/PortInterfaces/WdgM_AliveSupervision/UpdateAliveCounter</OPERATION-REF>
                        <QUEUE-LENGTH>1</QUEUE-LENGTH>
                      </SERVER-COM-SPEC>
                      <SERVER-COM-SPEC>
                        <OPERATION-REF DEST="OPERATION-PROTOTYPE">/AUTOSAR_WdgM/PortInterfaces/WdgM_AliveSupervision/CheckpointReached</OPERATION-REF>
                        <QUEUE-LENGTH>1</QUEUE-LENGTH>
                      </SERVER-COM-SPEC>
                    </PROVIDED-COM-SPECS>
                    <PROVIDED-INTERFACE-TREF DEST="CLIENT-SERVER-INTERFACE">/AUTOSAR_WdgM/PortInterfaces/WdgM_AliveSupervision</PROVIDED-INTERFACE-TREF>
                  </P-PORT-PROTOTYPE>
  [!/* individual mode port per SE */!]
                  <P-PORT-PROTOTYPE>
                    <SHORT-NAME>mode_[!"name(.)"!]</SHORT-NAME>
                    <PROVIDED-INTERFACE-TREF DEST="SENDER-RECEIVER-INTERFACE">/AUTOSAR_WdgM/PortInterfaces/WdgM_IndividualMode</PROVIDED-INTERFACE-TREF>
                  </P-PORT-PROTOTYPE>
  [!ENDLOOP!]
[!ENDIF!]
                </PORTS>
              </SERVICE-COMPONENT-TYPE>
            </ELEMENTS>
          </AR-PACKAGE>
          <AR-PACKAGE>
            <SHORT-NAME>InternalBehaviors</SHORT-NAME>
            <ELEMENTS>
              <INTERNAL-BEHAVIOR>
                <SHORT-NAME>SwcInternalBehavior_0</SHORT-NAME>
                <COMPONENT-REF DEST="SERVICE-COMPONENT-TYPE">/AUTOSAR_WdgM/[!"$swComponentTypePackageName"!]/WdgM</COMPONENT-REF>
                <EVENTS>
[!IF "node:exists(WdgMGeneral/WdgMServiceAPI) and (WdgMGeneral/WdgMServiceAPI/WdgMEnableASR32ServiceAPI = 'true')"!]
<!-- Provide AUTOSAR 3.2 service -->
  [!LOOP "WdgMGeneral/WdgMSupervisedEntity/*"!]
                  <OPERATION-INVOKED-EVENT>
                    <SHORT-NAME>EV_ASR32_UpdateAliveCounter_SE_[!"name(.)"!]</SHORT-NAME>
                    <START-ON-EVENT-REF DEST="RUNNABLE-ENTITY">/AUTOSAR_WdgM/InternalBehaviors/SwcInternalBehavior_0/RE_ASR32_UpdateAliveCounter</START-ON-EVENT-REF>
                    <OPERATION-IREF>
                      <P-PORT-PROTOTYPE-REF DEST="P-PORT-PROTOTYPE">/AUTOSAR_WdgM/[!"$swComponentTypePackageName"!]/WdgM/alive_ASR32_[!"name(.)"!]</P-PORT-PROTOTYPE-REF>
                      <OPERATION-PROTOTYPE-REF DEST="OPERATION-PROTOTYPE">/AUTOSAR_WdgM/ASR32/PortInterfaces/WdgM_ASR32_AliveSupervision/UpdateAliveCounter</OPERATION-PROTOTYPE-REF>
                    </OPERATION-IREF>
                  </OPERATION-INVOKED-EVENT>
    [!IF "node:exists(../../WdgMServiceAPI/WdgMEnableASR32ActivateAliveSupervisionAPI)"!]
                  <OPERATION-INVOKED-EVENT>
                    <SHORT-NAME>EV_ASR32_ActAliveSuperv_SE_[!"name(.)"!]</SHORT-NAME>
                    <START-ON-EVENT-REF DEST="RUNNABLE-ENTITY">/AUTOSAR_WdgM/InternalBehaviors/SwcInternalBehavior_0/RE_ASR32_ActivateAliveSupervision</START-ON-EVENT-REF>
                    <OPERATION-IREF>
                      <P-PORT-PROTOTYPE-REF DEST="P-PORT-PROTOTYPE">/AUTOSAR_WdgM/[!"$swComponentTypePackageName"!]/WdgM/alive_ASR32_[!"name(.)"!]</P-PORT-PROTOTYPE-REF>
                      <OPERATION-PROTOTYPE-REF DEST="OPERATION-PROTOTYPE">/AUTOSAR_WdgM/ASR32/PortInterfaces/WdgM_ASR32_AliveSupervision/ActivateAliveSupervision</OPERATION-PROTOTYPE-REF>
                    </OPERATION-IREF>
                  </OPERATION-INVOKED-EVENT>
    [!ENDIF!]
    [!IF "node:exists(../../WdgMServiceAPI/WdgMEnableASR32DeactivateAliveSupervisionAPI)"!]
                  <OPERATION-INVOKED-EVENT>
                    <SHORT-NAME>EV_ASR32_DeactAliveSuperv_SE_[!"name(.)"!]</SHORT-NAME>
                    <START-ON-EVENT-REF DEST="RUNNABLE-ENTITY">/AUTOSAR_WdgM/InternalBehaviors/SwcInternalBehavior_0/RE_ASR32_DeactivateAliveSupervision</START-ON-EVENT-REF>
                    <OPERATION-IREF>
                      <P-PORT-PROTOTYPE-REF DEST="P-PORT-PROTOTYPE">/AUTOSAR_WdgM/[!"$swComponentTypePackageName"!]/WdgM/alive_ASR32_[!"name(.)"!]</P-PORT-PROTOTYPE-REF>
                      <OPERATION-PROTOTYPE-REF DEST="OPERATION-PROTOTYPE">/AUTOSAR_WdgM/ASR32/PortInterfaces/WdgM_ASR32_AliveSupervision/DeactivateAliveSupervision</OPERATION-PROTOTYPE-REF>
                    </OPERATION-IREF>
                  </OPERATION-INVOKED-EVENT>
    [!ENDIF!]
  [!ENDLOOP!]
[!ENDIF!]
[!IF "node:exists(WdgMGeneral/WdgMServiceAPI) and (WdgMGeneral/WdgMServiceAPI/WdgMEnableASR40ServiceAPI = 'true')"!]
<!-- Provide AUTOSAR 4.0 service -->
  [!LOOP "WdgMGeneral/WdgMSupervisedEntity/*"!]
                  <OPERATION-INVOKED-EVENT>
                    <SHORT-NAME>EV_ASR40_UpdateAliveCounter_SE_[!"name(.)"!]</SHORT-NAME>
                    <START-ON-EVENT-REF DEST="RUNNABLE-ENTITY">/AUTOSAR_WdgM/InternalBehaviors/SwcInternalBehavior_0/RE_ASR40_UpdateAliveCounter</START-ON-EVENT-REF>
                    <OPERATION-IREF>
                      <P-PORT-PROTOTYPE-REF DEST="P-PORT-PROTOTYPE">/AUTOSAR_WdgM/[!"$swComponentTypePackageName"!]/WdgM/alive_ASR40_[!"name(.)"!]</P-PORT-PROTOTYPE-REF>
                      <OPERATION-PROTOTYPE-REF DEST="OPERATION-PROTOTYPE">/AUTOSAR_WdgM/ASR40/PortInterfaces/WdgM_ASR40_AliveSupervision/UpdateAliveCounter</OPERATION-PROTOTYPE-REF>
                    </OPERATION-IREF>
                  </OPERATION-INVOKED-EVENT>
                  <OPERATION-INVOKED-EVENT>
                    <SHORT-NAME>EV_ASR40_CheckpointReached_SE_[!"name(.)"!]</SHORT-NAME>
                    <START-ON-EVENT-REF DEST="RUNNABLE-ENTITY">/AUTOSAR_WdgM/InternalBehaviors/SwcInternalBehavior_0/RE_ASR40_CheckpointReached</START-ON-EVENT-REF>
                    <OPERATION-IREF>
                      <P-PORT-PROTOTYPE-REF DEST="P-PORT-PROTOTYPE">/AUTOSAR_WdgM/[!"$swComponentTypePackageName"!]/WdgM/alive_ASR40_[!"name(.)"!]</P-PORT-PROTOTYPE-REF>
                      <OPERATION-PROTOTYPE-REF DEST="OPERATION-PROTOTYPE">/AUTOSAR_WdgM/ASR40/PortInterfaces/WdgM_ASR40_AliveSupervision/CheckpointReached</OPERATION-PROTOTYPE-REF>
                    </OPERATION-IREF>
                  </OPERATION-INVOKED-EVENT>
  [!ENDLOOP!]
[!ENDIF!]
[!IF "node:exists(WdgMGeneral/WdgMServiceAPI) and WdgMGeneral/WdgMServiceAPI/WdgMDefaultASRServiceAPI = 'AUTOSAR_32'"!]
<!-- Provide default service -->
  [!LOOP "WdgMGeneral/WdgMSupervisedEntity/*"!]
                  <OPERATION-INVOKED-EVENT>
                    <SHORT-NAME>EV_UpdateAliveCounter_SE_[!"name(.)"!]</SHORT-NAME>
                    <START-ON-EVENT-REF DEST="RUNNABLE-ENTITY">/AUTOSAR_WdgM/InternalBehaviors/SwcInternalBehavior_0/RE_UpdateAliveCounter</START-ON-EVENT-REF>
                    <OPERATION-IREF>
                      <P-PORT-PROTOTYPE-REF DEST="P-PORT-PROTOTYPE">/AUTOSAR_WdgM/[!"$swComponentTypePackageName"!]/WdgM/alive_[!"name(.)"!]</P-PORT-PROTOTYPE-REF>
                      <OPERATION-PROTOTYPE-REF DEST="OPERATION-PROTOTYPE">/AUTOSAR_WdgM/PortInterfaces/WdgM_AliveSupervision/UpdateAliveCounter</OPERATION-PROTOTYPE-REF>
                    </OPERATION-IREF>
                  </OPERATION-INVOKED-EVENT>
    [!IF "node:exists(../../WdgMServiceAPI/WdgMEnableASR32ActivateAliveSupervisionAPI)"!]
                  <OPERATION-INVOKED-EVENT>
                    <SHORT-NAME>EV_ActAliveSuperv_SE_[!"name(.)"!]</SHORT-NAME>
                    <START-ON-EVENT-REF DEST="RUNNABLE-ENTITY">/AUTOSAR_WdgM/InternalBehaviors/SwcInternalBehavior_0/RE_ActivateAliveSupervision</START-ON-EVENT-REF>
                    <OPERATION-IREF>
                      <P-PORT-PROTOTYPE-REF DEST="P-PORT-PROTOTYPE">/AUTOSAR_WdgM/[!"$swComponentTypePackageName"!]/WdgM/alive_[!"name(.)"!]</P-PORT-PROTOTYPE-REF>
                      <OPERATION-PROTOTYPE-REF DEST="OPERATION-PROTOTYPE">/AUTOSAR_WdgM/PortInterfaces/WdgM_AliveSupervision/ActivateAliveSupervision</OPERATION-PROTOTYPE-REF>
                    </OPERATION-IREF>
                  </OPERATION-INVOKED-EVENT>
    [!ENDIF!]
    [!IF "node:exists(../../WdgMServiceAPI/WdgMEnableASR32DeactivateAliveSupervisionAPI)"!]
                  <OPERATION-INVOKED-EVENT>
                    <SHORT-NAME>EV_DeactAliveSuperv_SE_[!"name(.)"!]</SHORT-NAME>
                    <START-ON-EVENT-REF DEST="RUNNABLE-ENTITY">/AUTOSAR_WdgM/InternalBehaviors/SwcInternalBehavior_0/RE_DeactivateAliveSupervision</START-ON-EVENT-REF>
                    <OPERATION-IREF>
                      <P-PORT-PROTOTYPE-REF DEST="P-PORT-PROTOTYPE">/AUTOSAR_WdgM/[!"$swComponentTypePackageName"!]/WdgM/alive_[!"name(.)"!]</P-PORT-PROTOTYPE-REF>
                      <OPERATION-PROTOTYPE-REF DEST="OPERATION-PROTOTYPE">/AUTOSAR_WdgM/PortInterfaces/WdgM_AliveSupervision/DeactivateAliveSupervision</OPERATION-PROTOTYPE-REF>
                    </OPERATION-IREF>
                  </OPERATION-INVOKED-EVENT>
    [!ENDIF!]
  [!ENDLOOP!]
[!ENDIF!]
[!IF "node:exists(WdgMGeneral/WdgMServiceAPI) and WdgMGeneral/WdgMServiceAPI/WdgMDefaultASRServiceAPI = 'AUTOSAR_40'"!]
<!-- Provide default service -->
  [!LOOP "WdgMGeneral/WdgMSupervisedEntity/*"!]
                  <OPERATION-INVOKED-EVENT>
                    <SHORT-NAME>EV_UpdateAliveCounter_SE_[!"name(.)"!]</SHORT-NAME>
                    <START-ON-EVENT-REF DEST="RUNNABLE-ENTITY">/AUTOSAR_WdgM/InternalBehaviors/SwcInternalBehavior_0/RE_UpdateAliveCounter</START-ON-EVENT-REF>
                    <OPERATION-IREF>
                      <P-PORT-PROTOTYPE-REF DEST="P-PORT-PROTOTYPE">/AUTOSAR_WdgM/[!"$swComponentTypePackageName"!]/WdgM/alive_[!"name(.)"!]</P-PORT-PROTOTYPE-REF>
                      <OPERATION-PROTOTYPE-REF DEST="OPERATION-PROTOTYPE">/AUTOSAR_WdgM/PortInterfaces/WdgM_AliveSupervision/UpdateAliveCounter</OPERATION-PROTOTYPE-REF>
                    </OPERATION-IREF>
                  </OPERATION-INVOKED-EVENT>
                  <OPERATION-INVOKED-EVENT>
                    <SHORT-NAME>EV_CheckpointReached_SE_[!"name(.)"!]</SHORT-NAME>
                    <START-ON-EVENT-REF DEST="RUNNABLE-ENTITY">/AUTOSAR_WdgM/InternalBehaviors/SwcInternalBehavior_0/RE_CheckpointReached</START-ON-EVENT-REF>
                    <OPERATION-IREF>
                      <P-PORT-PROTOTYPE-REF DEST="P-PORT-PROTOTYPE">/AUTOSAR_WdgM/[!"$swComponentTypePackageName"!]/WdgM/alive_[!"name(.)"!]</P-PORT-PROTOTYPE-REF>
                      <OPERATION-PROTOTYPE-REF DEST="OPERATION-PROTOTYPE">/AUTOSAR_WdgM/PortInterfaces/WdgM_AliveSupervision/CheckpointReached</OPERATION-PROTOTYPE-REF>
                    </OPERATION-IREF>
                  </OPERATION-INVOKED-EVENT>
  [!ENDLOOP!]
[!ENDIF!]
                </EVENTS>
                <PORT-API-OPTIONS>
[!IF "node:exists(WdgMGeneral/WdgMServiceAPI) and (WdgMGeneral/WdgMServiceAPI/WdgMEnableASR32ServiceAPI = 'true')"!]
<!-- Provide AUTOSAR 3.2 service -->
                  <!-- switch functions must be accessible via function pointer -->
                  <PORT-API-OPTION>
                    <ENABLE-TAKE-ADDRESS>true</ENABLE-TAKE-ADDRESS>
                    <INDIRECT-API>false</INDIRECT-API>
                    <PORT-REF DEST="P-PORT-PROTOTYPE">/AUTOSAR_WdgM/[!"$swComponentTypePackageName"!]/WdgM/WdgM_ASR32_globalMode</PORT-REF>
                  </PORT-API-OPTION>
  [!LOOP "WdgMGeneral/WdgMSupervisedEntity/*"!]
                  <PORT-API-OPTION>
                    <ENABLE-TAKE-ADDRESS>false</ENABLE-TAKE-ADDRESS>
                    <INDIRECT-API>false</INDIRECT-API>
                    <PORT-ARG-VALUES>
                      <INTEGER-LITERAL>
                        <SHORT-NAME>PORTARG_ASR32_SE_[!"name(.)"!]</SHORT-NAME>
                        <TYPE-TREF DEST="INTEGER-TYPE">/AUTOSAR_WdgM/ASR32/Datatypes/WdgM_ASR32_SupervisedEntityIdType</TYPE-TREF>
                        <VALUE>[!"num:i(WdgMSupervisedEntityId)"!]</VALUE>
                      </INTEGER-LITERAL>
                    </PORT-ARG-VALUES>
                    <PORT-REF DEST="P-PORT-PROTOTYPE">/AUTOSAR_WdgM/[!"$swComponentTypePackageName"!]/WdgM/alive_ASR32_[!"name(.)"!]</PORT-REF>
                  </PORT-API-OPTION>
                  <!-- switch functions must be accessible via function pointer -->
                  <PORT-API-OPTION>
                    <ENABLE-TAKE-ADDRESS>true</ENABLE-TAKE-ADDRESS>
                    <INDIRECT-API>false</INDIRECT-API>
                    <PORT-REF DEST="P-PORT-PROTOTYPE">/AUTOSAR_WdgM/[!"$swComponentTypePackageName"!]/WdgM/mode_ASR32_[!"name(.)"!]</PORT-REF>
                  </PORT-API-OPTION>
  [!ENDLOOP!]
[!ENDIF!]
[!IF "node:exists(WdgMGeneral/WdgMServiceAPI) and (WdgMGeneral/WdgMServiceAPI/WdgMEnableASR40ServiceAPI = 'true')"!]
<!-- Provide AUTOSAR 4.0 service -->
                  <!-- switch functions must be accessible via function pointer -->
                  <PORT-API-OPTION>
                    <ENABLE-TAKE-ADDRESS>true</ENABLE-TAKE-ADDRESS>
                    <INDIRECT-API>false</INDIRECT-API>
                    <PORT-REF DEST="P-PORT-PROTOTYPE">/AUTOSAR_WdgM/[!"$swComponentTypePackageName"!]/WdgM/WdgM_ASR40_globalMode</PORT-REF>
                  </PORT-API-OPTION>
  [!LOOP "WdgMGeneral/WdgMSupervisedEntity/*"!]
                  <PORT-API-OPTION>
                    <ENABLE-TAKE-ADDRESS>false</ENABLE-TAKE-ADDRESS>
                    <INDIRECT-API>false</INDIRECT-API>
                    <PORT-ARG-VALUES>
                      <INTEGER-LITERAL>
                        <SHORT-NAME>PORTARG_ASR40_SE_[!"name(.)"!]</SHORT-NAME>
                        <TYPE-TREF DEST="INTEGER-TYPE">/AUTOSAR_WdgM/ASR40/Datatypes/WdgM_ASR40_SupervisedEntityIdType</TYPE-TREF>
                        <VALUE>[!"num:i(WdgMSupervisedEntityId)"!]</VALUE>
                      </INTEGER-LITERAL>
                    </PORT-ARG-VALUES>
                    <PORT-REF DEST="P-PORT-PROTOTYPE">/AUTOSAR_WdgM/[!"$swComponentTypePackageName"!]/WdgM/alive_ASR40_[!"name(.)"!]</PORT-REF>
                  </PORT-API-OPTION>
                  <!-- switch functions must be accessible via function pointer -->
                  <PORT-API-OPTION>
                    <ENABLE-TAKE-ADDRESS>true</ENABLE-TAKE-ADDRESS>
                    <INDIRECT-API>false</INDIRECT-API>
                    <PORT-REF DEST="P-PORT-PROTOTYPE">/AUTOSAR_WdgM/[!"$swComponentTypePackageName"!]/WdgM/mode_ASR40_[!"name(.)"!]</PORT-REF>
                  </PORT-API-OPTION>
  [!ENDLOOP!]
[!ENDIF!]
[!IF "node:exists(WdgMGeneral/WdgMServiceAPI) and WdgMGeneral/WdgMServiceAPI/WdgMDefaultASRServiceAPI != 'NONE'"!]
<!-- Provide default service -->
                  <!-- switch functions must be accessible via function pointer -->
                  <PORT-API-OPTION>
                    <ENABLE-TAKE-ADDRESS>true</ENABLE-TAKE-ADDRESS>
                    <INDIRECT-API>false</INDIRECT-API>
                    <PORT-REF DEST="P-PORT-PROTOTYPE">/AUTOSAR_WdgM/[!"$swComponentTypePackageName"!]/WdgM/globalMode</PORT-REF>
                  </PORT-API-OPTION>
  [!LOOP "WdgMGeneral/WdgMSupervisedEntity/*"!]
                  <PORT-API-OPTION>
                    <ENABLE-TAKE-ADDRESS>false</ENABLE-TAKE-ADDRESS>
                    <INDIRECT-API>false</INDIRECT-API>
                    <PORT-ARG-VALUES>
                      <INTEGER-LITERAL>
                        <SHORT-NAME>PORTARG_SE_[!"name(.)"!]</SHORT-NAME>
                        <TYPE-TREF DEST="INTEGER-TYPE">/AUTOSAR_WdgM/[!"$swcImplementationDataTypesPackageName"!]/WdgM_SupervisedEntityIdType</TYPE-TREF>
                        <VALUE>[!"num:i(WdgMSupervisedEntityId)"!]</VALUE>
                      </INTEGER-LITERAL>
                    </PORT-ARG-VALUES>
                    <PORT-REF DEST="P-PORT-PROTOTYPE">/AUTOSAR_WdgM/[!"$swComponentTypePackageName"!]/WdgM/alive_[!"name(.)"!]</PORT-REF>
                  </PORT-API-OPTION>
                  <!-- switch functions must be accessible via function pointer -->
                  <PORT-API-OPTION>
                    <ENABLE-TAKE-ADDRESS>true</ENABLE-TAKE-ADDRESS>
                    <INDIRECT-API>false</INDIRECT-API>
                    <PORT-REF DEST="P-PORT-PROTOTYPE">/AUTOSAR_WdgM/[!"$swComponentTypePackageName"!]/WdgM/mode_[!"name(.)"!]</PORT-REF>
                  </PORT-API-OPTION>
  [!ENDLOOP!]
[!ENDIF!]
                </PORT-API-OPTIONS>
                <RUNNABLES>
                  <RUNNABLE-ENTITY>
                    <SHORT-NAME>RE_Main</SHORT-NAME>
                    <CAN-BE-INVOKED-CONCURRENTLY>false</CAN-BE-INVOKED-CONCURRENTLY>
                    <MINIMUM-START-INTERVAL>0</MINIMUM-START-INTERVAL>
                    <MODE-SWITCH-POINTS>
[!IF "node:exists(WdgMGeneral/WdgMServiceAPI) and (WdgMGeneral/WdgMServiceAPI/WdgMEnableASR32ServiceAPI = 'true')"!]
<!-- Provide AUTOSAR 3.2 service -->
                      <MODE-SWITCH-POINT>
                        <SHORT-NAME>MSP_ASR32_globalMode</SHORT-NAME>
                        <MODE-GROUP-IREF>
                          <P-PORT-PROTOTYPE-REF DEST="P-PORT-PROTOTYPE">/AUTOSAR_WdgM/[!"$swComponentTypePackageName"!]/WdgM/WdgM_ASR32_globalMode</P-PORT-PROTOTYPE-REF>
                          <MODE-DECLARATION-GROUP-PROTOTYPE-REF DEST="MODE-DECLARATION-GROUP-PROTOTYPE">/AUTOSAR_WdgM/ASR32/PortInterfaces/WdgM_ASR32_GlobalMode/currentMode</MODE-DECLARATION-GROUP-PROTOTYPE-REF>
                        </MODE-GROUP-IREF>
                      </MODE-SWITCH-POINT>
  [!LOOP "WdgMGeneral/WdgMSupervisedEntity/*"!]
                      <MODE-SWITCH-POINT>
                        <SHORT-NAME>MSP_ASR32_mode_[!"name(.)"!]</SHORT-NAME>
                        <MODE-GROUP-IREF>
                          <P-PORT-PROTOTYPE-REF DEST="P-PORT-PROTOTYPE">/AUTOSAR_WdgM/[!"$swComponentTypePackageName"!]/WdgM/mode_ASR32_[!"name(.)"!]</P-PORT-PROTOTYPE-REF>
                          <MODE-DECLARATION-GROUP-PROTOTYPE-REF DEST="MODE-DECLARATION-GROUP-PROTOTYPE">/AUTOSAR_WdgM/ASR32/PortInterfaces/WdgM_ASR32_IndividualMode/currentMode</MODE-DECLARATION-GROUP-PROTOTYPE-REF>
                        </MODE-GROUP-IREF>
                      </MODE-SWITCH-POINT>
  [!ENDLOOP!]
[!ENDIF!]
[!IF "node:exists(WdgMGeneral/WdgMServiceAPI) and (WdgMGeneral/WdgMServiceAPI/WdgMEnableASR40ServiceAPI = 'true')"!]
<!-- Provide AUTOSAR 4.0 service -->
                      <MODE-SWITCH-POINT>
                        <SHORT-NAME>MSP_ASR40_globalMode</SHORT-NAME>
                        <MODE-GROUP-IREF>
                          <P-PORT-PROTOTYPE-REF DEST="P-PORT-PROTOTYPE">/AUTOSAR_WdgM/[!"$swComponentTypePackageName"!]/WdgM/WdgM_ASR40_globalMode</P-PORT-PROTOTYPE-REF>
                          <MODE-DECLARATION-GROUP-PROTOTYPE-REF DEST="MODE-DECLARATION-GROUP-PROTOTYPE">/AUTOSAR_WdgM/ASR40/PortInterfaces/WdgM_ASR40_GlobalMode/currentMode</MODE-DECLARATION-GROUP-PROTOTYPE-REF>
                        </MODE-GROUP-IREF>
                      </MODE-SWITCH-POINT>
  [!LOOP "WdgMGeneral/WdgMSupervisedEntity/*"!]
                      <MODE-SWITCH-POINT>
                        <SHORT-NAME>MSP_ASR40_mode_[!"name(.)"!]</SHORT-NAME>
                        <MODE-GROUP-IREF>
                          <P-PORT-PROTOTYPE-REF DEST="P-PORT-PROTOTYPE">/AUTOSAR_WdgM/[!"$swComponentTypePackageName"!]/WdgM/mode_ASR40_[!"name(.)"!]</P-PORT-PROTOTYPE-REF>
                          <MODE-DECLARATION-GROUP-PROTOTYPE-REF DEST="MODE-DECLARATION-GROUP-PROTOTYPE">/AUTOSAR_WdgM/ASR40/PortInterfaces/WdgM_ASR40_IndividualMode/currentMode</MODE-DECLARATION-GROUP-PROTOTYPE-REF>
                        </MODE-GROUP-IREF>
                      </MODE-SWITCH-POINT>
  [!ENDLOOP!]
[!ENDIF!]
[!IF "node:exists(WdgMGeneral/WdgMServiceAPI) and WdgMGeneral/WdgMServiceAPI/WdgMDefaultASRServiceAPI != 'NONE'"!]
<!-- Provide default service -->
                      <MODE-SWITCH-POINT>
                        <SHORT-NAME>MSP_globalMode</SHORT-NAME>
                        <MODE-GROUP-IREF>
                          <P-PORT-PROTOTYPE-REF DEST="P-PORT-PROTOTYPE">/AUTOSAR_WdgM/[!"$swComponentTypePackageName"!]/WdgM/globalMode</P-PORT-PROTOTYPE-REF>
                          <MODE-DECLARATION-GROUP-PROTOTYPE-REF DEST="MODE-DECLARATION-GROUP-PROTOTYPE">/AUTOSAR_WdgM/PortInterfaces/WdgM_GlobalMode/currentMode</MODE-DECLARATION-GROUP-PROTOTYPE-REF>
                        </MODE-GROUP-IREF>
                      </MODE-SWITCH-POINT>
  [!LOOP "WdgMGeneral/WdgMSupervisedEntity/*"!]
                      <MODE-SWITCH-POINT>
                        <SHORT-NAME>MSP_mode_[!"name(.)"!]</SHORT-NAME>
                        <MODE-GROUP-IREF>
                          <P-PORT-PROTOTYPE-REF DEST="P-PORT-PROTOTYPE">/AUTOSAR_WdgM/[!"$swComponentTypePackageName"!]/WdgM/mode_[!"name(.)"!]</P-PORT-PROTOTYPE-REF>
                          <MODE-DECLARATION-GROUP-PROTOTYPE-REF DEST="MODE-DECLARATION-GROUP-PROTOTYPE">/AUTOSAR_WdgM/PortInterfaces/WdgM_IndividualMode/currentMode</MODE-DECLARATION-GROUP-PROTOTYPE-REF>
                        </MODE-GROUP-IREF>
                      </MODE-SWITCH-POINT>
  [!ENDLOOP!]
[!ENDIF!]
                    </MODE-SWITCH-POINTS>
                    <SYMBOL>WdgM_MainFunction</SYMBOL>
                  </RUNNABLE-ENTITY>
[!IF "node:exists(WdgMGeneral/WdgMServiceAPI) and (WdgMGeneral/WdgMServiceAPI/WdgMEnableASR32ServiceAPI = 'true')"!]
<!-- Provide AUTOSAR 3.2 service -->
                  <RUNNABLE-ENTITY>
                    <SHORT-NAME>RE_ASR32_UpdateAliveCounter</SHORT-NAME>
                    <CAN-BE-INVOKED-CONCURRENTLY>true</CAN-BE-INVOKED-CONCURRENTLY>
                    <MINIMUM-START-INTERVAL>0</MINIMUM-START-INTERVAL>
                    <SYMBOL>WdgM_ASR32_Rte_UpdateAliveCounter</SYMBOL>
                  </RUNNABLE-ENTITY>
[!IF "node:exists(WdgMGeneral/WdgMServiceAPI/WdgMEnableASR32ActivateAliveSupervisionAPI)"!]
                  <RUNNABLE-ENTITY>
                    <SHORT-NAME>RE_ASR32_ActivateAliveSupervision</SHORT-NAME>
                    <CAN-BE-INVOKED-CONCURRENTLY>true</CAN-BE-INVOKED-CONCURRENTLY>
                    <MINIMUM-START-INTERVAL>0</MINIMUM-START-INTERVAL>
                    <SYMBOL>WdgM_ASR32_Rte_ActivateAliveSupervision</SYMBOL>
                  </RUNNABLE-ENTITY>
[!ENDIF!]
[!IF "node:exists(WdgMGeneral/WdgMServiceAPI/WdgMEnableASR32DeactivateAliveSupervisionAPI)"!]
                  <RUNNABLE-ENTITY>
                    <SHORT-NAME>RE_ASR32_DeactivateAliveSupervision</SHORT-NAME>
                    <CAN-BE-INVOKED-CONCURRENTLY>true</CAN-BE-INVOKED-CONCURRENTLY>
                    <MINIMUM-START-INTERVAL>0</MINIMUM-START-INTERVAL>
                    <SYMBOL>WdgM_ASR32_Rte_DeactivateAliveSupervision</SYMBOL>
                  </RUNNABLE-ENTITY>
[!ENDIF!]
[!ENDIF!]
[!IF "node:exists(WdgMGeneral/WdgMServiceAPI) and (WdgMGeneral/WdgMServiceAPI/WdgMEnableASR40ServiceAPI = 'true')"!]
<!-- Provide AUTOSAR 4.0 service -->
                  <RUNNABLE-ENTITY>
                    <SHORT-NAME>RE_ASR40_UpdateAliveCounter</SHORT-NAME>
                    <CAN-BE-INVOKED-CONCURRENTLY>true</CAN-BE-INVOKED-CONCURRENTLY>
                    <MINIMUM-START-INTERVAL>0</MINIMUM-START-INTERVAL>
                    <SYMBOL>WdgM_ASR40_Rte_UpdateAliveCounter</SYMBOL>
                  </RUNNABLE-ENTITY>
                  <RUNNABLE-ENTITY>
                    <SHORT-NAME>RE_ASR40_CheckpointReached</SHORT-NAME>
                    <CAN-BE-INVOKED-CONCURRENTLY>true</CAN-BE-INVOKED-CONCURRENTLY>
                    <MINIMUM-START-INTERVAL>0</MINIMUM-START-INTERVAL>
                    <SYMBOL>WdgM_ASR40_Rte_CheckpointReached</SYMBOL>
                  </RUNNABLE-ENTITY>
[!ENDIF!]
[!IF "node:exists(WdgMGeneral/WdgMServiceAPI) and WdgMGeneral/WdgMServiceAPI/WdgMDefaultASRServiceAPI != 'NONE'"!]
<!-- Provide default service -->
                  <RUNNABLE-ENTITY>
                    <SHORT-NAME>RE_UpdateAliveCounter</SHORT-NAME>
                    <CAN-BE-INVOKED-CONCURRENTLY>true</CAN-BE-INVOKED-CONCURRENTLY>
                    <MINIMUM-START-INTERVAL>0</MINIMUM-START-INTERVAL>
                    <SYMBOL>WdgM_Rte_UpdateAliveCounter</SYMBOL>
                  </RUNNABLE-ENTITY>
  [!IF "WdgMGeneral/WdgMServiceAPI/WdgMDefaultASRServiceAPI = 'AUTOSAR_40'"!]
                  <RUNNABLE-ENTITY>
                    <SHORT-NAME>RE_CheckpointReached</SHORT-NAME>
                    <CAN-BE-INVOKED-CONCURRENTLY>true</CAN-BE-INVOKED-CONCURRENTLY>
                    <MINIMUM-START-INTERVAL>0</MINIMUM-START-INTERVAL>
                    <SYMBOL>WdgM_Rte_CheckpointReached</SYMBOL>
                  </RUNNABLE-ENTITY>
  [!ENDIF!]
  [!IF "WdgMGeneral/WdgMServiceAPI/WdgMDefaultASRServiceAPI = 'AUTOSAR_32'"!]
    [!IF "node:exists(WdgMGeneral/WdgMServiceAPI/WdgMEnableASR32ActivateAliveSupervisionAPI)"!]
                  <RUNNABLE-ENTITY>
                    <SHORT-NAME>RE_ActivateAliveSupervision</SHORT-NAME>
                    <CAN-BE-INVOKED-CONCURRENTLY>true</CAN-BE-INVOKED-CONCURRENTLY>
                    <MINIMUM-START-INTERVAL>0</MINIMUM-START-INTERVAL>
                    <SYMBOL>WdgM_Rte_ActivateAliveSupervision</SYMBOL>
                  </RUNNABLE-ENTITY>
    [!ENDIF!]
    [!IF "node:exists(WdgMGeneral/WdgMServiceAPI/WdgMEnableASR32DeactivateAliveSupervisionAPI)"!]
                  <RUNNABLE-ENTITY>
                    <SHORT-NAME>RE_DeactivateAliveSupervision</SHORT-NAME>
                    <CAN-BE-INVOKED-CONCURRENTLY>true</CAN-BE-INVOKED-CONCURRENTLY>
                    <MINIMUM-START-INTERVAL>0</MINIMUM-START-INTERVAL>
                    <SYMBOL>WdgM_Rte_DeactivateAliveSupervision</SYMBOL>
                  </RUNNABLE-ENTITY>
    [!ENDIF!]
  [!ENDIF!]
[!ENDIF!]
                </RUNNABLES>
                <SUPPORTS-MULTIPLE-INSTANTIATION>false</SUPPORTS-MULTIPLE-INSTANTIATION>
              </INTERNAL-BEHAVIOR>
          </ELEMENTS>
        </AR-PACKAGE>
      </SUB-PACKAGES>
    </AR-PACKAGE>
    <AR-PACKAGE>
      <SHORT-NAME>EB_WdgM</SHORT-NAME>
      <SUB-PACKAGES>
        <AR-PACKAGE>
          <SHORT-NAME>[!"$swcImplementationPackageName"!]</SHORT-NAME>
          <ELEMENTS>
            <SWC-IMPLEMENTATION>
              <SHORT-NAME>SwcImplementation_0</SHORT-NAME>
              <CODE-DESCRIPTORS>
                <CODE>
                  <SHORT-NAME>WdgMCode</SHORT-NAME>
                  <TYPE>SRC</TYPE>
                </CODE>
              </CODE-DESCRIPTORS>
              <PROGRAMMING-LANGUAGE>C</PROGRAMMING-LANGUAGE>
              <RESOURCE-CONSUMPTION>
                <SHORT-NAME>Resources</SHORT-NAME>
                <OBJECT-FILE-SECTIONS>
                  <MEMORY-SECTION>
                    <SHORT-NAME>CODE</SHORT-NAME>
                    <ALIGNMENT>1</ALIGNMENT>
                    <SECTION-NAME>CODE</SECTION-NAME>
                    <SECTION-TYPE>CODE</SECTION-TYPE>
                    <SIZE>0</SIZE>
                    <SW-ADDR-METHOD-REFS>
                      <SW-ADDR-METHOD-REF DEST="SW-ADDR-METHOD">/AUTOSAR_MemMap/SwAddrMethods/CODE</SW-ADDR-METHOD-REF>
                    </SW-ADDR-METHOD-REFS>
                  </MEMORY-SECTION>
                </OBJECT-FILE-SECTIONS>
              </RESOURCE-CONSUMPTION>
              <SW-MAJOR-VERSION>6</SW-MAJOR-VERSION>
              <SW-MINOR-VERSION>1</SW-MINOR-VERSION>
              <SW-PATCH-VERSION>43</SW-PATCH-VERSION>
              <VENDOR-ID>1</VENDOR-ID>
              <BEHAVIOR-REF DEST="INTERNAL-BEHAVIOR">/AUTOSAR_WdgM/InternalBehaviors/SwcInternalBehavior_0</BEHAVIOR-REF>
            </SWC-IMPLEMENTATION>
          </ELEMENTS>
        </AR-PACKAGE>
      </SUB-PACKAGES>
    </AR-PACKAGE>
  </TOP-LEVEL-PACKAGES>
</AUTOSAR>
