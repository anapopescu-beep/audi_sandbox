AUTOSAR XML (schema 4-0-3)
package /BswM
  module config BswM: implementation-config-variant=VARIANT-POST-BUILD
    BswMConfig
      BswMArbitration
        5 x BswMLogicalExpression:
          BswM_LogEx_GoOffOneA: BswMArgumentRef=BswM_ModeCond_GoOffOneA
          BswM_LogEx_GoOffOneB: BswMArgumentRef=BswM_ModeCond_GoOffOneB
          BswM_LogEx_RunTwo: BswMArgumentRef=BswM_ModeCond_RunTwo
          BswM_LogEx_StartupTwoA: BswMArgumentRef=BswM_ModeCond_StartupTwoA
          BswM_LogEx_StartupTwoB: BswMArgumentRef=BswM_ModeCond_StartupTwoB
        5 x BswMModeCondition, all with BswMConditionType=BSWM_EQUALS, BswMConditionMode=BswM_ModeReqPort_EcuState:
          BswM_ModeCond_GoOffOneA
            BswMConditionValue
              BswMConditionValue (BswMBswMode): BswMBswRequestedMode=EB_INTGR_BSWM_GO_OFF_ONE_A
          BswM_ModeCond_GoOffOneB
            BswMConditionValue
              BswMConditionValue (BswMBswMode): BswMBswRequestedMode=EB_INTGR_BSWM_GO_OFF_ONE_B
          BswM_ModeCond_RunTwo
            BswMConditionValue
              BswMConditionValue (BswMModeDeclaration): BswMModeValueRef=EB_INTGR_BSWM_RUN_TWO
          BswM_ModeCond_StartupTwoA
            BswMConditionValue
              BswMConditionValue (BswMBswMode): BswMBswRequestedMode=EB_INTGR_BSWM_STARTUP_TWO_A
          BswM_ModeCond_StartupTwoB
            BswMConditionValue
              BswMConditionValue (BswMModeDeclaration): BswMModeValueRef=EB_INTGR_BSWM_STARTUP_TWO_B
        BswM_ModeReqPort_EcuState (BswMModeRequestPort): BswMRequestProcessing=BSWM_DEFERRED
          BswMModeInitValue
            BswMModeInitValue (BswMBswModeInitValue): BswMBswModeInitValueMode=0
          BswMModeRequestSource
            BswMModeRequestSource (BswMGenericRequest): BswMModeRequesterId=0
        5 x BswMRule, all with BswMNestedExecutionOnly=0:
          BswM_Rule_GoOffOneA: BswMRuleInitState=BSWM_FALSE, BswMRuleExpressionRef=BswM_LogEx_GoOffOneA, BswMRuleTrueActionList=BswM_ActLst_GoOffOneA
          BswM_Rule_GoOffOneB: BswMRuleInitState=BSWM_FALSE, BswMRuleExpressionRef=BswM_LogEx_GoOffOneB, BswMRuleTrueActionList=BswM_ActLst_GoOffOneB
          BswM_Rule_RunTwo: BswMRuleInitState=BSWM_FALSE, BswMRuleExpressionRef=BswM_LogEx_RunTwo, BswMRuleTrueActionList=BswM_ActLst_RunTwo
          BswM_Rule_StartupTwoA: BswMRuleInitState=BSWM_UNDEFINED, BswMRuleExpressionRef=BswM_LogEx_StartupTwoA, BswMRuleTrueActionList=BswM_ActLst_StartupTwoA
          BswM_Rule_StartupTwoB: BswMRuleInitState=BSWM_FALSE, BswMRuleExpressionRef=BswM_LogEx_StartupTwoB, BswMRuleTrueActionList=BswM_ActLst_StartupTwoB
      BswMModeControl
        6 x BswMAction:
          BswM_Act_GoOffOneA
            BswMAvailableActions
              BswMAvailableActions (BswMUserCallout): BswMUserCalloutFunction=Eb_Intgr_BswM_OnGoOffOneA()
          BswM_Act_GoOffOneB
            BswMAvailableActions
              BswMAvailableActions (BswMUserCallout): BswMUserCalloutFunction=Eb_Intgr_BswM_OnGoOffOneB()
          BswM_Act_NvMReadAll
            BswMAvailableActions
              BswMAvailableActions (BswMUserCallout): BswMUserCalloutFunction=Eb_Intgr_BswM_InitNvMReadAll()
          BswM_Act_ReqRunTwo
            BswMAvailableActions
              BswMAvailableActions (BswMUserCallout): BswMUserCalloutFunction=BswM_RequestMode(0, EB_INTGR_BSWM_RUN_TWO)
          BswM_Act_ReqStartupTwoB
            BswMAvailableActions
              BswMAvailableActions (BswMUserCallout): BswMUserCalloutFunction=Eb_Intgr_BswM_OnStartupTwoB()
          BswM_Act_RunTwo
            BswMAvailableActions
              BswMAvailableActions (BswMUserCallout): BswMUserCalloutFunction=Eb_Intgr_BswM_OnRunTwo()
        5 x BswMActionList, all with BswMActionListExecution=BSWM_TRIGGER:
          BswM_ActLst_GoOffOneA
            BswMActionListItem_0 (BswMActionListItem): BswMAbortOnFail=0, BswMActionListItemIndex=0, BswMActionListItemRef=BswM_Act_GoOffOneA
          BswM_ActLst_GoOffOneB
            BswMActionListItem_0 (BswMActionListItem): BswMAbortOnFail=0, BswMActionListItemIndex=0, BswMActionListItemRef=BswM_Act_GoOffOneB
          BswM_ActLst_RunTwo
            BswMActionListItem_0 (BswMActionListItem): BswMAbortOnFail=0, BswMActionListItemIndex=0, BswMActionListItemRef=BswM_Act_RunTwo
          BswM_ActLst_StartupTwoA
            BswMActionListItem_0 (BswMActionListItem): BswMActionListItemIndex=0, BswMActionListItemRef=BswM_Act_NvMReadAll
          BswM_ActLst_StartupTwoB
            BswMActionListItem_0 (BswMActionListItem): BswMAbortOnFail=0, BswMActionListItemIndex=0, BswMActionListItemRef=BswM_Act_ReqStartupTwoB
            BswMActionListItem_1 (BswMActionListItem): BswMAbortOnFail=0, BswMActionListItemIndex=2, BswMActionListItemRef=BswM_Act_ReqRunTwo
    BswMDefensiveProgramming:
      BswMDefProgEnabled = 0
      BswMInvariantAssertEnabled = 0
      BswMPostcondAssertEnabled = 0
      BswMPrecondAssertEnabled = 0
      BswMStaticAssertEnabled = 0
      BswMUnreachAssertEnabled = 0
    BswMGeneral:
      BswMActionsOptimization = 1
      BswMBinaryGenerationVerified = 0
      BswMCanSMEnabled = 0
      BswMComMEnabled = 0
      BswMDcmEnabled = 0
      BswMDevErrorDetect = 1
      BswMEcuMEnabled = 1
      BswMEthIfEnabled = 0
      BswMEthSMEnabled = 0
      BswMFrSMEnabled = 0
      BswMGenericRequestEnabled = 1
      BswMJ1939DcmEnabled = 0
      BswMJ1939NmEnabled = 0
      BswMLegacyDcmEnabled = 0
      BswMLinSMEnabled = 0
      BswMLinTPEnabled = 0
      BswMLogicalExpressionsOptimization = 0
      BswMMainFunctionPeriod = 0.02
      BswMNmEnabled = 0
      BswMNvMEnabled = 0
      BswMRelocatablePbcfgEnable = 1
      BswMRteUsage = 0
      BswMSdEnabled = 0
      BswMVersionInfoApi = 0
      BswMWdgMEnabled = 0
      BswMUserIncludeFiles: BswMUserIncludeFile=Eb_Intgr_BswM_UserCallouts.h
    ReportToDem: BswMActionFailedReportToDem=DISABLE
