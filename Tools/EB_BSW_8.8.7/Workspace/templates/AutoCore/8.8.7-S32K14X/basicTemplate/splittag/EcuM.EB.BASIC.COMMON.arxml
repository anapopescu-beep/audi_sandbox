AUTOSAR XML (schema 4-0-3)
package /EcuM
  module config EcuM: implementation-config-variant=VARIANT-POST-BUILD
    EcuM_Config_0 (EcuMConfiguration)
      EcuMCommonConfiguration: EcuMConfigConsistencyHash=0, EcuMDefaultAppMode=OSDEFAULTAPPMODE
        EcuMDefaultShutdownTarget: EcuMDefaultState=EcuMStateOff
        EcuMDemEventParameterRefs: ECUM_E_RAM_CHECK_FAILED=ECUM_E_RAM_CHECK_FAILED
        EcuMDriverInitListOne
          4 x EcuMDriverInitItem, all with EcuMEnableDriver=1, EcuMEnableVendorApiInfix=0:
            Dem_PreInit: EcuMModuleHeaderFile=(unset), EcuMModuleID=Dem, EcuMModuleService=PreInit
            Eb_Intgr_McuArchClockInit: EcuMModuleHeaderFile=Eb_Intgr_McuArchClockInit, EcuMModuleID=Eb_Intgr_McuArchClockInit, EcuMModuleService=Init
            Mcu_Init: EcuMModuleHeaderFile=Mcu, EcuMModuleID=Mcu, EcuMModuleInitConfigStr=BASE_MCU_CONFIG_PTR, EcuMModuleService=Init
            PbcfgM_Init: EcuMModuleHeaderFile=PbcfgM, EcuMModuleID=PbcfgM, EcuMModuleInitConfigStr=BASE_PBCFGM_CONFIG_PTR, EcuMModuleService=Init
        EcuMDriverInitListZero
          Det_Init (EcuMDriverInitItem): EcuMEnableVendorApiInfix=0, EcuMModuleHeaderFile=(unset), EcuMModuleID=Det, EcuMModuleService=Init
        EcuMSleepMode_0 (EcuMSleepMode):
          EcuMSleepModeId = 0
          EcuMSleepModeSuspend = 1
          EcuMSleepModeMcuModeRef = McuModeSettingConf_0
          EcuMWakeupSourceMask = ECUM_WKSOURCE_EXTERNAL_WDG
          EcuMWakeupSourceMask = ECUM_WKSOURCE_INTERNAL_RESET
          EcuMWakeupSourceMask = ECUM_WKSOURCE_INTERNAL_WDG
          EcuMWakeupSourceMask = ECUM_WKSOURCE_POWER
          EcuMWakeupSourceMask = ECUM_WKSOURCE_RESET
        5 x EcuMWakeupSource, all with EcuMWakeupSourcePolling=1:
          ECUM_WKSOURCE_EXTERNAL_WDG: EcuMWakeupSourceId=4, EcuMResetReasonRef=MCU_RESET_UNDEFINED
          ECUM_WKSOURCE_INTERNAL_RESET: EcuMWakeupSourceId=2, EcuMResetReasonRef=MCU_RESET_UNDEFINED
          ECUM_WKSOURCE_INTERNAL_WDG: EcuMWakeupSourceId=3, EcuMResetReasonRef=MCU_RESET_UNDEFINED
          ECUM_WKSOURCE_POWER: EcuMWakeupSourceId=0, EcuMResetReasonRef=MCU_POWER_ON_RESET
          ECUM_WKSOURCE_RESET: EcuMWakeupSourceId=1, EcuMResetReasonRef=MCU_RESET_UNDEFINED
      EcuMFlexConfiguration: EcuMFlexModuleConfigurationRef=McuModuleConfiguration, EcuMFlexModuleConfigurationRef=DemConfigSet, EcuMNormalMcuModeRef=McuModeSettingConf_0
        3 x EcuMFlexUserConfig:
          EcuMFlexUser_BswM: EcuMFlexUser=0
          EcuMFlexUser_ComM: EcuMFlexUser=2
          EcuMFlexUser_SchM: EcuMFlexUser=1
        3 x EcuMResetMode:
          ECUM_RESET_IO: EcuMResetModeId=2
          ECUM_RESET_MCU: EcuMResetModeId=0
          ECUM_RESET_WDG: EcuMResetModeId=1
        4 x EcuMShutdownCause:
          ECUM_CAUSE_DCM: EcuMShutdownCauseId=3
          ECUM_CAUSE_ECU_STATE: EcuMShutdownCauseId=1
          ECUM_CAUSE_UNKNOWN: EcuMShutdownCauseId=0
          ECUM_CAUSE_WDGM: EcuMShutdownCauseId=2
        3 x EcuMShutdownTarget:
          ECUM_STATE_OFF: EcuMShutdownTargetId=128
          ECUM_STATE_RESET: EcuMShutdownTargetId=144
          ECUM_STATE_SLEEP: EcuMShutdownTargetId=80
    EcuMDefensiveProgramming:
      EcuMDefProgEnabled = 0
      EcuMInvariantAssertEnabled = 0
      EcuMPostcondAssertEnabled = 0
      EcuMPrecondAssertEnabled = 0
      EcuMStaticAssertEnabled = 0
      EcuMUnreachAssertEnabled = 0
    EcuMFlexGeneral: EcuMAlarmClockPresent=0, EcuMResetLoopDetection=0, EcuMStoredShutdownOperations=1
    EcuMGeneral:
      EcuMCrossCoreComMWakeup = 0
      EcuMDevErrorDetect = 1
      EcuMEnableMulticore = 0
      EcuMIncludeDem = 1
      EcuMIncludeDet = 1
      EcuMMainFunctionPeriod = 0.02
      EcuMProvideShutdownHook = 0
      EcuMRelocatablePbcfgEnable = 1
      EcuMRteUsage = 0
      EcuMUseBoottargetSec = 0
      EcuMVersionInfoApi = 0
    ReportToDem: EcuMCfgDataInconsistentReportToDem=DISABLE, EcuMRamChkFailedReportToDem=DEM
