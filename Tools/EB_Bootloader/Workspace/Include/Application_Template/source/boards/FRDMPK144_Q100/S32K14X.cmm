; take name of binary from command line
entry &binaryFile=""
; Number of test ids
entry &testnumberids

B::
TOOLBAR ON
STATUSBAR ON
FramePOS 15.625,8.9286,,,Maximized
WinPAGE.RESet
WinPAGE.Create P000
WinCLEAR
WinPOS 0.0 0.0 111. 66. 16. 1. W000
WinTABS 10. 27. 25. 62.
List
WinPOS 115.75 0.0 42. 12. 0. 0. W001
Register
WinPOS 162.0 0.0 73. 10. 0. 0. W003
Var.Watch
WinPOS 115.75 16.286 99. 15. 5. 0. W002
Frame
WinPOS 115.63 37.429 71. 28. 16. 1. W005
Data.dump (0) /DIALOG
WinPAGE.select P000
; ------------------------------------------------------------------------------

SYStem.RESet
SYStem.CPU S32K144
SYStem.Up

;	S32K144 Flash Regions:
;	PFlashSize=0x80000	=	512 KB
;	DFlashSize=0x10000	=	64 KB


FLASH.RESet

FLASH.Create 1. 0x00000000--0x0007FFFF 0x1000 TARGET Quad
FLASH.Create 2. 0x10000000--0x1000FFFF 0x1000 TARGET Quad

FLASH.TARGET 0x1FFF8000 0x20000000 0x1000 ~~/demo/arm/flash/quad/s32k_quad.bin

FLASH.Erase ALL
FLASH.Program ALL
Data.LOAD.Elf "&binaryFile" /Quad /Verify
FLASH.Program OFF
SYStem.Down
SYStem.Up

; Debugger base end

SYStem.ResetTarget

; Start testing with Ts5Atl
; Set-up the break-point for memory dumping
b.s Ts5Atl_TheEnd
print "run (for 300 s)"
g
wait !run() 300.s
open #1 resultlog.log /create
&offset=0

v.while &offset<&testnumberids
(
  write #1 "0x" Data.Byte(d:&offset+v.address(Ts5Atl_Results))
  &offset=&offset+1
)
close #1

; Check for existence of timing information
if y.exist(Ts5Atl_TimingCount)
(
  ; Number of Timing entries
  &timingbufferlength=Data.Long(v.address(Ts5Atl_TimingCount))
  open #2 timinglog.log /create
  &offset=0
  &timingbufferid=0

  v.while &timingbufferid<&timingbufferlength
  (
    &offset=&timingbufferid*4
    &ticks=Data.Long(d:&offset+v.address(Ts5Atl_TimingTimeHi))*0x10000+Data.Long(d:&offset+v.address(Ts5Atl_TimingTimeLo))
    if y.exist(Ts5Atl_TimingConstant)
    (
      &realtime=v.VALUE(500000*(&ticks))/Data.Long(d:4+v.address(Ts5Atl_TimingConstant))
      write #2 %Decimal &timingbufferid "," %Decimal Data.Long(d:&offset+v.address(Ts5Atl_TimingId)) "," %Decimal &ticks "," &realtime "ns"
    )
    else
    (
      write #2 %Decimal &timingbufferid "," %Decimal Data.Long(d:&offset+v.address(Ts5Atl_TimingId)) "," %Decimal &ticks
    )
    &timingbufferid=&timingbufferid+1
  )
  close #2
)

;Get coverage measurement results
&coveragedata

; Perform test-specific post-processing.
&cmmMergedPostprocessing="../../../util/Merged_Postprocessing.cmm"
if os.file(&cmmMergedPostprocessing)
(
	do &cmmMergedPostprocessing
)

theEnd:
quit

