// T32 Thu Dec 12 06:41:24 2019

B::

Break.RESet
Break.Set     Can_Write /Program /DISable
Break.Set     Can_FlexCan_UpdateMB /Program /DISable
Break.Set     Can_FlexCan_ValidHth /Program
Break.Set     Can_FlexCan_Write /Program /DISable
Break.Set     Can_FlexCan_Write\129 /Program /DISable
Break.Set     CanIf_RxIndication /Program

ENDDO
