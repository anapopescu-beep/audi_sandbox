AUTOSAR XML (schema 4-0-3)
package /EbIntgr/BswModuleDescription
  bsw module description EbIntgr: module-id=255, provided-entrys=EbIntgr_Dummy
    provided-mode-groups:
      mode declaration group prototype EbIntgrBswMode: type=BswMBswModeGroup
    bsw internal behavior EbIntgr_IB: data-type-mapping=BswMBswModeMapping, bsw-mode-sender-policy{provided-mode-group=EbIntgrBswMode, queue-length=7}
      bsw schedulable entity EbIntgr_Dummy: implemented-entry=EbIntgr_Dummy, managed-mode-groups=EbIntgrBswMode
package /EbIntgr/BswModuleEntrys
  bsw module entry EbIntgr_Dummy: service-id=47, is-reentrant=false, is-synchronous=true, call-type=SCHEDULED, execution-context=TASK, sw-service-impl-policy=STANDARD
package /EbIntgr/Implementations
  bsw implementation EbIntr_Impl: programming-language=C, vendor-id=1, ar-release-version=4.0.3, behavior=EbIntgr_IB
    code-descriptors:
      code Files
        artifact-descriptors:
          short-label=EbIntgr::include::Eb_Intgr_BswM_UserCallouts.h, category=SWHDR
          short-label=EbIntgr::include::Eb_Intgr_BswM_UserCallouts.c, category=SWSRC
    resource consumption ResourceConsumption
      memory section EBINTGR_START_SEC_CODE: alignment=8, sw-addrmethod=CODE, symbol=CODE
package /BswMBswMode/PortInterfaces
  mode switch interface BswMMode: is-service=true
    mode group CurrentMode: type=BswMBswModeGroup
  sender receiver interface Ssa_BswM_ComIndication: is-service=true, invalidation-policy{data-element=comMode, handle-invalid=DONT-INVALIDATE}
    data comMode: type=Ssa_BswM_ComModeType
package /BswMBswMode/ModeDeclarationGroups
  mode declaration group BswMBswModeGroup: category=EXPLICIT_ORDER, initial-mode=EB_INTGR_BSWM_STARTUP_TWO_A, on-transition-value=9
    9 x mode:
      EB_INTGR_BSWM_STARTUP_TWO_A: value=0
      EB_INTGR_BSWM_STARTUP_TWO_B: value=1
      EB_INTGR_BSWM_RUN_TWO: value=2
      EB_INTGR_BSWM_POST_RUN: value=3
      EB_INTGR_BSWM_SLEEP: value=4
      EB_INTGR_BSWM_PRP_SHUTDOWN: value=5
      EB_INTGR_BSWM_WAKEUP_TWO: value=6
      EB_INTGR_BSWM_GO_OFF_ONE_A: value=7
      EB_INTGR_BSWM_GO_OFF_ONE_B: value=8
package /BswMBswMode/DataTypeMappingSets
  data type mapping set BswMBswModeMapping: mode-request-type-map{implementation-data-type=uint8, mode-group=BswMBswModeGroup}
