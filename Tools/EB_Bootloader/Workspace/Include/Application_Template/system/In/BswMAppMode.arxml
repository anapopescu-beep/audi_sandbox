AUTOSAR XML (schema 4-0-3)
package /AppMode/PortInterfaces
  mode switch interface If_AppState: is-service=true
    mode group AppStateMode: type=AppStateModeGroup
  sender receiver interface If_AppStateRequest: is-service=true
    data If_AppStateRequestMode: type=AppStateModeRequestType
package /AppMode/ModeDeclarationGroups
  mode declaration group AppStateModeGroup: category=EXPLICIT_ORDER, initial-mode=EB_INTGR_APP_BSW_STARTUP, on-transition-value=9
    7 x mode:
      EB_INTGR_APP_STARTUP: value=1
      EB_INTGR_APP_RUN: value=2
      EB_INTGR_APP_POST_RUN: value=3
      EB_INTGR_APP_SLEEP: value=4
      EB_INTGR_APP_SHUTDOWN: value=5
      EB_INTGR_APP_WAKEUP: value=6
      EB_INTGR_APP_BSW_STARTUP: value=0
package /AppMode/DataTypeMappingSets
  data type mapping set AppModeMapping: mode-request-type-map{implementation-data-type=uint8, mode-group=AppStateModeGroup}
package /AppMode/ImplementationDataTypes
  impl type AppStateModeRequestType: compu {1=EB_INTGR_APP_STARTUP, 2=EB_INTGR_APP_RUN, 3=EB_INTGR_APP_POST_RUN, 4=EB_INTGR_APP_SLEEP, 5=EB_INTGR_APP_SHUTDOWN, 6=EB_INTGR_APP_WAKEUP, 0=EB_INTGR_APP_BSW_STARTUP}, implementation-data-type=uint8
