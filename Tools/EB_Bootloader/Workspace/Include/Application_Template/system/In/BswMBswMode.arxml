AUTOSAR XML (schema 4-0-3)
package /EbIntgr/BswModuleDescription
  bsw module description EbIntgr: module-id=255, provided-entrys=EbIntgr_Dummy
    provided-mode-groups:
      mode declaration group prototype EbIntgrBswMode: type=BswMModeGroup
    bsw internal behavior EbIntgr_IB: data-type-mapping=BswMModeMapping, bsw-mode-sender-policy{provided-mode-group=EbIntgrBswMode, queue-length=7}
      bsw schedulable entity EbIntgr_Dummy: implemented-entry=EbIntgr_Dummy, managed-mode-groups=EbIntgrBswMode
package /EbIntgr/BswModuleEntrys
  bsw module entry EbIntgr_Dummy: service-id=47, is-reentrant=false, is-synchronous=true, call-type=SCHEDULED, execution-context=TASK, sw-service-impl-policy=STANDARD
package /EbIntgr/Implementations
  bsw implementation EbIntr_Impl: programming-language=C, vendor-id=1, ar-release-version=4.0.3, behavior=EbIntgr_IB
    code-descriptors:
      code Files
        artifact-descriptors:
          short-label=EbIntgr::include::Eb_Intgr_BswM_UserCallouts.h, category=SWHDR
          short-label=EbIntgr::include::Eb_Intgr_BswM_UserCallouts.c, category=SWSRC
    resource consumption ResourceConsumption
      memory section EBINTGR_START_SEC_CODE: alignment=8, sw-addrmethod=CODE, symbol=CODE
package /BswMMode/PortInterfaces
  mode switch interface BswMMode: is-service=true
    mode group CurrentMode: type=BswMModeGroup
package /BswMMode/ModeDeclarationGroups
  mode declaration group BswMModeGroup: initial-mode=EB_INTGR_BSWM_STARTUP_TWO_A
    9 x mode:
      EB_INTGR_BSWM_STARTUP_TWO_A
      EB_INTGR_BSWM_STARTUP_TWO_B
      EB_INTGR_BSWM_RUN_TWO
      EB_INTGR_BSWM_PRP_SHUTDOWN
      EB_INTGR_BSWM_GO_OFF_ONE_A
      EB_INTGR_BSWM_GO_OFF_ONE_B
      EB_INTGR_BSWM_WAKEUP_TWO
      EB_INTGR_BSWM_POST_RUN
      EB_INTGR_BSWM_SLEEP
package /BswMMode/DataTypeMappingSets
  data type mapping set BswMModeMapping: mode-request-type-map{implementation-data-type=uint8, mode-group=BswMModeGroup}
