AUTOSAR XML (schema 4-3-0)
package /TestSwc_RGS_VL/InitConst
  48 x constant specification:
    Init_KN_RGS_VL_BusKnockOut: value-spec=0
    Init_KN_RGS_VL_BusKnockOutTimer: value-spec=0
    Init_KN_RGS_VL_ECUKnockOut: value-spec=0
    Init_KN_RGS_VL_ECUKnockOutTimer: value-spec=0
    Init_NM_Airbag_01_FCAB: value-spec=7 x 0
    Init_NM_RGS_VL_CBV_AWB: value-spec=0
    Init_NM_RGS_VL_CBV_CRI: value-spec=1
    Init_NM_RGS_VL_FCAB: value-spec=7 x 0
    Init_NM_RGS_VL_FCIB: value-spec=7 x 0
    Init_NM_RGS_VL_NM_State: value-spec=0
    Init_NM_RGS_VL_NM_aktiv_Diag: value-spec=0
    Init_NM_RGS_VL_NM_aktiv_KL15: value-spec=0
    Init_NM_RGS_VL_NM_aktiv_Mot_aktiv: value-spec=0
    Init_NM_RGS_VL_NM_aktiv_Tmin: value-spec=0
    Init_NM_RGS_VL_SNI_10: value-spec=94
    Init_NM_RGS_VL_UDS_CC: value-spec=0
    Init_NM_RGS_VL_Wakeup: value-spec=0
    Init_RGS_Nachlauf_allg: value-spec=0
    Init_RGS_VL_Abschaltstufe: value-spec=0
    Init_RGS_VL_Anforderung: value-spec=31
    Init_RGS_VL_Bauteilfehler: value-spec=1
    Init_RGS_VL_Crashabschaltung: value-spec=1
    Init_RGS_VL_EEPROM_Datensatzfehler: value-spec=1
    Init_RGS_VL_Gurtbandauszug: value-spec=4094
    Init_RGS_VL_Gurtgeschwindigkeit: value-spec=511
    Init_RGS_VL_InPos: value-spec=0
    Init_RGS_VL_KD_Fehler: value-spec=0
    Init_RGS_VL_Kommunikationsfehler_ASG: value-spec=1
    Init_RGS_VL_KompSchutz: value-spec=0
    Init_RGS_VL_Lokalaktiv: value-spec=0
    Init_RGS_VL_Max_Gurtlosezyklen: value-spec=1
    Init_RGS_VL_Max_Haptikzyklenfehler: value-spec=1
    Init_RGS_VL_Max_Straffzyklenfehler: value-spec=1
    Init_RGS_VL_Motorfehler: value-spec=1
    Init_RGS_VL_Nachlauf_2: value-spec=0
    Init_RGS_VL_Nachlauftyp: value-spec=0
    Init_RGS_VL_SNI_10: value-spec=94
    Init_RGS_VL_Status: value-spec=31
    Init_RGS_VL_Strom: value-spec=254
    Init_RGS_VL_Subsystemaktiv: value-spec=0
    Init_RGS_VL_Temp: value-spec=254
    Init_RGS_VL_Transport_Mode: value-spec=0
    Init_RGS_VL_Ueberspannung: value-spec=1
    Init_RGS_VL_Uebertemperatur_defekt: value-spec=1
    Init_RGS_VL_Unterspannung: value-spec=1
    Init_RGS_VL_keineStraffungUeberspg: value-spec=1
    Init_RGS_VL_keineStraffungUnterspg: value-spec=1
    Init_RGS_VL_nicht_programmiert: value-spec=1
package /TestSwc_RGS_VL/Interfaces
  48 x sender receiver interface:
    IF_KN_RGS_VL_BusKnockOut
      data KN_RGS_VL_BusKnockOut: type=DT_KN_RGS_VL_BusKnockOut_XIX_KN_RGS_VL_XIX_Airbag_SUBCANFD01
    IF_KN_RGS_VL_BusKnockOutTimer
      data KN_RGS_VL_BusKnockOutTimer: type=DT_KN_RGS_VL_BusKnockOutTimer_XIX_KN_RGS_VL_XIX_Airbag_SUBCANFD01
    IF_KN_RGS_VL_ECUKnockOut
      data KN_RGS_VL_ECUKnockOut: type=DT_KN_RGS_VL_ECUKnockOut_XIX_KN_RGS_VL_XIX_Airbag_SUBCANFD01
    IF_KN_RGS_VL_ECUKnockOutTimer
      data KN_RGS_VL_ECUKnockOutTimer: type=DT_KN_RGS_VL_ECUKnockOutTimer_XIX_KN_RGS_VL_XIX_Airbag_SUBCANFD01
    IF_NM_Airbag_01_FCAB
      data NM_Airbag_01_FCAB: type=DT_NM_Airbag_01_FCAB_XIX_NM_Airbag_XIX_Airbag_SUBCANFD01
    IF_NM_RGS_VL_CBV_AWB
      data NM_RGS_VL_CBV_AWB: type=DT_NM_RGS_VL_CBV_AWB_XIX_NM_RGS_VL_XIX_Airbag_SUBCANFD01
    IF_NM_RGS_VL_CBV_CRI
      data NM_RGS_VL_CBV_CRI: type=DT_NM_RGS_VL_CBV_CRI_XIX_NM_RGS_VL_XIX_Airbag_SUBCANFD01
    IF_NM_RGS_VL_FCAB
      data NM_RGS_VL_FCAB: type=DT_NM_RGS_VL_FCAB_XIX_NM_RGS_VL_XIX_Airbag_SUBCANFD01
    IF_NM_RGS_VL_FCIB
      data NM_RGS_VL_FCIB: type=DT_NM_RGS_VL_FCIB_XIX_KN_RGS_VL_XIX_Airbag_SUBCANFD01
    IF_NM_RGS_VL_NM_State
      data NM_RGS_VL_NM_State: type=DT_NM_RGS_VL_NM_State_XIX_NM_RGS_VL_XIX_Airbag_SUBCANFD01
    IF_NM_RGS_VL_NM_aktiv_Diag
      data NM_RGS_VL_NM_aktiv_Diag: type=DT_NM_RGS_VL_NM_aktiv_Diag_XIX_NM_RGS_VL_XIX_Airbag_SUBCANFD01
    IF_NM_RGS_VL_NM_aktiv_KL15
      data NM_RGS_VL_NM_aktiv_KL15: type=DT_NM_RGS_VL_NM_aktiv_KL15_XIX_NM_RGS_VL_XIX_Airbag_SUBCANFD01
    IF_NM_RGS_VL_NM_aktiv_Mot_aktiv
      data NM_RGS_VL_NM_aktiv_Mot_aktiv: type=DT_NM_RGS_VL_NM_aktiv_Mot_aktiv_XIX_NM_RGS_VL_XIX_Airbag_SUBCANFD01
    IF_NM_RGS_VL_NM_aktiv_Tmin
      data NM_RGS_VL_NM_aktiv_Tmin: type=DT_NM_RGS_VL_NM_aktiv_Tmin_XIX_NM_RGS_VL_XIX_Airbag_SUBCANFD01
    IF_NM_RGS_VL_SNI_10
      data NM_RGS_VL_SNI_10: type=DT_NM_RGS_VL_SNI_10_XIX_NM_RGS_VL_XIX_Airbag_SUBCANFD01
    IF_NM_RGS_VL_UDS_CC
      data NM_RGS_VL_UDS_CC: type=DT_NM_RGS_VL_UDS_CC_XIX_NM_RGS_VL_XIX_Airbag_SUBCANFD01
    IF_NM_RGS_VL_Wakeup
      data NM_RGS_VL_Wakeup: type=DT_NM_RGS_VL_Wakeup_XIX_NM_RGS_VL_XIX_Airbag_SUBCANFD01
    IF_RGS_Nachlauf_allg
      data RGS_Nachlauf_allg: type=DT_RGS_Nachlauf_allg_XIX_RGS_Anf_01_XIX_Airbag_SUBCANFD01
    IF_RGS_VL_Abschaltstufe
      data RGS_VL_Abschaltstufe: type=DT_RGS_VL_Abschaltstufe_XIX_KN_RGS_VL_XIX_Airbag_SUBCANFD01
    IF_RGS_VL_Anforderung
      data RGS_VL_Anforderung: type=DT_RGS_VL_Anforderung_XIX_RGS_Anf_01_XIX_Airbag_SUBCANFD01
    IF_RGS_VL_Bauteilfehler
      data RGS_VL_Bauteilfehler: type=DT_RGS_VL_Bauteilfehler_XIX_RGS_VL_01_XIX_Airbag_SUBCANFD01
    IF_RGS_VL_Crashabschaltung
      data RGS_VL_Crashabschaltung: type=DT_RGS_VL_Crashabschaltung_XIX_RGS_VL_01_XIX_Airbag_SUBCANFD01
    IF_RGS_VL_EEPROM_Datensatzfehler
      data RGS_VL_EEPROM_Datensatzfehler: type=DT_RGS_VL_EEPROM_Datensatzfehler_XIX_RGS_VL_01_XIX_Airbag_SUBCANFD01
    IF_RGS_VL_Gurtbandauszug
      data RGS_VL_Gurtbandauszug: type=DT_RGS_VL_Gurtbandauszug_XIX_RGS_VL_01_XIX_Airbag_SUBCANFD01
    IF_RGS_VL_Gurtgeschwindigkeit
      data RGS_VL_Gurtgeschwindigkeit: type=DT_RGS_VL_Gurtgeschwindigkeit_XIX_RGS_VL_01_XIX_Airbag_SUBCANFD01
    IF_RGS_VL_InPos
      data RGS_VL_InPos: type=DT_RGS_VL_InPos_XIX_RGS_VL_01_XIX_Airbag_SUBCANFD01
    IF_RGS_VL_KD_Fehler
      data RGS_VL_KD_Fehler: type=DT_RGS_VL_KD_Fehler_XIX_KN_RGS_VL_XIX_Airbag_SUBCANFD01
    IF_RGS_VL_Kommunikationsfehler_ASG
      data RGS_VL_Kommunikationsfehler_ASG: type=DT_RGS_VL_Kommunikationsfehler_ASG_XIX_RGS_VL_01_XIX_Airbag_SUBCANFD01
    IF_RGS_VL_KompSchutz
      data RGS_VL_KompSchutz: type=DT_RGS_VL_KompSchutz_XIX_KN_RGS_VL_XIX_Airbag_SUBCANFD01
    IF_RGS_VL_Lokalaktiv
      data RGS_VL_Lokalaktiv: type=DT_RGS_VL_Lokalaktiv_XIX_KN_RGS_VL_XIX_Airbag_SUBCANFD01
    IF_RGS_VL_Max_Gurtlosezyklen
      data RGS_VL_Max_Gurtlosezyklen: type=DT_RGS_VL_Max_Gurtlosezyklen_XIX_RGS_VL_01_XIX_Airbag_SUBCANFD01
    IF_RGS_VL_Max_Haptikzyklenfehler
      data RGS_VL_Max_Haptikzyklenfehler: type=DT_RGS_VL_Max_Haptikzyklenfehler_XIX_RGS_VL_01_XIX_Airbag_SUBCANFD01
    IF_RGS_VL_Max_Straffzyklenfehler
      data RGS_VL_Max_Straffzyklenfehler: type=DT_RGS_VL_Max_Straffzyklenfehler_XIX_RGS_VL_01_XIX_Airbag_SUBCANFD01
    IF_RGS_VL_Motorfehler
      data RGS_VL_Motorfehler: type=DT_RGS_VL_Motorfehler_XIX_RGS_VL_01_XIX_Airbag_SUBCANFD01
    IF_RGS_VL_Nachlauf_2
      data RGS_VL_Nachlauf_2: type=DT_RGS_VL_Nachlauf_2_XIX_RGS_Anf_01_XIX_Airbag_SUBCANFD01
    IF_RGS_VL_Nachlauftyp
      data RGS_VL_Nachlauftyp: type=DT_RGS_VL_Nachlauftyp_XIX_KN_RGS_VL_XIX_Airbag_SUBCANFD01
    IF_RGS_VL_SNI_10
      data RGS_VL_SNI_10: type=DT_RGS_VL_SNI_10_XIX_KN_RGS_VL_XIX_Airbag_SUBCANFD01
    IF_RGS_VL_Status
      data RGS_VL_Status: type=DT_RGS_VL_Status_XIX_RGS_VL_01_XIX_Airbag_SUBCANFD01
    IF_RGS_VL_Strom
      data RGS_VL_Strom: type=DT_RGS_VL_Strom_XIX_RGS_VL_01_XIX_Airbag_SUBCANFD01
    IF_RGS_VL_Subsystemaktiv
      data RGS_VL_Subsystemaktiv: type=DT_RGS_VL_Subsystemaktiv_XIX_KN_RGS_VL_XIX_Airbag_SUBCANFD01
    IF_RGS_VL_Temp
      data RGS_VL_Temp: type=DT_RGS_VL_Temp_XIX_RGS_VL_01_XIX_Airbag_SUBCANFD01
    IF_RGS_VL_Transport_Mode
      data RGS_VL_Transport_Mode: type=DT_RGS_VL_Transport_Mode_XIX_KN_RGS_VL_XIX_Airbag_SUBCANFD01
    IF_RGS_VL_Ueberspannung
      data RGS_VL_Ueberspannung: type=DT_RGS_VL_Ueberspannung_XIX_RGS_VL_01_XIX_Airbag_SUBCANFD01
    IF_RGS_VL_Uebertemperatur_defekt
      data RGS_VL_Uebertemperatur_defekt: type=DT_RGS_VL_Uebertemperatur_defekt_XIX_RGS_VL_01_XIX_Airbag_SUBCANFD01
    IF_RGS_VL_Unterspannung
      data RGS_VL_Unterspannung: type=DT_RGS_VL_Unterspannung_XIX_RGS_VL_01_XIX_Airbag_SUBCANFD01
    IF_RGS_VL_keineStraffungUeberspg
      data RGS_VL_keineStraffungUeberspg: type=DT_RGS_VL_keineStraffungUeberspg_XIX_RGS_VL_01_XIX_Airbag_SUBCANFD01
    IF_RGS_VL_keineStraffungUnterspg
      data RGS_VL_keineStraffungUnterspg: type=DT_RGS_VL_keineStraffungUnterspg_XIX_RGS_VL_01_XIX_Airbag_SUBCANFD01
    IF_RGS_VL_nicht_programmiert
      data RGS_VL_nicht_programmiert: type=DT_RGS_VL_nicht_programmiert_XIX_RGS_VL_01_XIX_Airbag_SUBCANFD01
