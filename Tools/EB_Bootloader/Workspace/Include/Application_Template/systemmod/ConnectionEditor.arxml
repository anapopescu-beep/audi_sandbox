AUTOSAR XML (schema 4-2-1)
package /E3_1_2_Premium
  system System
    system mapping EBConnectionEditorMappings
      sw-mappings:
        swc to ecu mapping EBConnectionEditorSwcMappings: ecu-instance=RGS_VL
          component:
            Geltungsbereich_E3_1_2_Premium.BswM_Prototype
            Geltungsbereich_E3_1_2_Premium.ComM_Prototype
            Geltungsbereich_E3_1_2_Premium.Dem_Prototype
            Geltungsbereich_E3_1_2_Premium.Dcm_Prototype
            Geltungsbereich_E3_1_2_Premium.EcuM_Prototype
            Geltungsbereich_E3_1_2_Premium.DiagDt_Prototype
            Geltungsbereich_E3_1_2_Premium.NmUsrDt_SwCType_Prototype
            Geltungsbereich_E3_1_2_Premium.DiagDt_DiagExt_Prototype
            Geltungsbereich_E3_1_2_Premium.BusMon_SwCType_Prototype
            Geltungsbereich_E3_1_2_Premium.VoltMon_Prototype
package /ComponentTypes
  composition sw component type Geltungsbereich_E3_1_2_Premium
    10 x component:
      BswM_Prototype: type=BswM
      ComM_Prototype: type=ComM
      Dem_Prototype: type=Dem
      Dcm_Prototype: type=Dcm
      EcuM_Prototype: type=EcuM
      DiagDt_Prototype: type=DiagDt
      NmUsrDt_SwCType_Prototype: type=NmUsrDt_SwCType
      DiagDt_DiagExt_Prototype: type=DiagDt_DiagExt
      BusMon_SwCType_Prototype: type=BusMon_SwCType
      VoltMon_Prototype: type=VoltMon
