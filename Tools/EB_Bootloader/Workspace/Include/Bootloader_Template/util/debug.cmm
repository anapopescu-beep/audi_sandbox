do ..\source\boards\FRDMPK144_Q100_NoOS\S32K14X.cmm ..\output\bin\CORTEXM_S32K14X_Bootloader_Template.elf

