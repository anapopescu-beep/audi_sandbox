 --no_wrap_diagnostics --semihosting --entry boardResetStart
C:/devapp/EB/tresos_bolo/workspace/demoBoot_VAG_SigCompCRC_can_asr/output/obj/APP_Prg.o
C:/devapp/EB/tresos_bolo/workspace/demoBoot_VAG_SigCompCRC_can_asr/output/obj/BlPduR_Cbk.o
C:/devapp/EB/tresos_bolo/workspace/demoBoot_VAG_SigCompCRC_can_asr/output/obj/main.o
C:/devapp/EB/tresos_bolo/workspace/demoBoot_VAG_SigCompCRC_can_asr/output/obj/Watchdog.o
C:/devapp/EB/tresos_bolo/workspace/demoBoot_VAG_SigCompCRC_can_asr/output/obj/UDS_Cbk.o
C:/devapp/EB/tresos_bolo/workspace/demoBoot_VAG_SigCompCRC_can_asr/output/obj/SA_Cbk.o
C:/devapp/EB/tresos_bolo/workspace/demoBoot_VAG_SigCompCRC_can_asr/output/obj/BM_Cbk.o
C:/devapp/EB/tresos_bolo/workspace/demoBoot_VAG_SigCompCRC_can_asr/output/obj/SchM.o
C:/devapp/EB/tresos_bolo/workspace/demoBoot_VAG_SigCompCRC_can_asr/output/obj/PROG_Cbk.o
C:/devapp/EB/tresos_bolo/workspace/demoBoot_VAG_SigCompCRC_can_asr/output/obj/CanSM.o
C:/devapp/EB/tresos_bolo/workspace/demoBoot_VAG_SigCompCRC_can_asr/output/obj/ComM.o
C:/devapp/EB/tresos_bolo/workspace/demoBoot_VAG_SigCompCRC_can_asr/output/obj/Atomics.o
C:/devapp/EB/tresos_bolo/workspace/demoBoot_VAG_SigCompCRC_can_asr/output/obj/Atomics_TSPlatforms.o
C:/devapp/EB/tresos_bolo/workspace/demoBoot_VAG_SigCompCRC_can_asr/output/obj/board.o
C:/devapp/EB/tresos_bolo/workspace/demoBoot_VAG_SigCompCRC_can_asr/output/obj/board_reset_vector.o
C:/devapp/EB/tresos_bolo/workspace/demoBoot_VAG_SigCompCRC_can_asr/output/obj/board_irq.o
C:/devapp/EB/tresos_bolo/workspace/demoBoot_VAG_SigCompCRC_can_asr/output/obj/boardStartup.o
C:/devapp/EB/tresos_bolo/workspace/demoBoot_VAG_SigCompCRC_can_asr/output/obj/interruptvectors.o
C:/devapp/EB/tresos_bolo/workspace/demoBoot_VAG_SigCompCRC_can_asr/output/obj/exceptiontable.o
C:/devapp/EB/tresos_bolo/workspace/demoBoot_VAG_SigCompCRC_can_asr/output/lib/BM_src.a
C:/devapp/EB/tresos_bolo/workspace/demoBoot_VAG_SigCompCRC_can_asr/output/lib/Base_src.a
C:/devapp/EB/tresos_bolo/workspace/demoBoot_VAG_SigCompCRC_can_asr/output/lib/BlPduR_src.a
C:/devapp/EB/tresos_bolo/workspace/demoBoot_VAG_SigCompCRC_can_asr/output/lib/Cal_src.a
C:/devapp/EB/tresos_bolo/workspace/demoBoot_VAG_SigCompCRC_can_asr/output/lib/Can_src.a
C:/devapp/EB/tresos_bolo/workspace/demoBoot_VAG_SigCompCRC_can_asr/output/lib/CanIf_src.a
C:/devapp/EB/tresos_bolo/workspace/demoBoot_VAG_SigCompCRC_can_asr/output/lib/CanIf_pbconfig.a
C:/devapp/EB/tresos_bolo/workspace/demoBoot_VAG_SigCompCRC_can_asr/output/lib/CanSM_src.a
C:/devapp/EB/tresos_bolo/workspace/demoBoot_VAG_SigCompCRC_can_asr/output/lib/CanTp_src.a
C:/devapp/EB/tresos_bolo/workspace/demoBoot_VAG_SigCompCRC_can_asr/output/lib/CanTp_pbconfig.a
C:/devapp/EB/tresos_bolo/workspace/demoBoot_VAG_SigCompCRC_can_asr/output/lib/Cpl_src.a
C:/devapp/EB/tresos_bolo/workspace/demoBoot_VAG_SigCompCRC_can_asr/output/lib/Cry_src.a
C:/devapp/EB/tresos_bolo/workspace/demoBoot_VAG_SigCompCRC_can_asr/output/lib/Csm_src.a
C:/devapp/EB/tresos_bolo/workspace/demoBoot_VAG_SigCompCRC_can_asr/output/lib/Det_src.a
C:/devapp/EB/tresos_bolo/workspace/demoBoot_VAG_SigCompCRC_can_asr/output/lib/EcuC_src.a
C:/devapp/EB/tresos_bolo/workspace/demoBoot_VAG_SigCompCRC_can_asr/output/lib/Flash_src.a
C:/devapp/EB/tresos_bolo/workspace/demoBoot_VAG_SigCompCRC_can_asr/output/lib/Mcu_src.a
C:/devapp/EB/tresos_bolo/workspace/demoBoot_VAG_SigCompCRC_can_asr/output/lib/PduR_src.a
C:/devapp/EB/tresos_bolo/workspace/demoBoot_VAG_SigCompCRC_can_asr/output/lib/PduR_pbconfig.a
C:/devapp/EB/tresos_bolo/workspace/demoBoot_VAG_SigCompCRC_can_asr/output/lib/Port_src.a
C:/devapp/EB/tresos_bolo/workspace/demoBoot_VAG_SigCompCRC_can_asr/output/lib/Prog_src.a
C:/devapp/EB/tresos_bolo/workspace/demoBoot_VAG_SigCompCRC_can_asr/output/lib/ProgVAG_src.a
C:/devapp/EB/tresos_bolo/workspace/demoBoot_VAG_SigCompCRC_can_asr/output/lib/SA_src.a
C:/devapp/EB/tresos_bolo/workspace/demoBoot_VAG_SigCompCRC_can_asr/output/lib/Uds_src.a
