VERSION "HNNBNNNYNNNNNNNNNNNNNNNNNNNNNNNNNNNNNNNNNN/4/%%%/4/'%**4NNN///"

NS_ :

BS_:

BU_: Airbag eCS RGS_HL RGS_HR RGS_VL RGS_VR

BO_ 2600468501 NM_Airbag: 24 Airbag
 SG_ NM_Airbag_01_CBV_AWB : 4|1@1+ (1.0,0.0) [0.0|1] ""  Vector__XXX
 SG_ NM_Airbag_01_CBV_CRI : 6|1@1+ (1.0,0.0) [0.0|1] ""  Vector__XXX
 SG_ NM_Airbag_01_FCAB : 8|56@1+ (1.0,0.0) [0.0|72057594037927935] ""  eCS,RGS_HL,RGS_HR,RGS_VL,RGS_VR
 SG_ NM_Airbag_01_SNI_10 : 128|10@1+ (1.0,0.0) [0.0|1023] ""  Vector__XXX
 SG_ NM_Airbag_01_NM_State : 144|6@1+ (1.0,0.0) [0.0|63] ""  Vector__XXX
 SG_ NM_Airbag_01_UDS_CC : 151|1@1+ (1.0,0.0) [0.0|1] ""  Vector__XXX
 SG_ NM_Airbag_01_Wakeup : 152|8@1+ (1.0,0.0) [0.0|255] ""  Vector__XXX
 SG_ NM_Airbag_01_NM_aktiv_KL15 : 160|1@1+ (1.0,0.0) [0.0|1] ""  Vector__XXX
 SG_ NM_Airbag_01_NM_aktiv_Diag : 161|1@1+ (1.0,0.0) [0.0|1] ""  Vector__XXX
 SG_ NM_Airbag_01_NM_aktiv_Tmin : 162|1@1+ (1.0,0.0) [0.0|1] ""  Vector__XXX
 SG_ NM_aktiv_Kl15_unplausibel : 164|1@1+ (1.0,0.0) [0.0|1] ""  Vector__XXX
 SG_ NM_aktiv_Sitzbelegung : 165|1@1+ (1.0,0.0) [0.0|1] ""  Vector__XXX
 SG_ NM_aktiv_Ausloesefaehig : 166|1@1+ (1.0,0.0) [0.0|1] ""  Vector__XXX
 SG_ NM_aktiv_Gurtschloss : 167|1@1+ (1.0,0.0) [0.0|1] ""  Vector__XXX
 SG_ NM_aktiv_Gurtparken : 168|1@1+ (1.0,0.0) [0.0|1] ""  Vector__XXX
 SG_ NM_aktiv_AntriebsCAN_aktiv : 169|1@1+ (1.0,0.0) [0.0|1] ""  Vector__XXX

BO_ 2600468729 NM_RGS_HL: 24 RGS_HL
 SG_ NM_RGS_HL_CBV_AWB : 4|1@1+ (1.0,0.0) [0.0|1] ""  Vector__XXX
 SG_ NM_RGS_HL_CBV_CRI : 6|1@1+ (1.0,0.0) [0.0|1] ""  Vector__XXX
 SG_ NM_RGS_HL_FCAB : 8|56@1+ (1.0,0.0) [0.0|72057594037927935] ""  Airbag,eCS,RGS_HR,RGS_VL,RGS_VR
 SG_ NM_RGS_HL_SNI_10 : 128|10@1+ (1.0,0.0) [0.0|1023] ""  Vector__XXX
 SG_ NM_RGS_HL_NM_State : 144|6@1+ (1.0,0.0) [0.0|63] ""  Vector__XXX
 SG_ NM_RGS_HL_UDS_CC : 151|1@1+ (1.0,0.0) [0.0|1] ""  Vector__XXX
 SG_ NM_RGS_HL_Wakeup_V12 : 152|8@1+ (1.0,0.0) [0.0|255] ""  Vector__XXX
 SG_ NM_RGS_HL_NM_aktiv_KL15 : 160|1@1+ (1.0,0.0) [0.0|1] ""  Vector__XXX
 SG_ NM_RGS_HL_NM_aktiv_Diag : 161|1@1+ (1.0,0.0) [0.0|1] ""  Vector__XXX
 SG_ NM_RGS_HL_NM_aktiv_Tmin : 162|1@1+ (1.0,0.0) [0.0|1] ""  Vector__XXX
 SG_ NM_aktiv_Gurtbewegung_HL : 163|1@1+ (1.0,0.0) [0.0|1] ""  Vector__XXX

BO_ 2600468730 NM_RGS_HR: 24 RGS_HR
 SG_ NM_RGS_HR_CBV_AWB : 4|1@1+ (1.0,0.0) [0.0|1] ""  Vector__XXX
 SG_ NM_RGS_HR_CBV_CRI : 6|1@1+ (1.0,0.0) [0.0|1] ""  Vector__XXX
 SG_ NM_RGS_HR_FCAB : 8|56@1+ (1.0,0.0) [0.0|72057594037927935] ""  Airbag,eCS,RGS_HL,RGS_VL,RGS_VR
 SG_ NM_RGS_HR_SNI_10 : 128|10@1+ (1.0,0.0) [0.0|1023] ""  Vector__XXX
 SG_ NM_RGS_HR_NM_State : 144|6@1+ (1.0,0.0) [0.0|63] ""  Vector__XXX
 SG_ NM_RGS_HR_UDS_CC : 151|1@1+ (1.0,0.0) [0.0|1] ""  Vector__XXX
 SG_ NM_RGS_HR_Wakeup_V12 : 152|8@1+ (1.0,0.0) [0.0|255] ""  Vector__XXX
 SG_ NM_RGS_HR_NM_aktiv_KL15 : 160|1@1+ (1.0,0.0) [0.0|1] ""  Vector__XXX
 SG_ NM_RGS_HR_NM_aktiv_Diag : 161|1@1+ (1.0,0.0) [0.0|1] ""  Vector__XXX
 SG_ NM_RGS_HR_NM_aktiv_Tmin : 162|1@1+ (1.0,0.0) [0.0|1] ""  Vector__XXX
 SG_ NM_aktiv_Gurtbewegung_HR : 163|1@1+ (1.0,0.0) [0.0|1] ""  Vector__XXX

BO_ 2600468574 NM_RGS_VL: 24 RGS_VL
 SG_ NM_RGS_VL_CBV_AWB : 4|1@1+ (1.0,0.0) [0.0|1] ""  Vector__XXX
 SG_ NM_RGS_VL_CBV_CRI : 6|1@1+ (1.0,0.0) [0.0|1] ""  Vector__XXX
 SG_ NM_RGS_VL_FCAB : 8|56@1+ (1.0,0.0) [0.0|72057594037927935] ""  Airbag,eCS,RGS_HL,RGS_HR,RGS_VR
 SG_ NM_RGS_VL_SNI_10 : 128|10@1+ (1.0,0.0) [0.0|1023] ""  Vector__XXX
 SG_ NM_RGS_VL_NM_State : 144|6@1+ (1.0,0.0) [0.0|63] ""  Vector__XXX
 SG_ NM_RGS_VL_UDS_CC : 151|1@1+ (1.0,0.0) [0.0|1] ""  Vector__XXX
 SG_ NM_RGS_VL_Wakeup_V12 : 152|8@1+ (1.0,0.0) [0.0|255] ""  Vector__XXX
 SG_ NM_RGS_VL_NM_aktiv_KL15 : 160|1@1+ (1.0,0.0) [0.0|1] ""  Vector__XXX
 SG_ NM_RGS_VL_NM_aktiv_Diag : 161|1@1+ (1.0,0.0) [0.0|1] ""  Vector__XXX
 SG_ NM_RGS_VL_NM_aktiv_Tmin : 162|1@1+ (1.0,0.0) [0.0|1] ""  Vector__XXX
 SG_ NM_aktiv_Gurtbewegung_VL : 163|1@1+ (1.0,0.0) [0.0|1] ""  Vector__XXX

BO_ 2600468575 NM_RGS_VR: 24 RGS_VR
 SG_ NM_RGS_VR_CBV_AWB : 4|1@1+ (1.0,0.0) [0.0|1] ""  Vector__XXX
 SG_ NM_RGS_VR_CBV_CRI : 6|1@1+ (1.0,0.0) [0.0|1] ""  Vector__XXX
 SG_ NM_RGS_VR_FCAB : 8|56@1+ (1.0,0.0) [0.0|72057594037927935] ""  Airbag,eCS,RGS_HL,RGS_HR,RGS_VL
 SG_ NM_RGS_VR_SNI_10 : 128|10@1+ (1.0,0.0) [0.0|1023] ""  Vector__XXX
 SG_ NM_RGS_VR_NM_State : 144|6@1+ (1.0,0.0) [0.0|63] ""  Vector__XXX
 SG_ NM_RGS_VR_UDS_CC : 151|1@1+ (1.0,0.0) [0.0|1] ""  Vector__XXX
 SG_ NM_RGS_VR_Wakeup_V12 : 152|8@1+ (1.0,0.0) [0.0|255] ""  Vector__XXX
 SG_ NM_RGS_VR_NM_aktiv_KL15 : 160|1@1+ (1.0,0.0) [0.0|1] ""  Vector__XXX
 SG_ NM_RGS_VR_NM_aktiv_Diag : 161|1@1+ (1.0,0.0) [0.0|1] ""  Vector__XXX
 SG_ NM_RGS_VR_NM_aktiv_Tmin : 162|1@1+ (1.0,0.0) [0.0|1] ""  Vector__XXX
 SG_ NM_aktiv_Gurtbewegung_VR : 163|1@1+ (1.0,0.0) [0.0|1] ""  Vector__XXX

BO_ 567 NVEM_12: 12 Airbag
 SG_ NVEM_12_CRC : 0|8@1+ (1,0) [0|255] ""  Vector__XXX
 SG_ NVEM_12_BZ : 8|4@1+ (1,0) [0|15] ""  Vector__XXX
 SG_ NVEM_Bordnetzdiagnose : 12|2@1+ (1.0,0.0) [0.0|3] ""  Vector__XXX
 SG_ NVEM_Last_Anf : 14|2@1+ (1.0,0.0) [0.0|3] ""  Vector__XXX
 SG_ BEM_HL_Regelung_Status : 16|3@1+ (1.0,0.0) [0.0|7] ""  Vector__XXX
 SG_ NVEM_Abschaltstufe : 19|2@1+ (1.0,0.0) [0.0|3] ""  RGS_HL,RGS_HR,RGS_VL,RGS_VR
 SG_ NVEM_NV_BAT_ZellStatus_Index_Anf : 21|4@1+ (1.0,0.0) [0.0|15] ""  Vector__XXX
 SG_ NVEM_NV_BAT_ZellStatus_Typ_Anf : 25|3@1+ (1.0,0.0) [0.0|7] ""  Vector__XXX
 SG_ NVEM_Freigabe_OTA : 28|2@1+ (1.0,0.0) [0.0|3] ""  Vector__XXX
 SG_ BEM_Generatordiagnose : 30|2@1+ (1.0,0.0) [0.0|3] ""  Vector__XXX
 SG_ NVEM_DC_uSoll_NV : 32|8@1+ (0.025,10.6) [10.600|16.000] "Unit_Volt"  Vector__XXX
 SG_ NVEM_DC_iSoll_NV : 40|8@1+ (1,-253) [-253|0] "Unit_Amper"  Vector__XXX
 SG_ BEM_Batt_Ab : 48|1@1+ (1.0,0.0) [0.0|1] ""  Vector__XXX
 SG_ BEM_Red_Innengeblaese : 49|2@1+ (1.0,0.0) [0.0|3] ""  Vector__XXX
 SG_ NVEM_MV_DC_uMinLV : 51|7@1+ (0.1,3.5) [3.5|16.0] "Unit_Volt"  Vector__XXX
 SG_ NVEM_MV_DC_uSollLV : 58|7@1+ (0.05,10.6) [10.60|16.00] "Unit_Volt"  Vector__XXX
 SG_ BEM_STH_Einschaltverbot : 65|1@1+ (1.0,0.0) [0.0|1] ""  Vector__XXX
 SG_ BEM_STH_Zielzeit : 66|4@1+ (5,0) [0|60] "Unit_Minut"  Vector__XXX
 SG_ NVEM_Verbraucher_Information : 70|3@1+ (1.0,0.0) [0.0|7] ""  Vector__XXX
 SG_ NVEM3_Absch_SCR : 73|1@1+ (1.0,0.0) [0.0|1] ""  Vector__XXX
 SG_ NVEM_Bordnetz_Information : 76|4@1+ (1.0,0.0) [0.0|15] ""  Vector__XXX
 SG_ NVEM_DC_uMin_NV : 80|8@1+ (0.1,0) [0.0|25.5] "Unit_Volt"  Vector__XXX
 SG_ NVEM_MV_DC_iSoll_NV : 88|8@1+ (1,-253) [-253|0] "Unit_Amper"  Vector__XXX

BO_ 2621469190 OBDC_SSN_eCS_Req_FD: 64 Airbag
 SG_ OBDC_SSN_eCS_Req_FD_Data : 0|512@1+ (1.0,0.0) [0.0|13407807929942597099574024998205846127479365820592393377723561443721764030073546976801874298166903427690031858186486050853753882811946569946433649006084095] ""  eCS

BO_ 2621600262 OBDC_SSN_eCS_Resp_FD: 64 eCS
 SG_ OBDC_SSN_eCS_Resp_FD_Data : 0|512@1+ (1.0,0.0) [0.0|13407807929942597099574024998205846127479365820592393377723561443721764030073546976801874298166903427690031858186486050853753882811946569946433649006084095] ""  Airbag

BO_ 2549903646 OBDC_SSN_RGS_HL_Req: 8 Airbag
 SG_ OBDC_SSN_RGS_HL_Req_Data : 0|64@1+ (1.0,0.0) [0.0|18446744073709551615] ""  RGS_HL

BO_ 2550034718 OBDC_SSN_RGS_HL_Resp: 8 RGS_HL
 SG_ OBDC_SSN_RGS_HL_Resp_Data : 0|64@1+ (1.0,0.0) [0.0|18446744073709551615] ""  Airbag

BO_ 2549903647 OBDC_SSN_RGS_HR_Req: 8 Airbag
 SG_ OBDC_SSN_RGS_HR_Req_Data : 0|64@1+ (1.0,0.0) [0.0|18446744073709551615] ""  RGS_HR

BO_ 2550034719 OBDC_SSN_RGS_HR_Resp: 8 RGS_HR
 SG_ OBDC_SSN_RGS_HR_Resp_Data : 0|64@1+ (1.0,0.0) [0.0|18446744073709551615] ""  Airbag

BO_ 2549903402 OBDC_SSN_RGS_VL_Req: 8 Airbag
 SG_ OBDC_SSN_RGS_VL_Req_Data : 0|64@1+ (1.0,0.0) [0.0|18446744073709551615] ""  RGS_VL

BO_ 2550034474 OBDC_SSN_RGS_VL_Resp: 8 RGS_VL
 SG_ OBDC_SSN_RGS_VL_Resp_Data : 0|64@1+ (1.0,0.0) [0.0|18446744073709551615] ""  Airbag

BO_ 2549903403 OBDC_SSN_RGS_VR_Req: 8 Airbag
 SG_ OBDC_SSN_RGS_VR_Req_Data : 0|64@1+ (1.0,0.0) [0.0|18446744073709551615] ""  RGS_VR

BO_ 2550034475 OBDC_SSN_RGS_VR_Resp: 8 RGS_VR
 SG_ OBDC_SSN_RGS_VR_Resp_Data : 0|64@1+ (1.0,0.0) [0.0|18446744073709551615] ""  Airbag

BO_ 2589283656 ORU_01: 8 Airbag
 SG_ ORU_Warnung : 58|2@1+ (1.0,0.0) [0.0|3] ""  Vector__XXX
 SG_ ORU_Status : 61|3@1+ (1.0,0.0) [0.0|7] ""  RGS_HL,RGS_HR,RGS_VL,RGS_VR

BO_ 2527679787 RadioFunc_01: 12 Airbag
 SG_ WLC1_Systemzustand : 12|1@1+ (1.0,0.0) [0.0|1] ""  Vector__XXX
 SG_ WLC2_Systemzustand : 13|1@1+ (1.0,0.0) [0.0|1] ""  Vector__XXX
 SG_ RA_Frequency_unit : 14|2@1+ (1.0,0.0) [0.0|3] ""  RGS_HL,RGS_HR,RGS_VL,RGS_VR
 SG_ RA_Frequency : 16|14@1+ (1,0) [0|16383] "Unit_None"  RGS_HL,RGS_HR,RGS_VL,RGS_VR
 SG_ RA_AM_Tuning : 30|1@1+ (1.0,0.0) [0.0|1] ""  RGS_HL,RGS_HR,RGS_VL,RGS_VR

BO_ 2463978781 RGS_Anf_01: 16 Airbag
 SG_ RGS_VL_Anforderung : 12|5@1+ (1.0,0.0) [0.0|31] ""  RGS_VL
 SG_ RGS_VR_Anforderung : 17|5@1+ (1.0,0.0) [0.0|31] ""  RGS_VR
 SG_ RGS_HL_Anforderung : 22|5@1+ (1.0,0.0) [0.0|31] ""  RGS_HL
 SG_ RGS_HR_Anforderung : 27|5@1+ (1.0,0.0) [0.0|31] ""  RGS_HR
 SG_ RGS_VL_Nachlauf_2 : 32|1@1+ (1.0,0.0) [0.0|1] ""  RGS_VL
 SG_ RGS_VR_Nachlauf_2 : 33|1@1+ (1.0,0.0) [0.0|1] ""  RGS_VR
 SG_ RGS_HL_Nachlauf_2 : 34|1@1+ (1.0,0.0) [0.0|1] ""  RGS_HL
 SG_ RGS_HR_Nachlauf_2 : 35|1@1+ (1.0,0.0) [0.0|1] ""  RGS_HR
 SG_ RGS_Nachlauf_allg : 36|1@1+ (1.0,0.0) [0.0|1] ""  RGS_HL,RGS_HR,RGS_VL,RGS_VR
 SG_ RGS_Loesen_erlaubt : 37|1@1+ (1.0,0.0) [0.0|1] ""  RGS_HL,RGS_HR,RGS_VL,RGS_VR

BO_ 535 RGS_HL_01: 16 RGS_HL
 SG_ RGS_HL_Gurtgeschwindigkeit : 12|10@1+ (5,-2555) [-2550|2550] "Unit_DegreOfArcPerSecon"  Airbag
 SG_ RGS_HL_Gurtbandauszug : 22|12@1+ (5,-10235) [-10235|10230] "Unit_DegreOfArc"  Airbag
 SG_ RGS_HL_keine_Straffung_Unterspg : 34|1@1+ (1.0,0.0) [0.0|1] ""  Airbag
 SG_ RGS_HL_nicht_programmiert : 35|1@1+ (1.0,0.0) [0.0|1] ""  Airbag
 SG_ RGS_HL_Uebertemperatur_defekt : 36|1@1+ (1.0,0.0) [0.0|1] ""  Airbag
 SG_ RGS_HL_Bauteilfehler : 37|1@1+ (1.0,0.0) [0.0|1] ""  Airbag
 SG_ RGS_HL_keine_Straffung_Ueberspg : 38|1@1+ (1.0,0.0) [0.0|1] ""  Airbag
 SG_ RGS_HL_Max_Gurtlosezyklen : 39|1@1+ (1.0,0.0) [0.0|1] ""  Airbag
 SG_ RGS_HL_Temp : 40|8@1+ (0.5,-40) [-40.0|86.5] "Unit_DegreCelsi"  Airbag
 SG_ RGS_HL_Unterspannung : 49|1@1+ (1.0,0.0) [0.0|1] ""  Airbag
 SG_ RGS_HL_Max_Straffzyklenfehler : 50|1@1+ (1.0,0.0) [0.0|1] ""  Airbag
 SG_ RGS_HL_Max_Haptikzyklenfehler : 51|1@1+ (1.0,0.0) [0.0|1] ""  Airbag
 SG_ RGS_HL_Crashabschaltung : 52|1@1+ (1.0,0.0) [0.0|1] ""  Airbag
 SG_ RGS_HL_Ueberspannung : 53|1@1+ (1.0,0.0) [0.0|1] ""  Airbag
 SG_ RGS_HL_Motorfehler : 54|1@1+ (1.0,0.0) [0.0|1] ""  Airbag
 SG_ RGS_HL_InPos : 56|1@1+ (1.0,0.0) [0.0|1] ""  Airbag
 SG_ RGS_HL_Strom : 57|8@1+ (0.2,0) [0.2|50.6] "Unit_Amper"  Airbag
 SG_ RGS_HL_Status : 65|5@1+ (1.0,0.0) [0.0|31] ""  Airbag
 SG_ RGS_HL_Max_NGU_Zyklenfehler : 70|1@1+ (1.0,0.0) [0.0|1] ""  Airbag
 SG_ RGS_HL_Max_P2P_Zyklenfehler : 71|1@1+ (1.0,0.0) [0.0|1] ""  Vector__XXX
 SG_ RGS_HL_EEPROM_RAM_ROM_Fehler : 72|1@1+ (1.0,0.0) [0.0|1] ""  Airbag

BO_ 539 RGS_HR_01: 16 RGS_HR
 SG_ RGS_HR_Gurtgeschwindigkeit : 12|10@1+ (5,-2555) [-2550|2550] "Unit_DegreOfArcPerSecon"  Airbag
 SG_ RGS_HR_Gurtbandauszug : 22|12@1+ (5,-10235) [-10235|10230] "Unit_DegreOfArc"  Airbag
 SG_ RGS_HR_keine_Straffung_Unterspg : 34|1@1+ (1.0,0.0) [0.0|1] ""  Airbag
 SG_ RGS_HR_nicht_programmiert : 35|1@1+ (1.0,0.0) [0.0|1] ""  Airbag
 SG_ RGS_HR_Uebertemperatur_defekt : 36|1@1+ (1.0,0.0) [0.0|1] ""  Airbag
 SG_ RGS_HR_Bauteilfehler : 37|1@1+ (1.0,0.0) [0.0|1] ""  Airbag
 SG_ RGS_HR_keine_Straffung_Ueberspg : 38|1@1+ (1.0,0.0) [0.0|1] ""  Airbag
 SG_ RGS_HR_Max_Gurtlosezyklen : 39|1@1+ (1.0,0.0) [0.0|1] ""  Airbag
 SG_ RGS_HR_Temp : 40|8@1+ (0.5,-40) [-40.0|86.5] "Unit_DegreCelsi"  Airbag
 SG_ RGS_HR_Unterspannung : 49|1@1+ (1.0,0.0) [0.0|1] ""  Airbag
 SG_ RGS_HR_Max_Straffzyklenfehler : 50|1@1+ (1.0,0.0) [0.0|1] ""  Airbag
 SG_ RGS_HR_Max_Haptikzyklenfehler : 51|1@1+ (1.0,0.0) [0.0|1] ""  Airbag
 SG_ RGS_HR_Crashabschaltung : 52|1@1+ (1.0,0.0) [0.0|1] ""  Airbag
 SG_ RGS_HR_Ueberspannung : 53|1@1+ (1.0,0.0) [0.0|1] ""  Airbag
 SG_ RGS_HR_Motorfehler : 54|1@1+ (1.0,0.0) [0.0|1] ""  Airbag
 SG_ RGS_HR_InPos : 56|1@1+ (1.0,0.0) [0.0|1] ""  Airbag
 SG_ RGS_HR_Strom : 57|8@1+ (0.2,0) [0.2|50.6] "Unit_Amper"  Airbag
 SG_ RGS_HR_Status : 65|5@1+ (1.0,0.0) [0.0|31] ""  Airbag
 SG_ RGS_HR_Max_NGU_Zyklenfehler : 70|1@1+ (1.0,0.0) [0.0|1] ""  Airbag
 SG_ RGS_HR_Max_P2P_Zyklenfehler : 71|1@1+ (1.0,0.0) [0.0|1] ""  Vector__XXX
 SG_ RGS_HR_EEPROM_RAM_ROM_Fehler : 72|1@1+ (1.0,0.0) [0.0|1] ""  Airbag

BO_ 984 RGS_VL_01: 16 RGS_VL
 SG_ RGS_VL_Gurtgeschwindigkeit : 12|10@1+ (5,-2555) [-2550|2550] "Unit_DegreOfArcPerSecon"  Airbag
 SG_ RGS_VL_Gurtbandauszug : 22|12@1+ (5,-10235) [-10235|10230] "Unit_DegreOfArc"  Airbag
 SG_ RGS_VL_keineStraffungUnterspg : 34|1@1+ (1.0,0.0) [0.0|1] ""  Airbag
 SG_ RGS_VL_nicht_programmiert : 35|1@1+ (1.0,0.0) [0.0|1] ""  Airbag
 SG_ RGS_VL_Uebertemperatur_defekt : 36|1@1+ (1.0,0.0) [0.0|1] ""  Airbag
 SG_ RGS_VL_Bauteilfehler : 37|1@1+ (1.0,0.0) [0.0|1] ""  Airbag
 SG_ RGS_VL_keineStraffungUeberspg : 38|1@1+ (1.0,0.0) [0.0|1] ""  Airbag
 SG_ RGS_VL_Max_Gurtlosezyklen : 39|1@1+ (1.0,0.0) [0.0|1] ""  Airbag
 SG_ RGS_VL_Temp : 40|8@1+ (0.5,-40) [-40.0|86.5] "Unit_DegreCelsi"  Airbag
 SG_ RGS_VL_Unterspannung : 49|1@1+ (1.0,0.0) [0.0|1] ""  Airbag
 SG_ RGS_VL_Max_Straffzyklenfehler : 50|1@1+ (1.0,0.0) [0.0|1] ""  Airbag
 SG_ RGS_VL_Max_Haptikzyklenfehler : 51|1@1+ (1.0,0.0) [0.0|1] ""  Airbag
 SG_ RGS_VL_Crashabschaltung : 52|1@1+ (1.0,0.0) [0.0|1] ""  Airbag
 SG_ RGS_VL_Ueberspannung : 53|1@1+ (1.0,0.0) [0.0|1] ""  Airbag
 SG_ RGS_VL_Motorfehler : 54|1@1+ (1.0,0.0) [0.0|1] ""  Airbag
 SG_ RGS_VL_InPos : 56|1@1+ (1.0,0.0) [0.0|1] ""  Airbag
 SG_ RGS_VL_Strom : 57|8@1+ (0.2,0) [0.2|50.6] "Unit_Amper"  Airbag
 SG_ RGS_VL_Status : 65|5@1+ (1.0,0.0) [0.0|31] ""  Airbag
 SG_ RGS_VL_Max_NGU_Zyklenfehler : 70|1@1+ (1.0,0.0) [0.0|1] ""  Airbag
 SG_ RGS_VL_Max_P2P_Zyklenfehler : 71|1@1+ (1.0,0.0) [0.0|1] ""  Vector__XXX
 SG_ RGS_VL_EEPROM_RAM_ROM_Fehler : 72|1@1+ (1.0,0.0) [0.0|1] ""  Airbag

BO_ 985 RGS_VR_01: 16 RGS_VR
 SG_ RGS_VR_Gurtgeschwindigkeit : 12|10@1+ (5,-2555) [-2550|2550] "Unit_DegreOfArcPerSecon"  Airbag
 SG_ RGS_VR_Gurtbandauszug : 22|12@1+ (5,-10235) [-10235|10230] "Unit_DegreOfArc"  Airbag
 SG_ RGS_VR_keineStraffungUnterspg : 34|1@1+ (1.0,0.0) [0.0|1] ""  Airbag
 SG_ RGS_VR_nicht_programmiert : 35|1@1+ (1.0,0.0) [0.0|1] ""  Airbag
 SG_ RGS_VR_Uebertemperatur_defekt : 36|1@1+ (1.0,0.0) [0.0|1] ""  Airbag
 SG_ RGS_VR_Bauteilfehler : 37|1@1+ (1.0,0.0) [0.0|1] ""  Airbag
 SG_ RGS_VR_keineStraffungUeberspg : 38|1@1+ (1.0,0.0) [0.0|1] ""  Airbag
 SG_ RGS_VR_Max_Gurtlosezyklen : 39|1@1+ (1.0,0.0) [0.0|1] ""  Airbag
 SG_ RGS_VR_Temp : 40|8@1+ (0.5,-40) [-40.0|86.5] "Unit_DegreCelsi"  Airbag
 SG_ RGS_VR_Unterspannung : 49|1@1+ (1.0,0.0) [0.0|1] ""  Airbag
 SG_ RGS_VR_Max_Straffzyklenfehler : 50|1@1+ (1.0,0.0) [0.0|1] ""  Airbag
 SG_ RGS_VR_Max_Haptikzyklenfehler : 51|1@1+ (1.0,0.0) [0.0|1] ""  Airbag
 SG_ RGS_VR_Crashabschaltung : 52|1@1+ (1.0,0.0) [0.0|1] ""  Airbag
 SG_ RGS_VR_Ueberspannung : 53|1@1+ (1.0,0.0) [0.0|1] ""  Airbag
 SG_ RGS_VR_Motorfehler : 54|1@1+ (1.0,0.0) [0.0|1] ""  Airbag
 SG_ RGS_VR_InPos : 56|1@1+ (1.0,0.0) [0.0|1] ""  Airbag
 SG_ RGS_VR_Strom : 57|8@1+ (0.2,0) [0.2|50.6] "Unit_Amper"  Airbag
 SG_ RGS_VR_Status : 65|5@1+ (1.0,0.0) [0.0|31] ""  Airbag
 SG_ RGS_VR_Max_NGU_Zyklenfehler : 70|1@1+ (1.0,0.0) [0.0|1] ""  Airbag
 SG_ RGS_VR_Max_P2P_Zyklenfehler : 71|1@1+ (1.0,0.0) [0.0|1] ""  Vector__XXX
 SG_ RGS_VR_EEPROM_RAM_ROM_Fehler : 72|1@1+ (1.0,0.0) [0.0|1] ""  Airbag

CM_ SG_ 2600468501 NM_Airbag_01_CBV_AWB "Das Signal ist zu setzen, wenn das SG aktiv den Bus geweckt hat
0 = Passiver_WakeUp = SG hat das Netzwerk nicht aktiv geweckt
1 = Akitiver_WakeUp = SG hat das Netzwerk aktiv geweckt";
CM_ SG_ 2600468501 NM_Airbag_01_CBV_CRI "Das Signal ist dauerhaft gesetzt, wenn das NM-Layout Cluster- Anforderungen enthält";
CM_ SG_ 2600468501 NM_Airbag_01_FCAB "FCAB = Funktions-Cluster-Aktiv-Bits";
CM_ SG_ 2600468501 NM_Airbag_01_NM_aktiv_Diag "Diagnose befindet sich nach VW80124 in einer NonDefaultDiagnostic-Session, z.B. ExtendedDiagnostic-Session";
CM_ SG_ 2600468501 NM_Airbag_01_NM_aktiv_KL15 "Steuergerät hat KL15-EIN erkannt";
CM_ SG_ 2600468501 NM_Airbag_01_NM_aktiv_Tmin "Mindestaktivzeit ist noch nicht abgelaufen (bei jedem Weckereignis wird die Mindestaktivzeit neu gestartet)";
CM_ SG_ 2600468501 NM_Airbag_01_NM_State "1 = Zustand Repeat Message (<-- Bus-Sleep Mode)
2 = Zustand Repeat Message (<-- Prepare Bus-Sleep Mode)
4 = Zustand Normal Operation (<-- Repeat Message)
8 = Zustand Normal Operation (<-- Ready Sleep)";
CM_ SG_ 2600468501 NM_Airbag_01_SNI_10 "Source Node-Identifier (SNI) identifiziert den Sender der NM-Botschaft (Knotenadresse) eindeutig im Fahrzeug";
CM_ SG_ 2600468501 NM_Airbag_01_UDS_CC "Funktionseinschränkung aufgrund aktivem UDS-Communication Control, siehe VW80124";
CM_ SG_ 2600468501 NM_Airbag_01_Wakeup "enthält die Weckursache; stehen mehrere Weckursachen parallel an, dann muss der kleinste Wert übertragen werden";
CM_ SG_ 2600468501 NM_aktiv_AntriebsCAN_aktiv "Der Airbag muss den SC-CAN als SubCAN zun den Reversiblen Gurtstraffern immer wachhalten, solange der A-CAN aktiv ist.";
CM_ SG_ 2600468501 NM_aktiv_Ausloesefaehig "Die Auslösefähigkeit wird mit KL15 Ein hergestellt. Die Auslösefähigkeit bleibt nach KL15 Ein --> Aus solange erhalten, bis auch V< 'parametrierbare Geschwindigkeitsschwelle' für eine parametrierbare Zeit erkannt wird (Nachlaufursache). Danach endet die A";
CM_ SG_ 2600468501 NM_aktiv_Gurtparken "Der Airbag muss den SC-CAN  zu den Reversiblen Gurtstraffern  bei aktiver Gurtparken-Funktion wachhalten";
CM_ SG_ 2600468501 NM_aktiv_Gurtschloss "Wenn eine Änderung des Gurtschlossstatus erkannt wird weckt der Airbag den UserStateServer um die Information gegurtet / nicht gegurtet mitzuteilen. Gleichzeitig muss der Airbag das TSG wecken, um eine Verzögerung durch einen kaskadierten Wakeup durch den";
CM_ SG_ 2600468501 NM_aktiv_Kl15_unplausibel "Die Auslösefähigkeit bleibt nach SW KL15 Ein --> Aus solange erhalten, bis auch HW Kl15 aus ist (und auch V< parametrierbare Geschwindigkeitsschwelle für eine parametrierbare Zeit erkannt wird). Danach endet die Auslösefähigkeit im Airbag und wird erst wi";
CM_ SG_ 2600468501 NM_aktiv_Sitzbelegung "Wenn eine Änderung in der Sitzbelegung erkannt wird weckt der Airbag den UserStateServer um die Fahreranwesenheit oder Fahrerabwesenheit mitzuteilen. Gleichzeitig muss der Airbag das TSG wecken, um eine Verzögerung durch einen kaskadierten Wakeup durch de";

CM_ SG_ 2600468729 NM_aktiv_Gurtbewegung_HL "Bei Kl15 EIN->AUS gehen die RGS (VR,VR,HL, HR) in einen lokalen Nachlauf (ohne Busaktivität). Wenn innerhalb dieser Zeit eine Bewegung des Gurtes erkannt wird, weckt der entsprechende RGS das Airbag-Steuergerät auf um die Funktion Gurtparken (Funktionsmas";
CM_ SG_ 2600468729 NM_RGS_HL_CBV_AWB "Das Signal ist zu setzen, wenn das SG aktiv den Bus geweckt hat
0 = Passiver_WakeUp = SG hat das Netzwerk nicht aktiv geweckt
1 = Akitiver_WakeUp = SG hat das Netzwerk aktiv geweckt";
CM_ SG_ 2600468729 NM_RGS_HL_CBV_CRI "Das Signal ist dauerhaft gesetzt, wenn das NM-Layout Cluster- Anforderungen enthält";
CM_ SG_ 2600468729 NM_RGS_HL_FCAB "FCAB = Funktions-Cluster-Aktiv-Bits";
CM_ SG_ 2600468729 NM_RGS_HL_NM_aktiv_Diag "Diagnose befindet sich nach VW80124 in einer NonDefaultDiagnostic-Session, z.B. ExtendedDiagnostic-Session";
CM_ SG_ 2600468729 NM_RGS_HL_NM_aktiv_KL15 "Steuergerät hat KL15-EIN erkannt";
CM_ SG_ 2600468729 NM_RGS_HL_NM_aktiv_Tmin "Mindestaktivzeit ist noch nicht abgelaufen (bei jedem Weckereignis wird die Mindestaktivzeit neu gestartet)";
CM_ SG_ 2600468729 NM_RGS_HL_NM_State "1 = Zustand Repeat Message (<-- Bus-Sleep Mode)
2 = Zustand Repeat Message (<-- Prepare Bus-Sleep Mode)
4 = Zustand Normal Operation (<-- Repeat Message)
8 = Zustand Normal Operation (<-- Ready Sleep)";
CM_ SG_ 2600468729 NM_RGS_HL_SNI_10 "Source Node-Identifier (SNI) identifiziert den Sender der NM-Botschaft (Knotenadresse) eindeutig im Fahrzeug";
CM_ SG_ 2600468729 NM_RGS_HL_UDS_CC "Funktionseinschränkung aufgrund aktivem UDS-Communication Control, siehe VW80124";
CM_ SG_ 2600468729 NM_RGS_HL_Wakeup_V12 "enthält die Weckursache; stehen mehrere Weckursachen parallel an, dann muss der kleinste Wert übertragen werden";

CM_ SG_ 2600468730 NM_aktiv_Gurtbewegung_HR "Bei Kl15 EIN->AUS gehen die RGS (VR,VR,HL, HR) in einen lokalen Nachlauf (ohne Busaktivität). Wenn innerhalb dieser Zeit eine Bewegung des Gurtes erkannt wird, weckt der entsprechende RGS das Airbag-Steuergerät auf um die Funktion Gurtparken (Funktionsmas";
CM_ SG_ 2600468730 NM_RGS_HR_CBV_AWB "Das Signal ist zu setzen, wenn das SG aktiv den Bus geweckt hat
0 = Passiver_WakeUp = SG hat das Netzwerk nicht aktiv geweckt
1 = Akitiver_WakeUp = SG hat das Netzwerk aktiv geweckt";
CM_ SG_ 2600468730 NM_RGS_HR_CBV_CRI "Das Signal ist dauerhaft gesetzt, wenn das NM-Layout Cluster- Anforderungen enthält";
CM_ SG_ 2600468730 NM_RGS_HR_FCAB "FCAB = Funktions-Cluster-Aktiv-Bits";
CM_ SG_ 2600468730 NM_RGS_HR_NM_aktiv_Diag "Diagnose befindet sich nach VW80124 in einer NonDefaultDiagnostic-Session, z.B. ExtendedDiagnostic-Session";
CM_ SG_ 2600468730 NM_RGS_HR_NM_aktiv_KL15 "Steuergerät hat KL15-EIN erkannt";
CM_ SG_ 2600468730 NM_RGS_HR_NM_aktiv_Tmin "Mindestaktivzeit ist noch nicht abgelaufen (bei jedem Weckereignis wird die Mindestaktivzeit neu gestartet)";
CM_ SG_ 2600468730 NM_RGS_HR_NM_State "1 = Zustand Repeat Message (<-- Bus-Sleep Mode)
2 = Zustand Repeat Message (<-- Prepare Bus-Sleep Mode)
4 = Zustand Normal Operation (<-- Repeat Message)
8 = Zustand Normal Operation (<-- Ready Sleep)";
CM_ SG_ 2600468730 NM_RGS_HR_SNI_10 "Source Node-Identifier (SNI) identifiziert den Sender der NM-Botschaft (Knotenadresse) eindeutig im Fahrzeug";
CM_ SG_ 2600468730 NM_RGS_HR_UDS_CC "Funktionseinschränkung aufgrund aktivem UDS-Communication Control, siehe VW80124";
CM_ SG_ 2600468730 NM_RGS_HR_Wakeup_V12 "enthält die Weckursache; stehen mehrere Weckursachen parallel an, dann muss der kleinste Wert übertragen werden";

CM_ SG_ 2600468574 NM_aktiv_Gurtbewegung_VL "Bei Kl15 EIN->AUS gehen die RGS (VR,VR,HL, HR) in einen lokalen Nachlauf (ohne Busaktivität). Wenn innerhalb dieser Zeit eine Bewegung des Gurtes erkannt wird, weckt der entsprechende RGS das Airbag-Steuergerät auf um die Funktion Gurtparken (Funktionsmas";
CM_ SG_ 2600468574 NM_RGS_VL_CBV_AWB "Das Signal ist zu setzen, wenn das SG aktiv den Bus geweckt hat
0 = Passiver_WakeUp = SG hat das Netzwerk nicht aktiv geweckt
1 = Akitiver_WakeUp = SG hat das Netzwerk aktiv geweckt";
CM_ SG_ 2600468574 NM_RGS_VL_CBV_CRI "Das Signal ist dauerhaft gesetzt, wenn das NM-Layout Cluster- Anforderungen enthält";
CM_ SG_ 2600468574 NM_RGS_VL_FCAB "FCAB = Funktions-Cluster-Aktiv-Bits";
CM_ SG_ 2600468574 NM_RGS_VL_NM_aktiv_Diag "Diagnose befindet sich nach VW80124 in einer NonDefaultDiagnostic-Session, z.B. ExtendedDiagnostic-Session";
CM_ SG_ 2600468574 NM_RGS_VL_NM_aktiv_KL15 "Steuergerät hat KL15-EIN erkannt";
CM_ SG_ 2600468574 NM_RGS_VL_NM_aktiv_Tmin "Mindestaktivzeit ist noch nicht abgelaufen (bei jedem Weckereignis wird die Mindestaktivzeit neu gestartet)";
CM_ SG_ 2600468574 NM_RGS_VL_NM_State "1 = Zustand Repeat Message (<-- Bus-Sleep Mode)
2 = Zustand Repeat Message (<-- Prepare Bus-Sleep Mode)
4 = Zustand Normal Operation (<-- Repeat Message)
8 = Zustand Normal Operation (<-- Ready Sleep)";
CM_ SG_ 2600468574 NM_RGS_VL_SNI_10 "Source Node-Identifier (SNI) identifiziert den Sender der NM-Botschaft (Knotenadresse) eindeutig im Fahrzeug";
CM_ SG_ 2600468574 NM_RGS_VL_UDS_CC "Funktionseinschränkung aufgrund aktivem UDS-Communication Control, siehe VW80124";
CM_ SG_ 2600468574 NM_RGS_VL_Wakeup_V12 "enthält die Weckursache; stehen mehrere Weckursachen parallel an, dann muss der kleinste Wert übertragen werden";

CM_ SG_ 2600468575 NM_aktiv_Gurtbewegung_VR "Bei Kl15 EIN->AUS gehen die RGS (VR,VR,HL, HR) in einen lokalen Nachlauf (ohne Busaktivität). Wenn innerhalb dieser Zeit eine Bewegung des Gurtes erkannt wird, weckt der entsprechende RGS das Airbag-Steuergerät auf um die Funktion Gurtparken (Funktionsmas";
CM_ SG_ 2600468575 NM_RGS_VR_CBV_AWB "Das Signal ist zu setzen, wenn das SG aktiv den Bus geweckt hat
0 = Passiver_WakeUp = SG hat das Netzwerk nicht aktiv geweckt
1 = Akitiver_WakeUp = SG hat das Netzwerk aktiv geweckt";
CM_ SG_ 2600468575 NM_RGS_VR_CBV_CRI "Das Signal ist dauerhaft gesetzt, wenn das NM-Layout Cluster- Anforderungen enthält";
CM_ SG_ 2600468575 NM_RGS_VR_FCAB "FCAB = Funktions-Cluster-Aktiv-Bits";
CM_ SG_ 2600468575 NM_RGS_VR_NM_aktiv_Diag "Diagnose befindet sich nach VW80124 in einer NonDefaultDiagnostic-Session, z.B. ExtendedDiagnostic-Session";
CM_ SG_ 2600468575 NM_RGS_VR_NM_aktiv_KL15 "Steuergerät hat KL15-EIN erkannt";
CM_ SG_ 2600468575 NM_RGS_VR_NM_aktiv_Tmin "Mindestaktivzeit ist noch nicht abgelaufen (bei jedem Weckereignis wird die Mindestaktivzeit neu gestartet)";
CM_ SG_ 2600468575 NM_RGS_VR_NM_State "1 = Zustand Repeat Message (<-- Bus-Sleep Mode)
2 = Zustand Repeat Message (<-- Prepare Bus-Sleep Mode)
4 = Zustand Normal Operation (<-- Repeat Message)
8 = Zustand Normal Operation (<-- Ready Sleep)";
CM_ SG_ 2600468575 NM_RGS_VR_SNI_10 "Source Node-Identifier (SNI) identifiziert den Sender der NM-Botschaft (Knotenadresse) eindeutig im Fahrzeug";
CM_ SG_ 2600468575 NM_RGS_VR_UDS_CC "Funktionseinschränkung aufgrund aktivem UDS-Communication Control, siehe VW80124";
CM_ SG_ 2600468575 NM_RGS_VR_Wakeup_V12 "enthält die Weckursache; stehen mehrere Weckursachen parallel an, dann muss der kleinste Wert übertragen werden";

CM_ SG_ 567 BEM_Batt_Ab "Batterieverbindungskontrolle:
0x0: Batterie am Bordnetz
0x1: Batterie ab erkannt";
CM_ SG_ 567 BEM_Generatordiagnose "Ansteuerung Generatorwarnleuchte im Kombi
";
CM_ SG_ 567 BEM_HL_Regelung_Status "Status Regelung Heizleistung
";
CM_ SG_ 567 BEM_Red_Innengeblaese "Reduzierung Innengebläse
";
CM_ SG_ 567 BEM_STH_Einschaltverbot "Einschränkung Standheizung/-lüftung durch BEM: Setzt der BEM das Bit, dann darf die Standheizung nicht mehr einschalten
(Die Standheizung muss aber nicht abschalten, sondern darf weiterbrennen)
(Initialisierungswert aus EEprom)
";
CM_ SG_ 567 BEM_STH_Zielzeit "Maximal mögliche Zeit für den Standheizungsbetrieb, um die Startfähigkeit nicht zu gefährden";
CM_ SG_ 567 NVEM3_Absch_SCR "Abschaltung der SCR-Heizung durch das NVEM bei energetisch kritischen Zuständen.";
CM_ SG_ 567 NVEM_12_BZ "4bit Botschaftszähler, wird mit jeder Sendebotschaft inkrementiert";
CM_ SG_ 567 NVEM_12_CRC "Für MLB:
Berechnung siehe Lastenheft 'Kommunikationsabsicherung für FlexRay und CAN'
Ab MQB und MLBevo:
Berechnung siehe Lastenheft 'End-to-End Kommunikationsabsicherung'

Endwerte siehe Begleitdokument 'S-PDU Kennungsfolgen'";
CM_ SG_ 567 NVEM_Abschaltstufe "Abschaltstufe aus dem Ruheenergiemanagement
Maßnahmen des Empfängers werden im QLAH Ruhestrommanagement definiert";
CM_ SG_ 567 NVEM_Bordnetz_Information "Informationsanzeigen zum 12V - Bordnetz";
CM_ SG_ 567 NVEM_Bordnetzdiagnose "Wird vom NVEM im NV-Netz ein Bordnetz-Fehler erkannt, so soll dies zu einer mehrstufigen Anzeige führen.";
CM_ SG_ 567 NVEM_DC_iSoll_NV "Soll-Entladestrom 12V Seite des DCDC Wandlers";
CM_ SG_ 567 NVEM_DC_uMin_NV "Mindestspannung des DCDC Wandlers im Hochsetzbetrieb auf 12V Seite";
CM_ SG_ 567 NVEM_DC_uSoll_NV "Sollspannung 12V Seite des DC Wandlers, feine Auflösung";
CM_ SG_ 567 NVEM_Freigabe_OTA "Bestätigung oder Ablehnung eines konkreten, angefragten Online-Updates durch das Energiemangement";
CM_ SG_ 567 NVEM_Last_Anf "Das NVEM fordert für die Batteriediagnose einen Lastimpuls vom Fahrzeug an, der durch kontrollierte Verbraucherzuschaltungen (z. B. Aktivierung Heckscheibenheizung) generiert wird";
CM_ SG_ 567 NVEM_MV_DC_iSoll_NV "Sollstromvorgabe NVEM an MV - DCDC Wandler";
CM_ SG_ 567 NVEM_MV_DC_uMinLV "Abregelgrenze: minimal erlaubte Bordnetzspannung im Hochsetzbetrieb vom 12V-Bordnetz ins 48V-Netz";
CM_ SG_ 567 NVEM_MV_DC_uSollLV "Sollwert für die 12V-Bordnetzspannung im Tiefsetzbetrieb vom 48V-Netz ins 12V-Bordnetz";
CM_ SG_ 567 NVEM_NV_BAT_ZellStatus_Index_Anf "Multiplex signal for cell number of low voltage battery.";
CM_ SG_ 567 NVEM_NV_BAT_ZellStatus_Typ_Anf "Multiplex signal for cell status of low voltage battery.";
CM_ SG_ 567 NVEM_Verbraucher_Information "Mit diesem Signal löst Das NVM eine Anzeige bzgl. einer bevorstehenden oder erfolgten Verbraucherabschaltung aus";

CM_ SG_ 2621469190 OBDC_SSN_eCS_Req_FD_Data "Request FID- zu NA- Kommunikation zw. OnboardDiagnoseClient und DK2F Sub-System";

CM_ SG_ 2621600262 OBDC_SSN_eCS_Resp_FD_Data "Response FID- zu NA- Kommunikation zw. OnboardDiagnoseClient und DK2F Sub-System";

CM_ SG_ 2549903646 OBDC_SSN_RGS_HL_Req_Data "OnBoard Tester Diagnose Request RGS_HL";

CM_ SG_ 2550034718 OBDC_SSN_RGS_HL_Resp_Data "OnBoard Tester Diagnose Response RGS_HL";

CM_ SG_ 2549903647 OBDC_SSN_RGS_HR_Req_Data "OnBoard Tester Diagnose Request RGS_HR";

CM_ SG_ 2550034719 OBDC_SSN_RGS_HR_Resp_Data "OnBoard Tester Diagnose Response RGS_HR";

CM_ SG_ 2549903402 OBDC_SSN_RGS_VL_Req_Data "OnBoard Tester Diagnose Request RGS_VL";

CM_ SG_ 2550034474 OBDC_SSN_RGS_VL_Resp_Data "OnBoard Tester Diagnose Response RGS_VL";

CM_ SG_ 2549903403 OBDC_SSN_RGS_VR_Req_Data "OnBoard Tester Diagnose Request RGS_VR";

CM_ SG_ 2550034475 OBDC_SSN_RGS_VR_Resp_Data "OnBoard Tester Diagnose Response RGS_VR";

CM_ SG_ 2589283656 ORU_Status "Verteilung des internen ORU Zustandes";
CM_ SG_ 2589283656 ORU_Warnung "Wenn durch Störungen der Funktion Online Remote Update nicht sichergestellt ist, dass vor Kunde keine Funktionseinschränkungen auftreten, muss der Benutzer des Fahrzeugs entsprechend gewarnt werden.";

CM_ SG_ 2527679787 RA_AM_Tuning "Das Signal kennzeichnet einen aktiven AM Suchlauf. Während des Suchlaufes wird die Frequenz = 0 übertragen.
0 = frequency locked => Störquelle vermeidet die aktuelle Frequenz
1 = AM tuning in progress => Störquelle abschalten bzw.PWM Signal auf DC umsch";
CM_ SG_ 2527679787 RA_Frequency "Übermittlung der eingestellten Sendefrequenz AM oder FM, diese wird mit RA_Frequency_unit multipliziert.
Im DAB oder Hybrid/Online Mode wird die aktuelle FM-Alternativfrequenz oder, falls nicht vorhanden, die zuletzt gehörte Senderfrequenz übertragen (AM";
CM_ SG_ 2527679787 RA_Frequency_unit "Faktor für RA_Frequency
bei AM: Faktor 0 = 1kHz
sonst   Faktor 1 = 100kHz";
CM_ SG_ 2527679787 WLC1_Systemzustand "0 = Wireless Charger off (Message produced by HMI)
1 = Wireless Charger on (Message produced by HMI)";
CM_ SG_ 2527679787 WLC2_Systemzustand "0 = Wireless Charger off
1 = Wireless Charger on";

CM_ SG_ 2463978781 RGS_HL_Anforderung "Ansteuerung Reversibler Gurstraffer_HL";
CM_ SG_ 2463978781 RGS_HL_Nachlauf_2 "RGS HL führt die Nachlaufzeit 2 aus";
CM_ SG_ 2463978781 RGS_HR_Anforderung "Ansteuerung Reversibler Gurstraffer_VL";
CM_ SG_ 2463978781 RGS_HR_Nachlauf_2 "RGS HR führt die Nachlaufzeit 2 aus";
CM_ SG_ 2463978781 RGS_Loesen_erlaubt "Loesefreigabe an RGS (z.B. Kugel stabil)";
CM_ SG_ 2463978781 RGS_Nachlauf_allg "RGS führen Nachlauf aus ";
CM_ SG_ 2463978781 RGS_VL_Anforderung "Ansteuerung Reversibler Gurstraffer_VL";
CM_ SG_ 2463978781 RGS_VL_Nachlauf_2 "RGS VL führt die Nachlaufzeit 2 aus";
CM_ SG_ 2463978781 RGS_VR_Anforderung "Ansteuerung Reversibler Gurstraffer_VR";
CM_ SG_ 2463978781 RGS_VR_Nachlauf_2 "RGS VR führt die Nachlaufzeit 2 aus";

CM_ SG_ 535 RGS_HL_Bauteilfehler "RGS hinten links übermittelt einen Bauteilfehler an den Safety Computer.";
CM_ SG_ 535 RGS_HL_Crashabschaltung "RGS hinten links übermittelt an den Safety Computer, dass RGS aufgrund eines Crashevents den Straffvorgang abgebrochen hat.";
CM_ SG_ 535 RGS_HL_EEPROM_RAM_ROM_Fehler "RGS hinten links übermittelt einen EEPROM_RAM_ROOM_Fehler an den Safety Computer";
CM_ SG_ 535 RGS_HL_Gurtbandauszug "Länge des Gurtbandauszugs
";
CM_ SG_ 535 RGS_HL_Gurtgeschwindigkeit "positive Werte: Gurtbandauszug
negative Werte: Gurtbandeinlauf";
CM_ SG_ 535 RGS_HL_InPos "Der RGS setzt dieses Signal wenn der Insasse nach Fahrtbeginn an einen 'normale' Position ruhig sitzt (keine Gurtlose mehr vorhanden)";
CM_ SG_ 535 RGS_HL_keine_Straffung_Ueberspg "RGS hinten links übermittelt an den Safety Computer, dass keine Straffung aufgrund Ueberspannung möglich ist.";
CM_ SG_ 535 RGS_HL_keine_Straffung_Unterspg "RGS hinten links übermittelt an den Safety Computer, dass keine Straffung aufgrund Unterspannung möglich ist.";
CM_ SG_ 535 RGS_HL_Max_Gurtlosezyklen "RGS hinten links übermittelt einen Fehler an den Safety Computer wenn die maximalen Straffzyklen erreicht sind.";
CM_ SG_ 535 RGS_HL_Max_Haptikzyklenfehler "Der RGS übermittelt an den Airbag dass die maximale Strazyklen für Haptik erreicht ist";
CM_ SG_ 535 RGS_HL_Max_NGU_Zyklenfehler "Der RGS übermittelt an den Airbag, dass die maximal Anzahl an Straffzyklen für NGU erreicht ist";
CM_ SG_ 535 RGS_HL_Max_P2P_Zyklenfehler "Der RGS übermittelt an den Airbag, dass die maximale Anzahl Straffzyklen für Push2Pass erreicht ist.";
CM_ SG_ 535 RGS_HL_Max_Straffzyklenfehler "RGS hinten links übermittelt einen Fehler an den Safety Computer wenn die maximalen Straffzyklen erreicht sind.";
CM_ SG_ 535 RGS_HL_Motorfehler "RGS hinten links übermittelt einen Motorfehler an den Safety Computer.";
CM_ SG_ 535 RGS_HL_nicht_programmiert "RGS hinten links übermittelt einen Fehler an den Safety Computer wenn keine Straffkurven programmiert sind";
CM_ SG_ 535 RGS_HL_Status "Rückantwort von RGS HL, welche Aktion durchgeführt wird";
CM_ SG_ 535 RGS_HL_Strom "RGS hinten links übermittelt Stromwert an den Safety Computer.";
CM_ SG_ 535 RGS_HL_Temp "RGS hinten links übermittelt Temperatur an den Safety Computer.";
CM_ SG_ 535 RGS_HL_Ueberspannung "RGS hinten links übermittelt Ueberspannungsfehler an den Safety Computer.";
CM_ SG_ 535 RGS_HL_Uebertemperatur_defekt "RGS hinten links übermittelt an den Safety Computer, dass RGS aufgrund eines Temperaturfehlers defekt ist.";
CM_ SG_ 535 RGS_HL_Unterspannung "RGS hinten links übermittelt Unterspannungsfehler an den Safety Computer.";

CM_ SG_ 539 RGS_HR_Bauteilfehler "RGS hinten rechts übermittelt einen Bauteilfehler an den Safety Computer.";
CM_ SG_ 539 RGS_HR_Crashabschaltung "RGS hinten rechts übermittelt an den Safety Computer, dass RGS aufgrund eines Crashevents den Straffvorgang abgebrochen hat.";
CM_ SG_ 539 RGS_HR_EEPROM_RAM_ROM_Fehler "RGS hinten rechts übermittelt einen EEPROM_RAM_ROOM_Fehler an den Safety Computer";
CM_ SG_ 539 RGS_HR_Gurtbandauszug "Länge des Gurtbandauszugs
";
CM_ SG_ 539 RGS_HR_Gurtgeschwindigkeit "positive Werte: Gurtbandauszug
negative Werte: Gurtbandeinlauf";
CM_ SG_ 539 RGS_HR_InPos "Der RGS setzt dieses Signal wenn der Insasse nach Fahrtbeginn an einen 'normale' Position ruhig sitzt (keine Gurtlose mehr vorhanden)";
CM_ SG_ 539 RGS_HR_keine_Straffung_Ueberspg "RGS hinten rechts übermittelt an den Safety Computer, dass keine Straffung aufgrund Ueberspannung möglich ist.";
CM_ SG_ 539 RGS_HR_keine_Straffung_Unterspg "RGS hinten rechts übermittelt an den Safety Computer, dass keine Straffung aufgrund Unterspannung möglich ist.";
CM_ SG_ 539 RGS_HR_Max_Gurtlosezyklen "RGS hinten rechts übermittelt einen Fehler an den Safety Computer wenn die maximalen Straffzyklen erreicht sind.";
CM_ SG_ 539 RGS_HR_Max_Haptikzyklenfehler "Der RGS übermittelt an den Airbag dass die maximale Strazyklen für Haptik erreicht ist";
CM_ SG_ 539 RGS_HR_Max_NGU_Zyklenfehler "Der RGS übermittelt an den Airbag, dass die maximal Anzahl an Straffzyklen für NGU erreicht ist";
CM_ SG_ 539 RGS_HR_Max_P2P_Zyklenfehler "Der RGS übermittelt an den Airbag, dass die maximale Anzahl Straffzyklen für Push2Pass erreicht ist.";
CM_ SG_ 539 RGS_HR_Max_Straffzyklenfehler "RGS hinten rechts übermittelt einen Fehler an den Safety Computer wenn die maximalen Straffzyklen erreicht sind.";
CM_ SG_ 539 RGS_HR_Motorfehler "RGS hinten rechts übermittelt einen Motorfehler an den Safety Computer.";
CM_ SG_ 539 RGS_HR_nicht_programmiert "RGS HR übermittelt einen Fehler an den Safety Computer wenn keine Straffkurven programmiert sind";
CM_ SG_ 539 RGS_HR_Status "Rückantwort von RGS HR, welche Aktion durchgeführt wird";
CM_ SG_ 539 RGS_HR_Strom "RGS hinten rechts übermittelt Stromwert an den Safety Computer.";
CM_ SG_ 539 RGS_HR_Temp "RGS hinten rechts übermittelt Temperatur an den Safety Computer.";
CM_ SG_ 539 RGS_HR_Ueberspannung "RGS hinten rechts übermittelt Ueberspannungsfehler an den Safety Computer.";
CM_ SG_ 539 RGS_HR_Uebertemperatur_defekt "RGS hinten rechts übermittelt an den Safety Computer, dass RGS aufgrund eines Temperaturfehlers defekt ist.";
CM_ SG_ 539 RGS_HR_Unterspannung "RGS hinten rechts übermittelt Unterspannungsfehler an den Safety Computer.";

CM_ SG_ 984 RGS_VL_Bauteilfehler "RGS VL übermittelt einen Bauteilfehler an den Safety Computer.";
CM_ SG_ 984 RGS_VL_Crashabschaltung "RGS VL übermittelt an den Safety Computer, dass RGS aufgrund eines Crashevents den Straffvorgang abgebrochen hat.";
CM_ SG_ 984 RGS_VL_EEPROM_RAM_ROM_Fehler "RGS vorne links übermittelt einen EEPROM_RAM_ROOM_Fehler an den Safety Computer.";
CM_ SG_ 984 RGS_VL_Gurtbandauszug "Länge des Gurtbandauszugs
";
CM_ SG_ 984 RGS_VL_Gurtgeschwindigkeit "positive Werte: Gurtbandauszug
negative Werte: Gurtbandeinlauf";
CM_ SG_ 984 RGS_VL_InPos "Der RGS setzt dieses Signal wenn der Insasse nach Fahrtbeginn an einen 'normale' Position ruhig sitzt (keine Gurtlose mehr vorhanden)";
CM_ SG_ 984 RGS_VL_keineStraffungUeberspg "RGS hinten links übermittelt an den Safety Computer, dass keine Straffung aufgrund Ueberspannung möglich ist.";
CM_ SG_ 984 RGS_VL_keineStraffungUnterspg "RGS VL übermittelt an den Safety Computer, dass keine Straffung aufgrund Unterspannung möglich ist.";
CM_ SG_ 984 RGS_VL_Max_Gurtlosezyklen "RGS VL übermittelt einen Fehler an den Safety Computer wenn die maximalen Straffzyklen erreicht sind.";
CM_ SG_ 984 RGS_VL_Max_Haptikzyklenfehler "Der RGS übermittelt an den Airbag dass die maximale Strazyklen für Haptik erreicht ist";
CM_ SG_ 984 RGS_VL_Max_NGU_Zyklenfehler "Der RGS übermittelt an den Airbag, dass die maximal Anzahl an Straffzyklen für NGU erreicht ist";
CM_ SG_ 984 RGS_VL_Max_P2P_Zyklenfehler "Der RGS übermittelt an den Airbag, dass die maximale Anzahl Straffzyklen für Push2Pass erreicht ist.";
CM_ SG_ 984 RGS_VL_Max_Straffzyklenfehler "RGS VL übermittelt einen Fehler an den Safety Computer wenn die maximalen Straffzyklen erreicht sind.";
CM_ SG_ 984 RGS_VL_Motorfehler "RGS VL übermittelt einen Motorfehler an den Safety Computer.";
CM_ SG_ 984 RGS_VL_nicht_programmiert "RGS VL übermittelt einen Fehler an den Safety Computer wenn keine Straffkurven programmiert sind";
CM_ SG_ 984 RGS_VL_Status "Rückantwort von RGS VL, welche Aktion durchgeführt wird";
CM_ SG_ 984 RGS_VL_Strom "RGS VL übermittelt Stromwert an den Safety Computer.";
CM_ SG_ 984 RGS_VL_Temp "RGS VL übermittelt Temperatur an den Safety Computer.";
CM_ SG_ 984 RGS_VL_Ueberspannung "RGS hinten links übermittelt Ueberspannungsfehler an den Safety Computer.";
CM_ SG_ 984 RGS_VL_Uebertemperatur_defekt "RGS VL übermittelt an den Safety Computer, dass RGS aufgrund eines Temperaturfehlers defekt ist.";
CM_ SG_ 984 RGS_VL_Unterspannung "RGS VL übermittelt Unterspannungsfehler an den Safety Computer.";

CM_ SG_ 985 RGS_VR_Bauteilfehler "RGS VR übermittelt einen Bauteilfehler an den Safety Computer.";
CM_ SG_ 985 RGS_VR_Crashabschaltung "RGS VR übermittelt an den Safety Computer, dass RGS aufgrund eines Crashevents den Straffvorgang abgebrochen hat.";
CM_ SG_ 985 RGS_VR_EEPROM_RAM_ROM_Fehler "RGS vorne rechts übermittelt einen EEPROM_RAM_ROOM_Fehler an den Safety Computer";
CM_ SG_ 985 RGS_VR_Gurtbandauszug "Länge des Gurtbandauszugs
";
CM_ SG_ 985 RGS_VR_Gurtgeschwindigkeit "positive Werte: Gurtbandauszug
negative Werte: Gurtbandeinlauf";
CM_ SG_ 985 RGS_VR_InPos "Der RGS setzt dieses Signal wenn der Insasse nach Fahrtbeginn an einen 'normale' Position ruhig sitzt (keine Gurtlose mehr vorhanden)";
CM_ SG_ 985 RGS_VR_keineStraffungUeberspg "RGS hinten rechts übermittelt an den Safety Computer, dass keine Straffung aufgrund Ueberspannung möglich ist.";
CM_ SG_ 985 RGS_VR_keineStraffungUnterspg "RGS VR übermittelt an den Safety Computer, dass keine Straffung aufgrund Unterspannung möglich ist.";
CM_ SG_ 985 RGS_VR_Max_Gurtlosezyklen "RGS VR übermittelt einen Fehler an den Safety Computer wenn die maximalen Straffzyklen erreicht sind.";
CM_ SG_ 985 RGS_VR_Max_Haptikzyklenfehler "Der RGS übermittelt an den Airbag dass die maximale Strazyklen für Haptik erreicht ist";
CM_ SG_ 985 RGS_VR_Max_NGU_Zyklenfehler "Der RGS übermittelt an den Airbag, dass die maximal Anzahl an Straffzyklen für NGU erreicht ist";
CM_ SG_ 985 RGS_VR_Max_P2P_Zyklenfehler "Der RGS übermittelt an den Airbag, dass die maximale Anzahl Straffzyklen für Push2Pass erreicht ist.";
CM_ SG_ 985 RGS_VR_Max_Straffzyklenfehler "RGS VR übermittelt einen Fehler an den Safety Computer wenn die maximalen Straffzyklen erreicht sind.";
CM_ SG_ 985 RGS_VR_Motorfehler "RGS VR übermittelt einen Motorfehler an den Safety Computer.";
CM_ SG_ 985 RGS_VR_nicht_programmiert "RGS VR übermittelt einen Fehler an den Safety Computer wenn keine Straffkurven programmiert sind";
CM_ SG_ 985 RGS_VR_Status "Rückantwort von RGS VR, welche Aktion durchgeführt wird";
CM_ SG_ 985 RGS_VR_Strom "RGS VR übermittelt Stromwert an den Safety Computer.";
CM_ SG_ 985 RGS_VR_Temp "RGS VR übermittelt Temperatur an den Safety Computer.";
CM_ SG_ 985 RGS_VR_Ueberspannung "RGS hinten rechts übermittelt Ueberspannungsfehler an den Safety Computer.";
CM_ SG_ 985 RGS_VR_Uebertemperatur_defekt "RGS VR übermittelt an den Safety Computer, dass RGS aufgrund eines Temperaturfehlers defekt ist.";
CM_ SG_ 985 RGS_VR_Unterspannung "RGS VR übermittelt Unterspannungsfehler an den Safety Computer.";
BA_DEF_REL_ BU_SG_REL_  "GenSigTimeoutTime" INT 0 65535;
BA_DEF_ BO_  "DiagRequest" ENUM "No", "Yes";
BA_DEF_ BO_  "DiagResponse" ENUM "No", "Yes";
BA_DEF_ BO_  "DiagState" ENUM "No", "Yes";
BA_DEF_ BO_  "GenMsgChkConstant" HEX 0 4095;
BA_DEF_ BO_  "GenMsgCycleTime" INT 0 65535;
BA_DEF_ BO_  "GenMsgCycleTimeFast" INT 0 65535;
BA_DEF_ BO_  "GenMsgDelayTime" INT 0 100000;
BA_DEF_ BO_  "GenMsgILSupport" ENUM "No", "Yes";
BA_DEF_ BO_  "GenMsgNrOfRepetition" INT 0 100;
BA_DEF_ BO_  "GenMsgPDUConstants" STRING;
BA_DEF_ BO_  "GenMsgSendType" ENUM "Cyclic", "not_used", "not_used", "not_used", "not_used", "not_used", "not_used", "IfActive", "NoMsgSendType";
BA_DEF_ BO_  "GenMsgStartDelayTime" INT 0 100000;
BA_DEF_ BO_  "NmMessage" ENUM "No", "Yes";
BA_DEF_ BO_  "NmhMessage" ENUM "No", "Yes";
BA_DEF_ BO_  "MsgType" ENUM "Application", "NM ", "NMH", "TP2.0", "ISO-TP ", "BAP", "EID", "KS", "XCP_PRE_CONFIGURED", "XCP_RUNTIME_CONFIGURED";
BA_DEF_ BO_  "VAGTP20_API" HEX 0 255;
BA_DEF_ BO_  "VAGTP20_DynConnection" ENUM "No", "Yes";
BA_DEF_ BO_  "VAGTP20_DynSetup" ENUM "No", "Yes";
BA_DEF_ BO_  "VAGTP20_StatConnection" ENUM "No", "Yes";
BA_DEF_ BO_  "CANFD_BRS" ENUM "0", "1";
BA_DEF_ BO_  "VFrameFormat" ENUM "StandardCAN", "ExtendedCAN", "reserved", "reserved", "reserved", "reserved", "reserved", "reserved", "reserved", "reserved", "reserved", "reserved", "reserved", "reserved", "StandardCAN_FD", "ExtendedCAN_FD";
BA_DEF_ SG_  "GenSigActiveRepetitions" INT -2147483648 2147483647;
BA_DEF_ SG_  "GenSigInactiveValue" INT -2147483648 2147483647;
BA_DEF_ SG_  "GenSigSendType" ENUM "Cyclic", "OnWrite", "OnWriteWithRepetition", "OnChange", "OnChangeWithRepetition", "IfActive", "IfActiveWithRepetition", "NoSigSendType", "OnChangeAndIfActive", "OnChangeAndIfActiveWithRepetition";
BA_DEF_ SG_  "GenSigStartValue" INT -2147483648 2147483647;
BA_DEF_ SG_  "NWM-WakeupAllowed" ENUM "No", "Yes";
BA_DEF_ SG_  "GenSigFuncType" ENUM "NoFunction", "MsgCounter", "CRC-8", "XOR", "XOR-2", "DatedBit", "SW-Kl15", "CHK", "Constant", "Protocol", "CRC-8-SAE_J1850", "CRC-32", "DataLength", "DataID", "MsgCounter16", "SOK-Signatur", "Cluster";
BA_DEF_ SG_  "GenSigSwitchedByIgnition" ENUM "No", "Yes";
BA_DEF_ SG_  "Fehlerwert" HEX 0 2147483647;
BA_DEF_ SG_  "GenSigMissingSourceValue" HEX 0 2147483647;
BA_DEF_DEF_REL_  "GenSigTimeoutTime" 0;
BA_DEF_DEF_  "DiagRequest" "No";
BA_DEF_DEF_  "DiagResponse" "No";
BA_DEF_DEF_  "DiagState" "No";
BA_DEF_DEF_  "GenMsgChkConstant" 0;
BA_DEF_DEF_  "GenMsgCycleTime" 0;
BA_DEF_DEF_  "GenMsgCycleTimeFast" 0;
BA_DEF_DEF_  "GenMsgDelayTime" 0;
BA_DEF_DEF_  "GenMsgILSupport" "No";
BA_DEF_DEF_  "GenMsgNrOfRepetition" 0;
BA_DEF_DEF_  "GenMsgPDUConstants" "";
BA_DEF_DEF_  "GenMsgSendType" "NoMsgSendType";
BA_DEF_DEF_  "GenMsgStartDelayTime" 0;
BA_DEF_DEF_  "NmMessage" "No";
BA_DEF_DEF_  "NmhMessage" "No";
BA_DEF_DEF_  "MsgType" "Application";
BA_DEF_DEF_  "VAGTP20_API" 0;
BA_DEF_DEF_  "VAGTP20_DynConnection" "No";
BA_DEF_DEF_  "VAGTP20_DynSetup" "No";
BA_DEF_DEF_  "VAGTP20_StatConnection" "No";
BA_DEF_DEF_  "CANFD_BRS" "1";
BA_DEF_DEF_  "VFrameFormat" "StandardCAN";
BA_DEF_DEF_  "GenSigActiveRepetitions" 0;
BA_DEF_DEF_  "GenSigInactiveValue" 0;
BA_DEF_DEF_  "GenSigSendType" "NoSigSendType";
BA_DEF_DEF_  "GenSigStartValue" 0;
BA_DEF_DEF_  "NWM-WakeupAllowed" "No";
BA_DEF_DEF_  "GenSigFuncType" "NoFunction";
BA_DEF_DEF_  "GenSigSwitchedByIgnition" "Yes";
BA_DEF_DEF_  "Fehlerwert" 0;
BA_DEF_DEF_  "GenSigMissingSourceValue" 0;
BA_ "GenMsgCycleTime" BO_ 2600468501 200;
BA_ "GenMsgCycleTimeFast" BO_ 2600468501 20;
BA_ "GenMsgDelayTime" BO_ 2600468501 10;
BA_ "GenMsgNrOfRepetition" BO_ 2600468501 3;
BA_ "GenMsgSendType" BO_ 2600468501 7;
BA_ "NmhMessage" BO_ 2600468501 1;
BA_ "MsgType" BO_ 2600468501 2;
BA_ "CANFD_BRS" BO_ 2600468501 0;
BA_ "VFrameFormat" BO_ 2600468501 15;
BA_ "GenMsgCycleTime" BO_ 2600468729 200;
BA_ "GenMsgCycleTimeFast" BO_ 2600468729 20;
BA_ "GenMsgDelayTime" BO_ 2600468729 10;
BA_ "GenMsgNrOfRepetition" BO_ 2600468729 3;
BA_ "GenMsgSendType" BO_ 2600468729 7;
BA_ "NmhMessage" BO_ 2600468729 1;
BA_ "MsgType" BO_ 2600468729 2;
BA_ "CANFD_BRS" BO_ 2600468729 0;
BA_ "VFrameFormat" BO_ 2600468729 15;
BA_ "GenMsgCycleTime" BO_ 2600468730 200;
BA_ "GenMsgCycleTimeFast" BO_ 2600468730 20;
BA_ "GenMsgDelayTime" BO_ 2600468730 10;
BA_ "GenMsgNrOfRepetition" BO_ 2600468730 3;
BA_ "GenMsgSendType" BO_ 2600468730 7;
BA_ "NmhMessage" BO_ 2600468730 1;
BA_ "MsgType" BO_ 2600468730 2;
BA_ "CANFD_BRS" BO_ 2600468730 0;
BA_ "VFrameFormat" BO_ 2600468730 15;
BA_ "GenMsgCycleTime" BO_ 2600468574 200;
BA_ "GenMsgCycleTimeFast" BO_ 2600468574 20;
BA_ "GenMsgDelayTime" BO_ 2600468574 10;
BA_ "GenMsgNrOfRepetition" BO_ 2600468574 3;
BA_ "GenMsgSendType" BO_ 2600468574 7;
BA_ "NmhMessage" BO_ 2600468574 1;
BA_ "MsgType" BO_ 2600468574 2;
BA_ "CANFD_BRS" BO_ 2600468574 0;
BA_ "VFrameFormat" BO_ 2600468574 15;
BA_ "GenMsgCycleTime" BO_ 2600468575 200;
BA_ "GenMsgCycleTimeFast" BO_ 2600468575 20;
BA_ "GenMsgDelayTime" BO_ 2600468575 10;
BA_ "GenMsgNrOfRepetition" BO_ 2600468575 3;
BA_ "GenMsgSendType" BO_ 2600468575 7;
BA_ "NmhMessage" BO_ 2600468575 1;
BA_ "MsgType" BO_ 2600468575 2;
BA_ "CANFD_BRS" BO_ 2600468575 0;
BA_ "VFrameFormat" BO_ 2600468575 15;
BA_ "GenMsgCycleTime" BO_ 567 100;
BA_ "GenMsgILSupport" BO_ 567 1;
BA_ "GenMsgPDUConstants" BO_ 567 "0xd4,0x37,0x91,0x7d,0x5f,0xf3,0xbc,0xa9,0xd2,0x18,0x96,0x46,0xf8,0x6d,0xf5,0x4d";
BA_ "GenMsgSendType" BO_ 567 0;
BA_ "CANFD_BRS" BO_ 567 0;
BA_ "VFrameFormat" BO_ 567 14;
BA_ "DiagRequest" BO_ 2621469190 1;
BA_ "MsgType" BO_ 2621469190 4;
BA_ "CANFD_BRS" BO_ 2621469190 0;
BA_ "VFrameFormat" BO_ 2621469190 15;
BA_ "DiagResponse" BO_ 2621600262 1;
BA_ "MsgType" BO_ 2621600262 4;
BA_ "CANFD_BRS" BO_ 2621600262 0;
BA_ "VFrameFormat" BO_ 2621600262 15;
BA_ "DiagRequest" BO_ 2549903646 1;
BA_ "MsgType" BO_ 2549903646 4;
BA_ "CANFD_BRS" BO_ 2549903646 0;
BA_ "VFrameFormat" BO_ 2549903646 15;
BA_ "DiagResponse" BO_ 2550034718 1;
BA_ "MsgType" BO_ 2550034718 4;
BA_ "CANFD_BRS" BO_ 2550034718 0;
BA_ "VFrameFormat" BO_ 2550034718 15;
BA_ "DiagRequest" BO_ 2549903647 1;
BA_ "MsgType" BO_ 2549903647 4;
BA_ "CANFD_BRS" BO_ 2549903647 0;
BA_ "VFrameFormat" BO_ 2549903647 15;
BA_ "DiagResponse" BO_ 2550034719 1;
BA_ "MsgType" BO_ 2550034719 4;
BA_ "CANFD_BRS" BO_ 2550034719 0;
BA_ "VFrameFormat" BO_ 2550034719 15;
BA_ "DiagRequest" BO_ 2549903402 1;
BA_ "MsgType" BO_ 2549903402 4;
BA_ "CANFD_BRS" BO_ 2549903402 0;
BA_ "VFrameFormat" BO_ 2549903402 15;
BA_ "DiagResponse" BO_ 2550034474 1;
BA_ "MsgType" BO_ 2550034474 4;
BA_ "CANFD_BRS" BO_ 2550034474 0;
BA_ "VFrameFormat" BO_ 2550034474 15;
BA_ "DiagRequest" BO_ 2549903403 1;
BA_ "MsgType" BO_ 2549903403 4;
BA_ "CANFD_BRS" BO_ 2549903403 0;
BA_ "VFrameFormat" BO_ 2549903403 15;
BA_ "DiagResponse" BO_ 2550034475 1;
BA_ "MsgType" BO_ 2550034475 4;
BA_ "CANFD_BRS" BO_ 2550034475 0;
BA_ "VFrameFormat" BO_ 2550034475 15;
BA_ "GenMsgCycleTime" BO_ 2589283656 500;
BA_ "GenMsgDelayTime" BO_ 2589283656 100;
BA_ "GenMsgILSupport" BO_ 2589283656 1;
BA_ "GenMsgSendType" BO_ 2589283656 0;
BA_ "CANFD_BRS" BO_ 2589283656 0;
BA_ "VFrameFormat" BO_ 2589283656 15;
BA_ "GenMsgCycleTime" BO_ 2527679787 1000;
BA_ "GenMsgDelayTime" BO_ 2527679787 50;
BA_ "GenMsgILSupport" BO_ 2527679787 1;
BA_ "GenMsgSendType" BO_ 2527679787 0;
BA_ "CANFD_BRS" BO_ 2527679787 0;
BA_ "VFrameFormat" BO_ 2527679787 15;
BA_ "GenMsgCycleTime" BO_ 2463978781 500;
BA_ "GenMsgCycleTimeFast" BO_ 2463978781 10;
BA_ "GenMsgDelayTime" BO_ 2463978781 10;
BA_ "GenMsgILSupport" BO_ 2463978781 1;
BA_ "GenMsgNrOfRepetition" BO_ 2463978781 5;
BA_ "GenMsgSendType" BO_ 2463978781 0;
BA_ "CANFD_BRS" BO_ 2463978781 0;
BA_ "VFrameFormat" BO_ 2463978781 15;
BA_ "GenMsgCycleTime" BO_ 535 500;
BA_ "GenMsgCycleTimeFast" BO_ 535 10;
BA_ "GenMsgDelayTime" BO_ 535 10;
BA_ "GenMsgILSupport" BO_ 535 1;
BA_ "GenMsgSendType" BO_ 535 0;
BA_ "CANFD_BRS" BO_ 535 0;
BA_ "VFrameFormat" BO_ 535 14;
BA_ "GenMsgCycleTime" BO_ 539 500;
BA_ "GenMsgCycleTimeFast" BO_ 539 10;
BA_ "GenMsgDelayTime" BO_ 539 10;
BA_ "GenMsgILSupport" BO_ 539 1;
BA_ "GenMsgSendType" BO_ 539 0;
BA_ "CANFD_BRS" BO_ 539 0;
BA_ "VFrameFormat" BO_ 539 14;
BA_ "GenMsgCycleTime" BO_ 984 500;
BA_ "GenMsgCycleTimeFast" BO_ 984 10;
BA_ "GenMsgDelayTime" BO_ 984 10;
BA_ "GenMsgILSupport" BO_ 984 1;
BA_ "GenMsgSendType" BO_ 984 0;
BA_ "CANFD_BRS" BO_ 984 0;
BA_ "VFrameFormat" BO_ 984 14;
BA_ "GenMsgCycleTime" BO_ 985 500;
BA_ "GenMsgCycleTimeFast" BO_ 985 10;
BA_ "GenMsgDelayTime" BO_ 985 10;
BA_ "GenMsgILSupport" BO_ 985 1;
BA_ "GenMsgSendType" BO_ 985 0;
BA_ "CANFD_BRS" BO_ 985 0;
BA_ "VFrameFormat" BO_ 985 14;
BA_ "GenSigSwitchedByIgnition" SG_ 2600468501 NM_Airbag_01_CBV_AWB 0;
BA_ "GenSigSwitchedByIgnition" SG_ 2600468501 NM_Airbag_01_CBV_CRI 0;
BA_ "GenSigSendType" SG_ 2600468501 NM_Airbag_01_FCAB 4;
BA_ "GenSigFuncType" SG_ 2600468501 NM_Airbag_01_FCAB 16;
BA_ "GenSigSwitchedByIgnition" SG_ 2600468501 NM_Airbag_01_FCAB 0;
BA_ "GenSigSwitchedByIgnition" SG_ 2600468501 NM_Airbag_01_NM_aktiv_Diag 0;
BA_ "GenSigSwitchedByIgnition" SG_ 2600468501 NM_Airbag_01_NM_aktiv_KL15 0;
BA_ "GenSigSwitchedByIgnition" SG_ 2600468501 NM_Airbag_01_NM_aktiv_Tmin 0;
BA_ "GenSigSwitchedByIgnition" SG_ 2600468501 NM_Airbag_01_NM_State 0;
BA_ "GenSigStartValue" SG_ 2600468501 NM_Airbag_01_SNI_10 21;
BA_ "GenSigSwitchedByIgnition" SG_ 2600468501 NM_Airbag_01_SNI_10 0;
BA_ "GenSigSwitchedByIgnition" SG_ 2600468501 NM_Airbag_01_UDS_CC 0;
BA_ "NWM-WakeupAllowed" SG_ 2600468501 NM_Airbag_01_Wakeup 1;
BA_ "GenSigSwitchedByIgnition" SG_ 2600468501 NM_Airbag_01_Wakeup 0;
BA_ "GenSigSwitchedByIgnition" SG_ 2600468501 NM_aktiv_AntriebsCAN_aktiv 0;
BA_ "GenSigSwitchedByIgnition" SG_ 2600468501 NM_aktiv_Ausloesefaehig 0;
BA_ "GenSigSwitchedByIgnition" SG_ 2600468501 NM_aktiv_Gurtparken 0;
BA_ "GenSigSwitchedByIgnition" SG_ 2600468501 NM_aktiv_Gurtschloss 0;
BA_ "GenSigSwitchedByIgnition" SG_ 2600468501 NM_aktiv_Kl15_unplausibel 0;
BA_ "GenSigSwitchedByIgnition" SG_ 2600468501 NM_aktiv_Sitzbelegung 0;
BA_ "GenSigSwitchedByIgnition" SG_ 2600468729 NM_RGS_HL_CBV_AWB 0;
BA_ "GenSigStartValue" SG_ 2600468729 NM_RGS_HL_CBV_CRI 1;
BA_ "GenSigSwitchedByIgnition" SG_ 2600468729 NM_RGS_HL_CBV_CRI 0;
BA_ "GenSigSendType" SG_ 2600468729 NM_RGS_HL_FCAB 4;
BA_ "GenSigFuncType" SG_ 2600468729 NM_RGS_HL_FCAB 16;
BA_ "GenSigSwitchedByIgnition" SG_ 2600468729 NM_RGS_HL_FCAB 0;
BA_ "GenSigSwitchedByIgnition" SG_ 2600468729 NM_RGS_HL_NM_aktiv_Diag 0;
BA_ "GenSigSwitchedByIgnition" SG_ 2600468729 NM_RGS_HL_NM_aktiv_KL15 0;
BA_ "GenSigSwitchedByIgnition" SG_ 2600468729 NM_RGS_HL_NM_aktiv_Tmin 0;
BA_ "GenSigSwitchedByIgnition" SG_ 2600468729 NM_RGS_HL_NM_State 0;
BA_ "GenSigStartValue" SG_ 2600468729 NM_RGS_HL_SNI_10 249;
BA_ "GenSigSwitchedByIgnition" SG_ 2600468729 NM_RGS_HL_SNI_10 0;
BA_ "GenSigSwitchedByIgnition" SG_ 2600468729 NM_RGS_HL_UDS_CC 0;
BA_ "GenSigSwitchedByIgnition" SG_ 2600468729 NM_RGS_HL_Wakeup_V12 0;
BA_ "GenSigSwitchedByIgnition" SG_ 2600468730 NM_RGS_HR_CBV_AWB 0;
BA_ "GenSigSwitchedByIgnition" SG_ 2600468730 NM_RGS_HR_CBV_CRI 0;
BA_ "GenSigSendType" SG_ 2600468730 NM_RGS_HR_FCAB 4;
BA_ "GenSigFuncType" SG_ 2600468730 NM_RGS_HR_FCAB 16;
BA_ "GenSigSwitchedByIgnition" SG_ 2600468730 NM_RGS_HR_FCAB 0;
BA_ "GenSigSwitchedByIgnition" SG_ 2600468730 NM_RGS_HR_NM_aktiv_Diag 0;
BA_ "GenSigSwitchedByIgnition" SG_ 2600468730 NM_RGS_HR_NM_aktiv_KL15 0;
BA_ "GenSigSwitchedByIgnition" SG_ 2600468730 NM_RGS_HR_NM_aktiv_Tmin 0;
BA_ "GenSigSwitchedByIgnition" SG_ 2600468730 NM_RGS_HR_NM_State 0;
BA_ "GenSigSwitchedByIgnition" SG_ 2600468730 NM_RGS_HR_SNI_10 0;
BA_ "GenSigSwitchedByIgnition" SG_ 2600468730 NM_RGS_HR_UDS_CC 0;
BA_ "GenSigSwitchedByIgnition" SG_ 2600468730 NM_RGS_HR_Wakeup_V12 0;
BA_ "GenSigSwitchedByIgnition" SG_ 2600468574 NM_RGS_VL_CBV_AWB 0;
BA_ "GenSigStartValue" SG_ 2600468574 NM_RGS_VL_CBV_CRI 1;
BA_ "GenSigSwitchedByIgnition" SG_ 2600468574 NM_RGS_VL_CBV_CRI 0;
BA_ "GenSigSendType" SG_ 2600468574 NM_RGS_VL_FCAB 4;
BA_ "GenSigFuncType" SG_ 2600468574 NM_RGS_VL_FCAB 16;
BA_ "GenSigSwitchedByIgnition" SG_ 2600468574 NM_RGS_VL_FCAB 0;
BA_ "GenSigSwitchedByIgnition" SG_ 2600468574 NM_RGS_VL_NM_aktiv_Diag 0;
BA_ "GenSigSwitchedByIgnition" SG_ 2600468574 NM_RGS_VL_NM_aktiv_KL15 0;
BA_ "GenSigSwitchedByIgnition" SG_ 2600468574 NM_RGS_VL_NM_aktiv_Tmin 0;
BA_ "GenSigSwitchedByIgnition" SG_ 2600468574 NM_RGS_VL_NM_State 0;
BA_ "GenSigStartValue" SG_ 2600468574 NM_RGS_VL_SNI_10 94;
BA_ "GenSigSwitchedByIgnition" SG_ 2600468574 NM_RGS_VL_SNI_10 0;
BA_ "GenSigSwitchedByIgnition" SG_ 2600468574 NM_RGS_VL_UDS_CC 0;
BA_ "GenSigSwitchedByIgnition" SG_ 2600468574 NM_RGS_VL_Wakeup_V12 0;
BA_ "GenSigSwitchedByIgnition" SG_ 2600468575 NM_RGS_VR_CBV_AWB 0;
BA_ "GenSigStartValue" SG_ 2600468575 NM_RGS_VR_CBV_CRI 1;
BA_ "GenSigSwitchedByIgnition" SG_ 2600468575 NM_RGS_VR_CBV_CRI 0;
BA_ "GenSigSendType" SG_ 2600468575 NM_RGS_VR_FCAB 4;
BA_ "GenSigFuncType" SG_ 2600468575 NM_RGS_VR_FCAB 16;
BA_ "GenSigSwitchedByIgnition" SG_ 2600468575 NM_RGS_VR_FCAB 0;
BA_ "GenSigSwitchedByIgnition" SG_ 2600468575 NM_RGS_VR_NM_aktiv_Diag 0;
BA_ "GenSigSwitchedByIgnition" SG_ 2600468575 NM_RGS_VR_NM_aktiv_KL15 0;
BA_ "GenSigSwitchedByIgnition" SG_ 2600468575 NM_RGS_VR_NM_aktiv_Tmin 0;
BA_ "GenSigSwitchedByIgnition" SG_ 2600468575 NM_RGS_VR_NM_State 0;
BA_ "GenSigStartValue" SG_ 2600468575 NM_RGS_VR_SNI_10 95;
BA_ "GenSigSwitchedByIgnition" SG_ 2600468575 NM_RGS_VR_SNI_10 0;
BA_ "GenSigSwitchedByIgnition" SG_ 2600468575 NM_RGS_VR_UDS_CC 0;
BA_ "GenSigSwitchedByIgnition" SG_ 2600468575 NM_RGS_VR_Wakeup_V12 0;
BA_ "GenSigSendType" SG_ 567 BEM_Batt_Ab 0;
BA_ "GenSigSendType" SG_ 567 BEM_Generatordiagnose 0;
BA_ "GenSigSendType" SG_ 567 BEM_HL_Regelung_Status 0;
BA_ "GenSigSendType" SG_ 567 BEM_Red_Innengeblaese 0;
BA_ "GenSigSendType" SG_ 567 BEM_STH_Einschaltverbot 0;
BA_ "GenSigSendType" SG_ 567 BEM_STH_Zielzeit 0;
BA_ "GenSigStartValue" SG_ 567 BEM_STH_Zielzeit 14;
BA_ "Fehlerwert" SG_ 567 BEM_STH_Zielzeit 15;
BA_ "GenSigSendType" SG_ 567 NVEM3_Absch_SCR 0;
BA_ "GenSigSendType" SG_ 567 NVEM_12_BZ 0;
BA_ "GenSigFuncType" SG_ 567 NVEM_12_BZ 1;
BA_ "GenSigSendType" SG_ 567 NVEM_12_CRC 0;
BA_ "GenSigFuncType" SG_ 567 NVEM_12_CRC 2;
BA_ "GenSigSendType" SG_ 567 NVEM_Abschaltstufe 0;
BA_ "GenSigSwitchedByIgnition" SG_ 567 NVEM_Abschaltstufe 0;
BA_ "GenSigSendType" SG_ 567 NVEM_Bordnetz_Information 0;
BA_ "GenSigStartValue" SG_ 567 NVEM_Bordnetz_Information 14;
BA_ "Fehlerwert" SG_ 567 NVEM_Bordnetz_Information 15;
BA_ "GenSigSendType" SG_ 567 NVEM_Bordnetzdiagnose 0;
BA_ "GenSigSendType" SG_ 567 NVEM_DC_iSoll_NV 0;
BA_ "GenSigStartValue" SG_ 567 NVEM_DC_iSoll_NV 254;
BA_ "Fehlerwert" SG_ 567 NVEM_DC_iSoll_NV 255;
BA_ "GenSigSendType" SG_ 567 NVEM_DC_uMin_NV 0;
BA_ "GenSigStartValue" SG_ 567 NVEM_DC_uMin_NV 122;
BA_ "GenSigSendType" SG_ 567 NVEM_DC_uSoll_NV 0;
BA_ "GenSigStartValue" SG_ 567 NVEM_DC_uSoll_NV 116;
BA_ "Fehlerwert" SG_ 567 NVEM_DC_uSoll_NV 255;
BA_ "GenSigSendType" SG_ 567 NVEM_Freigabe_OTA 0;
BA_ "GenSigSendType" SG_ 567 NVEM_Last_Anf 0;
BA_ "GenSigSendType" SG_ 567 NVEM_MV_DC_iSoll_NV 0;
BA_ "GenSigStartValue" SG_ 567 NVEM_MV_DC_iSoll_NV 254;
BA_ "Fehlerwert" SG_ 567 NVEM_MV_DC_iSoll_NV 255;
BA_ "GenSigSendType" SG_ 567 NVEM_MV_DC_uMinLV 0;
BA_ "GenSigStartValue" SG_ 567 NVEM_MV_DC_uMinLV 126;
BA_ "Fehlerwert" SG_ 567 NVEM_MV_DC_uMinLV 127;
BA_ "GenSigSendType" SG_ 567 NVEM_MV_DC_uSollLV 0;
BA_ "GenSigStartValue" SG_ 567 NVEM_MV_DC_uSollLV 126;
BA_ "Fehlerwert" SG_ 567 NVEM_MV_DC_uSollLV 127;
BA_ "GenSigSendType" SG_ 567 NVEM_NV_BAT_ZellStatus_Index_Anf 0;
BA_ "GenSigSendType" SG_ 567 NVEM_NV_BAT_ZellStatus_Typ_Anf 0;
BA_ "GenSigSendType" SG_ 567 NVEM_Verbraucher_Information 0;
BA_ "GenSigStartValue" SG_ 567 NVEM_Verbraucher_Information 6;
BA_ "Fehlerwert" SG_ 567 NVEM_Verbraucher_Information 7;
BA_ "GenSigSendType" SG_ 2621469190 OBDC_SSN_eCS_Req_FD_Data 3;
BA_ "GenSigFuncType" SG_ 2621469190 OBDC_SSN_eCS_Req_FD_Data 9;
BA_ "GenSigSwitchedByIgnition" SG_ 2621469190 OBDC_SSN_eCS_Req_FD_Data 0;
BA_ "GenSigSendType" SG_ 2621600262 OBDC_SSN_eCS_Resp_FD_Data 3;
BA_ "GenSigFuncType" SG_ 2621600262 OBDC_SSN_eCS_Resp_FD_Data 9;
BA_ "GenSigSwitchedByIgnition" SG_ 2621600262 OBDC_SSN_eCS_Resp_FD_Data 0;
BA_ "GenSigSendType" SG_ 2549903646 OBDC_SSN_RGS_HL_Req_Data 3;
BA_ "GenSigFuncType" SG_ 2549903646 OBDC_SSN_RGS_HL_Req_Data 9;
BA_ "GenSigSwitchedByIgnition" SG_ 2549903646 OBDC_SSN_RGS_HL_Req_Data 0;
BA_ "GenSigSendType" SG_ 2550034718 OBDC_SSN_RGS_HL_Resp_Data 3;
BA_ "GenSigFuncType" SG_ 2550034718 OBDC_SSN_RGS_HL_Resp_Data 9;
BA_ "GenSigSwitchedByIgnition" SG_ 2550034718 OBDC_SSN_RGS_HL_Resp_Data 0;
BA_ "GenSigSendType" SG_ 2549903647 OBDC_SSN_RGS_HR_Req_Data 3;
BA_ "GenSigFuncType" SG_ 2549903647 OBDC_SSN_RGS_HR_Req_Data 9;
BA_ "GenSigSwitchedByIgnition" SG_ 2549903647 OBDC_SSN_RGS_HR_Req_Data 0;
BA_ "GenSigSendType" SG_ 2550034719 OBDC_SSN_RGS_HR_Resp_Data 3;
BA_ "GenSigFuncType" SG_ 2550034719 OBDC_SSN_RGS_HR_Resp_Data 9;
BA_ "GenSigSwitchedByIgnition" SG_ 2550034719 OBDC_SSN_RGS_HR_Resp_Data 0;
BA_ "GenSigSendType" SG_ 2549903402 OBDC_SSN_RGS_VL_Req_Data 3;
BA_ "GenSigFuncType" SG_ 2549903402 OBDC_SSN_RGS_VL_Req_Data 9;
BA_ "GenSigSwitchedByIgnition" SG_ 2549903402 OBDC_SSN_RGS_VL_Req_Data 0;
BA_ "GenSigSendType" SG_ 2550034474 OBDC_SSN_RGS_VL_Resp_Data 3;
BA_ "GenSigFuncType" SG_ 2550034474 OBDC_SSN_RGS_VL_Resp_Data 9;
BA_ "GenSigSwitchedByIgnition" SG_ 2550034474 OBDC_SSN_RGS_VL_Resp_Data 0;
BA_ "GenSigSendType" SG_ 2549903403 OBDC_SSN_RGS_VR_Req_Data 3;
BA_ "GenSigFuncType" SG_ 2549903403 OBDC_SSN_RGS_VR_Req_Data 9;
BA_ "GenSigSwitchedByIgnition" SG_ 2549903403 OBDC_SSN_RGS_VR_Req_Data 0;
BA_ "GenSigSendType" SG_ 2550034475 OBDC_SSN_RGS_VR_Resp_Data 3;
BA_ "GenSigFuncType" SG_ 2550034475 OBDC_SSN_RGS_VR_Resp_Data 9;
BA_ "GenSigSwitchedByIgnition" SG_ 2550034475 OBDC_SSN_RGS_VR_Resp_Data 0;
BA_ "GenSigSendType" SG_ 2589283656 ORU_Status 3;
BA_ "GenSigSwitchedByIgnition" SG_ 2589283656 ORU_Status 0;
BA_ "GenSigSendType" SG_ 2589283656 ORU_Warnung 3;
BA_ "GenSigSwitchedByIgnition" SG_ 2589283656 ORU_Warnung 0;
BA_ "GenSigSendType" SG_ 2527679787 RA_AM_Tuning 3;
BA_ "GenSigSwitchedByIgnition" SG_ 2527679787 RA_AM_Tuning 0;
BA_ "GenSigSendType" SG_ 2527679787 RA_Frequency 3;
BA_ "GenSigSwitchedByIgnition" SG_ 2527679787 RA_Frequency 0;
BA_ "GenSigSendType" SG_ 2527679787 RA_Frequency_unit 3;
BA_ "GenSigSwitchedByIgnition" SG_ 2527679787 RA_Frequency_unit 0;
BA_ "GenSigSendType" SG_ 2527679787 WLC1_Systemzustand 0;
BA_ "GenSigSendType" SG_ 2527679787 WLC2_Systemzustand 0;
BA_ "GenSigSendType" SG_ 2463978781 RGS_HL_Anforderung 4;
BA_ "GenSigStartValue" SG_ 2463978781 RGS_HL_Anforderung 31;
BA_ "GenSigSwitchedByIgnition" SG_ 2463978781 RGS_HL_Anforderung 0;
BA_ "GenSigSendType" SG_ 2463978781 RGS_HL_Nachlauf_2 0;
BA_ "GenSigSwitchedByIgnition" SG_ 2463978781 RGS_HL_Nachlauf_2 0;
BA_ "GenSigSendType" SG_ 2463978781 RGS_HR_Anforderung 4;
BA_ "GenSigStartValue" SG_ 2463978781 RGS_HR_Anforderung 31;
BA_ "GenSigSwitchedByIgnition" SG_ 2463978781 RGS_HR_Anforderung 0;
BA_ "GenSigSendType" SG_ 2463978781 RGS_HR_Nachlauf_2 0;
BA_ "GenSigSwitchedByIgnition" SG_ 2463978781 RGS_HR_Nachlauf_2 0;
BA_ "GenSigSendType" SG_ 2463978781 RGS_Loesen_erlaubt 4;
BA_ "GenSigSwitchedByIgnition" SG_ 2463978781 RGS_Loesen_erlaubt 0;
BA_ "GenSigSendType" SG_ 2463978781 RGS_Nachlauf_allg 0;
BA_ "GenSigSwitchedByIgnition" SG_ 2463978781 RGS_Nachlauf_allg 0;
BA_ "GenSigSendType" SG_ 2463978781 RGS_VL_Anforderung 4;
BA_ "GenSigStartValue" SG_ 2463978781 RGS_VL_Anforderung 31;
BA_ "GenSigSwitchedByIgnition" SG_ 2463978781 RGS_VL_Anforderung 0;
BA_ "GenSigSendType" SG_ 2463978781 RGS_VL_Nachlauf_2 0;
BA_ "GenSigSwitchedByIgnition" SG_ 2463978781 RGS_VL_Nachlauf_2 0;
BA_ "GenSigSendType" SG_ 2463978781 RGS_VR_Anforderung 4;
BA_ "GenSigStartValue" SG_ 2463978781 RGS_VR_Anforderung 31;
BA_ "GenSigSwitchedByIgnition" SG_ 2463978781 RGS_VR_Anforderung 0;
BA_ "GenSigSendType" SG_ 2463978781 RGS_VR_Nachlauf_2 0;
BA_ "GenSigSwitchedByIgnition" SG_ 2463978781 RGS_VR_Nachlauf_2 0;
BA_ "GenSigInactiveValue" SG_ 535 RGS_HL_Bauteilfehler 1;
BA_ "GenSigSendType" SG_ 535 RGS_HL_Bauteilfehler 5;
BA_ "GenSigStartValue" SG_ 535 RGS_HL_Bauteilfehler 1;
BA_ "GenSigInactiveValue" SG_ 535 RGS_HL_Crashabschaltung 1;
BA_ "GenSigSendType" SG_ 535 RGS_HL_Crashabschaltung 5;
BA_ "GenSigStartValue" SG_ 535 RGS_HL_Crashabschaltung 1;
BA_ "GenSigInactiveValue" SG_ 535 RGS_HL_EEPROM_RAM_ROM_Fehler 1;
BA_ "GenSigSendType" SG_ 535 RGS_HL_EEPROM_RAM_ROM_Fehler 5;
BA_ "GenSigStartValue" SG_ 535 RGS_HL_EEPROM_RAM_ROM_Fehler 1;
BA_ "GenSigSwitchedByIgnition" SG_ 535 RGS_HL_EEPROM_RAM_ROM_Fehler 0;
BA_ "GenSigSendType" SG_ 535 RGS_HL_Gurtbandauszug 3;
BA_ "GenSigStartValue" SG_ 535 RGS_HL_Gurtbandauszug 4094;
BA_ "Fehlerwert" SG_ 535 RGS_HL_Gurtbandauszug 4095;
BA_ "GenSigSendType" SG_ 535 RGS_HL_Gurtgeschwindigkeit 3;
BA_ "GenSigStartValue" SG_ 535 RGS_HL_Gurtgeschwindigkeit 511;
BA_ "Fehlerwert" SG_ 535 RGS_HL_Gurtgeschwindigkeit 1023;
BA_ "GenSigSendType" SG_ 535 RGS_HL_InPos 0;
BA_ "GenSigInactiveValue" SG_ 535 RGS_HL_keine_Straffung_Ueberspg 1;
BA_ "GenSigSendType" SG_ 535 RGS_HL_keine_Straffung_Ueberspg 5;
BA_ "GenSigStartValue" SG_ 535 RGS_HL_keine_Straffung_Ueberspg 1;
BA_ "GenSigInactiveValue" SG_ 535 RGS_HL_keine_Straffung_Unterspg 1;
BA_ "GenSigSendType" SG_ 535 RGS_HL_keine_Straffung_Unterspg 5;
BA_ "GenSigStartValue" SG_ 535 RGS_HL_keine_Straffung_Unterspg 1;
BA_ "GenSigInactiveValue" SG_ 535 RGS_HL_Max_Gurtlosezyklen 1;
BA_ "GenSigSendType" SG_ 535 RGS_HL_Max_Gurtlosezyklen 5;
BA_ "GenSigStartValue" SG_ 535 RGS_HL_Max_Gurtlosezyklen 1;
BA_ "GenSigSwitchedByIgnition" SG_ 535 RGS_HL_Max_Gurtlosezyklen 0;
BA_ "GenSigInactiveValue" SG_ 535 RGS_HL_Max_Haptikzyklenfehler 1;
BA_ "GenSigSendType" SG_ 535 RGS_HL_Max_Haptikzyklenfehler 5;
BA_ "GenSigStartValue" SG_ 535 RGS_HL_Max_Haptikzyklenfehler 1;
BA_ "GenSigSwitchedByIgnition" SG_ 535 RGS_HL_Max_Haptikzyklenfehler 0;
BA_ "GenSigInactiveValue" SG_ 535 RGS_HL_Max_NGU_Zyklenfehler 1;
BA_ "GenSigSendType" SG_ 535 RGS_HL_Max_NGU_Zyklenfehler 5;
BA_ "GenSigStartValue" SG_ 535 RGS_HL_Max_NGU_Zyklenfehler 1;
BA_ "GenSigInactiveValue" SG_ 535 RGS_HL_Max_P2P_Zyklenfehler 1;
BA_ "GenSigSendType" SG_ 535 RGS_HL_Max_P2P_Zyklenfehler 5;
BA_ "GenSigStartValue" SG_ 535 RGS_HL_Max_P2P_Zyklenfehler 1;
BA_ "GenSigSwitchedByIgnition" SG_ 535 RGS_HL_Max_P2P_Zyklenfehler 0;
BA_ "GenSigInactiveValue" SG_ 535 RGS_HL_Max_Straffzyklenfehler 1;
BA_ "GenSigSendType" SG_ 535 RGS_HL_Max_Straffzyklenfehler 5;
BA_ "GenSigStartValue" SG_ 535 RGS_HL_Max_Straffzyklenfehler 1;
BA_ "GenSigInactiveValue" SG_ 535 RGS_HL_Motorfehler 1;
BA_ "GenSigSendType" SG_ 535 RGS_HL_Motorfehler 5;
BA_ "GenSigStartValue" SG_ 535 RGS_HL_Motorfehler 1;
BA_ "GenSigInactiveValue" SG_ 535 RGS_HL_nicht_programmiert 1;
BA_ "GenSigSendType" SG_ 535 RGS_HL_nicht_programmiert 5;
BA_ "GenSigStartValue" SG_ 535 RGS_HL_nicht_programmiert 1;
BA_ "GenSigSendType" SG_ 535 RGS_HL_Status 5;
BA_ "GenSigStartValue" SG_ 535 RGS_HL_Status 31;
BA_ "GenSigSwitchedByIgnition" SG_ 535 RGS_HL_Status 0;
BA_ "GenSigSendType" SG_ 535 RGS_HL_Strom 5;
BA_ "GenSigStartValue" SG_ 535 RGS_HL_Strom 254;
BA_ "Fehlerwert" SG_ 535 RGS_HL_Strom 255;
BA_ "GenSigSendType" SG_ 535 RGS_HL_Temp 0;
BA_ "GenSigStartValue" SG_ 535 RGS_HL_Temp 254;
BA_ "Fehlerwert" SG_ 535 RGS_HL_Temp 255;
BA_ "GenSigInactiveValue" SG_ 535 RGS_HL_Ueberspannung 1;
BA_ "GenSigSendType" SG_ 535 RGS_HL_Ueberspannung 5;
BA_ "GenSigStartValue" SG_ 535 RGS_HL_Ueberspannung 1;
BA_ "GenSigInactiveValue" SG_ 535 RGS_HL_Uebertemperatur_defekt 1;
BA_ "GenSigSendType" SG_ 535 RGS_HL_Uebertemperatur_defekt 5;
BA_ "GenSigStartValue" SG_ 535 RGS_HL_Uebertemperatur_defekt 1;
BA_ "GenSigInactiveValue" SG_ 535 RGS_HL_Unterspannung 1;
BA_ "GenSigSendType" SG_ 535 RGS_HL_Unterspannung 5;
BA_ "GenSigStartValue" SG_ 535 RGS_HL_Unterspannung 1;
BA_ "GenSigInactiveValue" SG_ 539 RGS_HR_Bauteilfehler 1;
BA_ "GenSigSendType" SG_ 539 RGS_HR_Bauteilfehler 5;
BA_ "GenSigStartValue" SG_ 539 RGS_HR_Bauteilfehler 1;
BA_ "GenSigInactiveValue" SG_ 539 RGS_HR_Crashabschaltung 1;
BA_ "GenSigSendType" SG_ 539 RGS_HR_Crashabschaltung 5;
BA_ "GenSigStartValue" SG_ 539 RGS_HR_Crashabschaltung 1;
BA_ "GenSigInactiveValue" SG_ 539 RGS_HR_EEPROM_RAM_ROM_Fehler 1;
BA_ "GenSigSendType" SG_ 539 RGS_HR_EEPROM_RAM_ROM_Fehler 5;
BA_ "GenSigStartValue" SG_ 539 RGS_HR_EEPROM_RAM_ROM_Fehler 1;
BA_ "GenSigSwitchedByIgnition" SG_ 539 RGS_HR_EEPROM_RAM_ROM_Fehler 0;
BA_ "GenSigSendType" SG_ 539 RGS_HR_Gurtbandauszug 3;
BA_ "GenSigStartValue" SG_ 539 RGS_HR_Gurtbandauszug 4094;
BA_ "Fehlerwert" SG_ 539 RGS_HR_Gurtbandauszug 4095;
BA_ "GenSigSendType" SG_ 539 RGS_HR_Gurtgeschwindigkeit 3;
BA_ "GenSigStartValue" SG_ 539 RGS_HR_Gurtgeschwindigkeit 511;
BA_ "Fehlerwert" SG_ 539 RGS_HR_Gurtgeschwindigkeit 1023;
BA_ "GenSigSendType" SG_ 539 RGS_HR_InPos 0;
BA_ "GenSigInactiveValue" SG_ 539 RGS_HR_keine_Straffung_Ueberspg 1;
BA_ "GenSigSendType" SG_ 539 RGS_HR_keine_Straffung_Ueberspg 5;
BA_ "GenSigStartValue" SG_ 539 RGS_HR_keine_Straffung_Ueberspg 1;
BA_ "GenSigInactiveValue" SG_ 539 RGS_HR_keine_Straffung_Unterspg 1;
BA_ "GenSigSendType" SG_ 539 RGS_HR_keine_Straffung_Unterspg 5;
BA_ "GenSigStartValue" SG_ 539 RGS_HR_keine_Straffung_Unterspg 1;
BA_ "GenSigInactiveValue" SG_ 539 RGS_HR_Max_Gurtlosezyklen 1;
BA_ "GenSigSendType" SG_ 539 RGS_HR_Max_Gurtlosezyklen 5;
BA_ "GenSigStartValue" SG_ 539 RGS_HR_Max_Gurtlosezyklen 1;
BA_ "GenSigInactiveValue" SG_ 539 RGS_HR_Max_Haptikzyklenfehler 1;
BA_ "GenSigSendType" SG_ 539 RGS_HR_Max_Haptikzyklenfehler 5;
BA_ "GenSigStartValue" SG_ 539 RGS_HR_Max_Haptikzyklenfehler 1;
BA_ "GenSigSwitchedByIgnition" SG_ 539 RGS_HR_Max_Haptikzyklenfehler 0;
BA_ "GenSigInactiveValue" SG_ 539 RGS_HR_Max_NGU_Zyklenfehler 1;
BA_ "GenSigSendType" SG_ 539 RGS_HR_Max_NGU_Zyklenfehler 5;
BA_ "GenSigStartValue" SG_ 539 RGS_HR_Max_NGU_Zyklenfehler 1;
BA_ "GenSigInactiveValue" SG_ 539 RGS_HR_Max_P2P_Zyklenfehler 1;
BA_ "GenSigSendType" SG_ 539 RGS_HR_Max_P2P_Zyklenfehler 5;
BA_ "GenSigStartValue" SG_ 539 RGS_HR_Max_P2P_Zyklenfehler 1;
BA_ "GenSigSwitchedByIgnition" SG_ 539 RGS_HR_Max_P2P_Zyklenfehler 0;
BA_ "GenSigInactiveValue" SG_ 539 RGS_HR_Max_Straffzyklenfehler 1;
BA_ "GenSigSendType" SG_ 539 RGS_HR_Max_Straffzyklenfehler 5;
BA_ "GenSigStartValue" SG_ 539 RGS_HR_Max_Straffzyklenfehler 1;
BA_ "GenSigInactiveValue" SG_ 539 RGS_HR_Motorfehler 1;
BA_ "GenSigSendType" SG_ 539 RGS_HR_Motorfehler 5;
BA_ "GenSigStartValue" SG_ 539 RGS_HR_Motorfehler 1;
BA_ "GenSigInactiveValue" SG_ 539 RGS_HR_nicht_programmiert 1;
BA_ "GenSigSendType" SG_ 539 RGS_HR_nicht_programmiert 5;
BA_ "GenSigStartValue" SG_ 539 RGS_HR_nicht_programmiert 1;
BA_ "GenSigSendType" SG_ 539 RGS_HR_Status 5;
BA_ "GenSigStartValue" SG_ 539 RGS_HR_Status 31;
BA_ "GenSigSwitchedByIgnition" SG_ 539 RGS_HR_Status 0;
BA_ "GenSigSendType" SG_ 539 RGS_HR_Strom 5;
BA_ "GenSigStartValue" SG_ 539 RGS_HR_Strom 254;
BA_ "Fehlerwert" SG_ 539 RGS_HR_Strom 255;
BA_ "GenSigSendType" SG_ 539 RGS_HR_Temp 0;
BA_ "GenSigStartValue" SG_ 539 RGS_HR_Temp 254;
BA_ "Fehlerwert" SG_ 539 RGS_HR_Temp 255;
BA_ "GenSigInactiveValue" SG_ 539 RGS_HR_Ueberspannung 1;
BA_ "GenSigSendType" SG_ 539 RGS_HR_Ueberspannung 5;
BA_ "GenSigStartValue" SG_ 539 RGS_HR_Ueberspannung 1;
BA_ "GenSigInactiveValue" SG_ 539 RGS_HR_Uebertemperatur_defekt 1;
BA_ "GenSigSendType" SG_ 539 RGS_HR_Uebertemperatur_defekt 5;
BA_ "GenSigStartValue" SG_ 539 RGS_HR_Uebertemperatur_defekt 1;
BA_ "GenSigInactiveValue" SG_ 539 RGS_HR_Unterspannung 1;
BA_ "GenSigSendType" SG_ 539 RGS_HR_Unterspannung 5;
BA_ "GenSigStartValue" SG_ 539 RGS_HR_Unterspannung 1;
BA_ "GenSigInactiveValue" SG_ 984 RGS_VL_Bauteilfehler 1;
BA_ "GenSigSendType" SG_ 984 RGS_VL_Bauteilfehler 5;
BA_ "GenSigStartValue" SG_ 984 RGS_VL_Bauteilfehler 1;
BA_ "GenSigInactiveValue" SG_ 984 RGS_VL_Crashabschaltung 1;
BA_ "GenSigSendType" SG_ 984 RGS_VL_Crashabschaltung 5;
BA_ "GenSigStartValue" SG_ 984 RGS_VL_Crashabschaltung 1;
BA_ "GenSigInactiveValue" SG_ 984 RGS_VL_EEPROM_RAM_ROM_Fehler 1;
BA_ "GenSigSendType" SG_ 984 RGS_VL_EEPROM_RAM_ROM_Fehler 5;
BA_ "GenSigStartValue" SG_ 984 RGS_VL_EEPROM_RAM_ROM_Fehler 1;
BA_ "GenSigSwitchedByIgnition" SG_ 984 RGS_VL_EEPROM_RAM_ROM_Fehler 0;
BA_ "GenSigSendType" SG_ 984 RGS_VL_Gurtbandauszug 3;
BA_ "GenSigStartValue" SG_ 984 RGS_VL_Gurtbandauszug 4094;
BA_ "Fehlerwert" SG_ 984 RGS_VL_Gurtbandauszug 4095;
BA_ "GenSigSendType" SG_ 984 RGS_VL_Gurtgeschwindigkeit 3;
BA_ "GenSigStartValue" SG_ 984 RGS_VL_Gurtgeschwindigkeit 511;
BA_ "Fehlerwert" SG_ 984 RGS_VL_Gurtgeschwindigkeit 1023;
BA_ "GenSigSendType" SG_ 984 RGS_VL_InPos 0;
BA_ "GenSigInactiveValue" SG_ 984 RGS_VL_keineStraffungUeberspg 1;
BA_ "GenSigSendType" SG_ 984 RGS_VL_keineStraffungUeberspg 5;
BA_ "GenSigStartValue" SG_ 984 RGS_VL_keineStraffungUeberspg 1;
BA_ "GenSigInactiveValue" SG_ 984 RGS_VL_keineStraffungUnterspg 1;
BA_ "GenSigSendType" SG_ 984 RGS_VL_keineStraffungUnterspg 5;
BA_ "GenSigStartValue" SG_ 984 RGS_VL_keineStraffungUnterspg 1;
BA_ "GenSigInactiveValue" SG_ 984 RGS_VL_Max_Gurtlosezyklen 1;
BA_ "GenSigSendType" SG_ 984 RGS_VL_Max_Gurtlosezyklen 5;
BA_ "GenSigStartValue" SG_ 984 RGS_VL_Max_Gurtlosezyklen 1;
BA_ "GenSigSwitchedByIgnition" SG_ 984 RGS_VL_Max_Gurtlosezyklen 0;
BA_ "GenSigInactiveValue" SG_ 984 RGS_VL_Max_Haptikzyklenfehler 1;
BA_ "GenSigSendType" SG_ 984 RGS_VL_Max_Haptikzyklenfehler 5;
BA_ "GenSigStartValue" SG_ 984 RGS_VL_Max_Haptikzyklenfehler 1;
BA_ "GenSigSwitchedByIgnition" SG_ 984 RGS_VL_Max_Haptikzyklenfehler 0;
BA_ "GenSigInactiveValue" SG_ 984 RGS_VL_Max_NGU_Zyklenfehler 1;
BA_ "GenSigSendType" SG_ 984 RGS_VL_Max_NGU_Zyklenfehler 5;
BA_ "GenSigStartValue" SG_ 984 RGS_VL_Max_NGU_Zyklenfehler 1;
BA_ "GenSigInactiveValue" SG_ 984 RGS_VL_Max_P2P_Zyklenfehler 1;
BA_ "GenSigSendType" SG_ 984 RGS_VL_Max_P2P_Zyklenfehler 5;
BA_ "GenSigStartValue" SG_ 984 RGS_VL_Max_P2P_Zyklenfehler 1;
BA_ "GenSigSwitchedByIgnition" SG_ 984 RGS_VL_Max_P2P_Zyklenfehler 0;
BA_ "GenSigInactiveValue" SG_ 984 RGS_VL_Max_Straffzyklenfehler 1;
BA_ "GenSigSendType" SG_ 984 RGS_VL_Max_Straffzyklenfehler 5;
BA_ "GenSigStartValue" SG_ 984 RGS_VL_Max_Straffzyklenfehler 1;
BA_ "GenSigInactiveValue" SG_ 984 RGS_VL_Motorfehler 1;
BA_ "GenSigSendType" SG_ 984 RGS_VL_Motorfehler 5;
BA_ "GenSigStartValue" SG_ 984 RGS_VL_Motorfehler 1;
BA_ "GenSigInactiveValue" SG_ 984 RGS_VL_nicht_programmiert 1;
BA_ "GenSigSendType" SG_ 984 RGS_VL_nicht_programmiert 5;
BA_ "GenSigStartValue" SG_ 984 RGS_VL_nicht_programmiert 1;
BA_ "GenSigSendType" SG_ 984 RGS_VL_Status 5;
BA_ "GenSigStartValue" SG_ 984 RGS_VL_Status 31;
BA_ "GenSigSwitchedByIgnition" SG_ 984 RGS_VL_Status 0;
BA_ "GenSigSendType" SG_ 984 RGS_VL_Strom 5;
BA_ "GenSigStartValue" SG_ 984 RGS_VL_Strom 254;
BA_ "Fehlerwert" SG_ 984 RGS_VL_Strom 255;
BA_ "GenSigSendType" SG_ 984 RGS_VL_Temp 0;
BA_ "GenSigStartValue" SG_ 984 RGS_VL_Temp 254;
BA_ "Fehlerwert" SG_ 984 RGS_VL_Temp 255;
BA_ "GenSigInactiveValue" SG_ 984 RGS_VL_Ueberspannung 1;
BA_ "GenSigSendType" SG_ 984 RGS_VL_Ueberspannung 5;
BA_ "GenSigStartValue" SG_ 984 RGS_VL_Ueberspannung 1;
BA_ "GenSigInactiveValue" SG_ 984 RGS_VL_Uebertemperatur_defekt 1;
BA_ "GenSigSendType" SG_ 984 RGS_VL_Uebertemperatur_defekt 5;
BA_ "GenSigStartValue" SG_ 984 RGS_VL_Uebertemperatur_defekt 1;
BA_ "GenSigInactiveValue" SG_ 984 RGS_VL_Unterspannung 1;
BA_ "GenSigSendType" SG_ 984 RGS_VL_Unterspannung 5;
BA_ "GenSigStartValue" SG_ 984 RGS_VL_Unterspannung 1;
BA_ "GenSigInactiveValue" SG_ 985 RGS_VR_Bauteilfehler 1;
BA_ "GenSigSendType" SG_ 985 RGS_VR_Bauteilfehler 5;
BA_ "GenSigStartValue" SG_ 985 RGS_VR_Bauteilfehler 1;
BA_ "GenSigInactiveValue" SG_ 985 RGS_VR_Crashabschaltung 1;
BA_ "GenSigSendType" SG_ 985 RGS_VR_Crashabschaltung 5;
BA_ "GenSigStartValue" SG_ 985 RGS_VR_Crashabschaltung 1;
BA_ "GenSigInactiveValue" SG_ 985 RGS_VR_EEPROM_RAM_ROM_Fehler 1;
BA_ "GenSigSendType" SG_ 985 RGS_VR_EEPROM_RAM_ROM_Fehler 5;
BA_ "GenSigStartValue" SG_ 985 RGS_VR_EEPROM_RAM_ROM_Fehler 1;
BA_ "GenSigSwitchedByIgnition" SG_ 985 RGS_VR_EEPROM_RAM_ROM_Fehler 0;
BA_ "GenSigSendType" SG_ 985 RGS_VR_Gurtbandauszug 3;
BA_ "GenSigStartValue" SG_ 985 RGS_VR_Gurtbandauszug 4094;
BA_ "Fehlerwert" SG_ 985 RGS_VR_Gurtbandauszug 4095;
BA_ "GenSigSendType" SG_ 985 RGS_VR_Gurtgeschwindigkeit 3;
BA_ "GenSigStartValue" SG_ 985 RGS_VR_Gurtgeschwindigkeit 511;
BA_ "Fehlerwert" SG_ 985 RGS_VR_Gurtgeschwindigkeit 1023;
BA_ "GenSigSendType" SG_ 985 RGS_VR_InPos 0;
BA_ "GenSigInactiveValue" SG_ 985 RGS_VR_keineStraffungUeberspg 1;
BA_ "GenSigSendType" SG_ 985 RGS_VR_keineStraffungUeberspg 5;
BA_ "GenSigStartValue" SG_ 985 RGS_VR_keineStraffungUeberspg 1;
BA_ "GenSigInactiveValue" SG_ 985 RGS_VR_keineStraffungUnterspg 1;
BA_ "GenSigSendType" SG_ 985 RGS_VR_keineStraffungUnterspg 5;
BA_ "GenSigStartValue" SG_ 985 RGS_VR_keineStraffungUnterspg 1;
BA_ "GenSigInactiveValue" SG_ 985 RGS_VR_Max_Gurtlosezyklen 1;
BA_ "GenSigSendType" SG_ 985 RGS_VR_Max_Gurtlosezyklen 5;
BA_ "GenSigStartValue" SG_ 985 RGS_VR_Max_Gurtlosezyklen 1;
BA_ "GenSigSwitchedByIgnition" SG_ 985 RGS_VR_Max_Gurtlosezyklen 0;
BA_ "GenSigInactiveValue" SG_ 985 RGS_VR_Max_Haptikzyklenfehler 1;
BA_ "GenSigSendType" SG_ 985 RGS_VR_Max_Haptikzyklenfehler 5;
BA_ "GenSigStartValue" SG_ 985 RGS_VR_Max_Haptikzyklenfehler 1;
BA_ "GenSigSwitchedByIgnition" SG_ 985 RGS_VR_Max_Haptikzyklenfehler 0;
BA_ "GenSigInactiveValue" SG_ 985 RGS_VR_Max_NGU_Zyklenfehler 1;
BA_ "GenSigSendType" SG_ 985 RGS_VR_Max_NGU_Zyklenfehler 5;
BA_ "GenSigStartValue" SG_ 985 RGS_VR_Max_NGU_Zyklenfehler 1;
BA_ "GenSigInactiveValue" SG_ 985 RGS_VR_Max_P2P_Zyklenfehler 1;
BA_ "GenSigSendType" SG_ 985 RGS_VR_Max_P2P_Zyklenfehler 5;
BA_ "GenSigStartValue" SG_ 985 RGS_VR_Max_P2P_Zyklenfehler 1;
BA_ "GenSigSwitchedByIgnition" SG_ 985 RGS_VR_Max_P2P_Zyklenfehler 0;
BA_ "GenSigInactiveValue" SG_ 985 RGS_VR_Max_Straffzyklenfehler 1;
BA_ "GenSigSendType" SG_ 985 RGS_VR_Max_Straffzyklenfehler 5;
BA_ "GenSigStartValue" SG_ 985 RGS_VR_Max_Straffzyklenfehler 1;
BA_ "GenSigInactiveValue" SG_ 985 RGS_VR_Motorfehler 1;
BA_ "GenSigSendType" SG_ 985 RGS_VR_Motorfehler 5;
BA_ "GenSigStartValue" SG_ 985 RGS_VR_Motorfehler 1;
BA_ "GenSigInactiveValue" SG_ 985 RGS_VR_nicht_programmiert 1;
BA_ "GenSigSendType" SG_ 985 RGS_VR_nicht_programmiert 5;
BA_ "GenSigStartValue" SG_ 985 RGS_VR_nicht_programmiert 1;
BA_ "GenSigSendType" SG_ 985 RGS_VR_Status 5;
BA_ "GenSigStartValue" SG_ 985 RGS_VR_Status 31;
BA_ "GenSigSwitchedByIgnition" SG_ 985 RGS_VR_Status 0;
BA_ "GenSigSendType" SG_ 985 RGS_VR_Strom 5;
BA_ "GenSigStartValue" SG_ 985 RGS_VR_Strom 254;
BA_ "Fehlerwert" SG_ 985 RGS_VR_Strom 255;
BA_ "GenSigSendType" SG_ 985 RGS_VR_Temp 0;
BA_ "GenSigStartValue" SG_ 985 RGS_VR_Temp 254;
BA_ "Fehlerwert" SG_ 985 RGS_VR_Temp 255;
BA_ "GenSigInactiveValue" SG_ 985 RGS_VR_Ueberspannung 1;
BA_ "GenSigSendType" SG_ 985 RGS_VR_Ueberspannung 5;
BA_ "GenSigStartValue" SG_ 985 RGS_VR_Ueberspannung 1;
BA_ "GenSigInactiveValue" SG_ 985 RGS_VR_Uebertemperatur_defekt 1;
BA_ "GenSigSendType" SG_ 985 RGS_VR_Uebertemperatur_defekt 5;
BA_ "GenSigStartValue" SG_ 985 RGS_VR_Uebertemperatur_defekt 1;
BA_ "GenSigInactiveValue" SG_ 985 RGS_VR_Unterspannung 1;
BA_ "GenSigSendType" SG_ 985 RGS_VR_Unterspannung 5;
BA_ "GenSigStartValue" SG_ 985 RGS_VR_Unterspannung 1;
BA_REL_ "GenSigTimeoutTime" BU_SG_REL_ Airbag SG_ 2600468729 NM_RGS_HL_FCAB 2000;
BA_REL_ "GenSigTimeoutTime" BU_SG_REL_ Airbag SG_ 2600468730 NM_RGS_HR_FCAB 2000;
BA_REL_ "GenSigTimeoutTime" BU_SG_REL_ Airbag SG_ 2600468574 NM_RGS_VL_FCAB 2000;
BA_REL_ "GenSigTimeoutTime" BU_SG_REL_ Airbag SG_ 2600468575 NM_RGS_VR_FCAB 2000;
BA_REL_ "GenSigTimeoutTime" BU_SG_REL_ Airbag SG_ 535 RGS_HL_Gurtgeschwindigkeit 5000;
BA_REL_ "GenSigTimeoutTime" BU_SG_REL_ Airbag SG_ 535 RGS_HL_Gurtbandauszug 5000;
BA_REL_ "GenSigTimeoutTime" BU_SG_REL_ Airbag SG_ 535 RGS_HL_keine_Straffung_Unterspg 5000;
BA_REL_ "GenSigTimeoutTime" BU_SG_REL_ Airbag SG_ 535 RGS_HL_nicht_programmiert 5000;
BA_REL_ "GenSigTimeoutTime" BU_SG_REL_ Airbag SG_ 535 RGS_HL_Uebertemperatur_defekt 5000;
BA_REL_ "GenSigTimeoutTime" BU_SG_REL_ Airbag SG_ 535 RGS_HL_Bauteilfehler 5000;
BA_REL_ "GenSigTimeoutTime" BU_SG_REL_ Airbag SG_ 535 RGS_HL_keine_Straffung_Ueberspg 5000;
BA_REL_ "GenSigTimeoutTime" BU_SG_REL_ Airbag SG_ 535 RGS_HL_Max_Gurtlosezyklen 5000;
BA_REL_ "GenSigTimeoutTime" BU_SG_REL_ Airbag SG_ 535 RGS_HL_Temp 5000;
BA_REL_ "GenSigTimeoutTime" BU_SG_REL_ Airbag SG_ 535 RGS_HL_Unterspannung 5000;
BA_REL_ "GenSigTimeoutTime" BU_SG_REL_ Airbag SG_ 535 RGS_HL_Max_Straffzyklenfehler 5000;
BA_REL_ "GenSigTimeoutTime" BU_SG_REL_ Airbag SG_ 535 RGS_HL_Max_Haptikzyklenfehler 5000;
BA_REL_ "GenSigTimeoutTime" BU_SG_REL_ Airbag SG_ 535 RGS_HL_Crashabschaltung 5000;
BA_REL_ "GenSigTimeoutTime" BU_SG_REL_ Airbag SG_ 535 RGS_HL_Ueberspannung 5000;
BA_REL_ "GenSigTimeoutTime" BU_SG_REL_ Airbag SG_ 535 RGS_HL_Motorfehler 5000;
BA_REL_ "GenSigTimeoutTime" BU_SG_REL_ Airbag SG_ 535 RGS_HL_InPos 5000;
BA_REL_ "GenSigTimeoutTime" BU_SG_REL_ Airbag SG_ 535 RGS_HL_Strom 5000;
BA_REL_ "GenSigTimeoutTime" BU_SG_REL_ Airbag SG_ 535 RGS_HL_Status 5000;
BA_REL_ "GenSigTimeoutTime" BU_SG_REL_ Airbag SG_ 535 RGS_HL_Max_NGU_Zyklenfehler 5000;
BA_REL_ "GenSigTimeoutTime" BU_SG_REL_ Airbag SG_ 535 RGS_HL_EEPROM_RAM_ROM_Fehler 5000;
BA_REL_ "GenSigTimeoutTime" BU_SG_REL_ Airbag SG_ 539 RGS_HR_Gurtgeschwindigkeit 5000;
BA_REL_ "GenSigTimeoutTime" BU_SG_REL_ Airbag SG_ 539 RGS_HR_Gurtbandauszug 5000;
BA_REL_ "GenSigTimeoutTime" BU_SG_REL_ Airbag SG_ 539 RGS_HR_keine_Straffung_Unterspg 5000;
BA_REL_ "GenSigTimeoutTime" BU_SG_REL_ Airbag SG_ 539 RGS_HR_nicht_programmiert 5000;
BA_REL_ "GenSigTimeoutTime" BU_SG_REL_ Airbag SG_ 539 RGS_HR_Uebertemperatur_defekt 5000;
BA_REL_ "GenSigTimeoutTime" BU_SG_REL_ Airbag SG_ 539 RGS_HR_Bauteilfehler 5000;
BA_REL_ "GenSigTimeoutTime" BU_SG_REL_ Airbag SG_ 539 RGS_HR_keine_Straffung_Ueberspg 5000;
BA_REL_ "GenSigTimeoutTime" BU_SG_REL_ Airbag SG_ 539 RGS_HR_Max_Gurtlosezyklen 5000;
BA_REL_ "GenSigTimeoutTime" BU_SG_REL_ Airbag SG_ 539 RGS_HR_Temp 5000;
BA_REL_ "GenSigTimeoutTime" BU_SG_REL_ Airbag SG_ 539 RGS_HR_Unterspannung 5000;
BA_REL_ "GenSigTimeoutTime" BU_SG_REL_ Airbag SG_ 539 RGS_HR_Max_Straffzyklenfehler 5000;
BA_REL_ "GenSigTimeoutTime" BU_SG_REL_ Airbag SG_ 539 RGS_HR_Max_Haptikzyklenfehler 5000;
BA_REL_ "GenSigTimeoutTime" BU_SG_REL_ Airbag SG_ 539 RGS_HR_Crashabschaltung 5000;
BA_REL_ "GenSigTimeoutTime" BU_SG_REL_ Airbag SG_ 539 RGS_HR_Ueberspannung 5000;
BA_REL_ "GenSigTimeoutTime" BU_SG_REL_ Airbag SG_ 539 RGS_HR_Motorfehler 5000;
BA_REL_ "GenSigTimeoutTime" BU_SG_REL_ Airbag SG_ 539 RGS_HR_InPos 5000;
BA_REL_ "GenSigTimeoutTime" BU_SG_REL_ Airbag SG_ 539 RGS_HR_Strom 5000;
BA_REL_ "GenSigTimeoutTime" BU_SG_REL_ Airbag SG_ 539 RGS_HR_Status 5000;
BA_REL_ "GenSigTimeoutTime" BU_SG_REL_ Airbag SG_ 539 RGS_HR_Max_NGU_Zyklenfehler 5000;
BA_REL_ "GenSigTimeoutTime" BU_SG_REL_ Airbag SG_ 539 RGS_HR_EEPROM_RAM_ROM_Fehler 5000;
BA_REL_ "GenSigTimeoutTime" BU_SG_REL_ Airbag SG_ 984 RGS_VL_Gurtgeschwindigkeit 5000;
BA_REL_ "GenSigTimeoutTime" BU_SG_REL_ Airbag SG_ 984 RGS_VL_Gurtbandauszug 5000;
BA_REL_ "GenSigTimeoutTime" BU_SG_REL_ Airbag SG_ 984 RGS_VL_keineStraffungUnterspg 5000;
BA_REL_ "GenSigTimeoutTime" BU_SG_REL_ Airbag SG_ 984 RGS_VL_nicht_programmiert 5000;
BA_REL_ "GenSigTimeoutTime" BU_SG_REL_ Airbag SG_ 984 RGS_VL_Uebertemperatur_defekt 5000;
BA_REL_ "GenSigTimeoutTime" BU_SG_REL_ Airbag SG_ 984 RGS_VL_Bauteilfehler 5000;
BA_REL_ "GenSigTimeoutTime" BU_SG_REL_ Airbag SG_ 984 RGS_VL_keineStraffungUeberspg 5000;
BA_REL_ "GenSigTimeoutTime" BU_SG_REL_ Airbag SG_ 984 RGS_VL_Max_Gurtlosezyklen 5000;
BA_REL_ "GenSigTimeoutTime" BU_SG_REL_ Airbag SG_ 984 RGS_VL_Temp 5000;
BA_REL_ "GenSigTimeoutTime" BU_SG_REL_ Airbag SG_ 984 RGS_VL_Unterspannung 5000;
BA_REL_ "GenSigTimeoutTime" BU_SG_REL_ Airbag SG_ 984 RGS_VL_Max_Straffzyklenfehler 5000;
BA_REL_ "GenSigTimeoutTime" BU_SG_REL_ Airbag SG_ 984 RGS_VL_Max_Haptikzyklenfehler 5000;
BA_REL_ "GenSigTimeoutTime" BU_SG_REL_ Airbag SG_ 984 RGS_VL_Crashabschaltung 5000;
BA_REL_ "GenSigTimeoutTime" BU_SG_REL_ Airbag SG_ 984 RGS_VL_Ueberspannung 5000;
BA_REL_ "GenSigTimeoutTime" BU_SG_REL_ Airbag SG_ 984 RGS_VL_Motorfehler 5000;
BA_REL_ "GenSigTimeoutTime" BU_SG_REL_ Airbag SG_ 984 RGS_VL_InPos 5000;
BA_REL_ "GenSigTimeoutTime" BU_SG_REL_ Airbag SG_ 984 RGS_VL_Strom 5000;
BA_REL_ "GenSigTimeoutTime" BU_SG_REL_ Airbag SG_ 984 RGS_VL_Status 5000;
BA_REL_ "GenSigTimeoutTime" BU_SG_REL_ Airbag SG_ 984 RGS_VL_Max_NGU_Zyklenfehler 5000;
BA_REL_ "GenSigTimeoutTime" BU_SG_REL_ Airbag SG_ 984 RGS_VL_EEPROM_RAM_ROM_Fehler 5000;
BA_REL_ "GenSigTimeoutTime" BU_SG_REL_ Airbag SG_ 985 RGS_VR_Gurtgeschwindigkeit 5000;
BA_REL_ "GenSigTimeoutTime" BU_SG_REL_ Airbag SG_ 985 RGS_VR_Gurtbandauszug 5000;
BA_REL_ "GenSigTimeoutTime" BU_SG_REL_ Airbag SG_ 985 RGS_VR_keineStraffungUnterspg 5000;
BA_REL_ "GenSigTimeoutTime" BU_SG_REL_ Airbag SG_ 985 RGS_VR_nicht_programmiert 5000;
BA_REL_ "GenSigTimeoutTime" BU_SG_REL_ Airbag SG_ 985 RGS_VR_Uebertemperatur_defekt 5000;
BA_REL_ "GenSigTimeoutTime" BU_SG_REL_ Airbag SG_ 985 RGS_VR_Bauteilfehler 5000;
BA_REL_ "GenSigTimeoutTime" BU_SG_REL_ Airbag SG_ 985 RGS_VR_keineStraffungUeberspg 5000;
BA_REL_ "GenSigTimeoutTime" BU_SG_REL_ Airbag SG_ 985 RGS_VR_Max_Gurtlosezyklen 5000;
BA_REL_ "GenSigTimeoutTime" BU_SG_REL_ Airbag SG_ 985 RGS_VR_Temp 5000;
BA_REL_ "GenSigTimeoutTime" BU_SG_REL_ Airbag SG_ 985 RGS_VR_Unterspannung 5000;
BA_REL_ "GenSigTimeoutTime" BU_SG_REL_ Airbag SG_ 985 RGS_VR_Max_Straffzyklenfehler 5000;
BA_REL_ "GenSigTimeoutTime" BU_SG_REL_ Airbag SG_ 985 RGS_VR_Max_Haptikzyklenfehler 5000;
BA_REL_ "GenSigTimeoutTime" BU_SG_REL_ Airbag SG_ 985 RGS_VR_Crashabschaltung 5000;
BA_REL_ "GenSigTimeoutTime" BU_SG_REL_ Airbag SG_ 985 RGS_VR_Ueberspannung 5000;
BA_REL_ "GenSigTimeoutTime" BU_SG_REL_ Airbag SG_ 985 RGS_VR_Motorfehler 5000;
BA_REL_ "GenSigTimeoutTime" BU_SG_REL_ Airbag SG_ 985 RGS_VR_InPos 5000;
BA_REL_ "GenSigTimeoutTime" BU_SG_REL_ Airbag SG_ 985 RGS_VR_Strom 5000;
BA_REL_ "GenSigTimeoutTime" BU_SG_REL_ Airbag SG_ 985 RGS_VR_Status 5000;
BA_REL_ "GenSigTimeoutTime" BU_SG_REL_ Airbag SG_ 985 RGS_VR_Max_NGU_Zyklenfehler 5000;
BA_REL_ "GenSigTimeoutTime" BU_SG_REL_ Airbag SG_ 985 RGS_VR_EEPROM_RAM_ROM_Fehler 5000;
BA_REL_ "GenSigTimeoutTime" BU_SG_REL_ eCS SG_ 2600468501 NM_Airbag_01_FCAB 2000;
BA_REL_ "GenSigTimeoutTime" BU_SG_REL_ eCS SG_ 2600468729 NM_RGS_HL_FCAB 2000;
BA_REL_ "GenSigTimeoutTime" BU_SG_REL_ eCS SG_ 2600468730 NM_RGS_HR_FCAB 2000;
BA_REL_ "GenSigTimeoutTime" BU_SG_REL_ eCS SG_ 2600468574 NM_RGS_VL_FCAB 2000;
BA_REL_ "GenSigTimeoutTime" BU_SG_REL_ eCS SG_ 2600468575 NM_RGS_VR_FCAB 2000;
BA_REL_ "GenSigTimeoutTime" BU_SG_REL_ RGS_HL SG_ 2600468501 NM_Airbag_01_FCAB 2000;
BA_REL_ "GenSigTimeoutTime" BU_SG_REL_ RGS_HL SG_ 2600468730 NM_RGS_HR_FCAB 2000;
BA_REL_ "GenSigTimeoutTime" BU_SG_REL_ RGS_HL SG_ 2600468574 NM_RGS_VL_FCAB 2000;
BA_REL_ "GenSigTimeoutTime" BU_SG_REL_ RGS_HL SG_ 2600468575 NM_RGS_VR_FCAB 2000;
BA_REL_ "GenSigTimeoutTime" BU_SG_REL_ RGS_HL SG_ 567 NVEM_Abschaltstufe 1000;
BA_REL_ "GenSigTimeoutTime" BU_SG_REL_ RGS_HL SG_ 2589283656 ORU_Status 5000;
BA_REL_ "GenSigTimeoutTime" BU_SG_REL_ RGS_HL SG_ 2527679787 RA_Frequency_unit 5000;
BA_REL_ "GenSigTimeoutTime" BU_SG_REL_ RGS_HL SG_ 2527679787 RA_Frequency 5000;
BA_REL_ "GenSigTimeoutTime" BU_SG_REL_ RGS_HL SG_ 2527679787 RA_AM_Tuning 5000;
BA_REL_ "GenSigTimeoutTime" BU_SG_REL_ RGS_HL SG_ 2463978781 RGS_HL_Anforderung 5000;
BA_REL_ "GenSigTimeoutTime" BU_SG_REL_ RGS_HL SG_ 2463978781 RGS_HL_Nachlauf_2 5000;
BA_REL_ "GenSigTimeoutTime" BU_SG_REL_ RGS_HL SG_ 2463978781 RGS_Nachlauf_allg 5000;
BA_REL_ "GenSigTimeoutTime" BU_SG_REL_ RGS_HL SG_ 2463978781 RGS_Loesen_erlaubt 5000;
BA_REL_ "GenSigTimeoutTime" BU_SG_REL_ RGS_HR SG_ 2600468501 NM_Airbag_01_FCAB 2000;
BA_REL_ "GenSigTimeoutTime" BU_SG_REL_ RGS_HR SG_ 2600468729 NM_RGS_HL_FCAB 2000;
BA_REL_ "GenSigTimeoutTime" BU_SG_REL_ RGS_HR SG_ 2600468574 NM_RGS_VL_FCAB 2000;
BA_REL_ "GenSigTimeoutTime" BU_SG_REL_ RGS_HR SG_ 2600468575 NM_RGS_VR_FCAB 2000;
BA_REL_ "GenSigTimeoutTime" BU_SG_REL_ RGS_HR SG_ 567 NVEM_Abschaltstufe 1000;
BA_REL_ "GenSigTimeoutTime" BU_SG_REL_ RGS_HR SG_ 2589283656 ORU_Status 5000;
BA_REL_ "GenSigTimeoutTime" BU_SG_REL_ RGS_HR SG_ 2527679787 RA_Frequency_unit 5000;
BA_REL_ "GenSigTimeoutTime" BU_SG_REL_ RGS_HR SG_ 2527679787 RA_Frequency 5000;
BA_REL_ "GenSigTimeoutTime" BU_SG_REL_ RGS_HR SG_ 2527679787 RA_AM_Tuning 5000;
BA_REL_ "GenSigTimeoutTime" BU_SG_REL_ RGS_HR SG_ 2463978781 RGS_HR_Anforderung 5000;
BA_REL_ "GenSigTimeoutTime" BU_SG_REL_ RGS_HR SG_ 2463978781 RGS_HR_Nachlauf_2 5000;
BA_REL_ "GenSigTimeoutTime" BU_SG_REL_ RGS_HR SG_ 2463978781 RGS_Nachlauf_allg 5000;
BA_REL_ "GenSigTimeoutTime" BU_SG_REL_ RGS_HR SG_ 2463978781 RGS_Loesen_erlaubt 5000;
BA_REL_ "GenSigTimeoutTime" BU_SG_REL_ RGS_VL SG_ 2600468501 NM_Airbag_01_FCAB 2000;
BA_REL_ "GenSigTimeoutTime" BU_SG_REL_ RGS_VL SG_ 2600468729 NM_RGS_HL_FCAB 2000;
BA_REL_ "GenSigTimeoutTime" BU_SG_REL_ RGS_VL SG_ 2600468730 NM_RGS_HR_FCAB 2000;
BA_REL_ "GenSigTimeoutTime" BU_SG_REL_ RGS_VL SG_ 2600468575 NM_RGS_VR_FCAB 2000;
BA_REL_ "GenSigTimeoutTime" BU_SG_REL_ RGS_VL SG_ 567 NVEM_Abschaltstufe 1000;
BA_REL_ "GenSigTimeoutTime" BU_SG_REL_ RGS_VL SG_ 2589283656 ORU_Status 5000;
BA_REL_ "GenSigTimeoutTime" BU_SG_REL_ RGS_VL SG_ 2527679787 RA_Frequency_unit 5000;
BA_REL_ "GenSigTimeoutTime" BU_SG_REL_ RGS_VL SG_ 2527679787 RA_Frequency 5000;
BA_REL_ "GenSigTimeoutTime" BU_SG_REL_ RGS_VL SG_ 2527679787 RA_AM_Tuning 5000;
BA_REL_ "GenSigTimeoutTime" BU_SG_REL_ RGS_VL SG_ 2463978781 RGS_VL_Anforderung 5000;
BA_REL_ "GenSigTimeoutTime" BU_SG_REL_ RGS_VL SG_ 2463978781 RGS_VL_Nachlauf_2 5000;
BA_REL_ "GenSigTimeoutTime" BU_SG_REL_ RGS_VL SG_ 2463978781 RGS_Nachlauf_allg 5000;
BA_REL_ "GenSigTimeoutTime" BU_SG_REL_ RGS_VL SG_ 2463978781 RGS_Loesen_erlaubt 5000;
BA_REL_ "GenSigTimeoutTime" BU_SG_REL_ RGS_VR SG_ 2600468501 NM_Airbag_01_FCAB 2000;
BA_REL_ "GenSigTimeoutTime" BU_SG_REL_ RGS_VR SG_ 2600468729 NM_RGS_HL_FCAB 2000;
BA_REL_ "GenSigTimeoutTime" BU_SG_REL_ RGS_VR SG_ 2600468730 NM_RGS_HR_FCAB 2000;
BA_REL_ "GenSigTimeoutTime" BU_SG_REL_ RGS_VR SG_ 2600468574 NM_RGS_VL_FCAB 2000;
BA_REL_ "GenSigTimeoutTime" BU_SG_REL_ RGS_VR SG_ 567 NVEM_Abschaltstufe 1000;
BA_REL_ "GenSigTimeoutTime" BU_SG_REL_ RGS_VR SG_ 2589283656 ORU_Status 5000;
BA_REL_ "GenSigTimeoutTime" BU_SG_REL_ RGS_VR SG_ 2527679787 RA_Frequency_unit 5000;
BA_REL_ "GenSigTimeoutTime" BU_SG_REL_ RGS_VR SG_ 2527679787 RA_Frequency 5000;
BA_REL_ "GenSigTimeoutTime" BU_SG_REL_ RGS_VR SG_ 2527679787 RA_AM_Tuning 5000;
BA_REL_ "GenSigTimeoutTime" BU_SG_REL_ RGS_VR SG_ 2463978781 RGS_VR_Anforderung 5000;
BA_REL_ "GenSigTimeoutTime" BU_SG_REL_ RGS_VR SG_ 2463978781 RGS_VR_Nachlauf_2 5000;
BA_REL_ "GenSigTimeoutTime" BU_SG_REL_ RGS_VR SG_ 2463978781 RGS_Nachlauf_allg 5000;
BA_REL_ "GenSigTimeoutTime" BU_SG_REL_ RGS_VR SG_ 2463978781 RGS_Loesen_erlaubt 5000;
VAL_ 2600468501 NM_Airbag_01_CBV_AWB 0 "Passiver_WakeUp" 1 "Aktiver_WakeUp" ;
VAL_ 2600468501 NM_Airbag_01_CBV_CRI 0 "NM_ohne_Clusteranforderungen" 1 "NM_mit_Clusteranforderungen" ;
VAL_ 2600468501 NM_Airbag_01_FCAB 0 "Init" 1 "01_CarWakeUp" 2 "02_Basefunction_Powertrain" 4 "03_Basefunction_Chassis" 8 "04_Basefunction_DrivingAssistance" 16 "05_Basefunction_Infotainment" 32 "06_Basefunction_ComfortLight" 64 "07_Basefunction_CrossSection" 128 "08_Basefunction_Connectivity" 256 "09_<reserved>" 512 "10_Powertrain" 1024 "11_Chassis" 2048 "12_GearSelector" 4096 "13_Airbag" 8192 "14_InfotainmentExtensions" 16384 "15_InstrumentclusterDisplay" 32768 "16_InfotainmentDisplay" 65536 "17_Audio" 131072 "18_VirtualSideMirrors" 262144 "19_Doors_Hatches" 524288 "20_OptionalComfort" 1048576 "21_AirSuspension" 2097152 "22_ExteriorLights" 4194304 "23_Climate" 8388608 "24_ThermoManagement" 16777216 "25_AccessSystemSensors" 33554432 "26_HighVoltage_Charging" 67108864 "27_Timemaster_Timer" 134217728 "28_OnboardTester_DataCollector" 268435456 "29_SteeringColumnLock" 536870912 "30_EnergyManagement" 1073741824 "31_MultifunctionalSteeringWheel" 0 "32_OnlineAccess" 0 "33_ExternalWirelessCommunication" 0 "34_GPS_Localization" 0 "35_ExteriorSound" 0 "36_Preheater" 0 "37_HighVoltage_WirelessChargingStation" 0 "40_Diagnosis_Energy" 0 "41_Diagnosis_Powertrain" 0 "42_Diagnosis_FlexRay" 0 "43_Diagnosis_DrivingAssistance" 0 "44_Diagnosis_Infotainment" 0 "45_Diagnosis_Comfort" 0 "46_Diagnosis_Light" 0 "47_Diagnosis_ComfortLINs" 0 "48_Diagnosis_ClimateTmeLINs" 0 "49_<reserved>" 0 "53_Lock_Unlock" 0 "54_<reserved>" 0 "55_Dimming" 0 "56_ChargingStatus" ;
VAL_ 2600468501 NM_Airbag_01_SNI_10 21 "Airbag_01_SNI" ;
VAL_ 2600468501 NM_Airbag_01_NM_State 0 "Init" 1 "NM_RM_aus_BSM" 2 "NM_RM_aus_PBSM" 4 "NM_NO_aus_RM" 8 "NM_NO_aus_RS" 16 "reserved" 32 "reserved" ;
VAL_ 2600468501 NM_Airbag_01_UDS_CC 0 "Inaktiv" 1 "CC_aktiv" ;
VAL_ 2600468501 NM_Airbag_01_Wakeup 0 "Peripherie_Wakeup_Ursache_nicht_bekannt" 1 "Bus_Wakeup" 2 "KL15_HW" 3 "Sitzbelegungserkennung_Fahrer" 4 "Gurtschlosserkennung_Fahrer" ;
VAL_ 2600468501 NM_Airbag_01_NM_aktiv_KL15 0 "Inaktiv" 1 "KL15_EIN" ;
VAL_ 2600468501 NM_Airbag_01_NM_aktiv_Diag 0 "Inaktiv" 1 "Diagnose_aktiv" ;
VAL_ 2600468501 NM_Airbag_01_NM_aktiv_Tmin 0 "Inaktiv" 1 "Mindestaktivzeit" ;
VAL_ 2600468501 NM_aktiv_Kl15_unplausibel 0 "Inaktiv" 1 "Aktiv" ;
VAL_ 2600468501 NM_aktiv_Sitzbelegung 0 "Inaktiv" 1 "Aktiv" ;
VAL_ 2600468501 NM_aktiv_Ausloesefaehig 0 "Inaktiv" 1 "Aktiv" ;
VAL_ 2600468501 NM_aktiv_Gurtschloss 0 "Inaktiv" 1 "Aktiv" ;
VAL_ 2600468501 NM_aktiv_Gurtparken 0 "Inaktiv" 1 "Aktiv" ;
VAL_ 2600468501 NM_aktiv_AntriebsCAN_aktiv 0 "Inaktiv" 1 "Aktiv" ;
VAL_ 2600468729 NM_RGS_HL_CBV_AWB 0 "Passiver_WakeUp" 1 "Aktiver_WakeUp" ;
VAL_ 2600468729 NM_RGS_HL_CBV_CRI 0 "NM_ohne_Clusteranforderungen" 1 "NM_mit_Clusteranforderungen" ;
VAL_ 2600468729 NM_RGS_HL_FCAB 0 "Init" 1 "01_CarWakeUp" 2 "02_Basefunction_Powertrain" 4 "03_Basefunction_Chassis" 8 "04_Basefunction_DrivingAssistance" 16 "05_Basefunction_Infotainment" 32 "06_Basefunction_ComfortLight" 64 "07_Basefunction_CrossSection" 128 "08_Basefunction_Connectivity" 256 "09_<reserved>" 512 "10_Powertrain" 1024 "11_Chassis" 2048 "12_GearSelector" 4096 "13_Airbag" 8192 "14_InfotainmentExtensions" 16384 "15_InstrumentclusterDisplay" 32768 "16_InfotainmentDisplay" 65536 "17_Audio" 131072 "18_VirtualSideMirrors" 262144 "19_Doors_Hatches" 524288 "20_OptionalComfort" 1048576 "21_AirSuspension" 2097152 "22_ExteriorLights" 4194304 "23_Climate" 8388608 "24_ThermoManagement" 16777216 "25_AccessSystemSensors" 33554432 "26_HighVoltage_Charging" 67108864 "27_Timemaster_Timer" 134217728 "28_OnboardTester_DataCollector" 268435456 "29_SteeringColumnLock" 536870912 "30_EnergyManagement" 1073741824 "31_MultifunctionalSteeringWheel" 0 "32_OnlineAccess" 0 "33_ExternalWirelessCommunication" 0 "34_GPS_Localization" 0 "35_ExteriorSound" 0 "36_Preheater" 0 "37_HighVoltage_WirelessChargingStation" 0 "40_Diagnosis_Energy" 0 "41_Diagnosis_Powertrain" 0 "42_Diagnosis_FlexRay" 0 "43_Diagnosis_DrivingAssistance" 0 "44_Diagnosis_Infotainment" 0 "45_Diagnosis_Comfort" 0 "46_Diagnosis_Light" 0 "47_Diagnosis_ComfortLINs" 0 "48_Diagnosis_ClimateTmeLINs" 0 "49_<reserved>" 0 "53_Lock_Unlock" 0 "54_<reserved>" 0 "55_Dimming" 0 "56_ChargingStatus" ;
VAL_ 2600468729 NM_RGS_HL_SNI_10 286 "RGS_HL_SNI" ;
VAL_ 2600468729 NM_RGS_HL_NM_State 0 "Init" 1 "NM_RM_aus_BSM" 2 "NM_RM_aus_PBSM" 4 "NM_NO_aus_RM" 8 "NM_NO_aus_RS" 16 "reserved" 32 "reserved" ;
VAL_ 2600468729 NM_RGS_HL_UDS_CC 0 "Inaktiv" 1 "CC_aktiv" ;
VAL_ 2600468729 NM_RGS_HL_Wakeup_V12 0 "Peripherie_Wakeup_Ursache_nicht_bekannt" 1 "Bus_Wakeup" 2 "KL15_HW" 4 "Gurtbewegung_erkannt" ;
VAL_ 2600468729 NM_RGS_HL_NM_aktiv_KL15 0 "Inaktiv" 1 "KL15_EIN" ;
VAL_ 2600468729 NM_RGS_HL_NM_aktiv_Diag 0 "Inaktiv" 1 "Diagnose_aktiv" ;
VAL_ 2600468729 NM_RGS_HL_NM_aktiv_Tmin 0 "Inaktiv" 1 "Mindestaktivzeit" ;
VAL_ 2600468729 NM_aktiv_Gurtbewegung_HL 0 "Inaktiv" 1 "Aktiv" ;
VAL_ 2600468730 NM_RGS_HR_CBV_AWB 0 "Passiver_WakeUp" 1 "Aktiver_WakeUp" ;
VAL_ 2600468730 NM_RGS_HR_CBV_CRI 0 "NM_ohne_Clusteranforderungen" 1 "NM_mit_Clusteranforderungen" ;
VAL_ 2600468730 NM_RGS_HR_FCAB 0 "Init" 1 "01_CarWakeUp" 2 "02_Basefunction_Powertrain" 4 "03_Basefunction_Chassis" 8 "04_Basefunction_DrivingAssistance" 16 "05_Basefunction_Infotainment" 32 "06_Basefunction_ComfortLight" 64 "07_Basefunction_CrossSection" 128 "08_Basefunction_Connectivity" 256 "09_<reserved>" 512 "10_Powertrain" 1024 "11_Chassis" 2048 "12_GearSelector" 4096 "13_Airbag" 8192 "14_InfotainmentExtensions" 16384 "15_InstrumentclusterDisplay" 32768 "16_InfotainmentDisplay" 65536 "17_Audio" 131072 "18_VirtualSideMirrors" 262144 "19_Doors_Hatches" 524288 "20_OptionalComfort" 1048576 "21_AirSuspension" 2097152 "22_ExteriorLights" 4194304 "23_Climate" 8388608 "24_ThermoManagement" 16777216 "25_AccessSystemSensors" 33554432 "26_HighVoltage_Charging" 67108864 "27_Timemaster_Timer" 134217728 "28_OnboardTester_DataCollector" 268435456 "29_SteeringColumnLock" 536870912 "30_EnergyManagement" 1073741824 "31_MultifunctionalSteeringWheel" 0 "32_OnlineAccess" 0 "33_ExternalWirelessCommunication" 0 "34_GPS_Localization" 0 "35_ExteriorSound" 0 "36_Preheater" 0 "37_HighVoltage_WirelessChargingStation" 0 "40_Diagnosis_Energy" 0 "41_Diagnosis_Powertrain" 0 "42_Diagnosis_FlexRay" 0 "43_Diagnosis_DrivingAssistance" 0 "44_Diagnosis_Infotainment" 0 "45_Diagnosis_Comfort" 0 "46_Diagnosis_Light" 0 "47_Diagnosis_ComfortLINs" 0 "48_Diagnosis_ClimateTmeLINs" 0 "49_<reserved>" 0 "53_Lock_Unlock" 0 "54_<reserved>" 0 "55_Dimming" 0 "56_ChargingStatus" ;
VAL_ 2600468730 NM_RGS_HR_SNI_10 287 "RGS_HR_SNI" ;
VAL_ 2600468730 NM_RGS_HR_NM_State 0 "Init" 1 "NM_RM_aus_BSM" 2 "NM_RM_aus_PBSM" 4 "NM_NO_aus_RM" 8 "NM_NO_aus_RS" 16 "reserved" 32 "reserved" ;
VAL_ 2600468730 NM_RGS_HR_UDS_CC 0 "Inaktiv" 1 "CC_aktiv" ;
VAL_ 2600468730 NM_RGS_HR_Wakeup_V12 0 "Peripherie_Wakeup_Ursache_nicht_bekannt" 1 "Bus_Wakeup" 2 "KL15_HW" 4 "Gurtbewegung_erkannt" ;
VAL_ 2600468730 NM_RGS_HR_NM_aktiv_KL15 0 "Inaktiv" 1 "KL15_EIN" ;
VAL_ 2600468730 NM_RGS_HR_NM_aktiv_Diag 0 "Inaktiv" 1 "Diagnose_aktiv" ;
VAL_ 2600468730 NM_RGS_HR_NM_aktiv_Tmin 0 "Inaktiv" 1 "Mindestaktivzeit" ;
VAL_ 2600468730 NM_aktiv_Gurtbewegung_HR 0 "Inaktiv" 1 "Aktiv" ;
VAL_ 2600468574 NM_RGS_VL_CBV_AWB 0 "Passiver_WakeUp" 1 "Aktiver_WakeUp" ;
VAL_ 2600468574 NM_RGS_VL_CBV_CRI 0 "NM_ohne_Clusteranforderungen" 1 "NM_mit_Clusteranforderungen" ;
VAL_ 2600468574 NM_RGS_VL_FCAB 0 "Init" 1 "01_CarWakeUp" 2 "02_Basefunction_Powertrain" 4 "03_Basefunction_Chassis" 8 "04_Basefunction_DrivingAssistance" 16 "05_Basefunction_Infotainment" 32 "06_Basefunction_ComfortLight" 64 "07_Basefunction_CrossSection" 128 "08_Basefunction_Connectivity" 256 "09_<reserved>" 512 "10_Powertrain" 1024 "11_Chassis" 2048 "12_GearSelector" 4096 "13_Airbag" 8192 "14_InfotainmentExtensions" 16384 "15_InstrumentclusterDisplay" 32768 "16_InfotainmentDisplay" 65536 "17_Audio" 131072 "18_VirtualSideMirrors" 262144 "19_Doors_Hatches" 524288 "20_OptionalComfort" 1048576 "21_AirSuspension" 2097152 "22_ExteriorLights" 4194304 "23_Climate" 8388608 "24_ThermoManagement" 16777216 "25_AccessSystemSensors" 33554432 "26_HighVoltage_Charging" 67108864 "27_Timemaster_Timer" 134217728 "28_OnboardTester_DataCollector" 268435456 "29_SteeringColumnLock" 536870912 "30_EnergyManagement" 1073741824 "31_MultifunctionalSteeringWheel" 0 "32_OnlineAccess" 0 "33_ExternalWirelessCommunication" 0 "34_GPS_Localization" 0 "35_ExteriorSound" 0 "36_Preheater" 0 "37_HighVoltage_WirelessChargingStation" 0 "40_Diagnosis_Energy" 0 "41_Diagnosis_Powertrain" 0 "42_Diagnosis_FlexRay" 0 "43_Diagnosis_DrivingAssistance" 0 "44_Diagnosis_Infotainment" 0 "45_Diagnosis_Comfort" 0 "46_Diagnosis_Light" 0 "47_Diagnosis_ComfortLINs" 0 "48_Diagnosis_ClimateTmeLINs" 0 "49_<reserved>" 0 "53_Lock_Unlock" 0 "54_<reserved>" 0 "55_Dimming" 0 "56_ChargingStatus" ;
VAL_ 2600468574 NM_RGS_VL_SNI_10 42 "RGS_VL_SNI" ;
VAL_ 2600468574 NM_RGS_VL_NM_State 0 "Init" 1 "NM_RM_aus_BSM" 2 "NM_RM_aus_PBSM" 4 "NM_NO_aus_RM" 8 "NM_NO_aus_RS" 16 "reserved" 32 "reserved" ;
VAL_ 2600468574 NM_RGS_VL_UDS_CC 0 "Inaktiv" 1 "CC_aktiv" ;
VAL_ 2600468574 NM_RGS_VL_Wakeup_V12 0 "Peripherie_Wakeup_Ursache_nicht_bekannt" 1 "Bus_Wakeup" 2 "KL15_HW" 4 "Gurtbewegung_erkannt" ;
VAL_ 2600468574 NM_RGS_VL_NM_aktiv_KL15 0 "Inaktiv" 1 "KL15_EIN" ;
VAL_ 2600468574 NM_RGS_VL_NM_aktiv_Diag 0 "Inaktiv" 1 "Diagnose_aktiv" ;
VAL_ 2600468574 NM_RGS_VL_NM_aktiv_Tmin 0 "Inaktiv" 1 "Mindestaktivzeit" ;
VAL_ 2600468574 NM_aktiv_Gurtbewegung_VL 0 "Inaktiv" 1 "Aktiv" ;
VAL_ 2600468575 NM_RGS_VR_CBV_AWB 0 "Passiver_WakeUp" 1 "Aktiver_WakeUp" ;
VAL_ 2600468575 NM_RGS_VR_CBV_CRI 0 "NM_ohne_Clusteranforderungen" 1 "NM_mit_Clusteranforderungen" ;
VAL_ 2600468575 NM_RGS_VR_FCAB 0 "Init" 1 "01_CarWakeUp" 2 "02_Basefunction_Powertrain" 4 "03_Basefunction_Chassis" 8 "04_Basefunction_DrivingAssistance" 16 "05_Basefunction_Infotainment" 32 "06_Basefunction_ComfortLight" 64 "07_Basefunction_CrossSection" 128 "08_Basefunction_Connectivity" 256 "09_<reserved>" 512 "10_Powertrain" 1024 "11_Chassis" 2048 "12_GearSelector" 4096 "13_Airbag" 8192 "14_InfotainmentExtensions" 16384 "15_InstrumentclusterDisplay" 32768 "16_InfotainmentDisplay" 65536 "17_Audio" 131072 "18_VirtualSideMirrors" 262144 "19_Doors_Hatches" 524288 "20_OptionalComfort" 1048576 "21_AirSuspension" 2097152 "22_ExteriorLights" 4194304 "23_Climate" 8388608 "24_ThermoManagement" 16777216 "25_AccessSystemSensors" 33554432 "26_HighVoltage_Charging" 67108864 "27_Timemaster_Timer" 134217728 "28_OnboardTester_DataCollector" 268435456 "29_SteeringColumnLock" 536870912 "30_EnergyManagement" 1073741824 "31_MultifunctionalSteeringWheel" 0 "32_OnlineAccess" 0 "33_ExternalWirelessCommunication" 0 "34_GPS_Localization" 0 "35_ExteriorSound" 0 "36_Preheater" 0 "37_HighVoltage_WirelessChargingStation" 0 "40_Diagnosis_Energy" 0 "41_Diagnosis_Powertrain" 0 "42_Diagnosis_FlexRay" 0 "43_Diagnosis_DrivingAssistance" 0 "44_Diagnosis_Infotainment" 0 "45_Diagnosis_Comfort" 0 "46_Diagnosis_Light" 0 "47_Diagnosis_ComfortLINs" 0 "48_Diagnosis_ClimateTmeLINs" 0 "49_<reserved>" 0 "53_Lock_Unlock" 0 "54_<reserved>" 0 "55_Dimming" 0 "56_ChargingStatus" ;
VAL_ 2600468575 NM_RGS_VR_SNI_10 43 "RGS_VR_SNI" ;
VAL_ 2600468575 NM_RGS_VR_NM_State 0 "Init" 1 "NM_RM_aus_BSM" 2 "NM_RM_aus_PBSM" 4 "NM_NO_aus_RM" 8 "NM_NO_aus_RS" 16 "reserved" 32 "reserved" ;
VAL_ 2600468575 NM_RGS_VR_UDS_CC 0 "Inaktiv" 1 "CC_aktiv" ;
VAL_ 2600468575 NM_RGS_VR_Wakeup_V12 0 "Peripherie_Wakeup_Ursache_nicht_bekannt" 1 "Bus_Wakeup" 2 "KL15_HW" 4 "Gurtbewegung_erkannt" ;
VAL_ 2600468575 NM_RGS_VR_NM_aktiv_KL15 0 "Inaktiv" 1 "KL15_EIN" ;
VAL_ 2600468575 NM_RGS_VR_NM_aktiv_Diag 0 "Inaktiv" 1 "Diagnose_aktiv" ;
VAL_ 2600468575 NM_RGS_VR_NM_aktiv_Tmin 0 "Inaktiv" 1 "Mindestaktivzeit" ;
VAL_ 2600468575 NM_aktiv_Gurtbewegung_VR 0 "Inaktiv" 1 "Aktiv" ;
VAL_ 567 NVEM_Bordnetzdiagnose 0 "kein_Fehler" 1 "Warnung_1" 2 "Warnung_2" 3 "Warnung_3" ;
VAL_ 567 NVEM_Last_Anf 0 "keine Anforderung" 1 "Verbraucher_Anforderung_Stufe_1" 2 "Verbraucher_Anforderung_Stufe_2" 3 "Verbraucher_Anforderung_Stufe_3" ;
VAL_ 567 BEM_HL_Regelung_Status 0 "HL_Regelung_inaktiv_(vor_und_waehrend_Motorstart)" 1 "HL_Regelung_Stufe_1" 2 "HL_Regelung_Stufe_2" 3 "HL_Regelung_Stufe_3" 4 "Verbrauchernotabschaltung_(VNA)" 5 "HL_Regelung_Stufe_5" 7 "Default" ;
VAL_ 567 NVEM_Abschaltstufe 0 "Stufe_0_keine_Einschraenkung" 1 "Stufe_1" 2 "Stufe_2" 3 "Stufe_3" ;
VAL_ 567 NVEM_NV_BAT_ZellStatus_Index_Anf 0 "Cell_Nr_1" 1 "Cell_Nr_2" 2 "Cell_Nr_3" 3 "Cell_Nr_4" 4 "Cell_Nr_5" 5 "Cell_Nr_6" 6 "Cell_Nr_7" 7 "Cell_Nr_8" 8 "Cell_Nr_9" 9 "Cell_Nr_10" 10 "Cell_Nr_11" 11 "Cell_Nr_12" 12 "Cell_Nr_13" 13 "Cell_Nr_14" 14 "Cell_Nr_15" 15 "Cell_Nr_16" ;
VAL_ 567 NVEM_NV_BAT_ZellStatus_Typ_Anf 0 "Init" 1 "Voltage" 2 "Temperature" 3 "Voltage limit" 4 "SoF" 5 "SoH_C" 6 "reserved" 7 "reserved" ;
VAL_ 567 NVEM_Freigabe_OTA 0 "Init" 1 "Keine_Freigabe" 2 "Freigabe" ;
VAL_ 567 BEM_Generatordiagnose 0 "keine Anzeige" 1 "Ladekontrollanzeige ein (Vorhalt)" 2 "rotes Batteriesymbol und Text (Generator defekt)" 3 "Hybrid_DCDC_Wandler_defekt" ;
VAL_ 567 NVEM_DC_uSoll_NV 255 "Fehler" ;
VAL_ 567 NVEM_DC_iSoll_NV 254 "Init" 255 "Fehler" ;
VAL_ 567 BEM_Batt_Ab 0 "verbunden" 1 "nicht_verbunden" ;
VAL_ 567 BEM_Red_Innengeblaese 0 "keine Reduzierung" 1 "Reduzierung Stufe 1" 2 "Reduzierung Stufe 2" 3 "Reduzierung Stufe 2 und Abschaltung Kompressor" ;
VAL_ 567 NVEM_MV_DC_uMinLV 126 "Init" 127 "Fehler" ;
VAL_ 567 NVEM_MV_DC_uSollLV 126 "Init" 127 "Fehler" ;
VAL_ 567 BEM_STH_Einschaltverbot 0 "volle Verfuegbarkeit Standheizung/-lueftung" 1 "Standheizung/-lueftung nicht aktivierbar" ;
VAL_ 567 BEM_STH_Zielzeit 14 "Init" 15 "Fehler" ;
VAL_ 567 NVEM_Verbraucher_Information 0 "Keine_Anzeige" 1 "MMI_Vorwarnung" 2 "Anzeige_Verbraucherabschaltung" 3 "reserviert" 4 "reserviert" 5 "reserviert" 6 "Init" 7 "Fehler" ;
VAL_ 567 NVEM3_Absch_SCR 0 "Init" 1 "Abschaltung_SCR" ;
VAL_ 567 NVEM_Bordnetz_Information 0 "keine_Anzeige" 1 "NV_Batterie_iO" 2 "NV_Batterie_laden" 3 "NV_Batterie_pruefen" 4 "NV_Batterie_schwach" 5 "NV_Batterie_Ab" 6 "NV_Batterie_Service" 7 "NV_Energiesystem_unplausibel" 8 "Ladekontrollleuchte" 9 "Generator_defekt" 10 "reserviert" 11 "reserviert" 12 "reserviert" 13 "reserviert" 14 "Init" 15 "Fehler" ;
VAL_ 567 NVEM_MV_DC_iSoll_NV 254 "Init" 255 "Fehler" ;
VAL_ 2589283656 ORU_Warnung 0 "keine_Anzeige" 1 "Update_unvollstaendig_Prio1" 2 "Update_fehlgeschlagen_Prio1" 3 "reserviert" ;
VAL_ 2589283656 ORU_Status 0 "IDLE" 1 "PENDING" 2 "PREPARATION" 3 "PREPARATION_HV" 4 "RUNNING" 5 "RUNNING_HV" 6 "PENDING_NOTREADY" 7 "FAILURE_POWERTRAIN_DISABLED" ;
VAL_ 2527679787 WLC1_Systemzustand 0 "Wireless_Charger_off" 1 "InitWert_Wireless_Charger_on" ;
VAL_ 2527679787 WLC2_Systemzustand 0 "Wireless_Charger_off" 1 "InitWert_Wireless_Charger_on" ;
VAL_ 2527679787 RA_Frequency_unit 0 "1_kHz" 1 "100_kHz" ;
VAL_ 2527679787 RA_AM_Tuning 0 "frequency_locked" 1 "AM_tuning" ;
VAL_ 2463978781 RGS_VL_Anforderung 0 "keine_Aktion" 1 "Straffung_1" 2 "Straffung_2" 3 "Straffung_3" 4 "Straffung_4" 5 "Straffung_5" 6 "Straffung_6" 7 "Straffung_7" 8 "Straffung_8" 9 "Straffung_9" 10 "Straffung_10" 11 "Straffung_11" 12 "Straffung_12" 13 "Straffung_13" 14 "Straffung_14" 15 "Straffung_15" 16 "Straffung_16" 17 "Straffung_17" 18 "Straffung_18" 19 "Straffung_19" 20 "Straffung_20" 21 "Straffung_21" 22 "Loesekurve_2" 23 "Crashabschaltung" 24 "Gurtlosereduzierung" 25 "Antipatina" 26 "Gurtparken_1" 27 "Gurtparken_2" 28 "Funktion_beenden" 31 "Init" ;
VAL_ 2463978781 RGS_VR_Anforderung 0 "keine_Aktion" 1 "Straffung_1" 2 "Straffung_2" 3 "Straffung_3" 4 "Straffung_4" 5 "Straffung_5" 6 "Straffung_6" 7 "Straffung_7" 8 "Straffung_8" 9 "Straffung_9" 10 "Straffung_10" 11 "Straffung_11" 12 "Straffung_12" 13 "Straffung_13" 14 "Straffung_14" 15 "Straffung_15" 16 "Straffung_16" 17 "Straffung_17" 18 "Straffung_18" 19 "Straffung_19" 20 "Straffung_20" 21 "Straffung_21" 22 "Loesekurve_2" 23 "Crashabschaltung" 24 "Gurtlosereduzierung" 25 "Antipatina" 26 "Gurtparken_1" 27 "Gurtparken_2" 28 "Funktion_beenden" 31 "Init" ;
VAL_ 2463978781 RGS_HL_Anforderung 0 "keine_Aktion" 1 "Straffung_1" 2 "Straffung_2" 3 "Straffung_3" 4 "Straffung_4" 5 "Straffung_5" 6 "Straffung_6" 7 "Straffung_7" 8 "Straffung_8" 9 "Straffung_9" 10 "Straffung_10" 11 "Straffung_11" 12 "Straffung_12" 13 "Straffung_13" 14 "Straffung_14" 15 "Straffung_15" 16 "Straffung_16" 17 "Straffung_17" 18 "Straffung_18" 19 "Straffung_19" 20 "Straffung_20" 21 "Straffung_21" 22 "Loesekurve_2" 23 "Crashabschaltung" 24 "Gurtlosereduzierung" 25 "Antipatina" 26 "Gurtparken_1" 27 "Gurtparken_2" 28 "Funktion_beenden" 31 "Init" ;
VAL_ 2463978781 RGS_HR_Anforderung 0 "keine_Aktion" 1 "Straffung_1" 2 "Straffung_2" 3 "Straffung_3" 4 "Straffung_4" 5 "Straffung_5" 6 "Straffung_6" 7 "Straffung_7" 8 "Straffung_8" 9 "Straffung_9" 10 "Straffung_10" 11 "Straffung_11" 12 "Straffung_12" 13 "Straffung_13" 14 "Straffung_14" 15 "Straffung_15" 16 "Straffung_16" 17 "Straffung_17" 18 "Straffung_18" 19 "Straffung_19" 20 "Straffung_20" 21 "Straffung_21" 22 "Loesekurve_2" 23 "Crashabschaltung" 24 "Gurtlosereduzierung" 25 "Antipatina" 26 "Gurtparken_1" 27 "Gurtparken_2" 28 "Funktion_beenden" 31 "Init" ;
VAL_ 2463978781 RGS_VL_Nachlauf_2 0 "Nachlauf_2_nicht_aktiv" 1 "Nachlauf_2_aktiv" ;
VAL_ 2463978781 RGS_VR_Nachlauf_2 0 "Nachlauf_2_nicht_aktiv" 1 "Nachlauf_2_aktiv" ;
VAL_ 2463978781 RGS_HL_Nachlauf_2 0 "Nachlauf_2_nicht_aktiv" 1 "Nachlauf_2_aktiv" ;
VAL_ 2463978781 RGS_HR_Nachlauf_2 0 "Nachlauf_2_nicht_aktiv" 1 "Nachlauf_2_aktiv" ;
VAL_ 2463978781 RGS_Nachlauf_allg 0 "Nachlauf_nicht_aktiv" 1 "Nachlauf_aktiv" ;
VAL_ 2463978781 RGS_Loesen_erlaubt 0 "Loesen_nicht_erlaubt" 1 "Loesen_erlaubt" ;
VAL_ 535 RGS_HL_Gurtgeschwindigkeit 0 "Einlaufgeschwindigkeit_zu_hoch" 1022 "Auszugsgeschwindigkeit_zu_hoch" 1023 "Fehler" ;
VAL_ 535 RGS_HL_Gurtbandauszug 4094 "Init" 4095 "Fehler" ;
VAL_ 535 RGS_HL_keine_Straffung_Unterspg 0 "Fehler_aktiv" 1 "Fehler_nicht_aktiv" ;
VAL_ 535 RGS_HL_nicht_programmiert 0 "Fehler_aktiv" 1 "Fehler_nicht_aktiv" ;
VAL_ 535 RGS_HL_Uebertemperatur_defekt 0 "Fehler_aktiv" 1 "Fehler_nicht_aktiv" ;
VAL_ 535 RGS_HL_Bauteilfehler 0 "Fehler_aktiv" 1 "Fehler_nicht_aktiv" ;
VAL_ 535 RGS_HL_keine_Straffung_Ueberspg 0 "Fehler_aktiv" 1 "Fehler_nicht_aktiv" ;
VAL_ 535 RGS_HL_Max_Gurtlosezyklen 0 "Fehler_aktiv" 1 "Fehler_nicht_aktiv" ;
VAL_ 535 RGS_HL_Temp 254 "Init" 255 "Fehler" ;
VAL_ 535 RGS_HL_Unterspannung 0 "Fehler_aktiv" 1 "Fehler_nicht_aktiv" ;
VAL_ 535 RGS_HL_Max_Straffzyklenfehler 0 "Fehler_aktiv" 1 "Fehler_nicht_aktiv" ;
VAL_ 535 RGS_HL_Max_Haptikzyklenfehler 0 "Fehler_aktiv" 1 "Fehler_nicht_aktiv" ;
VAL_ 535 RGS_HL_Crashabschaltung 0 "Fehler_aktiv" 1 "Fehler_nicht_aktiv" ;
VAL_ 535 RGS_HL_Ueberspannung 0 "Fehler_aktiv" 1 "Fehler_nicht_aktiv" ;
VAL_ 535 RGS_HL_Motorfehler 0 "Fehler_aktiv" 1 "Fehler_nicht_aktiv" ;
VAL_ 535 RGS_HL_InPos 0 "Out_of_Position" 1 "In_Position" ;
VAL_ 535 RGS_HL_Strom 0 "Inaktiv" 254 "Init" 255 "Fehler" ;
VAL_ 535 RGS_HL_Status 0 "keine_Aktion" 1 "Straffung_1" 2 "Straffung_2" 3 "Straffung_3" 4 "Straffung_4" 5 "Straffung_5" 6 "Straffung_6" 7 "Straffung_7" 8 "Straffung_8" 9 "Straffung_9" 10 "Straffung_10" 11 "Straffung_11" 12 "Straffung_12" 13 "Straffung_13" 14 "Straffung_14" 15 "Straffung_15" 16 "Straffung_16" 17 "Straffung_17" 18 "Straffung_18" 19 "Straffung_19" 20 "Straffung_20" 21 "Straffung_21" 22 "Loesekurve_2" 23 "Crashabschaltung" 24 "Gurtlosereduzierung" 25 "Antipatina" 26 "Gurtparken_1" 27 "Gurtparken_2" 28 "Funktion_beenden" 29 "Fehlerhafte_Straffanforderung" 30 "Fehlerhafte_Straffdurchfuehrung" 31 "Init" ;
VAL_ 535 RGS_HL_Max_NGU_Zyklenfehler 0 "Fehler_aktiv" 1 "Fehler_nicht_aktiv" ;
VAL_ 535 RGS_HL_Max_P2P_Zyklenfehler 0 "Fehler_aktiv" 1 "Fehler_nicht_aktiv" ;
VAL_ 535 RGS_HL_EEPROM_RAM_ROM_Fehler 0 "Fehler_aktiv" 1 "Fehler_nicht_aktiv" ;
VAL_ 539 RGS_HR_Gurtgeschwindigkeit 0 "Einlaufgeschwindigkeit_zu_hoch" 1022 "Auszuggeschwindigkeit_zu_hoch" 1023 "Fehler" ;
VAL_ 539 RGS_HR_Gurtbandauszug 4094 "Init" 4095 "Fehler" ;
VAL_ 539 RGS_HR_keine_Straffung_Unterspg 0 "Fehler_aktiv" 1 "Fehler_nicht_aktiv" ;
VAL_ 539 RGS_HR_nicht_programmiert 0 "Fehler_aktiv" 1 "Fehler_nicht_aktiv" ;
VAL_ 539 RGS_HR_Uebertemperatur_defekt 0 "Fehler_aktiv" 1 "Fehler_nicht_aktiv" ;
VAL_ 539 RGS_HR_Bauteilfehler 0 "Fehler_aktiv" 1 "Fehler_nicht_aktiv" ;
VAL_ 539 RGS_HR_keine_Straffung_Ueberspg 0 "Fehler_aktiv" 1 "Fehler_nicht_aktiv" ;
VAL_ 539 RGS_HR_Max_Gurtlosezyklen 0 "Fehler_aktiv" 1 "Fehler_nicht_aktiv" ;
VAL_ 539 RGS_HR_Temp 254 "Init" 255 "Fehler" ;
VAL_ 539 RGS_HR_Unterspannung 0 "Fehler_aktiv" 1 "Fehler_nicht_aktiv" ;
VAL_ 539 RGS_HR_Max_Straffzyklenfehler 0 "Fehler_aktiv" 1 "Fehler_nicht_aktiv" ;
VAL_ 539 RGS_HR_Max_Haptikzyklenfehler 0 "Fehler_aktiv" 1 "Fehler_nicht_aktiv" ;
VAL_ 539 RGS_HR_Crashabschaltung 0 "Fehler_aktiv" 1 "Fehler_nicht_aktiv" ;
VAL_ 539 RGS_HR_Ueberspannung 0 "Fehler_aktiv" 1 "Fehler_nicht_aktiv" ;
VAL_ 539 RGS_HR_Motorfehler 0 "Fehler_aktiv" 1 "Fehler_nicht_aktiv" ;
VAL_ 539 RGS_HR_InPos 0 "Out_of_Position" 1 "In_Position" ;
VAL_ 539 RGS_HR_Strom 0 "Inaktiv" 254 "Init" 255 "Fehler" ;
VAL_ 539 RGS_HR_Status 0 "keine_Aktion" 1 "Straffung_1" 2 "Straffung_2" 3 "Straffung_3" 4 "Straffung_4" 5 "Straffung_5" 6 "Straffung_6" 7 "Straffung_7" 8 "Straffung_8" 9 "Straffung_9" 10 "Straffung_10" 11 "Straffung_11" 12 "Straffung_12" 13 "Straffung_13" 14 "Straffung_14" 15 "Straffung_15" 16 "Straffung_16" 17 "Straffung_17" 18 "Straffung_18" 19 "Straffung_19" 20 "Straffung_20" 21 "Straffung_21" 22 "Loesekurve_2" 23 "Crashabschaltung" 24 "Gurtlosereduzierung" 25 "Antipatina" 26 "Gurtparken_1" 27 "Gurtparken_2" 28 "Funktion_beenden" 29 "Fehlerhafte_Straffanforderung" 30 "Fehlerhafte_Straffdurchfuehrung" 31 "Init" ;
VAL_ 539 RGS_HR_Max_NGU_Zyklenfehler 0 "Fehler_aktiv" 1 "Fehler_nicht_aktiv" ;
VAL_ 539 RGS_HR_Max_P2P_Zyklenfehler 0 "Fehler_aktiv" 1 "Fehler_nicht_aktiv" ;
VAL_ 539 RGS_HR_EEPROM_RAM_ROM_Fehler 0 "Fehler_aktiv" 1 "Fehler_nicht_aktiv" ;
VAL_ 984 RGS_VL_Gurtgeschwindigkeit 0 "Einlaufgeschwindigkeit_zu_hoch" 1022 "Auszuggeschwindigkeit_zu_hoch" 1023 "Fehler" ;
VAL_ 984 RGS_VL_Gurtbandauszug 4094 "Init" 4095 "Fehler" ;
VAL_ 984 RGS_VL_keineStraffungUnterspg 0 "Fehler_aktiv" 1 "Fehler_nicht_aktiv" ;
VAL_ 984 RGS_VL_nicht_programmiert 0 "Fehler_aktiv" 1 "Fehler_nicht_aktiv" ;
VAL_ 984 RGS_VL_Uebertemperatur_defekt 0 "Fehler_aktiv" 1 "Fehler_nicht_aktiv" ;
VAL_ 984 RGS_VL_Bauteilfehler 0 "Fehler_aktiv" 1 "Fehler_nicht_aktiv" ;
VAL_ 984 RGS_VL_keineStraffungUeberspg 0 "Fehler_aktiv" 1 "Fehler_nicht_aktiv" ;
VAL_ 984 RGS_VL_Max_Gurtlosezyklen 0 "Fehler_aktiv" 1 "Fehler_nicht_aktiv" ;
VAL_ 984 RGS_VL_Temp 254 "Init" 255 "Fehler" ;
VAL_ 984 RGS_VL_Unterspannung 0 "Fehler_aktiv" 1 "Fehler_nicht_aktiv" ;
VAL_ 984 RGS_VL_Max_Straffzyklenfehler 0 "Fehler_aktiv" 1 "Fehler_nicht_aktiv" ;
VAL_ 984 RGS_VL_Max_Haptikzyklenfehler 0 "Fehler_aktiv" 1 "Fehler_nicht_aktiv" ;
VAL_ 984 RGS_VL_Crashabschaltung 0 "Fehler_aktiv" 1 "Fehler_nicht_aktiv" ;
VAL_ 984 RGS_VL_Ueberspannung 0 "Fehler_aktiv" 1 "Fehler_nicht_aktiv" ;
VAL_ 984 RGS_VL_Motorfehler 0 "Fehler_aktiv" 1 "Fehler_nicht_aktiv" ;
VAL_ 984 RGS_VL_InPos 0 "Out_of_Position" 1 "In_Position" ;
VAL_ 984 RGS_VL_Strom 0 "Inaktiv" 254 "Init" 255 "Fehler" ;
VAL_ 984 RGS_VL_Status 0 "keine_Aktion" 1 "Straffung_1" 2 "Straffung_2" 3 "Straffung_3" 4 "Straffung_4" 5 "Straffung_5" 6 "Straffung_6" 7 "Straffung_7" 8 "Straffung_8" 9 "Straffung_9" 10 "Straffung_10" 11 "Straffung_11" 12 "Straffung_12" 13 "Straffung_13" 14 "Straffung_14" 15 "Straffung_15" 16 "Straffung_16" 17 "Straffung_17" 18 "Straffung_18" 19 "Straffung_19" 20 "Straffung_20" 21 "Straffung_21" 22 "Loesekurve_2" 23 "Crashabschaltung" 24 "Gurtlosereduzierung" 25 "Antipatina" 26 "Gurtparken_1" 27 "Gurtparken_2" 28 "Funktion_beenden" 29 "Fehlerhafte_Straffanforderung" 30 "Fehlerhafte_Straffdurchfuehrung" 31 "Init" ;
VAL_ 984 RGS_VL_Max_NGU_Zyklenfehler 0 "Fehler_aktiv" 1 "Fehler_nicht_aktiv" ;
VAL_ 984 RGS_VL_Max_P2P_Zyklenfehler 0 "Fehler_aktiv" 1 "Fehler_nicht_aktiv" ;
VAL_ 984 RGS_VL_EEPROM_RAM_ROM_Fehler 0 "Fehler_aktiv" 1 "Fehler_nicht_aktiv" ;
VAL_ 985 RGS_VR_Gurtgeschwindigkeit 0 "Einlaufgeschwindigkeit_zu_hoch" 1022 "Auszuggeschwindigkeit_zu_hoch" 1023 "Fehler" ;
VAL_ 985 RGS_VR_Gurtbandauszug 4094 "Init" 4095 "Fehler" ;
VAL_ 985 RGS_VR_keineStraffungUnterspg 0 "Fehler_aktiv" 1 "Fehler_nicht_aktiv" ;
VAL_ 985 RGS_VR_nicht_programmiert 0 "Fehler_aktiv" 1 "Fehler_nicht_aktiv" ;
VAL_ 985 RGS_VR_Uebertemperatur_defekt 0 "Fehler_aktiv" 1 "Fehler_nicht_aktiv" ;
VAL_ 985 RGS_VR_Bauteilfehler 0 "Fehler_aktiv" 1 "Fehler_nicht_aktiv" ;
VAL_ 985 RGS_VR_keineStraffungUeberspg 0 "Fehler_aktiv" 1 "Fehler_nicht_aktiv" ;
VAL_ 985 RGS_VR_Max_Gurtlosezyklen 0 "Fehler_aktiv" 1 "Fehler_nicht_aktiv" ;
VAL_ 985 RGS_VR_Temp 254 "Init" 255 "Fehler" ;
VAL_ 985 RGS_VR_Unterspannung 0 "Fehler_aktiv" 1 "Fehler_nicht_aktiv" ;
VAL_ 985 RGS_VR_Max_Straffzyklenfehler 0 "Fehler_aktiv" 1 "Fehler_nicht_aktiv" ;
VAL_ 985 RGS_VR_Max_Haptikzyklenfehler 0 "Fehler_aktiv" 1 "Fehler_nicht_aktiv" ;
VAL_ 985 RGS_VR_Crashabschaltung 0 "Fehler_aktiv" 1 "Fehler_nicht_aktiv" ;
VAL_ 985 RGS_VR_Ueberspannung 0 "Fehler_aktiv" 1 "Fehler_nicht_aktiv" ;
VAL_ 985 RGS_VR_Motorfehler 0 "Fehler_aktiv" 1 "Fehler_nicht_aktiv" ;
VAL_ 985 RGS_VR_InPos 0 "Out_of_Position" 1 "In_Position" ;
VAL_ 985 RGS_VR_Strom 0 "Inaktiv" 254 "Init" 255 "Fehler" ;
VAL_ 985 RGS_VR_Status 0 "keine_Aktion" 1 "Straffung_1" 2 "Straffung_2" 3 "Straffung_3" 4 "Straffung_4" 5 "Straffung_5" 6 "Straffung_6" 7 "Straffung_7" 8 "Straffung_8" 9 "Straffung_9" 10 "Straffung_10" 11 "Straffung_11" 12 "Straffung_12" 13 "Straffung_13" 14 "Straffung_14" 15 "Straffung_15" 16 "Straffung_16" 17 "Straffung_17" 18 "Straffung_18" 19 "Straffung_19" 20 "Straffung_20" 21 "Straffung_21" 22 "Loesekurve_2" 23 "Crashabschaltung" 24 "Gurtlosereduzierung" 25 "Antipatina" 26 "Gurtparken_1" 27 "Gurtparken_2" 28 "Funktion_beenden" 29 "Fehlerhafte_Straffanforderung" 30 "Fehlerhafte_Straffdurchfuehrung" 31 "Init" ;
VAL_ 985 RGS_VR_Max_NGU_Zyklenfehler 0 "Fehler_aktiv" 1 "Fehler_nicht_aktiv" ;
VAL_ 985 RGS_VR_Max_P2P_Zyklenfehler 0 "Fehler_aktiv" 1 "Fehler_nicht_aktiv" ;
VAL_ 985 RGS_VR_EEPROM_RAM_ROM_Fehler 0 "Fehler_aktiv" 1 "Fehler_nicht_aktiv" ;
