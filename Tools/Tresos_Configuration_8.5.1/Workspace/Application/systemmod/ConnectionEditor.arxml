AUTOSAR XML (schema 4-2-1)
package /MQBw_Baseline
  system System
    system mapping EBConnectionEditorMappings: sender-receiver-to-signal-group-mapping{data-element=Geltungsbereich_MQBw_Baseline.P_CAN_CanDataOut_Frame_0.EcuCanDataOut, signal-group=DataOutGroup_0, type-mapping=sender-rec-record-type-mapping=record-element-mappings=[{application-record-element=u8Byte0, system-signal=DataOut_0_Byte_0}, {application-record-element=u8Byte1, system-signal=DataOut_0_Byte_1}, {application-record-element=u8Byte2, system-signal=DataOut_0_Byte_2}, {application-record-element=u8Byte3, system-signal=DataOut_0_Byte_3}, {application-record-element=u8Byte4, system-signal=DataOut_0_Byte_4}, {application-record-element=u8Byte5, system-signal=DataOut_0_Byte_5}, {application-record-element=u8Byte6, system-signal=DataOut_0_Byte_6}, {application-record-element=u8Byte7, system-signal=DataOut_0_Byte_7}, {application-record-element=u8Byte8, system-signal=DataOut_0_Byte_8}, {application-record-element=u8Byte9, system-signal=DataOut_0_Byte_9}, {application-record-element=u8Byte10, system-signal=DataOut_0_Byte_10}, {application-record-element=u8Byte11, system-signal=DataOut_0_Byte_11}, {application-record-element=u8Byte12, system-signal=DataOut_0_Byte_12}, {application-record-element=u8Byte13, system-signal=DataOut_0_Byte_13}, {application-record-element=u8Byte14, system-signal=DataOut_0_Byte_14}, {application-record-element=u8Byte15, system-signal=DataOut_0_Byte_15}, {application-record-element=u8Byte16, system-signal=DataOut_0_Byte_16}, {application-record-element=u8Byte17, system-signal=DataOut_0_Byte_17}, {application-record-element=u8Byte18, system-signal=DataOut_0_Byte_18}, {application-record-element=u8Byte19, system-signal=DataOut_0_Byte_19}, {application-record-element=u8Byte20, system-signal=DataOut_0_Byte_20}, {application-record-element=u8Byte21, system-signal=DataOut_0_Byte_21}, {application-record-element=u8Byte22, system-signal=DataOut_0_Byte_22}, {application-record-element=u8Byte23, system-signal=DataOut_0_Byte_23}, {application-record-element=u8Byte24, system-signal=DataOut_0_Byte_24}, {application-record-element=u8Byte25, system-signal=DataOut_0_Byte_25}, {application-record-element=u8Byte26, system-signal=DataOut_0_Byte_26}, {application-record-element=u8Byte27, system-signal=DataOut_0_Byte_27}, {application-record-element=u8Byte28, system-signal=DataOut_0_Byte_28}, {application-record-element=u8Byte29, system-signal=DataOut_0_Byte_29}, {application-record-element=u8Byte30, system-signal=DataOut_0_Byte_30}]}
