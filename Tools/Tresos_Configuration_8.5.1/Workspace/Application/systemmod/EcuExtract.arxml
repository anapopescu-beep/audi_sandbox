[part 2 of 2: package /EcuExtract]
AUTOSAR XML (schema 4-2-1)
package /EcuExtract  (continued)
  flat map FlatMap
    909 x flat instance descriptor:
      ACC_0: upstream-reference=Geltungsbereich_MQBw_Baseline.ACC, ecu-extract-reference=TopLevelCompositionPrototype.ACC
      pclDioIfServices_1: upstream-reference=ACC.Geltungsbereich_MQBw_Baseline.pclDioIfServices, ecu-extract-reference=ACC.TopLevelCompositionPrototype.pclDioIfServices
      prrSolenoidProfile_2: upstream-reference=ACC.Geltungsbereich_MQBw_Baseline.prrSolenoidProfile, ecu-extract-reference=ACC.TopLevelCompositionPrototype.prrSolenoidProfile
      au8SelectedProfile_3: upstream-reference=prrSolenoidProfile.ACC.Geltungsbereich_MQBw_Baseline.au8SelectedProfile, ecu-extract-reference=prrSolenoidProfile.ACC.TopLevelCompositionPrototype.au8SelectedProfile
      pseAccRestartInit_4: upstream-reference=ACC.Geltungsbereich_MQBw_Baseline.pseAccRestartInit, ecu-extract-reference=ACC.TopLevelCompositionPrototype.pseAccRestartInit
      pseAccTemperatureSpiData_5: upstream-reference=ACC.Geltungsbereich_MQBw_Baseline.pseAccTemperatureSpiData, ecu-extract-reference=ACC.TopLevelCompositionPrototype.pseAccTemperatureSpiData
      pseCheckAccAlarmbPin_6: upstream-reference=ACC.Geltungsbereich_MQBw_Baseline.pseCheckAccAlarmbPin, ecu-extract-reference=ACC.TopLevelCompositionPrototype.pseCheckAccAlarmbPin
      psr3DAcceleration_7: upstream-reference=ACC.Geltungsbereich_MQBw_Baseline.psr3DAcceleration, ecu-extract-reference=ACC.TopLevelCompositionPrototype.psr3DAcceleration
      st3DAccel_8: upstream-reference=psr3DAcceleration.ACC.Geltungsbereich_MQBw_Baseline.st3DAccel, ecu-extract-reference=psr3DAcceleration.ACC.TopLevelCompositionPrototype.st3DAccel
      s16AxAppl_9: upstream-reference=psr3DAcceleration.ACC.Geltungsbereich_MQBw_Baseline.st3DAccel.s16AxAppl, ecu-extract-reference=psr3DAcceleration.ACC.TopLevelCompositionPrototype.st3DAccel.s16AxAppl
      s16AyAppl_10: upstream-reference=psr3DAcceleration.ACC.Geltungsbereich_MQBw_Baseline.st3DAccel.s16AyAppl, ecu-extract-reference=psr3DAcceleration.ACC.TopLevelCompositionPrototype.st3DAccel.s16AyAppl
      s16AzAppl_11: upstream-reference=psr3DAcceleration.ACC.Geltungsbereich_MQBw_Baseline.st3DAccel.s16AzAppl, ecu-extract-reference=psr3DAcceleration.ACC.TopLevelCompositionPrototype.st3DAccel.s16AzAppl
      psrACCServices_12: upstream-reference=ACC.Geltungsbereich_MQBw_Baseline.psrACCServices, ecu-extract-reference=ACC.TopLevelCompositionPrototype.psrACCServices
      u8AccInitStateMachine_13: upstream-reference=psrACCServices.ACC.Geltungsbereich_MQBw_Baseline.u8AccInitStateMachine, ecu-extract-reference=psrACCServices.ACC.TopLevelCompositionPrototype.u8AccInitStateMachine
      psrAccStatusFailiureSource_14: upstream-reference=ACC.Geltungsbereich_MQBw_Baseline.psrAccStatusFailiureSource, ecu-extract-reference=ACC.TopLevelCompositionPrototype.psrAccStatusFailiureSource
      u32AccAlarmRegStatus_15: upstream-reference=psrAccStatusFailiureSource.ACC.Geltungsbereich_MQBw_Baseline.u32AccAlarmRegStatus, ecu-extract-reference=psrAccStatusFailiureSource.ACC.TopLevelCompositionPrototype.u32AccAlarmRegStatus
      u8AccAlarmbPreinitSeqStatus_16: upstream-reference=psrAccStatusFailiureSource.ACC.Geltungsbereich_MQBw_Baseline.u8AccAlarmbPreinitSeqStatus, ecu-extract-reference=psrAccStatusFailiureSource.ACC.TopLevelCompositionPrototype.u8AccAlarmbPreinitSeqStatus
      u8AccCRCStatus_17: upstream-reference=psrAccStatusFailiureSource.ACC.Geltungsbereich_MQBw_Baseline.u8AccCRCStatus, ecu-extract-reference=psrAccStatusFailiureSource.ACC.TopLevelCompositionPrototype.u8AccCRCStatus
      u8AccReturnStatus_18: upstream-reference=psrAccStatusFailiureSource.ACC.Geltungsbereich_MQBw_Baseline.u8AccReturnStatus, ecu-extract-reference=psrAccStatusFailiureSource.ACC.TopLevelCompositionPrototype.u8AccReturnStatus
      u8AccelAxisBroken_19: upstream-reference=psrAccStatusFailiureSource.ACC.Geltungsbereich_MQBw_Baseline.u8AccelAxisBroken, ecu-extract-reference=psrAccStatusFailiureSource.ACC.TopLevelCompositionPrototype.u8AccelAxisBroken
      psrAccelMtrPerSecSqd_20: upstream-reference=ACC.Geltungsbereich_MQBw_Baseline.psrAccelMtrPerSecSqd, ecu-extract-reference=ACC.TopLevelCompositionPrototype.psrAccelMtrPerSecSqd
      stAccelMtrPerSecSqd_21: upstream-reference=psrAccelMtrPerSecSqd.ACC.Geltungsbereich_MQBw_Baseline.stAccelMtrPerSecSqd, ecu-extract-reference=psrAccelMtrPerSecSqd.ACC.TopLevelCompositionPrototype.stAccelMtrPerSecSqd
      s16AxAppl_22: upstream-reference=psrAccelMtrPerSecSqd.ACC.Geltungsbereich_MQBw_Baseline.stAccelMtrPerSecSqd.s16AxAppl, ecu-extract-reference=psrAccelMtrPerSecSqd.ACC.TopLevelCompositionPrototype.stAccelMtrPerSecSqd.s16AxAppl
      s16AyAppl_23: upstream-reference=psrAccelMtrPerSecSqd.ACC.Geltungsbereich_MQBw_Baseline.stAccelMtrPerSecSqd.s16AyAppl, ecu-extract-reference=psrAccelMtrPerSecSqd.ACC.TopLevelCompositionPrototype.stAccelMtrPerSecSqd.s16AyAppl
      s16AzAppl_24: upstream-reference=psrAccelMtrPerSecSqd.ACC.Geltungsbereich_MQBw_Baseline.stAccelMtrPerSecSqd.s16AzAppl, ecu-extract-reference=psrAccelMtrPerSecSqd.ACC.TopLevelCompositionPrototype.stAccelMtrPerSecSqd.s16AzAppl
      ptrpAsrOsServicesACC_25: upstream-reference=ACC.Geltungsbereich_MQBw_Baseline.ptrpAsrOsServicesACC, ecu-extract-reference=ACC.TopLevelCompositionPrototype.ptrpAsrOsServicesACC
      ptrrSpiIfServices_26: upstream-reference=ACC.Geltungsbereich_MQBw_Baseline.ptrrSpiIfServices, ecu-extract-reference=ACC.TopLevelCompositionPrototype.ptrrSpiIfServices
      ATM_27: upstream-reference=Geltungsbereich_MQBw_Baseline.ATM, ecu-extract-reference=TopLevelCompositionPrototype.ATM
      pclCheckAccAlarmbPin_28: upstream-reference=ATM.Geltungsbereich_MQBw_Baseline.pclCheckAccAlarmbPin, ecu-extract-reference=ATM.TopLevelCompositionPrototype.pclCheckAccAlarmbPin
      pclCheckActuatorState_29: upstream-reference=ATM.Geltungsbereich_MQBw_Baseline.pclCheckActuatorState, ecu-extract-reference=ATM.TopLevelCompositionPrototype.pclCheckActuatorState
      pclCheckAdc_30: upstream-reference=ATM.Geltungsbereich_MQBw_Baseline.pclCheckAdc, ecu-extract-reference=ATM.TopLevelCompositionPrototype.pclCheckAdc
      pclCheckAdcCalib_31: upstream-reference=ATM.Geltungsbereich_MQBw_Baseline.pclCheckAdcCalib, ecu-extract-reference=ATM.TopLevelCompositionPrototype.pclCheckAdcCalib
      pclCheckCrcOnMcuRegisters_32: upstream-reference=ATM.Geltungsbereich_MQBw_Baseline.pclCheckCrcOnMcuRegisters, ecu-extract-reference=ATM.TopLevelCompositionPrototype.pclCheckCrcOnMcuRegisters
      pclCheckMcuSelfTest_33: upstream-reference=ATM.Geltungsbereich_MQBw_Baseline.pclCheckMcuSelfTest, ecu-extract-reference=ATM.TopLevelCompositionPrototype.pclCheckMcuSelfTest
      pclCheckOpenCircuit_34: upstream-reference=ATM.Geltungsbereich_MQBw_Baseline.pclCheckOpenCircuit, ecu-extract-reference=ATM.TopLevelCompositionPrototype.pclCheckOpenCircuit
      pclCheckPowerStage_35: upstream-reference=ATM.Geltungsbereich_MQBw_Baseline.pclCheckPowerStage, ecu-extract-reference=ATM.TopLevelCompositionPrototype.pclCheckPowerStage
      pclCheckPowerSupplyOV_36: upstream-reference=ATM.Geltungsbereich_MQBw_Baseline.pclCheckPowerSupplyOV, ecu-extract-reference=ATM.TopLevelCompositionPrototype.pclCheckPowerSupplyOV
      pclCheckPowerSupplyUV_37: upstream-reference=ATM.Geltungsbereich_MQBw_Baseline.pclCheckPowerSupplyUV, ecu-extract-reference=ATM.TopLevelCompositionPrototype.pclCheckPowerSupplyUV
      pclCheckSbcStatusInfo_38: upstream-reference=ATM.Geltungsbereich_MQBw_Baseline.pclCheckSbcStatusInfo, ecu-extract-reference=ATM.TopLevelCompositionPrototype.pclCheckSbcStatusInfo
      pclCheckShortToGND_39: upstream-reference=ATM.Geltungsbereich_MQBw_Baseline.pclCheckShortToGND, ecu-extract-reference=ATM.TopLevelCompositionPrototype.pclCheckShortToGND
      pclCheckShortToVBAT_40: upstream-reference=ATM.Geltungsbereich_MQBw_Baseline.pclCheckShortToVBAT, ecu-extract-reference=ATM.TopLevelCompositionPrototype.pclCheckShortToVBAT
      pclCheckSolenoidOvervoltage_41: upstream-reference=ATM.Geltungsbereich_MQBw_Baseline.pclCheckSolenoidOvervoltage, ecu-extract-reference=ATM.TopLevelCompositionPrototype.pclCheckSolenoidOvervoltage
      pclEcuOverTemperature_42: upstream-reference=ATM.Geltungsbereich_MQBw_Baseline.pclEcuOverTemperature, ecu-extract-reference=ATM.TopLevelCompositionPrototype.pclEcuOverTemperature
      pclEvtAccStatusFailure_43: upstream-reference=ATM.Geltungsbereich_MQBw_Baseline.pclEvtAccStatusFailure, ecu-extract-reference=ATM.TopLevelCompositionPrototype.pclEvtAccStatusFailure
      pclEvtActuatorOpenCircuit_44: upstream-reference=ATM.Geltungsbereich_MQBw_Baseline.pclEvtActuatorOpenCircuit, ecu-extract-reference=ATM.TopLevelCompositionPrototype.pclEvtActuatorOpenCircuit
      pclEvtActuatorShortToGND_45: upstream-reference=ATM.Geltungsbereich_MQBw_Baseline.pclEvtActuatorShortToGND, ecu-extract-reference=ATM.TopLevelCompositionPrototype.pclEvtActuatorShortToGND
      pclEvtActuatorShortToVBAT_46: upstream-reference=ATM.Geltungsbereich_MQBw_Baseline.pclEvtActuatorShortToVBAT, ecu-extract-reference=ATM.TopLevelCompositionPrototype.pclEvtActuatorShortToVBAT
      pclEvtActuatorState_47: upstream-reference=ATM.Geltungsbereich_MQBw_Baseline.pclEvtActuatorState, ecu-extract-reference=ATM.TopLevelCompositionPrototype.pclEvtActuatorState
      pclEvtAdcCalibration_48: upstream-reference=ATM.Geltungsbereich_MQBw_Baseline.pclEvtAdcCalibration, ecu-extract-reference=ATM.TopLevelCompositionPrototype.pclEvtAdcCalibration
      pclEvtAdcOutOfOrder_49: upstream-reference=ATM.Geltungsbereich_MQBw_Baseline.pclEvtAdcOutOfOrder, ecu-extract-reference=ATM.TopLevelCompositionPrototype.pclEvtAdcOutOfOrder
      pclEvtEcuoverTemperature_50: upstream-reference=ATM.Geltungsbereich_MQBw_Baseline.pclEvtEcuoverTemperature, ecu-extract-reference=ATM.TopLevelCompositionPrototype.pclEvtEcuoverTemperature
      pclEvtExtWdgOutOfOrder_51: upstream-reference=ATM.Geltungsbereich_MQBw_Baseline.pclEvtExtWdgOutOfOrder, ecu-extract-reference=ATM.TopLevelCompositionPrototype.pclEvtExtWdgOutOfOrder
      pclEvtFlsEcc_52: upstream-reference=ATM.Geltungsbereich_MQBw_Baseline.pclEvtFlsEcc, ecu-extract-reference=ATM.TopLevelCompositionPrototype.pclEvtFlsEcc
      pclEvtMcuCrcRegisters_53: upstream-reference=ATM.Geltungsbereich_MQBw_Baseline.pclEvtMcuCrcRegisters, ecu-extract-reference=ATM.TopLevelCompositionPrototype.pclEvtMcuCrcRegisters
      pclEvtMcuSelftest_54: upstream-reference=ATM.Geltungsbereich_MQBw_Baseline.pclEvtMcuSelftest, ecu-extract-reference=ATM.TopLevelCompositionPrototype.pclEvtMcuSelftest
      pclEvtNvmEcc_55: upstream-reference=ATM.Geltungsbereich_MQBw_Baseline.pclEvtNvmEcc, ecu-extract-reference=ATM.TopLevelCompositionPrototype.pclEvtNvmEcc
      pclEvtNvmNotPrg_56: upstream-reference=ATM.Geltungsbereich_MQBw_Baseline.pclEvtNvmNotPrg, ecu-extract-reference=ATM.TopLevelCompositionPrototype.pclEvtNvmNotPrg
      pclEvtPowerStageFailiure_57: upstream-reference=ATM.Geltungsbereich_MQBw_Baseline.pclEvtPowerStageFailiure, ecu-extract-reference=ATM.TopLevelCompositionPrototype.pclEvtPowerStageFailiure
      pclEvtPowerSupllyOV_58: upstream-reference=ATM.Geltungsbereich_MQBw_Baseline.pclEvtPowerSupllyOV, ecu-extract-reference=ATM.TopLevelCompositionPrototype.pclEvtPowerSupllyOV
      pclEvtPowerSupllyUV_59: upstream-reference=ATM.Geltungsbereich_MQBw_Baseline.pclEvtPowerSupllyUV, ecu-extract-reference=ATM.TopLevelCompositionPrototype.pclEvtPowerSupllyUV
      pclEvtRamEcc_60: upstream-reference=ATM.Geltungsbereich_MQBw_Baseline.pclEvtRamEcc, ecu-extract-reference=ATM.TopLevelCompositionPrototype.pclEvtRamEcc
      pclEvtSbcStatusFailiure_61: upstream-reference=ATM.Geltungsbereich_MQBw_Baseline.pclEvtSbcStatusFailiure, ecu-extract-reference=ATM.TopLevelCompositionPrototype.pclEvtSbcStatusFailiure
      pclEvtSolenoidOvervoltage_62: upstream-reference=ATM.Geltungsbereich_MQBw_Baseline.pclEvtSolenoidOvervoltage, ecu-extract-reference=ATM.TopLevelCompositionPrototype.pclEvtSolenoidOvervoltage
      pclEvtWarmReset_63: upstream-reference=ATM.Geltungsbereich_MQBw_Baseline.pclEvtWarmReset, ecu-extract-reference=ATM.TopLevelCompositionPrototype.pclEvtWarmReset
      pclInjectError_64: upstream-reference=ATM.Geltungsbereich_MQBw_Baseline.pclInjectError, ecu-extract-reference=ATM.TopLevelCompositionPrototype.pclInjectError
      pclModeManagement_65: upstream-reference=ATM.Geltungsbereich_MQBw_Baseline.pclModeManagement, ecu-extract-reference=ATM.TopLevelCompositionPrototype.pclModeManagement
      pclRunEepromMemoryCorruption_66: upstream-reference=ATM.Geltungsbereich_MQBw_Baseline.pclRunEepromMemoryCorruption, ecu-extract-reference=ATM.TopLevelCompositionPrototype.pclRunEepromMemoryCorruption
      pclRunEepromMemoryNotProgrammed_67: upstream-reference=ATM.Geltungsbereich_MQBw_Baseline.pclRunEepromMemoryNotProgrammed, ecu-extract-reference=ATM.TopLevelCompositionPrototype.pclRunEepromMemoryNotProgrammed
      pclRunExtWDTest_68: upstream-reference=ATM.Geltungsbereich_MQBw_Baseline.pclRunExtWDTest, ecu-extract-reference=ATM.TopLevelCompositionPrototype.pclRunExtWDTest
      pclRunPFlashMemoryCorruption_69: upstream-reference=ATM.Geltungsbereich_MQBw_Baseline.pclRunPFlashMemoryCorruption, ecu-extract-reference=ATM.TopLevelCompositionPrototype.pclRunPFlashMemoryCorruption
      pclRunRamMemoryCorruption_70: upstream-reference=ATM.Geltungsbereich_MQBw_Baseline.pclRunRamMemoryCorruption, ecu-extract-reference=ATM.TopLevelCompositionPrototype.pclRunRamMemoryCorruption
      pclRunResetCause_71: upstream-reference=ATM.Geltungsbereich_MQBw_Baseline.pclRunResetCause, ecu-extract-reference=ATM.TopLevelCompositionPrototype.pclRunResetCause
      pseAutotestServices_72: upstream-reference=ATM.Geltungsbereich_MQBw_Baseline.pseAutotestServices, ecu-extract-reference=ATM.TopLevelCompositionPrototype.pseAutotestServices
      ptrpAtmServicesAsrOs_73: upstream-reference=ATM.Geltungsbereich_MQBw_Baseline.ptrpAtmServicesAsrOs, ecu-extract-reference=ATM.TopLevelCompositionPrototype.ptrpAtmServicesAsrOs
      ptrpAtmServicesBswMIf_74: upstream-reference=ATM.Geltungsbereich_MQBw_Baseline.ptrpAtmServicesBswMIf, ecu-extract-reference=ATM.TopLevelCompositionPrototype.ptrpAtmServicesBswMIf
      AdcIf_75: upstream-reference=Geltungsbereich_MQBw_Baseline.AdcIf, ecu-extract-reference=TopLevelCompositionPrototype.AdcIf
      prrAdcBufferServices_76: upstream-reference=AdcIf.Geltungsbereich_MQBw_Baseline.prrAdcBufferServices, ecu-extract-reference=AdcIf.TopLevelCompositionPrototype.prrAdcBufferServices
      aau16HistoricalAdcSamples_77: upstream-reference=prrAdcBufferServices.AdcIf.Geltungsbereich_MQBw_Baseline.aau16HistoricalAdcSamples, ecu-extract-reference=prrAdcBufferServices.AdcIf.TopLevelCompositionPrototype.aau16HistoricalAdcSamples
      u8HistoricalAdcSampleIndex_78: upstream-reference=prrAdcBufferServices.AdcIf.Geltungsbereich_MQBw_Baseline.u8HistoricalAdcSampleIndex, ecu-extract-reference=prrAdcBufferServices.AdcIf.TopLevelCompositionPrototype.u8HistoricalAdcSampleIndex
      pseAdcIfServices_79: upstream-reference=AdcIf.Geltungsbereich_MQBw_Baseline.pseAdcIfServices, ecu-extract-reference=AdcIf.TopLevelCompositionPrototype.pseAdcIfServices
      pseCheckAdc_80: upstream-reference=AdcIf.Geltungsbereich_MQBw_Baseline.pseCheckAdc, ecu-extract-reference=AdcIf.TopLevelCompositionPrototype.pseCheckAdc
      pseCheckAdcCalib_81: upstream-reference=AdcIf.Geltungsbereich_MQBw_Baseline.pseCheckAdcCalib, ecu-extract-reference=AdcIf.TopLevelCompositionPrototype.pseCheckAdcCalib
      pseRawAdcService_82: upstream-reference=AdcIf.Geltungsbereich_MQBw_Baseline.pseRawAdcService, ecu-extract-reference=AdcIf.TopLevelCompositionPrototype.pseRawAdcService
      ptrpAdcIfServicesBswMIf_83: upstream-reference=AdcIf.Geltungsbereich_MQBw_Baseline.ptrpAdcIfServicesBswMIf, ecu-extract-reference=AdcIf.TopLevelCompositionPrototype.ptrpAdcIfServicesBswMIf
      ptrpAsrGptServicesAdcIf_84: upstream-reference=AdcIf.Geltungsbereich_MQBw_Baseline.ptrpAsrGptServicesAdcIf, ecu-extract-reference=AdcIf.TopLevelCompositionPrototype.ptrpAsrGptServicesAdcIf
      ptrpEcuMIfServicesAdcIf_85: upstream-reference=AdcIf.Geltungsbereich_MQBw_Baseline.ptrpEcuMIfServicesAdcIf, ecu-extract-reference=AdcIf.TopLevelCompositionPrototype.ptrpEcuMIfServicesAdcIf
      ptrrAsrAdcServicesAdcIf_86: upstream-reference=AdcIf.Geltungsbereich_MQBw_Baseline.ptrrAsrAdcServicesAdcIf, ecu-extract-reference=AdcIf.TopLevelCompositionPrototype.ptrrAsrAdcServicesAdcIf
      ptrrAsrGptServicesAdcIf_87: upstream-reference=AdcIf.Geltungsbereich_MQBw_Baseline.ptrrAsrGptServicesAdcIf, ecu-extract-reference=AdcIf.TopLevelCompositionPrototype.ptrrAsrGptServicesAdcIf
      BswMIf_88: upstream-reference=Geltungsbereich_MQBw_Baseline.BswMIf, ecu-extract-reference=TopLevelCompositionPrototype.BswMIf
      pclCILGetEcuState_89: upstream-reference=BswMIf.Geltungsbereich_MQBw_Baseline.pclCILGetEcuState, ecu-extract-reference=BswMIf.TopLevelCompositionPrototype.pclCILGetEcuState
      pclDemSetOpCycle_90: upstream-reference=BswMIf.Geltungsbereich_MQBw_Baseline.pclDemSetOpCycle, ecu-extract-reference=BswMIf.TopLevelCompositionPrototype.pclDemSetOpCycle
      pclNotifyResetCause_91: upstream-reference=BswMIf.Geltungsbereich_MQBw_Baseline.pclNotifyResetCause, ecu-extract-reference=BswMIf.TopLevelCompositionPrototype.pclNotifyResetCause
      pclNvmIfServices_92: upstream-reference=BswMIf.Geltungsbereich_MQBw_Baseline.pclNvmIfServices, ecu-extract-reference=BswMIf.TopLevelCompositionPrototype.pclNvmIfServices
      pseEcuStateTransitions_93: upstream-reference=BswMIf.Geltungsbereich_MQBw_Baseline.pseEcuStateTransitions, ecu-extract-reference=BswMIf.TopLevelCompositionPrototype.pseEcuStateTransitions
      psePassengerOccupancyState_94: upstream-reference=BswMIf.Geltungsbereich_MQBw_Baseline.psePassengerOccupancyState, ecu-extract-reference=BswMIf.TopLevelCompositionPrototype.psePassengerOccupancyState
      psrBswMIfServices_95: upstream-reference=BswMIf.Geltungsbereich_MQBw_Baseline.psrBswMIfServices, ecu-extract-reference=BswMIf.TopLevelCompositionPrototype.psrBswMIfServices
      u8BlockRestoreStatus_96: upstream-reference=psrBswMIfServices.BswMIf.Geltungsbereich_MQBw_Baseline.u8BlockRestoreStatus, ecu-extract-reference=psrBswMIfServices.BswMIf.TopLevelCompositionPrototype.u8BlockRestoreStatus
      psrFsmSolenoidReqBswMIf_97: upstream-reference=BswMIf.Geltungsbereich_MQBw_Baseline.psrFsmSolenoidReqBswMIf, ecu-extract-reference=BswMIf.TopLevelCompositionPrototype.psrFsmSolenoidReqBswMIf
      au8DiagReq_98: upstream-reference=psrFsmSolenoidReqBswMIf.BswMIf.Geltungsbereich_MQBw_Baseline.au8DiagReq, ecu-extract-reference=psrFsmSolenoidReqBswMIf.BswMIf.TopLevelCompositionPrototype.au8DiagReq
      au8DiagReqComplement_99: upstream-reference=psrFsmSolenoidReqBswMIf.BswMIf.Geltungsbereich_MQBw_Baseline.au8DiagReqComplement, ecu-extract-reference=psrFsmSolenoidReqBswMIf.BswMIf.TopLevelCompositionPrototype.au8DiagReqComplement
      ptrpAsrBswMServicesBswMIf_100: upstream-reference=BswMIf.Geltungsbereich_MQBw_Baseline.ptrpAsrBswMServicesBswMIf, ecu-extract-reference=BswMIf.TopLevelCompositionPrototype.ptrpAsrBswMServicesBswMIf
      ptrpAsrGptServicesBswMIf_101: upstream-reference=BswMIf.Geltungsbereich_MQBw_Baseline.ptrpAsrGptServicesBswMIf, ecu-extract-reference=BswMIf.TopLevelCompositionPrototype.ptrpAsrGptServicesBswMIf
      ptrpAsrNvMServicesBswMIf_102: upstream-reference=BswMIf.Geltungsbereich_MQBw_Baseline.ptrpAsrNvMServicesBswMIf, ecu-extract-reference=BswMIf.TopLevelCompositionPrototype.ptrpAsrNvMServicesBswMIf
      ptrpAsrOsServicesBswMIf_103: upstream-reference=BswMIf.Geltungsbereich_MQBw_Baseline.ptrpAsrOsServicesBswMIf, ecu-extract-reference=BswMIf.TopLevelCompositionPrototype.ptrpAsrOsServicesBswMIf
      ptrpNmIfServicesBswMIf_104: upstream-reference=BswMIf.Geltungsbereich_MQBw_Baseline.ptrpNmIfServicesBswMIf, ecu-extract-reference=BswMIf.TopLevelCompositionPrototype.ptrpNmIfServicesBswMIf
      ptrrAdcIfServicesBswMIf_105: upstream-reference=BswMIf.Geltungsbereich_MQBw_Baseline.ptrrAdcIfServicesBswMIf, ecu-extract-reference=BswMIf.TopLevelCompositionPrototype.ptrrAdcIfServicesBswMIf
      ptrrAsrBswMServicesBswMIf_106: upstream-reference=BswMIf.Geltungsbereich_MQBw_Baseline.ptrrAsrBswMServicesBswMIf, ecu-extract-reference=BswMIf.TopLevelCompositionPrototype.ptrrAsrBswMServicesBswMIf
      ptrrAsrCanIfServicesBswMIf_107: upstream-reference=BswMIf.Geltungsbereich_MQBw_Baseline.ptrrAsrCanIfServicesBswMIf, ecu-extract-reference=BswMIf.TopLevelCompositionPrototype.ptrrAsrCanIfServicesBswMIf
      ptrrAsrCanSMServicesBswMIf_108: upstream-reference=BswMIf.Geltungsbereich_MQBw_Baseline.ptrrAsrCanSMServicesBswMIf, ecu-extract-reference=BswMIf.TopLevelCompositionPrototype.ptrrAsrCanSMServicesBswMIf
      ptrrAsrCanServicesBswMIf_109: upstream-reference=BswMIf.Geltungsbereich_MQBw_Baseline.ptrrAsrCanServicesBswMIf, ecu-extract-reference=BswMIf.TopLevelCompositionPrototype.ptrrAsrCanServicesBswMIf
      ptrrAsrCanTpServicesBswMIf_110: upstream-reference=BswMIf.Geltungsbereich_MQBw_Baseline.ptrrAsrCanTpServicesBswMIf, ecu-extract-reference=BswMIf.TopLevelCompositionPrototype.ptrrAsrCanTpServicesBswMIf
      ptrrAsrComMServicesBswMIf_111: upstream-reference=BswMIf.Geltungsbereich_MQBw_Baseline.ptrrAsrComMServicesBswMIf, ecu-extract-reference=BswMIf.TopLevelCompositionPrototype.ptrrAsrComMServicesBswMIf
      ptrrAsrComServicesBswMIf_112: upstream-reference=BswMIf.Geltungsbereich_MQBw_Baseline.ptrrAsrComServicesBswMIf, ecu-extract-reference=BswMIf.TopLevelCompositionPrototype.ptrrAsrComServicesBswMIf
      ptrrAsrDcmServicesBswMIf_113: upstream-reference=BswMIf.Geltungsbereich_MQBw_Baseline.ptrrAsrDcmServicesBswMIf, ecu-extract-reference=BswMIf.TopLevelCompositionPrototype.ptrrAsrDcmServicesBswMIf
      ptrrAsrDemServicesBswMIf_114: upstream-reference=BswMIf.Geltungsbereich_MQBw_Baseline.ptrrAsrDemServicesBswMIf, ecu-extract-reference=BswMIf.TopLevelCompositionPrototype.ptrrAsrDemServicesBswMIf
      ptrrAsrEcuMServicesBswMIf_115: upstream-reference=BswMIf.Geltungsbereich_MQBw_Baseline.ptrrAsrEcuMServicesBswMIf, ecu-extract-reference=BswMIf.TopLevelCompositionPrototype.ptrrAsrEcuMServicesBswMIf
      ptrrAsrFeeServicesBswMIf_116: upstream-reference=BswMIf.Geltungsbereich_MQBw_Baseline.ptrrAsrFeeServicesBswMIf, ecu-extract-reference=BswMIf.TopLevelCompositionPrototype.ptrrAsrFeeServicesBswMIf
      ptrrAsrFlsServicesBswMIf_117: upstream-reference=BswMIf.Geltungsbereich_MQBw_Baseline.ptrrAsrFlsServicesBswMIf, ecu-extract-reference=BswMIf.TopLevelCompositionPrototype.ptrrAsrFlsServicesBswMIf
      ptrrAsrGptServicesBswMIf_118: upstream-reference=BswMIf.Geltungsbereich_MQBw_Baseline.ptrrAsrGptServicesBswMIf, ecu-extract-reference=BswMIf.TopLevelCompositionPrototype.ptrrAsrGptServicesBswMIf
      ptrrAsrNvMServicesBswMIf_119: upstream-reference=BswMIf.Geltungsbereich_MQBw_Baseline.ptrrAsrNvMServicesBswMIf, ecu-extract-reference=BswMIf.TopLevelCompositionPrototype.ptrrAsrNvMServicesBswMIf
      ptrrAsrOsServicesBswMIf_120: upstream-reference=BswMIf.Geltungsbereich_MQBw_Baseline.ptrrAsrOsServicesBswMIf, ecu-extract-reference=BswMIf.TopLevelCompositionPrototype.ptrrAsrOsServicesBswMIf
      ptrrAsrPduRServicesBswMIf_121: upstream-reference=BswMIf.Geltungsbereich_MQBw_Baseline.ptrrAsrPduRServicesBswMIf, ecu-extract-reference=BswMIf.TopLevelCompositionPrototype.ptrrAsrPduRServicesBswMIf
      ptrrAsrRteServicesBswMIf_122: upstream-reference=BswMIf.Geltungsbereich_MQBw_Baseline.ptrrAsrRteServicesBswMIf, ecu-extract-reference=BswMIf.TopLevelCompositionPrototype.ptrrAsrRteServicesBswMIf
      ptrrAtmServicesBswMIf_123: upstream-reference=BswMIf.Geltungsbereich_MQBw_Baseline.ptrrAtmServicesBswMIf, ecu-extract-reference=BswMIf.TopLevelCompositionPrototype.ptrrAtmServicesBswMIf
      ptrrCilServicesBswMIf_124: upstream-reference=BswMIf.Geltungsbereich_MQBw_Baseline.ptrrCilServicesBswMIf, ecu-extract-reference=BswMIf.TopLevelCompositionPrototype.ptrrCilServicesBswMIf
      ptrrDiaServicesBswMIf_125: upstream-reference=BswMIf.Geltungsbereich_MQBw_Baseline.ptrrDiaServicesBswMIf, ecu-extract-reference=BswMIf.TopLevelCompositionPrototype.ptrrDiaServicesBswMIf
      ptrrFsmServicesBswMIf_126: upstream-reference=BswMIf.Geltungsbereich_MQBw_Baseline.ptrrFsmServicesBswMIf, ecu-extract-reference=BswMIf.TopLevelCompositionPrototype.ptrrFsmServicesBswMIf
      ptrrLpmServicesBswMIf_127: upstream-reference=BswMIf.Geltungsbereich_MQBw_Baseline.ptrrLpmServicesBswMIf, ecu-extract-reference=BswMIf.TopLevelCompositionPrototype.ptrrLpmServicesBswMIf
      ptrrMcuIfServicesBswMIf_128: upstream-reference=BswMIf.Geltungsbereich_MQBw_Baseline.ptrrMcuIfServicesBswMIf, ecu-extract-reference=BswMIf.TopLevelCompositionPrototype.ptrrMcuIfServicesBswMIf
      ptrrMicServices_129: upstream-reference=BswMIf.Geltungsbereich_MQBw_Baseline.ptrrMicServices, ecu-extract-reference=BswMIf.TopLevelCompositionPrototype.ptrrMicServices
      ptrrRcmServicesBswMIf_130: upstream-reference=BswMIf.Geltungsbereich_MQBw_Baseline.ptrrRcmServicesBswMIf, ecu-extract-reference=BswMIf.TopLevelCompositionPrototype.ptrrRcmServicesBswMIf
      ptrrSadServicesBswMIf_131: upstream-reference=BswMIf.Geltungsbereich_MQBw_Baseline.ptrrSadServicesBswMIf, ecu-extract-reference=BswMIf.TopLevelCompositionPrototype.ptrrSadServicesBswMIf
      CIL_132: upstream-reference=Geltungsbereich_MQBw_Baseline.CIL, ecu-extract-reference=TopLevelCompositionPrototype.CIL
      P_CAN_CanDataOut_Frame_0_133: upstream-reference=CIL.Geltungsbereich_MQBw_Baseline.P_CAN_CanDataOut_Frame_0, ecu-extract-reference=CIL.TopLevelCompositionPrototype.P_CAN_CanDataOut_Frame_0
      EcuCanDataOut_134: upstream-reference=P_CAN_CanDataOut_Frame_0.CIL.Geltungsbereich_MQBw_Baseline.EcuCanDataOut, ecu-extract-reference=P_CAN_CanDataOut_Frame_0.CIL.TopLevelCompositionPrototype.EcuCanDataOut
      u64Byte_0_7_135: upstream-reference=P_CAN_CanDataOut_Frame_0.CIL.Geltungsbereich_MQBw_Baseline.EcuCanDataOut.u64Byte_0_7, ecu-extract-reference=P_CAN_CanDataOut_Frame_0.CIL.TopLevelCompositionPrototype.EcuCanDataOut.u64Byte_0_7
      u64Byte_8_15_136: upstream-reference=P_CAN_CanDataOut_Frame_0.CIL.Geltungsbereich_MQBw_Baseline.EcuCanDataOut.u64Byte_8_15, ecu-extract-reference=P_CAN_CanDataOut_Frame_0.CIL.TopLevelCompositionPrototype.EcuCanDataOut.u64Byte_8_15
      u64Byte_16_23_137: upstream-reference=P_CAN_CanDataOut_Frame_0.CIL.Geltungsbereich_MQBw_Baseline.EcuCanDataOut.u64Byte_16_23, ecu-extract-reference=P_CAN_CanDataOut_Frame_0.CIL.TopLevelCompositionPrototype.EcuCanDataOut.u64Byte_16_23
      u64Byte_24_31_138: upstream-reference=P_CAN_CanDataOut_Frame_0.CIL.Geltungsbereich_MQBw_Baseline.EcuCanDataOut.u64Byte_24_31, ecu-extract-reference=P_CAN_CanDataOut_Frame_0.CIL.TopLevelCompositionPrototype.EcuCanDataOut.u64Byte_24_31
      u64Byte_32_39_139: upstream-reference=P_CAN_CanDataOut_Frame_0.CIL.Geltungsbereich_MQBw_Baseline.EcuCanDataOut.u64Byte_32_39, ecu-extract-reference=P_CAN_CanDataOut_Frame_0.CIL.TopLevelCompositionPrototype.EcuCanDataOut.u64Byte_32_39
      u64Byte_40_47_140: upstream-reference=P_CAN_CanDataOut_Frame_0.CIL.Geltungsbereich_MQBw_Baseline.EcuCanDataOut.u64Byte_40_47, ecu-extract-reference=P_CAN_CanDataOut_Frame_0.CIL.TopLevelCompositionPrototype.EcuCanDataOut.u64Byte_40_47
      u64Byte_48_55_141: upstream-reference=P_CAN_CanDataOut_Frame_0.CIL.Geltungsbereich_MQBw_Baseline.EcuCanDataOut.u64Byte_48_55, ecu-extract-reference=P_CAN_CanDataOut_Frame_0.CIL.TopLevelCompositionPrototype.EcuCanDataOut.u64Byte_48_55
      u64Byte_56_63_142: upstream-reference=P_CAN_CanDataOut_Frame_0.CIL.Geltungsbereich_MQBw_Baseline.EcuCanDataOut.u64Byte_56_63, ecu-extract-reference=P_CAN_CanDataOut_Frame_0.CIL.TopLevelCompositionPrototype.EcuCanDataOut.u64Byte_56_63
      P_CAN_GliwaDataIn_Frame_143: upstream-reference=CIL.Geltungsbereich_MQBw_Baseline.P_CAN_GliwaDataIn_Frame, ecu-extract-reference=CIL.TopLevelCompositionPrototype.P_CAN_GliwaDataIn_Frame
      GliwaCanDataIn_144: upstream-reference=P_CAN_GliwaDataIn_Frame.CIL.Geltungsbereich_MQBw_Baseline.GliwaCanDataIn, ecu-extract-reference=P_CAN_GliwaDataIn_Frame.CIL.TopLevelCompositionPrototype.GliwaCanDataIn
      u8Byte1_145: upstream-reference=P_CAN_GliwaDataIn_Frame.CIL.Geltungsbereich_MQBw_Baseline.GliwaCanDataIn.u8Byte1, ecu-extract-reference=P_CAN_GliwaDataIn_Frame.CIL.TopLevelCompositionPrototype.GliwaCanDataIn.u8Byte1
      u8Byte2_146: upstream-reference=P_CAN_GliwaDataIn_Frame.CIL.Geltungsbereich_MQBw_Baseline.GliwaCanDataIn.u8Byte2, ecu-extract-reference=P_CAN_GliwaDataIn_Frame.CIL.TopLevelCompositionPrototype.GliwaCanDataIn.u8Byte2
      u8Byte3_147: upstream-reference=P_CAN_GliwaDataIn_Frame.CIL.Geltungsbereich_MQBw_Baseline.GliwaCanDataIn.u8Byte3, ecu-extract-reference=P_CAN_GliwaDataIn_Frame.CIL.TopLevelCompositionPrototype.GliwaCanDataIn.u8Byte3
      u8Byte4_148: upstream-reference=P_CAN_GliwaDataIn_Frame.CIL.Geltungsbereich_MQBw_Baseline.GliwaCanDataIn.u8Byte4, ecu-extract-reference=P_CAN_GliwaDataIn_Frame.CIL.TopLevelCompositionPrototype.GliwaCanDataIn.u8Byte4
      u8Byte5_149: upstream-reference=P_CAN_GliwaDataIn_Frame.CIL.Geltungsbereich_MQBw_Baseline.GliwaCanDataIn.u8Byte5, ecu-extract-reference=P_CAN_GliwaDataIn_Frame.CIL.TopLevelCompositionPrototype.GliwaCanDataIn.u8Byte5
      u8Byte6_150: upstream-reference=P_CAN_GliwaDataIn_Frame.CIL.Geltungsbereich_MQBw_Baseline.GliwaCanDataIn.u8Byte6, ecu-extract-reference=P_CAN_GliwaDataIn_Frame.CIL.TopLevelCompositionPrototype.GliwaCanDataIn.u8Byte6
      u8Byte7_151: upstream-reference=P_CAN_GliwaDataIn_Frame.CIL.Geltungsbereich_MQBw_Baseline.GliwaCanDataIn.u8Byte7, ecu-extract-reference=P_CAN_GliwaDataIn_Frame.CIL.TopLevelCompositionPrototype.GliwaCanDataIn.u8Byte7
      u8Byte0_152: upstream-reference=P_CAN_GliwaDataIn_Frame.CIL.Geltungsbereich_MQBw_Baseline.GliwaCanDataIn.u8Byte0, ecu-extract-reference=P_CAN_GliwaDataIn_Frame.CIL.TopLevelCompositionPrototype.GliwaCanDataIn.u8Byte0
      P_CAN_GliwaDataOut_Frame_153: upstream-reference=CIL.Geltungsbereich_MQBw_Baseline.P_CAN_GliwaDataOut_Frame, ecu-extract-reference=CIL.TopLevelCompositionPrototype.P_CAN_GliwaDataOut_Frame
      GliwaCanDataOut_154: upstream-reference=P_CAN_GliwaDataOut_Frame.CIL.Geltungsbereich_MQBw_Baseline.GliwaCanDataOut, ecu-extract-reference=P_CAN_GliwaDataOut_Frame.CIL.TopLevelCompositionPrototype.GliwaCanDataOut
      u64Byte_0_7_155: upstream-reference=P_CAN_GliwaDataOut_Frame.CIL.Geltungsbereich_MQBw_Baseline.GliwaCanDataOut.u64Byte_0_7, ecu-extract-reference=P_CAN_GliwaDataOut_Frame.CIL.TopLevelCompositionPrototype.GliwaCanDataOut.u64Byte_0_7
      u64Byte_8_15_156: upstream-reference=P_CAN_GliwaDataOut_Frame.CIL.Geltungsbereich_MQBw_Baseline.GliwaCanDataOut.u64Byte_8_15, ecu-extract-reference=P_CAN_GliwaDataOut_Frame.CIL.TopLevelCompositionPrototype.GliwaCanDataOut.u64Byte_8_15
      u64Byte_16_23_157: upstream-reference=P_CAN_GliwaDataOut_Frame.CIL.Geltungsbereich_MQBw_Baseline.GliwaCanDataOut.u64Byte_16_23, ecu-extract-reference=P_CAN_GliwaDataOut_Frame.CIL.TopLevelCompositionPrototype.GliwaCanDataOut.u64Byte_16_23
      u64Byte_24_31_158: upstream-reference=P_CAN_GliwaDataOut_Frame.CIL.Geltungsbereich_MQBw_Baseline.GliwaCanDataOut.u64Byte_24_31, ecu-extract-reference=P_CAN_GliwaDataOut_Frame.CIL.TopLevelCompositionPrototype.GliwaCanDataOut.u64Byte_24_31
      u64Byte_32_39_159: upstream-reference=P_CAN_GliwaDataOut_Frame.CIL.Geltungsbereich_MQBw_Baseline.GliwaCanDataOut.u64Byte_32_39, ecu-extract-reference=P_CAN_GliwaDataOut_Frame.CIL.TopLevelCompositionPrototype.GliwaCanDataOut.u64Byte_32_39
      u64Byte_40_47_160: upstream-reference=P_CAN_GliwaDataOut_Frame.CIL.Geltungsbereich_MQBw_Baseline.GliwaCanDataOut.u64Byte_40_47, ecu-extract-reference=P_CAN_GliwaDataOut_Frame.CIL.TopLevelCompositionPrototype.GliwaCanDataOut.u64Byte_40_47
      u64Byte_48_55_161: upstream-reference=P_CAN_GliwaDataOut_Frame.CIL.Geltungsbereich_MQBw_Baseline.GliwaCanDataOut.u64Byte_48_55, ecu-extract-reference=P_CAN_GliwaDataOut_Frame.CIL.TopLevelCompositionPrototype.GliwaCanDataOut.u64Byte_48_55
      u64Byte_56_63_162: upstream-reference=P_CAN_GliwaDataOut_Frame.CIL.Geltungsbereich_MQBw_Baseline.GliwaCanDataOut.u64Byte_56_63, ecu-extract-reference=P_CAN_GliwaDataOut_Frame.CIL.TopLevelCompositionPrototype.GliwaCanDataOut.u64Byte_56_63
      P_CAN_MF_Frame_163: upstream-reference=CIL.Geltungsbereich_MQBw_Baseline.P_CAN_MF_Frame, ecu-extract-reference=CIL.TopLevelCompositionPrototype.P_CAN_MF_Frame
      stMFData_164: upstream-reference=P_CAN_MF_Frame.CIL.Geltungsbereich_MQBw_Baseline.stMFData, ecu-extract-reference=P_CAN_MF_Frame.CIL.TopLevelCompositionPrototype.stMFData
      u64Byte_0_7_165: upstream-reference=P_CAN_MF_Frame.CIL.Geltungsbereich_MQBw_Baseline.stMFData.u64Byte_0_7, ecu-extract-reference=P_CAN_MF_Frame.CIL.TopLevelCompositionPrototype.stMFData.u64Byte_0_7
      u64Byte_8_15_166: upstream-reference=P_CAN_MF_Frame.CIL.Geltungsbereich_MQBw_Baseline.stMFData.u64Byte_8_15, ecu-extract-reference=P_CAN_MF_Frame.CIL.TopLevelCompositionPrototype.stMFData.u64Byte_8_15
      u64Byte_16_23_167: upstream-reference=P_CAN_MF_Frame.CIL.Geltungsbereich_MQBw_Baseline.stMFData.u64Byte_16_23, ecu-extract-reference=P_CAN_MF_Frame.CIL.TopLevelCompositionPrototype.stMFData.u64Byte_16_23
      u64Byte_24_31_168: upstream-reference=P_CAN_MF_Frame.CIL.Geltungsbereich_MQBw_Baseline.stMFData.u64Byte_24_31, ecu-extract-reference=P_CAN_MF_Frame.CIL.TopLevelCompositionPrototype.stMFData.u64Byte_24_31
      u64Byte_32_39_169: upstream-reference=P_CAN_MF_Frame.CIL.Geltungsbereich_MQBw_Baseline.stMFData.u64Byte_32_39, ecu-extract-reference=P_CAN_MF_Frame.CIL.TopLevelCompositionPrototype.stMFData.u64Byte_32_39
      u64Byte_40_47_170: upstream-reference=P_CAN_MF_Frame.CIL.Geltungsbereich_MQBw_Baseline.stMFData.u64Byte_40_47, ecu-extract-reference=P_CAN_MF_Frame.CIL.TopLevelCompositionPrototype.stMFData.u64Byte_40_47
      u64Byte_48_55_171: upstream-reference=P_CAN_MF_Frame.CIL.Geltungsbereich_MQBw_Baseline.stMFData.u64Byte_48_55, ecu-extract-reference=P_CAN_MF_Frame.CIL.TopLevelCompositionPrototype.stMFData.u64Byte_48_55
      u64Byte_56_63_172: upstream-reference=P_CAN_MF_Frame.CIL.Geltungsbereich_MQBw_Baseline.stMFData.u64Byte_56_63, ecu-extract-reference=P_CAN_MF_Frame.CIL.TopLevelCompositionPrototype.stMFData.u64Byte_56_63
      P_CAN_MF_Logger_Frame_173: upstream-reference=CIL.Geltungsbereich_MQBw_Baseline.P_CAN_MF_Logger_Frame, ecu-extract-reference=CIL.TopLevelCompositionPrototype.P_CAN_MF_Logger_Frame
      MfLogger_174: upstream-reference=P_CAN_MF_Logger_Frame.CIL.Geltungsbereich_MQBw_Baseline.MfLogger, ecu-extract-reference=P_CAN_MF_Logger_Frame.CIL.TopLevelCompositionPrototype.MfLogger
      RP_IF_AB_Crash_Int_XIX_Grundumfang_XIX_eCS_175: upstream-reference=CIL.Geltungsbereich_MQBw_Baseline.RP_IF_AB_Crash_Int_XIX_Grundumfang_XIX_eCS, ecu-extract-reference=CIL.TopLevelCompositionPrototype.RP_IF_AB_Crash_Int_XIX_Grundumfang_XIX_eCS
      DE_AB_Crash_Int_176: upstream-reference=RP_IF_AB_Crash_Int_XIX_Grundumfang_XIX_eCS.CIL.Geltungsbereich_MQBw_Baseline.DE_AB_Crash_Int, ecu-extract-reference=RP_IF_AB_Crash_Int_XIX_Grundumfang_XIX_eCS.CIL.TopLevelCompositionPrototype.DE_AB_Crash_Int
      RP_IF_AB_Gurtschloss_BF_XIX_Grundumfang_XIX_eCS_177: upstream-reference=CIL.Geltungsbereich_MQBw_Baseline.RP_IF_AB_Gurtschloss_BF_XIX_Grundumfang_XIX_eCS, ecu-extract-reference=CIL.TopLevelCompositionPrototype.RP_IF_AB_Gurtschloss_BF_XIX_Grundumfang_XIX_eCS
      DE_AB_Gurtschloss_BF_178: upstream-reference=RP_IF_AB_Gurtschloss_BF_XIX_Grundumfang_XIX_eCS.CIL.Geltungsbereich_MQBw_Baseline.DE_AB_Gurtschloss_BF, ecu-extract-reference=RP_IF_AB_Gurtschloss_BF_XIX_Grundumfang_XIX_eCS.CIL.TopLevelCompositionPrototype.DE_AB_Gurtschloss_BF
      RP_IF_AB_Gurtschloss_FA_XIX_Grundumfang_XIX_eCS_179: upstream-reference=CIL.Geltungsbereich_MQBw_Baseline.RP_IF_AB_Gurtschloss_FA_XIX_Grundumfang_XIX_eCS, ecu-extract-reference=CIL.TopLevelCompositionPrototype.RP_IF_AB_Gurtschloss_FA_XIX_Grundumfang_XIX_eCS
      DE_AB_Gurtschloss_FA_180: upstream-reference=RP_IF_AB_Gurtschloss_FA_XIX_Grundumfang_XIX_eCS.CIL.Geltungsbereich_MQBw_Baseline.DE_AB_Gurtschloss_FA, ecu-extract-reference=RP_IF_AB_Gurtschloss_FA_XIX_Grundumfang_XIX_eCS.CIL.TopLevelCompositionPrototype.DE_AB_Gurtschloss_FA
      RP_IF_AB_Gurtschloss_Reihe2_BF_XIX_Grundumfang_XIX_eCS_181: upstream-reference=CIL.Geltungsbereich_MQBw_Baseline.RP_IF_AB_Gurtschloss_Reihe2_BF_XIX_Grundumfang_XIX_eCS, ecu-extract-reference=CIL.TopLevelCompositionPrototype.RP_IF_AB_Gurtschloss_Reihe2_BF_XIX_Grundumfang_XIX_eCS
      DE_AB_Gurtschloss_Reihe2_BF_182: upstream-reference=RP_IF_AB_Gurtschloss_Reihe2_BF_XIX_Grundumfang_XIX_eCS.CIL.Geltungsbereich_MQBw_Baseline.DE_AB_Gurtschloss_Reihe2_BF, ecu-extract-reference=RP_IF_AB_Gurtschloss_Reihe2_BF_XIX_Grundumfang_XIX_eCS.CIL.TopLevelCompositionPrototype.DE_AB_Gurtschloss_Reihe2_BF
      RP_IF_AB_Gurtschloss_Reihe2_FA_XIX_Grundumfang_XIX_eCS_183: upstream-reference=CIL.Geltungsbereich_MQBw_Baseline.RP_IF_AB_Gurtschloss_Reihe2_FA_XIX_Grundumfang_XIX_eCS, ecu-extract-reference=CIL.TopLevelCompositionPrototype.RP_IF_AB_Gurtschloss_Reihe2_FA_XIX_Grundumfang_XIX_eCS
      DE_AB_Gurtschloss_Reihe2_FA_184: upstream-reference=RP_IF_AB_Gurtschloss_Reihe2_FA_XIX_Grundumfang_XIX_eCS.CIL.Geltungsbereich_MQBw_Baseline.DE_AB_Gurtschloss_Reihe2_FA, ecu-extract-reference=RP_IF_AB_Gurtschloss_Reihe2_FA_XIX_Grundumfang_XIX_eCS.CIL.TopLevelCompositionPrototype.DE_AB_Gurtschloss_Reihe2_FA
      RP_IF_AB_Gurtschloss_Reihe3_BF_XIX_Grundumfang_XIX_eCS_185: upstream-reference=CIL.Geltungsbereich_MQBw_Baseline.RP_IF_AB_Gurtschloss_Reihe3_BF_XIX_Grundumfang_XIX_eCS, ecu-extract-reference=CIL.TopLevelCompositionPrototype.RP_IF_AB_Gurtschloss_Reihe3_BF_XIX_Grundumfang_XIX_eCS
      DE_AB_Gurtschloss_Reihe3_BF_186: upstream-reference=RP_IF_AB_Gurtschloss_Reihe3_BF_XIX_Grundumfang_XIX_eCS.CIL.Geltungsbereich_MQBw_Baseline.DE_AB_Gurtschloss_Reihe3_BF, ecu-extract-reference=RP_IF_AB_Gurtschloss_Reihe3_BF_XIX_Grundumfang_XIX_eCS.CIL.TopLevelCompositionPrototype.DE_AB_Gurtschloss_Reihe3_BF
      RP_IF_AB_Gurtschloss_Reihe3_FA_XIX_Grundumfang_XIX_eCS_187: upstream-reference=CIL.Geltungsbereich_MQBw_Baseline.RP_IF_AB_Gurtschloss_Reihe3_FA_XIX_Grundumfang_XIX_eCS, ecu-extract-reference=CIL.TopLevelCompositionPrototype.RP_IF_AB_Gurtschloss_Reihe3_FA_XIX_Grundumfang_XIX_eCS
      DE_AB_Gurtschloss_Reihe3_FA_188: upstream-reference=RP_IF_AB_Gurtschloss_Reihe3_FA_XIX_Grundumfang_XIX_eCS.CIL.Geltungsbereich_MQBw_Baseline.DE_AB_Gurtschloss_Reihe3_FA, ecu-extract-reference=RP_IF_AB_Gurtschloss_Reihe3_FA_XIX_Grundumfang_XIX_eCS.CIL.TopLevelCompositionPrototype.DE_AB_Gurtschloss_Reihe3_FA
      RP_IF_AB_eCS_Aktuatortest_BF_XIX_Grundumfang_XIX_eCS_189: upstream-reference=CIL.Geltungsbereich_MQBw_Baseline.RP_IF_AB_eCS_Aktuatortest_BF_XIX_Grundumfang_XIX_eCS, ecu-extract-reference=CIL.TopLevelCompositionPrototype.RP_IF_AB_eCS_Aktuatortest_BF_XIX_Grundumfang_XIX_eCS
      DE_AB_eCS_Aktuatortest_BF_190: upstream-reference=RP_IF_AB_eCS_Aktuatortest_BF_XIX_Grundumfang_XIX_eCS.CIL.Geltungsbereich_MQBw_Baseline.DE_AB_eCS_Aktuatortest_BF, ecu-extract-reference=RP_IF_AB_eCS_Aktuatortest_BF_XIX_Grundumfang_XIX_eCS.CIL.TopLevelCompositionPrototype.DE_AB_eCS_Aktuatortest_BF
      RP_IF_AB_eCS_Aktuatortest_FA_XIX_Grundumfang_XIX_eCS_191: upstream-reference=CIL.Geltungsbereich_MQBw_Baseline.RP_IF_AB_eCS_Aktuatortest_FA_XIX_Grundumfang_XIX_eCS, ecu-extract-reference=CIL.TopLevelCompositionPrototype.RP_IF_AB_eCS_Aktuatortest_FA_XIX_Grundumfang_XIX_eCS
      DE_AB_eCS_Aktuatortest_FA_192: upstream-reference=RP_IF_AB_eCS_Aktuatortest_FA_XIX_Grundumfang_XIX_eCS.CIL.Geltungsbereich_MQBw_Baseline.DE_AB_eCS_Aktuatortest_FA, ecu-extract-reference=RP_IF_AB_eCS_Aktuatortest_FA_XIX_Grundumfang_XIX_eCS.CIL.TopLevelCompositionPrototype.DE_AB_eCS_Aktuatortest_FA
      RP_IF_AB_eCS_Aktuatortest_Reihe2_BF_XIX_Grundumfang_XIX_eCS_193: upstream-reference=CIL.Geltungsbereich_MQBw_Baseline.RP_IF_AB_eCS_Aktuatortest_Reihe2_BF_XIX_Grundumfang_XIX_eCS, ecu-extract-reference=CIL.TopLevelCompositionPrototype.RP_IF_AB_eCS_Aktuatortest_Reihe2_BF_XIX_Grundumfang_XIX_eCS
      DE_AB_eCS_Aktuatortest_Reihe2_BF_194: upstream-reference=RP_IF_AB_eCS_Aktuatortest_Reihe2_BF_XIX_Grundumfang_XIX_eCS.CIL.Geltungsbereich_MQBw_Baseline.DE_AB_eCS_Aktuatortest_Reihe2_BF, ecu-extract-reference=RP_IF_AB_eCS_Aktuatortest_Reihe2_BF_XIX_Grundumfang_XIX_eCS.CIL.TopLevelCompositionPrototype.DE_AB_eCS_Aktuatortest_Reihe2_BF
      RP_IF_AB_eCS_Aktuatortest_Reihe2_FA_XIX_Grundumfang_XIX_eCS_195: upstream-reference=CIL.Geltungsbereich_MQBw_Baseline.RP_IF_AB_eCS_Aktuatortest_Reihe2_FA_XIX_Grundumfang_XIX_eCS, ecu-extract-reference=CIL.TopLevelCompositionPrototype.RP_IF_AB_eCS_Aktuatortest_Reihe2_FA_XIX_Grundumfang_XIX_eCS
      DE_AB_eCS_Aktuatortest_Reihe2_FA_196: upstream-reference=RP_IF_AB_eCS_Aktuatortest_Reihe2_FA_XIX_Grundumfang_XIX_eCS.CIL.Geltungsbereich_MQBw_Baseline.DE_AB_eCS_Aktuatortest_Reihe2_FA, ecu-extract-reference=RP_IF_AB_eCS_Aktuatortest_Reihe2_FA_XIX_Grundumfang_XIX_eCS.CIL.TopLevelCompositionPrototype.DE_AB_eCS_Aktuatortest_Reihe2_FA
      RP_IF_AB_eCS_Aktuatortest_Reihe3_BF_XIX_Grundumfang_XIX_eCS_197: upstream-reference=CIL.Geltungsbereich_MQBw_Baseline.RP_IF_AB_eCS_Aktuatortest_Reihe3_BF_XIX_Grundumfang_XIX_eCS, ecu-extract-reference=CIL.TopLevelCompositionPrototype.RP_IF_AB_eCS_Aktuatortest_Reihe3_BF_XIX_Grundumfang_XIX_eCS
      DE_AB_eCS_Aktuatortest_Reihe3_BF_198: upstream-reference=RP_IF_AB_eCS_Aktuatortest_Reihe3_BF_XIX_Grundumfang_XIX_eCS.CIL.Geltungsbereich_MQBw_Baseline.DE_AB_eCS_Aktuatortest_Reihe3_BF, ecu-extract-reference=RP_IF_AB_eCS_Aktuatortest_Reihe3_BF_XIX_Grundumfang_XIX_eCS.CIL.TopLevelCompositionPrototype.DE_AB_eCS_Aktuatortest_Reihe3_BF
      RP_IF_AB_eCS_Aktuatortest_Reihe3_FA_XIX_Grundumfang_XIX_eCS_199: upstream-reference=CIL.Geltungsbereich_MQBw_Baseline.RP_IF_AB_eCS_Aktuatortest_Reihe3_FA_XIX_Grundumfang_XIX_eCS, ecu-extract-reference=CIL.TopLevelCompositionPrototype.RP_IF_AB_eCS_Aktuatortest_Reihe3_FA_XIX_Grundumfang_XIX_eCS
      DE_AB_eCS_Aktuatortest_Reihe3_FA_200: upstream-reference=RP_IF_AB_eCS_Aktuatortest_Reihe3_FA_XIX_Grundumfang_XIX_eCS.CIL.Geltungsbereich_MQBw_Baseline.DE_AB_eCS_Aktuatortest_Reihe3_FA, ecu-extract-reference=RP_IF_AB_eCS_Aktuatortest_Reihe3_FA_XIX_Grundumfang_XIX_eCS.CIL.TopLevelCompositionPrototype.DE_AB_eCS_Aktuatortest_Reihe3_FA
      SP_IF_eCS_Error_Reihe1_BFS_1_201: upstream-reference=CIL.Geltungsbereich_MQBw_Baseline.SP_IF_eCS_Error_Reihe1_BFS_1, ecu-extract-reference=CIL.TopLevelCompositionPrototype.SP_IF_eCS_Error_Reihe1_BFS_1
      DE_eCS_Error_Reihe1_BFS_1_202: upstream-reference=SP_IF_eCS_Error_Reihe1_BFS_1.CIL.Geltungsbereich_MQBw_Baseline.DE_eCS_Error_Reihe1_BFS_1, ecu-extract-reference=SP_IF_eCS_Error_Reihe1_BFS_1.CIL.TopLevelCompositionPrototype.DE_eCS_Error_Reihe1_BFS_1
      SP_IF_eCS_Error_Reihe1_BFS_2_203: upstream-reference=CIL.Geltungsbereich_MQBw_Baseline.SP_IF_eCS_Error_Reihe1_BFS_2, ecu-extract-reference=CIL.TopLevelCompositionPrototype.SP_IF_eCS_Error_Reihe1_BFS_2
      DE_eCS_Error_Reihe1_BFS_2_204: upstream-reference=SP_IF_eCS_Error_Reihe1_BFS_2.CIL.Geltungsbereich_MQBw_Baseline.DE_eCS_Error_Reihe1_BFS_2, ecu-extract-reference=SP_IF_eCS_Error_Reihe1_BFS_2.CIL.TopLevelCompositionPrototype.DE_eCS_Error_Reihe1_BFS_2
      SP_IF_eCS_Error_Reihe1_FS_1_205: upstream-reference=CIL.Geltungsbereich_MQBw_Baseline.SP_IF_eCS_Error_Reihe1_FS_1, ecu-extract-reference=CIL.TopLevelCompositionPrototype.SP_IF_eCS_Error_Reihe1_FS_1
      DE_eCS_Error_Reihe1_FS_1_206: upstream-reference=SP_IF_eCS_Error_Reihe1_FS_1.CIL.Geltungsbereich_MQBw_Baseline.DE_eCS_Error_Reihe1_FS_1, ecu-extract-reference=SP_IF_eCS_Error_Reihe1_FS_1.CIL.TopLevelCompositionPrototype.DE_eCS_Error_Reihe1_FS_1
      SP_IF_eCS_Error_Reihe1_FS_2_207: upstream-reference=CIL.Geltungsbereich_MQBw_Baseline.SP_IF_eCS_Error_Reihe1_FS_2, ecu-extract-reference=CIL.TopLevelCompositionPrototype.SP_IF_eCS_Error_Reihe1_FS_2
      DE_eCS_Error_Reihe1_FS_2_208: upstream-reference=SP_IF_eCS_Error_Reihe1_FS_2.CIL.Geltungsbereich_MQBw_Baseline.DE_eCS_Error_Reihe1_FS_2, ecu-extract-reference=SP_IF_eCS_Error_Reihe1_FS_2.CIL.TopLevelCompositionPrototype.DE_eCS_Error_Reihe1_FS_2
      SP_IF_eCS_Error_Reihe2_BFS_209: upstream-reference=CIL.Geltungsbereich_MQBw_Baseline.SP_IF_eCS_Error_Reihe2_BFS, ecu-extract-reference=CIL.TopLevelCompositionPrototype.SP_IF_eCS_Error_Reihe2_BFS
      DE_eCS_Error_Reihe2_BFS_210: upstream-reference=SP_IF_eCS_Error_Reihe2_BFS.CIL.Geltungsbereich_MQBw_Baseline.DE_eCS_Error_Reihe2_BFS, ecu-extract-reference=SP_IF_eCS_Error_Reihe2_BFS.CIL.TopLevelCompositionPrototype.DE_eCS_Error_Reihe2_BFS
      SP_IF_eCS_Error_Reihe2_FS_211: upstream-reference=CIL.Geltungsbereich_MQBw_Baseline.SP_IF_eCS_Error_Reihe2_FS, ecu-extract-reference=CIL.TopLevelCompositionPrototype.SP_IF_eCS_Error_Reihe2_FS
      DE_eCS_Error_Reihe2_FS_212: upstream-reference=SP_IF_eCS_Error_Reihe2_FS.CIL.Geltungsbereich_MQBw_Baseline.DE_eCS_Error_Reihe2_FS, ecu-extract-reference=SP_IF_eCS_Error_Reihe2_FS.CIL.TopLevelCompositionPrototype.DE_eCS_Error_Reihe2_FS
      SP_IF_eCS_Gurtschloss_Status_Reihe2_BF_XIX_Grundumfang_XIX_eCS_213: upstream-reference=CIL.Geltungsbereich_MQBw_Baseline.SP_IF_eCS_Gurtschloss_Status_Reihe2_BF_XIX_Grundumfang_XIX_eCS, ecu-extract-reference=CIL.TopLevelCompositionPrototype.SP_IF_eCS_Gurtschloss_Status_Reihe2_BF_XIX_Grundumfang_XIX_eCS
      DE_eCS_Gurtschloss_Status_Reihe2_BF_214: upstream-reference=SP_IF_eCS_Gurtschloss_Status_Reihe2_BF_XIX_Grundumfang_XIX_eCS.CIL.Geltungsbereich_MQBw_Baseline.DE_eCS_Gurtschloss_Status_Reihe2_BF, ecu-extract-reference=SP_IF_eCS_Gurtschloss_Status_Reihe2_BF_XIX_Grundumfang_XIX_eCS.CIL.TopLevelCompositionPrototype.DE_eCS_Gurtschloss_Status_Reihe2_BF
      SP_IF_eCS_Gurtschloss_Status_Reihe2_FA_XIX_Grundumfang_XIX_eCS_215: upstream-reference=CIL.Geltungsbereich_MQBw_Baseline.SP_IF_eCS_Gurtschloss_Status_Reihe2_FA_XIX_Grundumfang_XIX_eCS, ecu-extract-reference=CIL.TopLevelCompositionPrototype.SP_IF_eCS_Gurtschloss_Status_Reihe2_FA_XIX_Grundumfang_XIX_eCS
      DE_eCS_Gurtschloss_Status_Reihe2_FA_216: upstream-reference=SP_IF_eCS_Gurtschloss_Status_Reihe2_FA_XIX_Grundumfang_XIX_eCS.CIL.Geltungsbereich_MQBw_Baseline.DE_eCS_Gurtschloss_Status_Reihe2_FA, ecu-extract-reference=SP_IF_eCS_Gurtschloss_Status_Reihe2_FA_XIX_Grundumfang_XIX_eCS.CIL.TopLevelCompositionPrototype.DE_eCS_Gurtschloss_Status_Reihe2_FA
      SP_IF_eCS_HW_defekt_XIX_Grundumfang_XIX_eCS_217: upstream-reference=CIL.Geltungsbereich_MQBw_Baseline.SP_IF_eCS_HW_defekt_XIX_Grundumfang_XIX_eCS, ecu-extract-reference=CIL.TopLevelCompositionPrototype.SP_IF_eCS_HW_defekt_XIX_Grundumfang_XIX_eCS
      DE_eCS_HW_defekt_218: upstream-reference=SP_IF_eCS_HW_defekt_XIX_Grundumfang_XIX_eCS.CIL.Geltungsbereich_MQBw_Baseline.DE_eCS_HW_defekt, ecu-extract-reference=SP_IF_eCS_HW_defekt_XIX_Grundumfang_XIX_eCS.CIL.TopLevelCompositionPrototype.DE_eCS_HW_defekt
      SP_IF_eCS_SBS_Belegung_Reihe2_BF_XIX_Grundumfang_XIX_eCS_219: upstream-reference=CIL.Geltungsbereich_MQBw_Baseline.SP_IF_eCS_SBS_Belegung_Reihe2_BF_XIX_Grundumfang_XIX_eCS, ecu-extract-reference=CIL.TopLevelCompositionPrototype.SP_IF_eCS_SBS_Belegung_Reihe2_BF_XIX_Grundumfang_XIX_eCS
      DE_eCS_SBS_Belegung_Reihe2_BF_220: upstream-reference=SP_IF_eCS_SBS_Belegung_Reihe2_BF_XIX_Grundumfang_XIX_eCS.CIL.Geltungsbereich_MQBw_Baseline.DE_eCS_SBS_Belegung_Reihe2_BF, ecu-extract-reference=SP_IF_eCS_SBS_Belegung_Reihe2_BF_XIX_Grundumfang_XIX_eCS.CIL.TopLevelCompositionPrototype.DE_eCS_SBS_Belegung_Reihe2_BF
      SP_IF_eCS_SBS_Belegung_Reihe2_FA_XIX_Grundumfang_XIX_eCS_221: upstream-reference=CIL.Geltungsbereich_MQBw_Baseline.SP_IF_eCS_SBS_Belegung_Reihe2_FA_XIX_Grundumfang_XIX_eCS, ecu-extract-reference=CIL.TopLevelCompositionPrototype.SP_IF_eCS_SBS_Belegung_Reihe2_FA_XIX_Grundumfang_XIX_eCS
      DE_eCS_SBS_Belegung_Reihe2_FA_222: upstream-reference=SP_IF_eCS_SBS_Belegung_Reihe2_FA_XIX_Grundumfang_XIX_eCS.CIL.Geltungsbereich_MQBw_Baseline.DE_eCS_SBS_Belegung_Reihe2_FA, ecu-extract-reference=SP_IF_eCS_SBS_Belegung_Reihe2_FA_XIX_Grundumfang_XIX_eCS.CIL.TopLevelCompositionPrototype.DE_eCS_SBS_Belegung_Reihe2_FA
      SP_IF_eCS_SBS_LastState_Reihe2_BFS_223: upstream-reference=CIL.Geltungsbereich_MQBw_Baseline.SP_IF_eCS_SBS_LastState_Reihe2_BFS, ecu-extract-reference=CIL.TopLevelCompositionPrototype.SP_IF_eCS_SBS_LastState_Reihe2_BFS
      DE_eCS_SBS_LastState_Reihe2_BFS_224: upstream-reference=SP_IF_eCS_SBS_LastState_Reihe2_BFS.CIL.Geltungsbereich_MQBw_Baseline.DE_eCS_SBS_LastState_Reihe2_BFS, ecu-extract-reference=SP_IF_eCS_SBS_LastState_Reihe2_BFS.CIL.TopLevelCompositionPrototype.DE_eCS_SBS_LastState_Reihe2_BFS
      SP_IF_eCS_SBS_LastState_Reihe2_FS_225: upstream-reference=CIL.Geltungsbereich_MQBw_Baseline.SP_IF_eCS_SBS_LastState_Reihe2_FS, ecu-extract-reference=CIL.TopLevelCompositionPrototype.SP_IF_eCS_SBS_LastState_Reihe2_FS
      DE_eCS_SBS_LastState_Reihe2_FS_226: upstream-reference=SP_IF_eCS_SBS_LastState_Reihe2_FS.CIL.Geltungsbereich_MQBw_Baseline.DE_eCS_SBS_LastState_Reihe2_FS, ecu-extract-reference=SP_IF_eCS_SBS_LastState_Reihe2_FS.CIL.TopLevelCompositionPrototype.DE_eCS_SBS_LastState_Reihe2_FS
      SP_IF_eCS_Status_Verr_Reihe1_BFS_1_227: upstream-reference=CIL.Geltungsbereich_MQBw_Baseline.SP_IF_eCS_Status_Verr_Reihe1_BFS_1, ecu-extract-reference=CIL.TopLevelCompositionPrototype.SP_IF_eCS_Status_Verr_Reihe1_BFS_1
      DE_eCS_Status_Verr_Reihe1_BFS_1_228: upstream-reference=SP_IF_eCS_Status_Verr_Reihe1_BFS_1.CIL.Geltungsbereich_MQBw_Baseline.DE_eCS_Status_Verr_Reihe1_BFS_1, ecu-extract-reference=SP_IF_eCS_Status_Verr_Reihe1_BFS_1.CIL.TopLevelCompositionPrototype.DE_eCS_Status_Verr_Reihe1_BFS_1
      SP_IF_eCS_Status_Verr_Reihe1_BFS_2_229: upstream-reference=CIL.Geltungsbereich_MQBw_Baseline.SP_IF_eCS_Status_Verr_Reihe1_BFS_2, ecu-extract-reference=CIL.TopLevelCompositionPrototype.SP_IF_eCS_Status_Verr_Reihe1_BFS_2
      DE_eCS_Status_Verr_Reihe1_BFS_2_230: upstream-reference=SP_IF_eCS_Status_Verr_Reihe1_BFS_2.CIL.Geltungsbereich_MQBw_Baseline.DE_eCS_Status_Verr_Reihe1_BFS_2, ecu-extract-reference=SP_IF_eCS_Status_Verr_Reihe1_BFS_2.CIL.TopLevelCompositionPrototype.DE_eCS_Status_Verr_Reihe1_BFS_2
      SP_IF_eCS_Status_Verr_Reihe1_FS_1_231: upstream-reference=CIL.Geltungsbereich_MQBw_Baseline.SP_IF_eCS_Status_Verr_Reihe1_FS_1, ecu-extract-reference=CIL.TopLevelCompositionPrototype.SP_IF_eCS_Status_Verr_Reihe1_FS_1
      DE_eCS_Status_Verr_Reihe1_FS_1_232: upstream-reference=SP_IF_eCS_Status_Verr_Reihe1_FS_1.CIL.Geltungsbereich_MQBw_Baseline.DE_eCS_Status_Verr_Reihe1_FS_1, ecu-extract-reference=SP_IF_eCS_Status_Verr_Reihe1_FS_1.CIL.TopLevelCompositionPrototype.DE_eCS_Status_Verr_Reihe1_FS_1
      SP_IF_eCS_Status_Verr_Reihe1_FS_2_233: upstream-reference=CIL.Geltungsbereich_MQBw_Baseline.SP_IF_eCS_Status_Verr_Reihe1_FS_2, ecu-extract-reference=CIL.TopLevelCompositionPrototype.SP_IF_eCS_Status_Verr_Reihe1_FS_2
      DE_eCS_Status_Verr_Reihe1_FS_2_234: upstream-reference=SP_IF_eCS_Status_Verr_Reihe1_FS_2.CIL.Geltungsbereich_MQBw_Baseline.DE_eCS_Status_Verr_Reihe1_FS_2, ecu-extract-reference=SP_IF_eCS_Status_Verr_Reihe1_FS_2.CIL.TopLevelCompositionPrototype.DE_eCS_Status_Verr_Reihe1_FS_2
      SP_IF_eCS_Status_Verr_Reihe2_BFS_235: upstream-reference=CIL.Geltungsbereich_MQBw_Baseline.SP_IF_eCS_Status_Verr_Reihe2_BFS, ecu-extract-reference=CIL.TopLevelCompositionPrototype.SP_IF_eCS_Status_Verr_Reihe2_BFS
      DE_eCS_Status_Verr_Reihe2_BFS_236: upstream-reference=SP_IF_eCS_Status_Verr_Reihe2_BFS.CIL.Geltungsbereich_MQBw_Baseline.DE_eCS_Status_Verr_Reihe2_BFS, ecu-extract-reference=SP_IF_eCS_Status_Verr_Reihe2_BFS.CIL.TopLevelCompositionPrototype.DE_eCS_Status_Verr_Reihe2_BFS
      SP_IF_eCS_Status_Verr_Reihe2_FS_237: upstream-reference=CIL.Geltungsbereich_MQBw_Baseline.SP_IF_eCS_Status_Verr_Reihe2_FS, ecu-extract-reference=CIL.TopLevelCompositionPrototype.SP_IF_eCS_Status_Verr_Reihe2_FS
      DE_eCS_Status_Verr_Reihe2_FS_238: upstream-reference=SP_IF_eCS_Status_Verr_Reihe2_FS.CIL.Geltungsbereich_MQBw_Baseline.DE_eCS_Status_Verr_Reihe2_FS, ecu-extract-reference=SP_IF_eCS_Status_Verr_Reihe2_FS.CIL.TopLevelCompositionPrototype.DE_eCS_Status_Verr_Reihe2_FS
      SP_IF_eCS_Status_XIX_Grundumfang_XIX_eCS_239: upstream-reference=CIL.Geltungsbereich_MQBw_Baseline.SP_IF_eCS_Status_XIX_Grundumfang_XIX_eCS, ecu-extract-reference=CIL.TopLevelCompositionPrototype.SP_IF_eCS_Status_XIX_Grundumfang_XIX_eCS
      DE_eCS_Status_240: upstream-reference=SP_IF_eCS_Status_XIX_Grundumfang_XIX_eCS.CIL.Geltungsbereich_MQBw_Baseline.DE_eCS_Status, ecu-extract-reference=SP_IF_eCS_Status_XIX_Grundumfang_XIX_eCS.CIL.TopLevelCompositionPrototype.DE_eCS_Status
      SP_IF_eCS_Stoerung_XIX_Grundumfang_XIX_eCS_241: upstream-reference=CIL.Geltungsbereich_MQBw_Baseline.SP_IF_eCS_Stoerung_XIX_Grundumfang_XIX_eCS, ecu-extract-reference=CIL.TopLevelCompositionPrototype.SP_IF_eCS_Stoerung_XIX_Grundumfang_XIX_eCS
      DE_eCS_Stoerung_242: upstream-reference=SP_IF_eCS_Stoerung_XIX_Grundumfang_XIX_eCS.CIL.Geltungsbereich_MQBw_Baseline.DE_eCS_Stoerung, ecu-extract-reference=SP_IF_eCS_Stoerung_XIX_Grundumfang_XIX_eCS.CIL.TopLevelCompositionPrototype.DE_eCS_Stoerung
      pclAccSensor_243: upstream-reference=CIL.Geltungsbereich_MQBw_Baseline.pclAccSensor, ecu-extract-reference=CIL.TopLevelCompositionPrototype.pclAccSensor
      pclConvAdcService_244: upstream-reference=CIL.Geltungsbereich_MQBw_Baseline.pclConvAdcService, ecu-extract-reference=CIL.TopLevelCompositionPrototype.pclConvAdcService
      pclEcuCharacterstics_245: upstream-reference=CIL.Geltungsbereich_MQBw_Baseline.pclEcuCharacterstics, ecu-extract-reference=CIL.TopLevelCompositionPrototype.pclEcuCharacterstics
      pclMcuCharacteristics_246: upstream-reference=CIL.Geltungsbereich_MQBw_Baseline.pclMcuCharacteristics, ecu-extract-reference=CIL.TopLevelCompositionPrototype.pclMcuCharacteristics
      pclModeManagement_247: upstream-reference=CIL.Geltungsbereich_MQBw_Baseline.pclModeManagement, ecu-extract-reference=CIL.TopLevelCompositionPrototype.pclModeManagement
      pclPtcSensor_248: upstream-reference=CIL.Geltungsbereich_MQBw_Baseline.pclPtcSensor, ecu-extract-reference=CIL.TopLevelCompositionPrototype.pclPtcSensor
      pclSolenoidCharacteristics_249: upstream-reference=CIL.Geltungsbereich_MQBw_Baseline.pclSolenoidCharacteristics, ecu-extract-reference=CIL.TopLevelCompositionPrototype.pclSolenoidCharacteristics
      pclSolenoidProfile_250: upstream-reference=CIL.Geltungsbereich_MQBw_Baseline.pclSolenoidProfile, ecu-extract-reference=CIL.TopLevelCompositionPrototype.pclSolenoidProfile
      au8SelectedProfile_251: upstream-reference=pclSolenoidProfile.CIL.Geltungsbereich_MQBw_Baseline.au8SelectedProfile, ecu-extract-reference=pclSolenoidProfile.CIL.TopLevelCompositionPrototype.au8SelectedProfile
      pclSolenoidStep_252: upstream-reference=CIL.Geltungsbereich_MQBw_Baseline.pclSolenoidStep, ecu-extract-reference=CIL.TopLevelCompositionPrototype.pclSolenoidStep
      au8CurrentStep_253: upstream-reference=pclSolenoidStep.CIL.Geltungsbereich_MQBw_Baseline.au8CurrentStep, ecu-extract-reference=pclSolenoidStep.CIL.TopLevelCompositionPrototype.au8CurrentStep
      prr3DAcceleration_254: upstream-reference=CIL.Geltungsbereich_MQBw_Baseline.prr3DAcceleration, ecu-extract-reference=CIL.TopLevelCompositionPrototype.prr3DAcceleration
      st3DAccel_255: upstream-reference=prr3DAcceleration.CIL.Geltungsbereich_MQBw_Baseline.st3DAccel, ecu-extract-reference=prr3DAcceleration.CIL.TopLevelCompositionPrototype.st3DAccel
      s16AxAppl_256: upstream-reference=prr3DAcceleration.CIL.Geltungsbereich_MQBw_Baseline.st3DAccel.s16AxAppl, ecu-extract-reference=prr3DAcceleration.CIL.TopLevelCompositionPrototype.st3DAccel.s16AxAppl
      s16AyAppl_257: upstream-reference=prr3DAcceleration.CIL.Geltungsbereich_MQBw_Baseline.st3DAccel.s16AyAppl, ecu-extract-reference=prr3DAcceleration.CIL.TopLevelCompositionPrototype.st3DAccel.s16AyAppl
      s16AzAppl_258: upstream-reference=prr3DAcceleration.CIL.Geltungsbereich_MQBw_Baseline.st3DAccel.s16AzAppl, ecu-extract-reference=prr3DAcceleration.CIL.TopLevelCompositionPrototype.st3DAccel.s16AzAppl
      prrAccStatusFailiureSource_259: upstream-reference=CIL.Geltungsbereich_MQBw_Baseline.prrAccStatusFailiureSource, ecu-extract-reference=CIL.TopLevelCompositionPrototype.prrAccStatusFailiureSource
      u32AccAlarmRegStatus_260: upstream-reference=prrAccStatusFailiureSource.CIL.Geltungsbereich_MQBw_Baseline.u32AccAlarmRegStatus, ecu-extract-reference=prrAccStatusFailiureSource.CIL.TopLevelCompositionPrototype.u32AccAlarmRegStatus
      u8AccAlarmbPreinitSeqStatus_261: upstream-reference=prrAccStatusFailiureSource.CIL.Geltungsbereich_MQBw_Baseline.u8AccAlarmbPreinitSeqStatus, ecu-extract-reference=prrAccStatusFailiureSource.CIL.TopLevelCompositionPrototype.u8AccAlarmbPreinitSeqStatus
      u8AccCRCStatus_262: upstream-reference=prrAccStatusFailiureSource.CIL.Geltungsbereich_MQBw_Baseline.u8AccCRCStatus, ecu-extract-reference=prrAccStatusFailiureSource.CIL.TopLevelCompositionPrototype.u8AccCRCStatus
      u8AccReturnStatus_263: upstream-reference=prrAccStatusFailiureSource.CIL.Geltungsbereich_MQBw_Baseline.u8AccReturnStatus, ecu-extract-reference=prrAccStatusFailiureSource.CIL.TopLevelCompositionPrototype.u8AccReturnStatus
      u8AccelAxisBroken_264: upstream-reference=prrAccStatusFailiureSource.CIL.Geltungsbereich_MQBw_Baseline.u8AccelAxisBroken, ecu-extract-reference=prrAccStatusFailiureSource.CIL.TopLevelCompositionPrototype.u8AccelAxisBroken
      prrAccelMtrPerSecSqd_265: upstream-reference=CIL.Geltungsbereich_MQBw_Baseline.prrAccelMtrPerSecSqd, ecu-extract-reference=CIL.TopLevelCompositionPrototype.prrAccelMtrPerSecSqd
      stAccelMtrPerSecSqd_266: upstream-reference=prrAccelMtrPerSecSqd.CIL.Geltungsbereich_MQBw_Baseline.stAccelMtrPerSecSqd, ecu-extract-reference=prrAccelMtrPerSecSqd.CIL.TopLevelCompositionPrototype.stAccelMtrPerSecSqd
      s16AxAppl_267: upstream-reference=prrAccelMtrPerSecSqd.CIL.Geltungsbereich_MQBw_Baseline.stAccelMtrPerSecSqd.s16AxAppl, ecu-extract-reference=prrAccelMtrPerSecSqd.CIL.TopLevelCompositionPrototype.stAccelMtrPerSecSqd.s16AxAppl
      s16AyAppl_268: upstream-reference=prrAccelMtrPerSecSqd.CIL.Geltungsbereich_MQBw_Baseline.stAccelMtrPerSecSqd.s16AyAppl, ecu-extract-reference=prrAccelMtrPerSecSqd.CIL.TopLevelCompositionPrototype.stAccelMtrPerSecSqd.s16AyAppl
      s16AzAppl_269: upstream-reference=prrAccelMtrPerSecSqd.CIL.Geltungsbereich_MQBw_Baseline.stAccelMtrPerSecSqd.s16AzAppl, ecu-extract-reference=prrAccelMtrPerSecSqd.CIL.TopLevelCompositionPrototype.stAccelMtrPerSecSqd.s16AzAppl
      prrBuckleStatus_270: upstream-reference=CIL.Geltungsbereich_MQBw_Baseline.prrBuckleStatus, ecu-extract-reference=CIL.TopLevelCompositionPrototype.prrBuckleStatus
      au8BuckleStatus_271: upstream-reference=prrBuckleStatus.CIL.Geltungsbereich_MQBw_Baseline.au8BuckleStatus, ecu-extract-reference=prrBuckleStatus.CIL.TopLevelCompositionPrototype.au8BuckleStatus
      prrEcsAlgoData_272: upstream-reference=CIL.Geltungsbereich_MQBw_Baseline.prrEcsAlgoData, ecu-extract-reference=CIL.TopLevelCompositionPrototype.prrEcsAlgoData
      u16BallPosition_273: upstream-reference=prrEcsAlgoData.CIL.Geltungsbereich_MQBw_Baseline.u16BallPosition, ecu-extract-reference=prrEcsAlgoData.CIL.TopLevelCompositionPrototype.u16BallPosition
      u8EcsFlag_274: upstream-reference=prrEcsAlgoData.CIL.Geltungsbereich_MQBw_Baseline.u8EcsFlag, ecu-extract-reference=prrEcsAlgoData.CIL.TopLevelCompositionPrototype.u8EcsFlag
      prrSbcStatusFailiureSource_275: upstream-reference=CIL.Geltungsbereich_MQBw_Baseline.prrSbcStatusFailiureSource, ecu-extract-reference=CIL.TopLevelCompositionPrototype.prrSbcStatusFailiureSource
      u32SbcReg1Status_276: upstream-reference=prrSbcStatusFailiureSource.CIL.Geltungsbereich_MQBw_Baseline.u32SbcReg1Status, ecu-extract-reference=prrSbcStatusFailiureSource.CIL.TopLevelCompositionPrototype.u32SbcReg1Status
      prrSeatOccupancySensorStatus_277: upstream-reference=CIL.Geltungsbereich_MQBw_Baseline.prrSeatOccupancySensorStatus, ecu-extract-reference=CIL.TopLevelCompositionPrototype.prrSeatOccupancySensorStatus
      au8SeatOccupancySensorStatus_278: upstream-reference=prrSeatOccupancySensorStatus.CIL.Geltungsbereich_MQBw_Baseline.au8SeatOccupancySensorStatus, ecu-extract-reference=prrSeatOccupancySensorStatus.CIL.TopLevelCompositionPrototype.au8SeatOccupancySensorStatus
      prrSolenoidOCStatus_279: upstream-reference=CIL.Geltungsbereich_MQBw_Baseline.prrSolenoidOCStatus, ecu-extract-reference=CIL.TopLevelCompositionPrototype.prrSolenoidOCStatus
      au8SolenoidAutotestStatus_280: upstream-reference=prrSolenoidOCStatus.CIL.Geltungsbereich_MQBw_Baseline.au8SolenoidAutotestStatus, ecu-extract-reference=prrSolenoidOCStatus.CIL.TopLevelCompositionPrototype.au8SolenoidAutotestStatus
      prrSolenoidOvervoltageStatus_281: upstream-reference=CIL.Geltungsbereich_MQBw_Baseline.prrSolenoidOvervoltageStatus, ecu-extract-reference=CIL.TopLevelCompositionPrototype.prrSolenoidOvervoltageStatus
      au8SolenoidOvervoltageStatus_282: upstream-reference=prrSolenoidOvervoltageStatus.CIL.Geltungsbereich_MQBw_Baseline.au8SolenoidOvervoltageStatus, ecu-extract-reference=prrSolenoidOvervoltageStatus.CIL.TopLevelCompositionPrototype.au8SolenoidOvervoltageStatus
      prrSolenoidPWM_283: upstream-reference=CIL.Geltungsbereich_MQBw_Baseline.prrSolenoidPWM, ecu-extract-reference=CIL.TopLevelCompositionPrototype.prrSolenoidPWM
      au16Pwm_284: upstream-reference=prrSolenoidPWM.CIL.Geltungsbereich_MQBw_Baseline.au16Pwm, ecu-extract-reference=prrSolenoidPWM.CIL.TopLevelCompositionPrototype.au16Pwm
      prrSolenoidShortToGndStatus_285: upstream-reference=CIL.Geltungsbereich_MQBw_Baseline.prrSolenoidShortToGndStatus, ecu-extract-reference=CIL.TopLevelCompositionPrototype.prrSolenoidShortToGndStatus
      au8SolenoidAutotestStatus_286: upstream-reference=prrSolenoidShortToGndStatus.CIL.Geltungsbereich_MQBw_Baseline.au8SolenoidAutotestStatus, ecu-extract-reference=prrSolenoidShortToGndStatus.CIL.TopLevelCompositionPrototype.au8SolenoidAutotestStatus
      prrSolenoidShortToVccStatus_287: upstream-reference=CIL.Geltungsbereich_MQBw_Baseline.prrSolenoidShortToVccStatus, ecu-extract-reference=CIL.TopLevelCompositionPrototype.prrSolenoidShortToVccStatus
      au8SolenoidAutotestStatus_288: upstream-reference=prrSolenoidShortToVccStatus.CIL.Geltungsbereich_MQBw_Baseline.au8SolenoidAutotestStatus, ecu-extract-reference=prrSolenoidShortToVccStatus.CIL.TopLevelCompositionPrototype.au8SolenoidAutotestStatus
      prrSolenoidState_289: upstream-reference=CIL.Geltungsbereich_MQBw_Baseline.prrSolenoidState, ecu-extract-reference=CIL.TopLevelCompositionPrototype.prrSolenoidState
      au8SolenoidState_290: upstream-reference=prrSolenoidState.CIL.Geltungsbereich_MQBw_Baseline.au8SolenoidState, ecu-extract-reference=prrSolenoidState.CIL.TopLevelCompositionPrototype.au8SolenoidState
      prrSolenoidStuckStatus_291: upstream-reference=CIL.Geltungsbereich_MQBw_Baseline.prrSolenoidStuckStatus, ecu-extract-reference=CIL.TopLevelCompositionPrototype.prrSolenoidStuckStatus
      au8SolenoidIsStuck_292: upstream-reference=prrSolenoidStuckStatus.CIL.Geltungsbereich_MQBw_Baseline.au8SolenoidIsStuck, ecu-extract-reference=prrSolenoidStuckStatus.CIL.TopLevelCompositionPrototype.au8SolenoidIsStuck
      pseSetEcuStateSignal_293: upstream-reference=CIL.Geltungsbereich_MQBw_Baseline.pseSetEcuStateSignal, ecu-extract-reference=CIL.TopLevelCompositionPrototype.pseSetEcuStateSignal
      psrCILData_294: upstream-reference=CIL.Geltungsbereich_MQBw_Baseline.psrCILData, ecu-extract-reference=CIL.TopLevelCompositionPrototype.psrCILData
      au8MergedBuckleStatus_295: upstream-reference=psrCILData.CIL.Geltungsbereich_MQBw_Baseline.au8MergedBuckleStatus, ecu-extract-reference=psrCILData.CIL.TopLevelCompositionPrototype.au8MergedBuckleStatus
      psrCrashStatus_296: upstream-reference=CIL.Geltungsbereich_MQBw_Baseline.psrCrashStatus, ecu-extract-reference=CIL.TopLevelCompositionPrototype.psrCrashStatus
      u8IsCrashActive_297: upstream-reference=psrCrashStatus.CIL.Geltungsbereich_MQBw_Baseline.u8IsCrashActive, ecu-extract-reference=psrCrashStatus.CIL.TopLevelCompositionPrototype.u8IsCrashActive
      psrEcsDiagRequest_298: upstream-reference=CIL.Geltungsbereich_MQBw_Baseline.psrEcsDiagRequest, ecu-extract-reference=CIL.TopLevelCompositionPrototype.psrEcsDiagRequest
      au8DiagReq_299: upstream-reference=psrEcsDiagRequest.CIL.Geltungsbereich_MQBw_Baseline.au8DiagReq, ecu-extract-reference=psrEcsDiagRequest.CIL.TopLevelCompositionPrototype.au8DiagReq
      au8DiagReqComplement_300: upstream-reference=psrEcsDiagRequest.CIL.Geltungsbereich_MQBw_Baseline.au8DiagReqComplement, ecu-extract-reference=psrEcsDiagRequest.CIL.TopLevelCompositionPrototype.au8DiagReqComplement
      ptrpAsrOsServicesCIL_301: upstream-reference=CIL.Geltungsbereich_MQBw_Baseline.ptrpAsrOsServicesCIL, ecu-extract-reference=CIL.TopLevelCompositionPrototype.ptrpAsrOsServicesCIL
      ptrpCilServicesBswMIf_302: upstream-reference=CIL.Geltungsbereich_MQBw_Baseline.ptrpCilServicesBswMIf, ecu-extract-reference=CIL.TopLevelCompositionPrototype.ptrpCilServicesBswMIf
      DIA_303: upstream-reference=Geltungsbereich_MQBw_Baseline.DIA, ecu-extract-reference=TopLevelCompositionPrototype.DIA
      pclAccSensor_304: upstream-reference=DIA.Geltungsbereich_MQBw_Baseline.pclAccSensor, ecu-extract-reference=DIA.TopLevelCompositionPrototype.pclAccSensor
      pclConvAdcService_305: upstream-reference=DIA.Geltungsbereich_MQBw_Baseline.pclConvAdcService, ecu-extract-reference=DIA.TopLevelCompositionPrototype.pclConvAdcService
      pclDemServices_306: upstream-reference=DIA.Geltungsbereich_MQBw_Baseline.pclDemServices, ecu-extract-reference=DIA.TopLevelCompositionPrototype.pclDemServices
      pclEcuCharacterstics_307: upstream-reference=DIA.Geltungsbereich_MQBw_Baseline.pclEcuCharacterstics, ecu-extract-reference=DIA.TopLevelCompositionPrototype.pclEcuCharacterstics
      pclFsmServices_308: upstream-reference=DIA.Geltungsbereich_MQBw_Baseline.pclFsmServices, ecu-extract-reference=DIA.TopLevelCompositionPrototype.pclFsmServices
      pclMcuCharacteristics_309: upstream-reference=DIA.Geltungsbereich_MQBw_Baseline.pclMcuCharacteristics, ecu-extract-reference=DIA.TopLevelCompositionPrototype.pclMcuCharacteristics
      pclNvmIfServices_310: upstream-reference=DIA.Geltungsbereich_MQBw_Baseline.pclNvmIfServices, ecu-extract-reference=DIA.TopLevelCompositionPrototype.pclNvmIfServices
      pclPtcSensor_311: upstream-reference=DIA.Geltungsbereich_MQBw_Baseline.pclPtcSensor, ecu-extract-reference=DIA.TopLevelCompositionPrototype.pclPtcSensor
      pclResetCause_312: upstream-reference=DIA.Geltungsbereich_MQBw_Baseline.pclResetCause, ecu-extract-reference=DIA.TopLevelCompositionPrototype.pclResetCause
      pclResetCauseNotification_313: upstream-reference=DIA.Geltungsbereich_MQBw_Baseline.pclResetCauseNotification, ecu-extract-reference=DIA.TopLevelCompositionPrototype.pclResetCauseNotification
      pclSystemTime_314: upstream-reference=DIA.Geltungsbereich_MQBw_Baseline.pclSystemTime, ecu-extract-reference=DIA.TopLevelCompositionPrototype.pclSystemTime
      prr3DAcceleration_315: upstream-reference=DIA.Geltungsbereich_MQBw_Baseline.prr3DAcceleration, ecu-extract-reference=DIA.TopLevelCompositionPrototype.prr3DAcceleration
      st3DAccel_316: upstream-reference=prr3DAcceleration.DIA.Geltungsbereich_MQBw_Baseline.st3DAccel, ecu-extract-reference=prr3DAcceleration.DIA.TopLevelCompositionPrototype.st3DAccel
      s16AxAppl_317: upstream-reference=prr3DAcceleration.DIA.Geltungsbereich_MQBw_Baseline.st3DAccel.s16AxAppl, ecu-extract-reference=prr3DAcceleration.DIA.TopLevelCompositionPrototype.st3DAccel.s16AxAppl
      s16AyAppl_318: upstream-reference=prr3DAcceleration.DIA.Geltungsbereich_MQBw_Baseline.st3DAccel.s16AyAppl, ecu-extract-reference=prr3DAcceleration.DIA.TopLevelCompositionPrototype.st3DAccel.s16AyAppl
      s16AzAppl_319: upstream-reference=prr3DAcceleration.DIA.Geltungsbereich_MQBw_Baseline.st3DAccel.s16AzAppl, ecu-extract-reference=prr3DAcceleration.DIA.TopLevelCompositionPrototype.st3DAccel.s16AzAppl
      pseCallBackDCMRequestServices_CBReqServInd_1_320: upstream-reference=DIA.Geltungsbereich_MQBw_Baseline.pseCallBackDCMRequestServices_CBReqServInd_1, ecu-extract-reference=DIA.TopLevelCompositionPrototype.pseCallBackDCMRequestServices_CBReqServInd_1
      pseDID_0236_ProgrammingDataElockEcu_321: upstream-reference=DIA.Geltungsbereich_MQBw_Baseline.pseDID_0236_ProgrammingDataElockEcu, ecu-extract-reference=DIA.TopLevelCompositionPrototype.pseDID_0236_ProgrammingDataElockEcu
      pseDID_023E_WSCForProgrammingElockEcu_322: upstream-reference=DIA.Geltungsbereich_MQBw_Baseline.pseDID_023E_WSCForProgrammingElockEcu, ecu-extract-reference=DIA.TopLevelCompositionPrototype.pseDID_023E_WSCForProgrammingElockEcu
      pseDID_0407_VWLogicalSoftwareBlockCounterOfProgrammingAttempts_323: upstream-reference=DIA.Geltungsbereich_MQBw_Baseline.pseDID_0407_VWLogicalSoftwareBlockCounterOfProgrammingAttempts, ecu-extract-reference=DIA.TopLevelCompositionPrototype.pseDID_0407_VWLogicalSoftwareBlockCounterOfProgrammingAttempts
      pseDID_040F_VWLogicalSoftwareBlockLockValue_324: upstream-reference=DIA.Geltungsbereich_MQBw_Baseline.pseDID_040F_VWLogicalSoftwareBlockLockValue, ecu-extract-reference=DIA.TopLevelCompositionPrototype.pseDID_040F_VWLogicalSoftwareBlockLockValue
      pseDID_0410_BootloaderTPBlocksize_325: upstream-reference=DIA.Geltungsbereich_MQBw_Baseline.pseDID_0410_BootloaderTPBlocksize, ecu-extract-reference=DIA.TopLevelCompositionPrototype.pseDID_0410_BootloaderTPBlocksize
      pseDID_0448_ProgrammingPreconditions_326: upstream-reference=DIA.Geltungsbereich_MQBw_Baseline.pseDID_0448_ProgrammingPreconditions, ecu-extract-reference=DIA.TopLevelCompositionPrototype.pseDID_0448_ProgrammingPreconditions
      pseDID_4024_SWSystemTime_327: upstream-reference=DIA.Geltungsbereich_MQBw_Baseline.pseDID_4024_SWSystemTime, ecu-extract-reference=DIA.TopLevelCompositionPrototype.pseDID_4024_SWSystemTime
      pseDID_F15B_FingerprintAndProgrammingDateOfLogicalSoftwareBlocks_328: upstream-reference=DIA.Geltungsbereich_MQBw_Baseline.pseDID_F15B_FingerprintAndProgrammingDateOfLogicalSoftwareBlocks, ecu-extract-reference=DIA.TopLevelCompositionPrototype.pseDID_F15B_FingerprintAndProgrammingDateOfLogicalSoftwareBlocks
      pseDID_F187_VWSparePartNumber_329: upstream-reference=DIA.Geltungsbereich_MQBw_Baseline.pseDID_F187_VWSparePartNumber, ecu-extract-reference=DIA.TopLevelCompositionPrototype.pseDID_F187_VWSparePartNumber
      pseDID_F189_VWApplicationSoftwareVersionNumber_330: upstream-reference=DIA.Geltungsbereich_MQBw_Baseline.pseDID_F189_VWApplicationSoftwareVersionNumber, ecu-extract-reference=DIA.TopLevelCompositionPrototype.pseDID_F189_VWApplicationSoftwareVersionNumber
      pseDID_F18C_ECUSerialNumberData_331: upstream-reference=DIA.Geltungsbereich_MQBw_Baseline.pseDID_F18C_ECUSerialNumberData, ecu-extract-reference=DIA.TopLevelCompositionPrototype.pseDID_F18C_ECUSerialNumberData
      pseDID_F191_VWECUHardwareNumber_332: upstream-reference=DIA.Geltungsbereich_MQBw_Baseline.pseDID_F191_VWECUHardwareNumber, ecu-extract-reference=DIA.TopLevelCompositionPrototype.pseDID_F191_VWECUHardwareNumber
      pseDID_F197_VWSystemNameOrEngineType_333: upstream-reference=DIA.Geltungsbereich_MQBw_Baseline.pseDID_F197_VWSystemNameOrEngineType, ecu-extract-reference=DIA.TopLevelCompositionPrototype.pseDID_F197_VWSystemNameOrEngineType
      pseDID_F19E_ASAMODXFileIdentifier_334: upstream-reference=DIA.Geltungsbereich_MQBw_Baseline.pseDID_F19E_ASAMODXFileIdentifier, ecu-extract-reference=DIA.TopLevelCompositionPrototype.pseDID_F19E_ASAMODXFileIdentifier
      pseDID_F1A2_ASAMODXFileVersion_335: upstream-reference=DIA.Geltungsbereich_MQBw_Baseline.pseDID_F1A2_ASAMODXFileVersion, ecu-extract-reference=DIA.TopLevelCompositionPrototype.pseDID_F1A2_ASAMODXFileVersion
      pseDID_F1A3_VWECUHardwareVersionNumber_336: upstream-reference=DIA.Geltungsbereich_MQBw_Baseline.pseDID_F1A3_VWECUHardwareVersionNumber, ecu-extract-reference=DIA.TopLevelCompositionPrototype.pseDID_F1A3_VWECUHardwareVersionNumber
      pseDID_F1AB_VWLogicalSoftwareBlockVersion_337: upstream-reference=DIA.Geltungsbereich_MQBw_Baseline.pseDID_F1AB_VWLogicalSoftwareBlockVersion, ecu-extract-reference=DIA.TopLevelCompositionPrototype.pseDID_F1AB_VWLogicalSoftwareBlockVersion
      pseDID_F1B4_TechnicalSpecificationsVersion_338: upstream-reference=DIA.Geltungsbereich_MQBw_Baseline.pseDID_F1B4_TechnicalSpecificationsVersion, ecu-extract-reference=DIA.TopLevelCompositionPrototype.pseDID_F1B4_TechnicalSpecificationsVersion
      pseDID_F1D5_FDSProject_339: upstream-reference=DIA.Geltungsbereich_MQBw_Baseline.pseDID_F1D5_FDSProject, ecu-extract-reference=DIA.TopLevelCompositionPrototype.pseDID_F1D5_FDSProject
      pseDID_F1DF_ECUProgrammingInformation_340: upstream-reference=DIA.Geltungsbereich_MQBw_Baseline.pseDID_F1DF_ECUProgrammingInformation, ecu-extract-reference=DIA.TopLevelCompositionPrototype.pseDID_F1DF_ECUProgrammingInformation
      pseDID_FD00_HWVersion_341: upstream-reference=DIA.Geltungsbereich_MQBw_Baseline.pseDID_FD00_HWVersion, ecu-extract-reference=DIA.TopLevelCompositionPrototype.pseDID_FD00_HWVersion
      pseDID_FD01_SWVersion_342: upstream-reference=DIA.Geltungsbereich_MQBw_Baseline.pseDID_FD01_SWVersion, ecu-extract-reference=DIA.TopLevelCompositionPrototype.pseDID_FD01_SWVersion
      pseDID_FD03_AEETraceabilityNumber_343: upstream-reference=DIA.Geltungsbereich_MQBw_Baseline.pseDID_FD03_AEETraceabilityNumber, ecu-extract-reference=DIA.TopLevelCompositionPrototype.pseDID_FD03_AEETraceabilityNumber
      pseDID_FD08_ResetCause_344: upstream-reference=DIA.Geltungsbereich_MQBw_Baseline.pseDID_FD08_ResetCause, ecu-extract-reference=DIA.TopLevelCompositionPrototype.pseDID_FD08_ResetCause
      pseDID_FD09_LastWarmResetParam_345: upstream-reference=DIA.Geltungsbereich_MQBw_Baseline.pseDID_FD09_LastWarmResetParam, ecu-extract-reference=DIA.TopLevelCompositionPrototype.pseDID_FD09_LastWarmResetParam
      pseDID_FD0F_BatteryMeasure_346: upstream-reference=DIA.Geltungsbereich_MQBw_Baseline.pseDID_FD0F_BatteryMeasure, ecu-extract-reference=DIA.TopLevelCompositionPrototype.pseDID_FD0F_BatteryMeasure
      pseDID_FD10_ECUTemperature_347: upstream-reference=DIA.Geltungsbereich_MQBw_Baseline.pseDID_FD10_ECUTemperature, ecu-extract-reference=DIA.TopLevelCompositionPrototype.pseDID_FD10_ECUTemperature
      pseDID_FD62_EccOccurenceNb_348: upstream-reference=DIA.Geltungsbereich_MQBw_Baseline.pseDID_FD62_EccOccurenceNb, ecu-extract-reference=DIA.TopLevelCompositionPrototype.pseDID_FD62_EccOccurenceNb
      pseDID_FD8B_ECUManufacturingDate_349: upstream-reference=DIA.Geltungsbereich_MQBw_Baseline.pseDID_FD8B_ECUManufacturingDate, ecu-extract-reference=DIA.TopLevelCompositionPrototype.pseDID_FD8B_ECUManufacturingDate
      pseDID_FD8C_AssemblySerialNumber_350: upstream-reference=DIA.Geltungsbereich_MQBw_Baseline.pseDID_FD8C_AssemblySerialNumber, ecu-extract-reference=DIA.TopLevelCompositionPrototype.pseDID_FD8C_AssemblySerialNumber
      pseDID_FDE0_EcsVariant_351: upstream-reference=DIA.Geltungsbereich_MQBw_Baseline.pseDID_FDE0_EcsVariant, ecu-extract-reference=DIA.TopLevelCompositionPrototype.pseDID_FDE0_EcsVariant
      pseDID_FDE1_EcsParameters_352: upstream-reference=DIA.Geltungsbereich_MQBw_Baseline.pseDID_FDE1_EcsParameters, ecu-extract-reference=DIA.TopLevelCompositionPrototype.pseDID_FDE1_EcsParameters
      pseDID_FDE2_EcsAccOffsets_353: upstream-reference=DIA.Geltungsbereich_MQBw_Baseline.pseDID_FDE2_EcsAccOffsets, ecu-extract-reference=DIA.TopLevelCompositionPrototype.pseDID_FDE2_EcsAccOffsets
      pseDID_FDE3_EcsProfiles_354: upstream-reference=DIA.Geltungsbereich_MQBw_Baseline.pseDID_FDE3_EcsProfiles, ecu-extract-reference=DIA.TopLevelCompositionPrototype.pseDID_FDE3_EcsProfiles
      pseDID_FDE4_EcsSteps_355: upstream-reference=DIA.Geltungsbereich_MQBw_Baseline.pseDID_FDE4_EcsSteps, ecu-extract-reference=DIA.TopLevelCompositionPrototype.pseDID_FDE4_EcsSteps
      pseDID_FDE5_EcsAccLowPass_356: upstream-reference=DIA.Geltungsbereich_MQBw_Baseline.pseDID_FDE5_EcsAccLowPass, ecu-extract-reference=DIA.TopLevelCompositionPrototype.pseDID_FDE5_EcsAccLowPass
      pseDID_FDE7_EcsAlgoOutputDelay_357: upstream-reference=DIA.Geltungsbereich_MQBw_Baseline.pseDID_FDE7_EcsAlgoOutputDelay, ecu-extract-reference=DIA.TopLevelCompositionPrototype.pseDID_FDE7_EcsAlgoOutputDelay
      pseDID_FDE9_SensitivityLutData_358: upstream-reference=DIA.Geltungsbereich_MQBw_Baseline.pseDID_FDE9_SensitivityLutData, ecu-extract-reference=DIA.TopLevelCompositionPrototype.pseDID_FDE9_SensitivityLutData
      pseDID_FDEA_SensitivityOptData_359: upstream-reference=DIA.Geltungsbereich_MQBw_Baseline.pseDID_FDEA_SensitivityOptData, ecu-extract-reference=DIA.TopLevelCompositionPrototype.pseDID_FDEA_SensitivityOptData
      pseDID_FDFF_MeasurementFrameRamConf_360: upstream-reference=DIA.Geltungsbereich_MQBw_Baseline.pseDID_FDFF_MeasurementFrameRamConf, ecu-extract-reference=DIA.TopLevelCompositionPrototype.pseDID_FDFF_MeasurementFrameRamConf
      pseDID_FE00_AllEventStatusesRead_361: upstream-reference=DIA.Geltungsbereich_MQBw_Baseline.pseDID_FE00_AllEventStatusesRead, ecu-extract-reference=DIA.TopLevelCompositionPrototype.pseDID_FE00_AllEventStatusesRead
      pseDID_FEFF_MeasurementFramesConf_362: upstream-reference=DIA.Geltungsbereich_MQBw_Baseline.pseDID_FEFF_MeasurementFramesConf, ecu-extract-reference=DIA.TopLevelCompositionPrototype.pseDID_FEFF_MeasurementFramesConf
      pseEcsDiagRequest_363: upstream-reference=DIA.Geltungsbereich_MQBw_Baseline.pseEcsDiagRequest, ecu-extract-reference=DIA.TopLevelCompositionPrototype.pseEcsDiagRequest
      au8DiagReq_364: upstream-reference=pseEcsDiagRequest.DIA.Geltungsbereich_MQBw_Baseline.au8DiagReq, ecu-extract-reference=pseEcsDiagRequest.DIA.TopLevelCompositionPrototype.au8DiagReq
      au8DiagReqComplement_365: upstream-reference=pseEcsDiagRequest.DIA.Geltungsbereich_MQBw_Baseline.au8DiagReqComplement, ecu-extract-reference=pseEcsDiagRequest.DIA.TopLevelCompositionPrototype.au8DiagReqComplement
      pseNvpBlockData_366: upstream-reference=DIA.Geltungsbereich_MQBw_Baseline.pseNvpBlockData, ecu-extract-reference=DIA.TopLevelCompositionPrototype.pseNvpBlockData
      u8NvpEcuLockStatus_367: upstream-reference=pseNvpBlockData.DIA.Geltungsbereich_MQBw_Baseline.u8NvpEcuLockStatus, ecu-extract-reference=pseNvpBlockData.DIA.TopLevelCompositionPrototype.u8NvpEcuLockStatus
      u8NvpProcessMode_368: upstream-reference=pseNvpBlockData.DIA.Geltungsbereich_MQBw_Baseline.u8NvpProcessMode, ecu-extract-reference=pseNvpBlockData.DIA.TopLevelCompositionPrototype.u8NvpProcessMode
      pseRoutineControl_AccAngleOffsetCalibration_369: upstream-reference=DIA.Geltungsbereich_MQBw_Baseline.pseRoutineControl_AccAngleOffsetCalibration, ecu-extract-reference=DIA.TopLevelCompositionPrototype.pseRoutineControl_AccAngleOffsetCalibration
      pseRoutineControl_AccCalib_370: upstream-reference=DIA.Geltungsbereich_MQBw_Baseline.pseRoutineControl_AccCalib, ecu-extract-reference=DIA.TopLevelCompositionPrototype.pseRoutineControl_AccCalib
      pseRoutineControl_CheckProgrammingPreconditions_371: upstream-reference=DIA.Geltungsbereich_MQBw_Baseline.pseRoutineControl_CheckProgrammingPreconditions, ecu-extract-reference=DIA.TopLevelCompositionPrototype.pseRoutineControl_CheckProgrammingPreconditions
      pseRoutineControl_EcuTempCalibration_372: upstream-reference=DIA.Geltungsbereich_MQBw_Baseline.pseRoutineControl_EcuTempCalibration, ecu-extract-reference=DIA.TopLevelCompositionPrototype.pseRoutineControl_EcuTempCalibration
      pseRoutineControl_LockSolenoid_373: upstream-reference=DIA.Geltungsbereich_MQBw_Baseline.pseRoutineControl_LockSolenoid, ecu-extract-reference=DIA.TopLevelCompositionPrototype.pseRoutineControl_LockSolenoid
      pseRoutineControl_LockUnlockECU_374: upstream-reference=DIA.Geltungsbereich_MQBw_Baseline.pseRoutineControl_LockUnlockECU, ecu-extract-reference=DIA.TopLevelCompositionPrototype.pseRoutineControl_LockUnlockECU
      pseRoutineControl_ProcessModeRoutine_375: upstream-reference=DIA.Geltungsbereich_MQBw_Baseline.pseRoutineControl_ProcessModeRoutine, ecu-extract-reference=DIA.TopLevelCompositionPrototype.pseRoutineControl_ProcessModeRoutine
      pseSecurityAccess_376: upstream-reference=DIA.Geltungsbereich_MQBw_Baseline.pseSecurityAccess, ecu-extract-reference=DIA.TopLevelCompositionPrototype.pseSecurityAccess
      pseServiceRequestSupplierNotification_377: upstream-reference=DIA.Geltungsbereich_MQBw_Baseline.pseServiceRequestSupplierNotification, ecu-extract-reference=DIA.TopLevelCompositionPrototype.pseServiceRequestSupplierNotification
      ptrpDiaServicesBswMIf_378: upstream-reference=DIA.Geltungsbereich_MQBw_Baseline.ptrpDiaServicesBswMIf, ecu-extract-reference=DIA.TopLevelCompositionPrototype.ptrpDiaServicesBswMIf
      DcmIf_379: upstream-reference=Geltungsbereich_MQBw_Baseline.DcmIf, ecu-extract-reference=TopLevelCompositionPrototype.DcmIf
      pclNvmIfServices_380: upstream-reference=DcmIf.Geltungsbereich_MQBw_Baseline.pclNvmIfServices, ecu-extract-reference=DcmIf.TopLevelCompositionPrototype.pclNvmIfServices
      pseNvpBlockData_381: upstream-reference=DcmIf.Geltungsbereich_MQBw_Baseline.pseNvpBlockData, ecu-extract-reference=DcmIf.TopLevelCompositionPrototype.pseNvpBlockData
      u8NvpEcuLockStatus_382: upstream-reference=pseNvpBlockData.DcmIf.Geltungsbereich_MQBw_Baseline.u8NvpEcuLockStatus, ecu-extract-reference=pseNvpBlockData.DcmIf.TopLevelCompositionPrototype.u8NvpEcuLockStatus
      u8NvpProcessMode_383: upstream-reference=pseNvpBlockData.DcmIf.Geltungsbereich_MQBw_Baseline.u8NvpProcessMode, ecu-extract-reference=pseNvpBlockData.DcmIf.TopLevelCompositionPrototype.u8NvpProcessMode
      ptrpAsrDcmServicesDcmIf_384: upstream-reference=DcmIf.Geltungsbereich_MQBw_Baseline.ptrpAsrDcmServicesDcmIf, ecu-extract-reference=DcmIf.TopLevelCompositionPrototype.ptrpAsrDcmServicesDcmIf
      DemIf_385: upstream-reference=Geltungsbereich_MQBw_Baseline.DemIf, ecu-extract-reference=TopLevelCompositionPrototype.DemIf
      pseDemIfEventServices_386: upstream-reference=DemIf.Geltungsbereich_MQBw_Baseline.pseDemIfEventServices, ecu-extract-reference=DemIf.TopLevelCompositionPrototype.pseDemIfEventServices
      ptrpAsrDemServicesDemIf_387: upstream-reference=DemIf.Geltungsbereich_MQBw_Baseline.ptrpAsrDemServicesDemIf, ecu-extract-reference=DemIf.TopLevelCompositionPrototype.ptrpAsrDemServicesDemIf
      DioIf_388: upstream-reference=Geltungsbereich_MQBw_Baseline.DioIf, ecu-extract-reference=TopLevelCompositionPrototype.DioIf
      psrDioIfServices_389: upstream-reference=DioIf.Geltungsbereich_MQBw_Baseline.psrDioIfServices, ecu-extract-reference=DioIf.TopLevelCompositionPrototype.psrDioIfServices
      ptrpEcuMIfServicesDioIf_390: upstream-reference=DioIf.Geltungsbereich_MQBw_Baseline.ptrpEcuMIfServicesDioIf, ecu-extract-reference=DioIf.TopLevelCompositionPrototype.ptrpEcuMIfServicesDioIf
      ptrrAsrDioServicesDioIf_391: upstream-reference=DioIf.Geltungsbereich_MQBw_Baseline.ptrrAsrDioServicesDioIf, ecu-extract-reference=DioIf.TopLevelCompositionPrototype.ptrrAsrDioServicesDioIf
      EFX_392: upstream-reference=Geltungsbereich_MQBw_Baseline.EFX, ecu-extract-reference=TopLevelCompositionPrototype.EFX
      pseEfxServices_393: upstream-reference=EFX.Geltungsbereich_MQBw_Baseline.pseEfxServices, ecu-extract-reference=EFX.TopLevelCompositionPrototype.pseEfxServices
      EIM_394: upstream-reference=Geltungsbereich_MQBw_Baseline.EIM, ecu-extract-reference=TopLevelCompositionPrototype.EIM
      pclDemDiagMonitor_395: upstream-reference=EIM.Geltungsbereich_MQBw_Baseline.pclDemDiagMonitor, ecu-extract-reference=EIM.TopLevelCompositionPrototype.pclDemDiagMonitor
      prrFSMSolenoidProfile_396: upstream-reference=EIM.Geltungsbereich_MQBw_Baseline.prrFSMSolenoidProfile, ecu-extract-reference=EIM.TopLevelCompositionPrototype.prrFSMSolenoidProfile
      au8SelectedProfile_397: upstream-reference=prrFSMSolenoidProfile.EIM.Geltungsbereich_MQBw_Baseline.au8SelectedProfile, ecu-extract-reference=prrFSMSolenoidProfile.EIM.TopLevelCompositionPrototype.au8SelectedProfile
      pseInjectError_398: upstream-reference=EIM.Geltungsbereich_MQBw_Baseline.pseInjectError, ecu-extract-reference=EIM.TopLevelCompositionPrototype.pseInjectError
      EcuMIf_399: upstream-reference=Geltungsbereich_MQBw_Baseline.EcuMIf, ecu-extract-reference=TopLevelCompositionPrototype.EcuMIf
      pclNotifyResetCause_400: upstream-reference=EcuMIf.Geltungsbereich_MQBw_Baseline.pclNotifyResetCause, ecu-extract-reference=EcuMIf.TopLevelCompositionPrototype.pclNotifyResetCause
      pclSbcServices_401: upstream-reference=EcuMIf.Geltungsbereich_MQBw_Baseline.pclSbcServices, ecu-extract-reference=EcuMIf.TopLevelCompositionPrototype.pclSbcServices
      ptrpAsrCanServicesEcuMIf_402: upstream-reference=EcuMIf.Geltungsbereich_MQBw_Baseline.ptrpAsrCanServicesEcuMIf, ecu-extract-reference=EcuMIf.TopLevelCompositionPrototype.ptrpAsrCanServicesEcuMIf
      ptrpAsrEcuMServicesEcuMIf_403: upstream-reference=EcuMIf.Geltungsbereich_MQBw_Baseline.ptrpAsrEcuMServicesEcuMIf, ecu-extract-reference=EcuMIf.TopLevelCompositionPrototype.ptrpAsrEcuMServicesEcuMIf
      ptrrAsrAdcServicesEcuMIf_404: upstream-reference=EcuMIf.Geltungsbereich_MQBw_Baseline.ptrrAsrAdcServicesEcuMIf, ecu-extract-reference=EcuMIf.TopLevelCompositionPrototype.ptrrAsrAdcServicesEcuMIf
      ptrrAsrCanIfServicesEcuMIf_405: upstream-reference=EcuMIf.Geltungsbereich_MQBw_Baseline.ptrrAsrCanIfServicesEcuMIf, ecu-extract-reference=EcuMIf.TopLevelCompositionPrototype.ptrrAsrCanIfServicesEcuMIf
      ptrrAsrCanServicesEcuMIf_406: upstream-reference=EcuMIf.Geltungsbereich_MQBw_Baseline.ptrrAsrCanServicesEcuMIf, ecu-extract-reference=EcuMIf.TopLevelCompositionPrototype.ptrrAsrCanServicesEcuMIf
      ptrrAsrDemServicesEcuMIf_407: upstream-reference=EcuMIf.Geltungsbereich_MQBw_Baseline.ptrrAsrDemServicesEcuMIf, ecu-extract-reference=EcuMIf.TopLevelCompositionPrototype.ptrrAsrDemServicesEcuMIf
      ptrrAsrEcuMServicesEcuMIf_408: upstream-reference=EcuMIf.Geltungsbereich_MQBw_Baseline.ptrrAsrEcuMServicesEcuMIf, ecu-extract-reference=EcuMIf.TopLevelCompositionPrototype.ptrrAsrEcuMServicesEcuMIf
      ptrrAsrFeeServicesEcuMIf_409: upstream-reference=EcuMIf.Geltungsbereich_MQBw_Baseline.ptrrAsrFeeServicesEcuMIf, ecu-extract-reference=EcuMIf.TopLevelCompositionPrototype.ptrrAsrFeeServicesEcuMIf
      ptrrAsrFlsServicesEcuMIf_410: upstream-reference=EcuMIf.Geltungsbereich_MQBw_Baseline.ptrrAsrFlsServicesEcuMIf, ecu-extract-reference=EcuMIf.TopLevelCompositionPrototype.ptrrAsrFlsServicesEcuMIf
      ptrrAsrMcuServicesEcuMIf_411: upstream-reference=EcuMIf.Geltungsbereich_MQBw_Baseline.ptrrAsrMcuServicesEcuMIf, ecu-extract-reference=EcuMIf.TopLevelCompositionPrototype.ptrrAsrMcuServicesEcuMIf
      ptrrAsrPwmServicesEcuMIf_412: upstream-reference=EcuMIf.Geltungsbereich_MQBw_Baseline.ptrrAsrPwmServicesEcuMIf, ecu-extract-reference=EcuMIf.TopLevelCompositionPrototype.ptrrAsrPwmServicesEcuMIf
      ptrrEcuMIfServicesAdcIf_413: upstream-reference=EcuMIf.Geltungsbereich_MQBw_Baseline.ptrrEcuMIfServicesAdcIf, ecu-extract-reference=EcuMIf.TopLevelCompositionPrototype.ptrrEcuMIfServicesAdcIf
      ptrrEcuMIfServicesDioIf_414: upstream-reference=EcuMIf.Geltungsbereich_MQBw_Baseline.ptrrEcuMIfServicesDioIf, ecu-extract-reference=EcuMIf.TopLevelCompositionPrototype.ptrrEcuMIfServicesDioIf
      ptrrSpiServicesEcuMIf_415: upstream-reference=EcuMIf.Geltungsbereich_MQBw_Baseline.ptrrSpiServicesEcuMIf, ecu-extract-reference=EcuMIf.TopLevelCompositionPrototype.ptrrSpiServicesEcuMIf
      FSM_416: upstream-reference=Geltungsbereich_MQBw_Baseline.FSM, ecu-extract-reference=TopLevelCompositionPrototype.FSM
      pclAutotestServices_417: upstream-reference=FSM.Geltungsbereich_MQBw_Baseline.pclAutotestServices, ecu-extract-reference=FSM.TopLevelCompositionPrototype.pclAutotestServices
      pclConvAdcService_418: upstream-reference=FSM.Geltungsbereich_MQBw_Baseline.pclConvAdcService, ecu-extract-reference=FSM.TopLevelCompositionPrototype.pclConvAdcService
      pclDemIfEventSerices_419: upstream-reference=FSM.Geltungsbereich_MQBw_Baseline.pclDemIfEventSerices, ecu-extract-reference=FSM.TopLevelCompositionPrototype.pclDemIfEventSerices
      pclDemServices_420: upstream-reference=FSM.Geltungsbereich_MQBw_Baseline.pclDemServices, ecu-extract-reference=FSM.TopLevelCompositionPrototype.pclDemServices
      pclNvmIfServices_421: upstream-reference=FSM.Geltungsbereich_MQBw_Baseline.pclNvmIfServices, ecu-extract-reference=FSM.TopLevelCompositionPrototype.pclNvmIfServices
      prrACCServices_422: upstream-reference=FSM.Geltungsbereich_MQBw_Baseline.prrACCServices, ecu-extract-reference=FSM.TopLevelCompositionPrototype.prrACCServices
      u8AccInitStateMachine_423: upstream-reference=prrACCServices.FSM.Geltungsbereich_MQBw_Baseline.u8AccInitStateMachine, ecu-extract-reference=prrACCServices.FSM.TopLevelCompositionPrototype.u8AccInitStateMachine
      prrBswMIfServices_424: upstream-reference=FSM.Geltungsbereich_MQBw_Baseline.prrBswMIfServices, ecu-extract-reference=FSM.TopLevelCompositionPrototype.prrBswMIfServices
      u8BlockRestoreStatus_425: upstream-reference=prrBswMIfServices.FSM.Geltungsbereich_MQBw_Baseline.u8BlockRestoreStatus, ecu-extract-reference=prrBswMIfServices.FSM.TopLevelCompositionPrototype.u8BlockRestoreStatus
      prrCILData_426: upstream-reference=FSM.Geltungsbereich_MQBw_Baseline.prrCILData, ecu-extract-reference=FSM.TopLevelCompositionPrototype.prrCILData
      au8MergedBuckleStatus_427: upstream-reference=prrCILData.FSM.Geltungsbereich_MQBw_Baseline.au8MergedBuckleStatus, ecu-extract-reference=prrCILData.FSM.TopLevelCompositionPrototype.au8MergedBuckleStatus
      prrCrashStatus_428: upstream-reference=FSM.Geltungsbereich_MQBw_Baseline.prrCrashStatus, ecu-extract-reference=FSM.TopLevelCompositionPrototype.prrCrashStatus
      u8IsCrashActive_429: upstream-reference=prrCrashStatus.FSM.Geltungsbereich_MQBw_Baseline.u8IsCrashActive, ecu-extract-reference=prrCrashStatus.FSM.TopLevelCompositionPrototype.u8IsCrashActive
      prrEcsAlgoFlag_430: upstream-reference=FSM.Geltungsbereich_MQBw_Baseline.prrEcsAlgoFlag, ecu-extract-reference=FSM.TopLevelCompositionPrototype.prrEcsAlgoFlag
      u16BallPosition_431: upstream-reference=prrEcsAlgoFlag.FSM.Geltungsbereich_MQBw_Baseline.u16BallPosition, ecu-extract-reference=prrEcsAlgoFlag.FSM.TopLevelCompositionPrototype.u16BallPosition
      u8EcsFlag_432: upstream-reference=prrEcsAlgoFlag.FSM.Geltungsbereich_MQBw_Baseline.u8EcsFlag, ecu-extract-reference=prrEcsAlgoFlag.FSM.TopLevelCompositionPrototype.u8EcsFlag
      prrEcsDiagRequest_433: upstream-reference=FSM.Geltungsbereich_MQBw_Baseline.prrEcsDiagRequest, ecu-extract-reference=FSM.TopLevelCompositionPrototype.prrEcsDiagRequest
      au8DiagReq_434: upstream-reference=prrEcsDiagRequest.FSM.Geltungsbereich_MQBw_Baseline.au8DiagReq, ecu-extract-reference=prrEcsDiagRequest.FSM.TopLevelCompositionPrototype.au8DiagReq
      au8DiagReqComplement_435: upstream-reference=prrEcsDiagRequest.FSM.Geltungsbereich_MQBw_Baseline.au8DiagReqComplement, ecu-extract-reference=prrEcsDiagRequest.FSM.TopLevelCompositionPrototype.au8DiagReqComplement
      prrSolenoidConfirmation_436: upstream-reference=FSM.Geltungsbereich_MQBw_Baseline.prrSolenoidConfirmation, ecu-extract-reference=FSM.TopLevelCompositionPrototype.prrSolenoidConfirmation
      au8SolenoidStatus_437: upstream-reference=prrSolenoidConfirmation.FSM.Geltungsbereich_MQBw_Baseline.au8SolenoidStatus, ecu-extract-reference=prrSolenoidConfirmation.FSM.TopLevelCompositionPrototype.au8SolenoidStatus
      prrSolenoidOpenCircuitStatus_438: upstream-reference=FSM.Geltungsbereich_MQBw_Baseline.prrSolenoidOpenCircuitStatus, ecu-extract-reference=FSM.TopLevelCompositionPrototype.prrSolenoidOpenCircuitStatus
      au8SolenoidAutotestStatus_439: upstream-reference=prrSolenoidOpenCircuitStatus.FSM.Geltungsbereich_MQBw_Baseline.au8SolenoidAutotestStatus, ecu-extract-reference=prrSolenoidOpenCircuitStatus.FSM.TopLevelCompositionPrototype.au8SolenoidAutotestStatus
      prrSolenoidOverVoltageStatus_440: upstream-reference=FSM.Geltungsbereich_MQBw_Baseline.prrSolenoidOverVoltageStatus, ecu-extract-reference=FSM.TopLevelCompositionPrototype.prrSolenoidOverVoltageStatus
      au8SolenoidOvervoltageStatus_441: upstream-reference=prrSolenoidOverVoltageStatus.FSM.Geltungsbereich_MQBw_Baseline.au8SolenoidOvervoltageStatus, ecu-extract-reference=prrSolenoidOverVoltageStatus.FSM.TopLevelCompositionPrototype.au8SolenoidOvervoltageStatus
      prrSolenoidShortToGndStatus_442: upstream-reference=FSM.Geltungsbereich_MQBw_Baseline.prrSolenoidShortToGndStatus, ecu-extract-reference=FSM.TopLevelCompositionPrototype.prrSolenoidShortToGndStatus
      au8SolenoidAutotestStatus_443: upstream-reference=prrSolenoidShortToGndStatus.FSM.Geltungsbereich_MQBw_Baseline.au8SolenoidAutotestStatus, ecu-extract-reference=prrSolenoidShortToGndStatus.FSM.TopLevelCompositionPrototype.au8SolenoidAutotestStatus
      pseFsmServices_444: upstream-reference=FSM.Geltungsbereich_MQBw_Baseline.pseFsmServices, ecu-extract-reference=FSM.TopLevelCompositionPrototype.pseFsmServices
      pseModeManagement_445: upstream-reference=FSM.Geltungsbereich_MQBw_Baseline.pseModeManagement, ecu-extract-reference=FSM.TopLevelCompositionPrototype.pseModeManagement
      psrSolenoidProfile_446: upstream-reference=FSM.Geltungsbereich_MQBw_Baseline.psrSolenoidProfile, ecu-extract-reference=FSM.TopLevelCompositionPrototype.psrSolenoidProfile
      au8SelectedProfile_447: upstream-reference=psrSolenoidProfile.FSM.Geltungsbereich_MQBw_Baseline.au8SelectedProfile, ecu-extract-reference=psrSolenoidProfile.FSM.TopLevelCompositionPrototype.au8SelectedProfile
      psrSolenoidState_448: upstream-reference=FSM.Geltungsbereich_MQBw_Baseline.psrSolenoidState, ecu-extract-reference=FSM.TopLevelCompositionPrototype.psrSolenoidState
      au8SolenoidState_449: upstream-reference=psrSolenoidState.FSM.Geltungsbereich_MQBw_Baseline.au8SolenoidState, ecu-extract-reference=psrSolenoidState.FSM.TopLevelCompositionPrototype.au8SolenoidState
      psrSolenoidStuckStatus_450: upstream-reference=FSM.Geltungsbereich_MQBw_Baseline.psrSolenoidStuckStatus, ecu-extract-reference=FSM.TopLevelCompositionPrototype.psrSolenoidStuckStatus
      au8SolenoidIsStuck_451: upstream-reference=psrSolenoidStuckStatus.FSM.Geltungsbereich_MQBw_Baseline.au8SolenoidIsStuck, ecu-extract-reference=psrSolenoidStuckStatus.FSM.TopLevelCompositionPrototype.au8SolenoidIsStuck
      ptrpAsrOsServicesFSM_452: upstream-reference=FSM.Geltungsbereich_MQBw_Baseline.ptrpAsrOsServicesFSM, ecu-extract-reference=FSM.TopLevelCompositionPrototype.ptrpAsrOsServicesFSM
      ptrpFsmServicesBswMIf_453: upstream-reference=FSM.Geltungsbereich_MQBw_Baseline.ptrpFsmServicesBswMIf, ecu-extract-reference=FSM.TopLevelCompositionPrototype.ptrpFsmServicesBswMIf
      FSM_u32_ModesStatus_454: upstream-reference=FSM.Geltungsbereich_MQBw_Baseline.FSM_u32_ModesStatus, ecu-extract-reference=FSM.TopLevelCompositionPrototype.FSM_u32_ModesStatus
      FSM_u32_ModesStatusComplement_455: upstream-reference=FSM.Geltungsbereich_MQBw_Baseline.FSM_u32_ModesStatusComplement, ecu-extract-reference=FSM.TopLevelCompositionPrototype.FSM_u32_ModesStatusComplement
      IoHwAb_456: upstream-reference=Geltungsbereich_MQBw_Baseline.IoHwAb, ecu-extract-reference=TopLevelCompositionPrototype.IoHwAb
      pclAccSpiData_457: upstream-reference=IoHwAb.Geltungsbereich_MQBw_Baseline.pclAccSpiData, ecu-extract-reference=IoHwAb.TopLevelCompositionPrototype.pclAccSpiData
      pclAutotestServices_458: upstream-reference=IoHwAb.Geltungsbereich_MQBw_Baseline.pclAutotestServices, ecu-extract-reference=IoHwAb.TopLevelCompositionPrototype.pclAutotestServices
      pclDioIfServices_459: upstream-reference=IoHwAb.Geltungsbereich_MQBw_Baseline.pclDioIfServices, ecu-extract-reference=IoHwAb.TopLevelCompositionPrototype.pclDioIfServices
      pclEfxServices_460: upstream-reference=IoHwAb.Geltungsbereich_MQBw_Baseline.pclEfxServices, ecu-extract-reference=IoHwAb.TopLevelCompositionPrototype.pclEfxServices
      pclModeManagement_461: upstream-reference=IoHwAb.Geltungsbereich_MQBw_Baseline.pclModeManagement, ecu-extract-reference=IoHwAb.TopLevelCompositionPrototype.pclModeManagement
      pclNvmIfServices_462: upstream-reference=IoHwAb.Geltungsbereich_MQBw_Baseline.pclNvmIfServices, ecu-extract-reference=IoHwAb.TopLevelCompositionPrototype.pclNvmIfServices
      pclPassengerOccupancyState_463: upstream-reference=IoHwAb.Geltungsbereich_MQBw_Baseline.pclPassengerOccupancyState, ecu-extract-reference=IoHwAb.TopLevelCompositionPrototype.pclPassengerOccupancyState
      pclRawAdcService_464: upstream-reference=IoHwAb.Geltungsbereich_MQBw_Baseline.pclRawAdcService, ecu-extract-reference=IoHwAb.TopLevelCompositionPrototype.pclRawAdcService
      pclSolenoidProfile_465: upstream-reference=IoHwAb.Geltungsbereich_MQBw_Baseline.pclSolenoidProfile, ecu-extract-reference=IoHwAb.TopLevelCompositionPrototype.pclSolenoidProfile
      au8SelectedProfile_466: upstream-reference=pclSolenoidProfile.IoHwAb.Geltungsbereich_MQBw_Baseline.au8SelectedProfile, ecu-extract-reference=pclSolenoidProfile.IoHwAb.TopLevelCompositionPrototype.au8SelectedProfile
      pclSolenoidStep_467: upstream-reference=IoHwAb.Geltungsbereich_MQBw_Baseline.pclSolenoidStep, ecu-extract-reference=IoHwAb.TopLevelCompositionPrototype.pclSolenoidStep
      au8CurrentStep_468: upstream-reference=pclSolenoidStep.IoHwAb.Geltungsbereich_MQBw_Baseline.au8CurrentStep, ecu-extract-reference=pclSolenoidStep.IoHwAb.TopLevelCompositionPrototype.au8CurrentStep
      pclUnlockTimeout_469: upstream-reference=IoHwAb.Geltungsbereich_MQBw_Baseline.pclUnlockTimeout, ecu-extract-reference=IoHwAb.TopLevelCompositionPrototype.pclUnlockTimeout
      prrAdcBufferServices_470: upstream-reference=IoHwAb.Geltungsbereich_MQBw_Baseline.prrAdcBufferServices, ecu-extract-reference=IoHwAb.TopLevelCompositionPrototype.prrAdcBufferServices
      aau16HistoricalAdcSamples_471: upstream-reference=prrAdcBufferServices.IoHwAb.Geltungsbereich_MQBw_Baseline.aau16HistoricalAdcSamples, ecu-extract-reference=prrAdcBufferServices.IoHwAb.TopLevelCompositionPrototype.aau16HistoricalAdcSamples
      u8HistoricalAdcSampleIndex_472: upstream-reference=prrAdcBufferServices.IoHwAb.Geltungsbereich_MQBw_Baseline.u8HistoricalAdcSampleIndex, ecu-extract-reference=prrAdcBufferServices.IoHwAb.TopLevelCompositionPrototype.u8HistoricalAdcSampleIndex
      prrSolenoidElectricalCharacteristics_473: upstream-reference=IoHwAb.Geltungsbereich_MQBw_Baseline.prrSolenoidElectricalCharacteristics, ecu-extract-reference=IoHwAb.TopLevelCompositionPrototype.prrSolenoidElectricalCharacteristics
      au32SolenoidmATarget_474: upstream-reference=prrSolenoidElectricalCharacteristics.IoHwAb.Geltungsbereich_MQBw_Baseline.au32SolenoidmATarget, ecu-extract-reference=prrSolenoidElectricalCharacteristics.IoHwAb.TopLevelCompositionPrototype.au32SolenoidmATarget
      prrSolenoidPwm_475: upstream-reference=IoHwAb.Geltungsbereich_MQBw_Baseline.prrSolenoidPwm, ecu-extract-reference=IoHwAb.TopLevelCompositionPrototype.prrSolenoidPwm
      au16Pwm_476: upstream-reference=prrSolenoidPwm.IoHwAb.Geltungsbereich_MQBw_Baseline.au16Pwm, ecu-extract-reference=prrSolenoidPwm.IoHwAb.TopLevelCompositionPrototype.au16Pwm
      pseAccSensor_477: upstream-reference=IoHwAb.Geltungsbereich_MQBw_Baseline.pseAccSensor, ecu-extract-reference=IoHwAb.TopLevelCompositionPrototype.pseAccSensor
      pseCheckPowerSupplyOV_478: upstream-reference=IoHwAb.Geltungsbereich_MQBw_Baseline.pseCheckPowerSupplyOV, ecu-extract-reference=IoHwAb.TopLevelCompositionPrototype.pseCheckPowerSupplyOV
      pseCheckPowerSupplyUV_479: upstream-reference=IoHwAb.Geltungsbereich_MQBw_Baseline.pseCheckPowerSupplyUV, ecu-extract-reference=IoHwAb.TopLevelCompositionPrototype.pseCheckPowerSupplyUV
      pseConvAdcService_480: upstream-reference=IoHwAb.Geltungsbereich_MQBw_Baseline.pseConvAdcService, ecu-extract-reference=IoHwAb.TopLevelCompositionPrototype.pseConvAdcService
      pseEcuCharacteristics_481: upstream-reference=IoHwAb.Geltungsbereich_MQBw_Baseline.pseEcuCharacteristics, ecu-extract-reference=IoHwAb.TopLevelCompositionPrototype.pseEcuCharacteristics
      pseEcuOverTemperature_482: upstream-reference=IoHwAb.Geltungsbereich_MQBw_Baseline.pseEcuOverTemperature, ecu-extract-reference=IoHwAb.TopLevelCompositionPrototype.pseEcuOverTemperature
      pseHandleSeatCurrentCircuit_483: upstream-reference=IoHwAb.Geltungsbereich_MQBw_Baseline.pseHandleSeatCurrentCircuit, ecu-extract-reference=IoHwAb.TopLevelCompositionPrototype.pseHandleSeatCurrentCircuit
      pseLowPowerWakeUp_484: upstream-reference=IoHwAb.Geltungsbereich_MQBw_Baseline.pseLowPowerWakeUp, ecu-extract-reference=IoHwAb.TopLevelCompositionPrototype.pseLowPowerWakeUp
      pseMcuCharacteristics_485: upstream-reference=IoHwAb.Geltungsbereich_MQBw_Baseline.pseMcuCharacteristics, ecu-extract-reference=IoHwAb.TopLevelCompositionPrototype.pseMcuCharacteristics
      psePtcSensor_486: upstream-reference=IoHwAb.Geltungsbereich_MQBw_Baseline.psePtcSensor, ecu-extract-reference=IoHwAb.TopLevelCompositionPrototype.psePtcSensor
      pseSolenoidCharacterstics_487: upstream-reference=IoHwAb.Geltungsbereich_MQBw_Baseline.pseSolenoidCharacterstics, ecu-extract-reference=IoHwAb.TopLevelCompositionPrototype.pseSolenoidCharacterstics
      psrBuckleStatus_488: upstream-reference=IoHwAb.Geltungsbereich_MQBw_Baseline.psrBuckleStatus, ecu-extract-reference=IoHwAb.TopLevelCompositionPrototype.psrBuckleStatus
      au8BuckleStatus_489: upstream-reference=psrBuckleStatus.IoHwAb.Geltungsbereich_MQBw_Baseline.au8BuckleStatus, ecu-extract-reference=psrBuckleStatus.IoHwAb.TopLevelCompositionPrototype.au8BuckleStatus
      psrSeatOccupancySensorStatus_490: upstream-reference=IoHwAb.Geltungsbereich_MQBw_Baseline.psrSeatOccupancySensorStatus, ecu-extract-reference=IoHwAb.TopLevelCompositionPrototype.psrSeatOccupancySensorStatus
      au8SeatOccupancySensorStatus_491: upstream-reference=psrSeatOccupancySensorStatus.IoHwAb.Geltungsbereich_MQBw_Baseline.au8SeatOccupancySensorStatus, ecu-extract-reference=psrSeatOccupancySensorStatus.IoHwAb.TopLevelCompositionPrototype.au8SeatOccupancySensorStatus
      psrSolenoidConfirmation_492: upstream-reference=IoHwAb.Geltungsbereich_MQBw_Baseline.psrSolenoidConfirmation, ecu-extract-reference=IoHwAb.TopLevelCompositionPrototype.psrSolenoidConfirmation
      au8SolenoidStatus_493: upstream-reference=psrSolenoidConfirmation.IoHwAb.Geltungsbereich_MQBw_Baseline.au8SolenoidStatus, ecu-extract-reference=psrSolenoidConfirmation.IoHwAb.TopLevelCompositionPrototype.au8SolenoidStatus
      ptrpAsrOsServicesIoHwAb_494: upstream-reference=IoHwAb.Geltungsbereich_MQBw_Baseline.ptrpAsrOsServicesIoHwAb, ecu-extract-reference=IoHwAb.TopLevelCompositionPrototype.ptrpAsrOsServicesIoHwAb
      LPM_495: upstream-reference=Geltungsbereich_MQBw_Baseline.LPM, ecu-extract-reference=TopLevelCompositionPrototype.LPM
      pclAccRestartInit_496: upstream-reference=LPM.Geltungsbereich_MQBw_Baseline.pclAccRestartInit, ecu-extract-reference=LPM.TopLevelCompositionPrototype.pclAccRestartInit
      pclAdcIfServices_497: upstream-reference=LPM.Geltungsbereich_MQBw_Baseline.pclAdcIfServices, ecu-extract-reference=LPM.TopLevelCompositionPrototype.pclAdcIfServices
      pclHandleSeatCurrentCircuit_498: upstream-reference=LPM.Geltungsbereich_MQBw_Baseline.pclHandleSeatCurrentCircuit, ecu-extract-reference=LPM.TopLevelCompositionPrototype.pclHandleSeatCurrentCircuit
      pclLowPowerWakeUp_499: upstream-reference=LPM.Geltungsbereich_MQBw_Baseline.pclLowPowerWakeUp, ecu-extract-reference=LPM.TopLevelCompositionPrototype.pclLowPowerWakeUp
      pclSbcServices_500: upstream-reference=LPM.Geltungsbereich_MQBw_Baseline.pclSbcServices, ecu-extract-reference=LPM.TopLevelCompositionPrototype.pclSbcServices
      ptrpLpmServicesAsrOs_501: upstream-reference=LPM.Geltungsbereich_MQBw_Baseline.ptrpLpmServicesAsrOs, ecu-extract-reference=LPM.TopLevelCompositionPrototype.ptrpLpmServicesAsrOs
      ptrpLpmServicesBswMIf_502: upstream-reference=LPM.Geltungsbereich_MQBw_Baseline.ptrpLpmServicesBswMIf, ecu-extract-reference=LPM.TopLevelCompositionPrototype.ptrpLpmServicesBswMIf
      MIC_503: upstream-reference=Geltungsbereich_MQBw_Baseline.MIC, ecu-extract-reference=TopLevelCompositionPrototype.MIC
      p_ptrrMicServicesBswMIf_504: upstream-reference=MIC.Geltungsbereich_MQBw_Baseline.p_ptrrMicServicesBswMIf, ecu-extract-reference=MIC.TopLevelCompositionPrototype.p_ptrrMicServicesBswMIf
      p_ptrrMicServicesOsIf_505: upstream-reference=MIC.Geltungsbereich_MQBw_Baseline.p_ptrrMicServicesOsIf, ecu-extract-reference=MIC.TopLevelCompositionPrototype.p_ptrrMicServicesOsIf
      pclNvmIfServices_506: upstream-reference=MIC.Geltungsbereich_MQBw_Baseline.pclNvmIfServices, ecu-extract-reference=MIC.TopLevelCompositionPrototype.pclNvmIfServices
      pclResetCause_507: upstream-reference=MIC.Geltungsbereich_MQBw_Baseline.pclResetCause, ecu-extract-reference=MIC.TopLevelCompositionPrototype.pclResetCause
      pclResetCauseNotification_508: upstream-reference=MIC.Geltungsbereich_MQBw_Baseline.pclResetCauseNotification, ecu-extract-reference=MIC.TopLevelCompositionPrototype.pclResetCauseNotification
      pclSbcServices_509: upstream-reference=MIC.Geltungsbereich_MQBw_Baseline.pclSbcServices, ecu-extract-reference=MIC.TopLevelCompositionPrototype.pclSbcServices
      pseRunEepromMemoryCorruption_510: upstream-reference=MIC.Geltungsbereich_MQBw_Baseline.pseRunEepromMemoryCorruption, ecu-extract-reference=MIC.TopLevelCompositionPrototype.pseRunEepromMemoryCorruption
      pseRunPFlashMemoryCorruption_511: upstream-reference=MIC.Geltungsbereich_MQBw_Baseline.pseRunPFlashMemoryCorruption, ecu-extract-reference=MIC.TopLevelCompositionPrototype.pseRunPFlashMemoryCorruption
      pseRunRamMemoryCorruption_512: upstream-reference=MIC.Geltungsbereich_MQBw_Baseline.pseRunRamMemoryCorruption, ecu-extract-reference=MIC.TopLevelCompositionPrototype.pseRunRamMemoryCorruption
      McuIf_513: upstream-reference=Geltungsbereich_MQBw_Baseline.McuIf, ecu-extract-reference=TopLevelCompositionPrototype.McuIf
      pseCheckCrcOnMcuRegisters_514: upstream-reference=McuIf.Geltungsbereich_MQBw_Baseline.pseCheckCrcOnMcuRegisters, ecu-extract-reference=McuIf.TopLevelCompositionPrototype.pseCheckCrcOnMcuRegisters
      pseCheckMcuSelfTest_515: upstream-reference=McuIf.Geltungsbereich_MQBw_Baseline.pseCheckMcuSelfTest, ecu-extract-reference=McuIf.TopLevelCompositionPrototype.pseCheckMcuSelfTest
      ptrpMcuIfServicesBswmIf_516: upstream-reference=McuIf.Geltungsbereich_MQBw_Baseline.ptrpMcuIfServicesBswmIf, ecu-extract-reference=McuIf.TopLevelCompositionPrototype.ptrpMcuIfServicesBswmIf
      NVP_517: upstream-reference=Geltungsbereich_MQBw_Baseline.NVP, ecu-extract-reference=TopLevelCompositionPrototype.NVP
      pseNvpBlockDataDcmIf_518: upstream-reference=NVP.Geltungsbereich_MQBw_Baseline.pseNvpBlockDataDcmIf, ecu-extract-reference=NVP.TopLevelCompositionPrototype.pseNvpBlockDataDcmIf
      u8NvpEcuLockStatus_519: upstream-reference=pseNvpBlockDataDcmIf.NVP.Geltungsbereich_MQBw_Baseline.u8NvpEcuLockStatus, ecu-extract-reference=pseNvpBlockDataDcmIf.NVP.TopLevelCompositionPrototype.u8NvpEcuLockStatus
      u8NvpProcessMode_520: upstream-reference=pseNvpBlockDataDcmIf.NVP.Geltungsbereich_MQBw_Baseline.u8NvpProcessMode, ecu-extract-reference=pseNvpBlockDataDcmIf.NVP.TopLevelCompositionPrototype.u8NvpProcessMode
      pseNvpBlockDataDia_521: upstream-reference=NVP.Geltungsbereich_MQBw_Baseline.pseNvpBlockDataDia, ecu-extract-reference=NVP.TopLevelCompositionPrototype.pseNvpBlockDataDia
      u8NvpEcuLockStatus_522: upstream-reference=pseNvpBlockDataDia.NVP.Geltungsbereich_MQBw_Baseline.u8NvpEcuLockStatus, ecu-extract-reference=pseNvpBlockDataDia.NVP.TopLevelCompositionPrototype.u8NvpEcuLockStatus
      u8NvpProcessMode_523: upstream-reference=pseNvpBlockDataDia.NVP.Geltungsbereich_MQBw_Baseline.u8NvpProcessMode, ecu-extract-reference=pseNvpBlockDataDia.NVP.TopLevelCompositionPrototype.u8NvpProcessMode
      NmIf_524: upstream-reference=Geltungsbereich_MQBw_Baseline.NmIf, ecu-extract-reference=TopLevelCompositionPrototype.NmIf
      pclEcuStateTransitionBswMIf_525: upstream-reference=NmIf.Geltungsbereich_MQBw_Baseline.pclEcuStateTransitionBswMIf, ecu-extract-reference=NmIf.TopLevelCompositionPrototype.pclEcuStateTransitionBswMIf
      ptrpAsrComServicesNmIf_526: upstream-reference=NmIf.Geltungsbereich_MQBw_Baseline.ptrpAsrComServicesNmIf, ecu-extract-reference=NmIf.TopLevelCompositionPrototype.ptrpAsrComServicesNmIf
      ptrpAsrOsServicesNmIf_527: upstream-reference=NmIf.Geltungsbereich_MQBw_Baseline.ptrpAsrOsServicesNmIf, ecu-extract-reference=NmIf.TopLevelCompositionPrototype.ptrpAsrOsServicesNmIf
      ptrrAsrBswMServicesNmIf_528: upstream-reference=NmIf.Geltungsbereich_MQBw_Baseline.ptrrAsrBswMServicesNmIf, ecu-extract-reference=NmIf.TopLevelCompositionPrototype.ptrrAsrBswMServicesNmIf
      ptrrAsrComMServicesNmIf_529: upstream-reference=NmIf.Geltungsbereich_MQBw_Baseline.ptrrAsrComMServicesNmIf, ecu-extract-reference=NmIf.TopLevelCompositionPrototype.ptrrAsrComMServicesNmIf
      ptrrNmIfServicesBswMIf_530: upstream-reference=NmIf.Geltungsbereich_MQBw_Baseline.ptrrNmIfServicesBswMIf, ecu-extract-reference=NmIf.TopLevelCompositionPrototype.ptrrNmIfServicesBswMIf
      NvmIf_531: upstream-reference=Geltungsbereich_MQBw_Baseline.NvmIf, ecu-extract-reference=TopLevelCompositionPrototype.NvmIf
      pclNvmService_AccAngleCalibration_532: upstream-reference=NvmIf.Geltungsbereich_MQBw_Baseline.pclNvmService_AccAngleCalibration, ecu-extract-reference=NvmIf.TopLevelCompositionPrototype.pclNvmService_AccAngleCalibration
      pclNvmService_AeeTraceabilityNumber_533: upstream-reference=NvmIf.Geltungsbereich_MQBw_Baseline.pclNvmService_AeeTraceabilityNumber, ecu-extract-reference=NvmIf.TopLevelCompositionPrototype.pclNvmService_AeeTraceabilityNumber
      pclNvmService_AlvNvmVersion_534: upstream-reference=NvmIf.Geltungsbereich_MQBw_Baseline.pclNvmService_AlvNvmVersion, ecu-extract-reference=NvmIf.TopLevelCompositionPrototype.pclNvmService_AlvNvmVersion
      pclNvmService_AssemblySerialNumber_535: upstream-reference=NvmIf.Geltungsbereich_MQBw_Baseline.pclNvmService_AssemblySerialNumber, ecu-extract-reference=NvmIf.TopLevelCompositionPrototype.pclNvmService_AssemblySerialNumber
      pclNvmService_EcsAccLowPass_536: upstream-reference=NvmIf.Geltungsbereich_MQBw_Baseline.pclNvmService_EcsAccLowPass, ecu-extract-reference=NvmIf.TopLevelCompositionPrototype.pclNvmService_EcsAccLowPass
      pclNvmService_EcsAccOffsets_537: upstream-reference=NvmIf.Geltungsbereich_MQBw_Baseline.pclNvmService_EcsAccOffsets, ecu-extract-reference=NvmIf.TopLevelCompositionPrototype.pclNvmService_EcsAccOffsets
      pclNvmService_EcsAlgoOutputDelay_538: upstream-reference=NvmIf.Geltungsbereich_MQBw_Baseline.pclNvmService_EcsAlgoOutputDelay, ecu-extract-reference=NvmIf.TopLevelCompositionPrototype.pclNvmService_EcsAlgoOutputDelay
      pclNvmService_EcsParameters_539: upstream-reference=NvmIf.Geltungsbereich_MQBw_Baseline.pclNvmService_EcsParameters, ecu-extract-reference=NvmIf.TopLevelCompositionPrototype.pclNvmService_EcsParameters
      pclNvmService_EcsProfiles_540: upstream-reference=NvmIf.Geltungsbereich_MQBw_Baseline.pclNvmService_EcsProfiles, ecu-extract-reference=NvmIf.TopLevelCompositionPrototype.pclNvmService_EcsProfiles
      pclNvmService_EcsSensitivityLUT_541: upstream-reference=NvmIf.Geltungsbereich_MQBw_Baseline.pclNvmService_EcsSensitivityLUT, ecu-extract-reference=NvmIf.TopLevelCompositionPrototype.pclNvmService_EcsSensitivityLUT
      pclNvmService_EcsSensitivityOPT_542: upstream-reference=NvmIf.Geltungsbereich_MQBw_Baseline.pclNvmService_EcsSensitivityOPT, ecu-extract-reference=NvmIf.TopLevelCompositionPrototype.pclNvmService_EcsSensitivityOPT
      pclNvmService_EcsSteps_543: upstream-reference=NvmIf.Geltungsbereich_MQBw_Baseline.pclNvmService_EcsSteps, ecu-extract-reference=NvmIf.TopLevelCompositionPrototype.pclNvmService_EcsSteps
      pclNvmService_EcsVariant_544: upstream-reference=NvmIf.Geltungsbereich_MQBw_Baseline.pclNvmService_EcsVariant, ecu-extract-reference=NvmIf.TopLevelCompositionPrototype.pclNvmService_EcsVariant
      pclNvmService_EcuStateTimingParam_545: upstream-reference=NvmIf.Geltungsbereich_MQBw_Baseline.pclNvmService_EcuStateTimingParam, ecu-extract-reference=NvmIf.TopLevelCompositionPrototype.pclNvmService_EcuStateTimingParam
      pclNvmService_EolCounters_546: upstream-reference=NvmIf.Geltungsbereich_MQBw_Baseline.pclNvmService_EolCounters, ecu-extract-reference=NvmIf.TopLevelCompositionPrototype.pclNvmService_EolCounters
      pclNvmService_HwPartNumber_547: upstream-reference=NvmIf.Geltungsbereich_MQBw_Baseline.pclNvmService_HwPartNumber, ecu-extract-reference=NvmIf.TopLevelCompositionPrototype.pclNvmService_HwPartNumber
      pclNvmService_LockUnlockECU_548: upstream-reference=NvmIf.Geltungsbereich_MQBw_Baseline.pclNvmService_LockUnlockECU, ecu-extract-reference=NvmIf.TopLevelCompositionPrototype.pclNvmService_LockUnlockECU
      pclNvmService_OemAppSwVersionNumber_549: upstream-reference=NvmIf.Geltungsbereich_MQBw_Baseline.pclNvmService_OemAppSwVersionNumber, ecu-extract-reference=NvmIf.TopLevelCompositionPrototype.pclNvmService_OemAppSwVersionNumber
      pclNvmService_OemEcuSerialNumber_550: upstream-reference=NvmIf.Geltungsbereich_MQBw_Baseline.pclNvmService_OemEcuSerialNumber, ecu-extract-reference=NvmIf.TopLevelCompositionPrototype.pclNvmService_OemEcuSerialNumber
      pclNvmService_OemFlashBootloader_551: upstream-reference=NvmIf.Geltungsbereich_MQBw_Baseline.pclNvmService_OemFlashBootloader, ecu-extract-reference=NvmIf.TopLevelCompositionPrototype.pclNvmService_OemFlashBootloader
      pclNvmService_OemHardwareNumber_552: upstream-reference=NvmIf.Geltungsbereich_MQBw_Baseline.pclNvmService_OemHardwareNumber, ecu-extract-reference=NvmIf.TopLevelCompositionPrototype.pclNvmService_OemHardwareNumber
      pclNvmService_OemHardwareVersionNumber_553: upstream-reference=NvmIf.Geltungsbereich_MQBw_Baseline.pclNvmService_OemHardwareVersionNumber, ecu-extract-reference=NvmIf.TopLevelCompositionPrototype.pclNvmService_OemHardwareVersionNumber
      pclNvmService_OemLogicalBlockVersion_554: upstream-reference=NvmIf.Geltungsbereich_MQBw_Baseline.pclNvmService_OemLogicalBlockVersion, ecu-extract-reference=NvmIf.TopLevelCompositionPrototype.pclNvmService_OemLogicalBlockVersion
      pclNvmService_OemOdxIdentifier_555: upstream-reference=NvmIf.Geltungsbereich_MQBw_Baseline.pclNvmService_OemOdxIdentifier, ecu-extract-reference=NvmIf.TopLevelCompositionPrototype.pclNvmService_OemOdxIdentifier
      pclNvmService_OemOdxVersion_556: upstream-reference=NvmIf.Geltungsbereich_MQBw_Baseline.pclNvmService_OemOdxVersion, ecu-extract-reference=NvmIf.TopLevelCompositionPrototype.pclNvmService_OemOdxVersion
      pclNvmService_OemSparePartNumber_557: upstream-reference=NvmIf.Geltungsbereich_MQBw_Baseline.pclNvmService_OemSparePartNumber, ecu-extract-reference=NvmIf.TopLevelCompositionPrototype.pclNvmService_OemSparePartNumber
      pclNvmService_OemSystemName_558: upstream-reference=NvmIf.Geltungsbereich_MQBw_Baseline.pclNvmService_OemSystemName, ecu-extract-reference=NvmIf.TopLevelCompositionPrototype.pclNvmService_OemSystemName
      pclNvmService_PhysicalMeasurements_559: upstream-reference=NvmIf.Geltungsbereich_MQBw_Baseline.pclNvmService_PhysicalMeasurements, ecu-extract-reference=NvmIf.TopLevelCompositionPrototype.pclNvmService_PhysicalMeasurements
      pclNvmService_SBSLastState_560: upstream-reference=NvmIf.Geltungsbereich_MQBw_Baseline.pclNvmService_SBSLastState, ecu-extract-reference=NvmIf.TopLevelCompositionPrototype.pclNvmService_SBSLastState
      pclNvmService_SolenoidParam_561: upstream-reference=NvmIf.Geltungsbereich_MQBw_Baseline.pclNvmService_SolenoidParam, ecu-extract-reference=NvmIf.TopLevelCompositionPrototype.pclNvmService_SolenoidParam
      pclNvmServices_AutotestEnableParam_562: upstream-reference=NvmIf.Geltungsbereich_MQBw_Baseline.pclNvmServices_AutotestEnableParam, ecu-extract-reference=NvmIf.TopLevelCompositionPrototype.pclNvmServices_AutotestEnableParam
      pclNvmServices_AutotestParam_563: upstream-reference=NvmIf.Geltungsbereich_MQBw_Baseline.pclNvmServices_AutotestParam, ecu-extract-reference=NvmIf.TopLevelCompositionPrototype.pclNvmServices_AutotestParam
      pclNvmServices_DemDefault_564: upstream-reference=NvmIf.Geltungsbereich_MQBw_Baseline.pclNvmServices_DemDefault, ecu-extract-reference=NvmIf.TopLevelCompositionPrototype.pclNvmServices_DemDefault
      pclNvmServices_EccCounters_565: upstream-reference=NvmIf.Geltungsbereich_MQBw_Baseline.pclNvmServices_EccCounters, ecu-extract-reference=NvmIf.TopLevelCompositionPrototype.pclNvmServices_EccCounters
      pclNvmServices_EcuTempCalibration_566: upstream-reference=NvmIf.Geltungsbereich_MQBw_Baseline.pclNvmServices_EcuTempCalibration, ecu-extract-reference=NvmIf.TopLevelCompositionPrototype.pclNvmServices_EcuTempCalibration
      pclNvmServices_MeasFrameCfg_567: upstream-reference=NvmIf.Geltungsbereich_MQBw_Baseline.pclNvmServices_MeasFrameCfg, ecu-extract-reference=NvmIf.TopLevelCompositionPrototype.pclNvmServices_MeasFrameCfg
      pclNvmServices_MeasFrameRamCfg_568: upstream-reference=NvmIf.Geltungsbereich_MQBw_Baseline.pclNvmServices_MeasFrameRamCfg, ecu-extract-reference=NvmIf.TopLevelCompositionPrototype.pclNvmServices_MeasFrameRamCfg
      pclNvmServices_ProcessMode_569: upstream-reference=NvmIf.Geltungsbereich_MQBw_Baseline.pclNvmServices_ProcessMode, ecu-extract-reference=NvmIf.TopLevelCompositionPrototype.pclNvmServices_ProcessMode
      pclNvmServices_WarmResetCounters_570: upstream-reference=NvmIf.Geltungsbereich_MQBw_Baseline.pclNvmServices_WarmResetCounters, ecu-extract-reference=NvmIf.TopLevelCompositionPrototype.pclNvmServices_WarmResetCounters
      pseNvmIfServices_571: upstream-reference=NvmIf.Geltungsbereich_MQBw_Baseline.pseNvmIfServices, ecu-extract-reference=NvmIf.TopLevelCompositionPrototype.pseNvmIfServices
      pseRunEepromMemoryNotProgrammed_572: upstream-reference=NvmIf.Geltungsbereich_MQBw_Baseline.pseRunEepromMemoryNotProgrammed, ecu-extract-reference=NvmIf.TopLevelCompositionPrototype.pseRunEepromMemoryNotProgrammed
      OsIf_573: upstream-reference=Geltungsbereich_MQBw_Baseline.OsIf, ecu-extract-reference=TopLevelCompositionPrototype.OsIf
      pclRcmServices_574: upstream-reference=OsIf.Geltungsbereich_MQBw_Baseline.pclRcmServices, ecu-extract-reference=OsIf.TopLevelCompositionPrototype.pclRcmServices
      pclResetCauseNotification_575: upstream-reference=OsIf.Geltungsbereich_MQBw_Baseline.pclResetCauseNotification, ecu-extract-reference=OsIf.TopLevelCompositionPrototype.pclResetCauseNotification
      ptrpAsrOsServicesOsIf_576: upstream-reference=OsIf.Geltungsbereich_MQBw_Baseline.ptrpAsrOsServicesOsIf, ecu-extract-reference=OsIf.TopLevelCompositionPrototype.ptrpAsrOsServicesOsIf
      ptrrAsrBswMServicesOsIf_577: upstream-reference=OsIf.Geltungsbereich_MQBw_Baseline.ptrrAsrBswMServicesOsIf, ecu-extract-reference=OsIf.TopLevelCompositionPrototype.ptrrAsrBswMServicesOsIf
      ptrrAsrEcuMServicesOsIf_578: upstream-reference=OsIf.Geltungsbereich_MQBw_Baseline.ptrrAsrEcuMServicesOsIf, ecu-extract-reference=OsIf.TopLevelCompositionPrototype.ptrrAsrEcuMServicesOsIf
      ptrrMicServices_579: upstream-reference=OsIf.Geltungsbereich_MQBw_Baseline.ptrrMicServices, ecu-extract-reference=OsIf.TopLevelCompositionPrototype.ptrrMicServices
      PwmIf_580: upstream-reference=Geltungsbereich_MQBw_Baseline.PwmIf, ecu-extract-reference=TopLevelCompositionPrototype.PwmIf
      psePwmServices_581: upstream-reference=PwmIf.Geltungsbereich_MQBw_Baseline.psePwmServices, ecu-extract-reference=PwmIf.TopLevelCompositionPrototype.psePwmServices
      ptrrAsrPwmServicesPwmIf_582: upstream-reference=PwmIf.Geltungsbereich_MQBw_Baseline.ptrrAsrPwmServicesPwmIf, ecu-extract-reference=PwmIf.TopLevelCompositionPrototype.ptrrAsrPwmServicesPwmIf
      RCM_583: upstream-reference=Geltungsbereich_MQBw_Baseline.RCM, ecu-extract-reference=TopLevelCompositionPrototype.RCM
      pclNvmIfServices_584: upstream-reference=RCM.Geltungsbereich_MQBw_Baseline.pclNvmIfServices, ecu-extract-reference=RCM.TopLevelCompositionPrototype.pclNvmIfServices
      pclSbcWdgServices_585: upstream-reference=RCM.Geltungsbereich_MQBw_Baseline.pclSbcWdgServices, ecu-extract-reference=RCM.TopLevelCompositionPrototype.pclSbcWdgServices
      pseOSErrorReport_586: upstream-reference=RCM.Geltungsbereich_MQBw_Baseline.pseOSErrorReport, ecu-extract-reference=RCM.TopLevelCompositionPrototype.pseOSErrorReport
      pseResetCause_587: upstream-reference=RCM.Geltungsbereich_MQBw_Baseline.pseResetCause, ecu-extract-reference=RCM.TopLevelCompositionPrototype.pseResetCause
      pseResetCauseNotification_588: upstream-reference=RCM.Geltungsbereich_MQBw_Baseline.pseResetCauseNotification, ecu-extract-reference=RCM.TopLevelCompositionPrototype.pseResetCauseNotification
      pseRunResetCause_589: upstream-reference=RCM.Geltungsbereich_MQBw_Baseline.pseRunResetCause, ecu-extract-reference=RCM.TopLevelCompositionPrototype.pseRunResetCause
      ptrpRcmServicesBswMIf_590: upstream-reference=RCM.Geltungsbereich_MQBw_Baseline.ptrpRcmServicesBswMIf, ecu-extract-reference=RCM.TopLevelCompositionPrototype.ptrpRcmServicesBswMIf
      u8ResetCause_591: upstream-reference=RCM.Geltungsbereich_MQBw_Baseline.u8ResetCause, ecu-extract-reference=RCM.TopLevelCompositionPrototype.u8ResetCause
      SAD_592: upstream-reference=Geltungsbereich_MQBw_Baseline.SAD, ecu-extract-reference=TopLevelCompositionPrototype.SAD
      pclAutotestServices_593: upstream-reference=SAD.Geltungsbereich_MQBw_Baseline.pclAutotestServices, ecu-extract-reference=SAD.TopLevelCompositionPrototype.pclAutotestServices
      pclConvAdcService_594: upstream-reference=SAD.Geltungsbereich_MQBw_Baseline.pclConvAdcService, ecu-extract-reference=SAD.TopLevelCompositionPrototype.pclConvAdcService
      pclDioIfServices_595: upstream-reference=SAD.Geltungsbereich_MQBw_Baseline.pclDioIfServices, ecu-extract-reference=SAD.TopLevelCompositionPrototype.pclDioIfServices
      pclEvtActuatorOpenCircuit_596: upstream-reference=SAD.Geltungsbereich_MQBw_Baseline.pclEvtActuatorOpenCircuit, ecu-extract-reference=SAD.TopLevelCompositionPrototype.pclEvtActuatorOpenCircuit
      pclEvtActuatorShortToGround_597: upstream-reference=SAD.Geltungsbereich_MQBw_Baseline.pclEvtActuatorShortToGround, ecu-extract-reference=SAD.TopLevelCompositionPrototype.pclEvtActuatorShortToGround
      pclEvtActuatorShortToVbat_598: upstream-reference=SAD.Geltungsbereich_MQBw_Baseline.pclEvtActuatorShortToVbat, ecu-extract-reference=SAD.TopLevelCompositionPrototype.pclEvtActuatorShortToVbat
      pclEvtSolenoidOvervoltage_599: upstream-reference=SAD.Geltungsbereich_MQBw_Baseline.pclEvtSolenoidOvervoltage, ecu-extract-reference=SAD.TopLevelCompositionPrototype.pclEvtSolenoidOvervoltage
      pclModeManagement_600: upstream-reference=SAD.Geltungsbereich_MQBw_Baseline.pclModeManagement, ecu-extract-reference=SAD.TopLevelCompositionPrototype.pclModeManagement
      pclPwmServices_601: upstream-reference=SAD.Geltungsbereich_MQBw_Baseline.pclPwmServices, ecu-extract-reference=SAD.TopLevelCompositionPrototype.pclPwmServices
      prrSolenoidProfile_602: upstream-reference=SAD.Geltungsbereich_MQBw_Baseline.prrSolenoidProfile, ecu-extract-reference=SAD.TopLevelCompositionPrototype.prrSolenoidProfile
      au8SelectedProfile_603: upstream-reference=prrSolenoidProfile.SAD.Geltungsbereich_MQBw_Baseline.au8SelectedProfile, ecu-extract-reference=prrSolenoidProfile.SAD.TopLevelCompositionPrototype.au8SelectedProfile
      prrSolenoidState_604: upstream-reference=SAD.Geltungsbereich_MQBw_Baseline.prrSolenoidState, ecu-extract-reference=SAD.TopLevelCompositionPrototype.prrSolenoidState
      au8SolenoidState_605: upstream-reference=prrSolenoidState.SAD.Geltungsbereich_MQBw_Baseline.au8SolenoidState, ecu-extract-reference=prrSolenoidState.SAD.TopLevelCompositionPrototype.au8SolenoidState
      prrSolenoidStuckStatus_606: upstream-reference=SAD.Geltungsbereich_MQBw_Baseline.prrSolenoidStuckStatus, ecu-extract-reference=SAD.TopLevelCompositionPrototype.prrSolenoidStuckStatus
      au8SolenoidIsStuck_607: upstream-reference=prrSolenoidStuckStatus.SAD.Geltungsbereich_MQBw_Baseline.au8SolenoidIsStuck, ecu-extract-reference=prrSolenoidStuckStatus.SAD.TopLevelCompositionPrototype.au8SolenoidIsStuck
      pseCheckActuatorState_608: upstream-reference=SAD.Geltungsbereich_MQBw_Baseline.pseCheckActuatorState, ecu-extract-reference=SAD.TopLevelCompositionPrototype.pseCheckActuatorState
      pseCheckPowerStage_609: upstream-reference=SAD.Geltungsbereich_MQBw_Baseline.pseCheckPowerStage, ecu-extract-reference=SAD.TopLevelCompositionPrototype.pseCheckPowerStage
      pseCheckSolenoidOpenCircuit_610: upstream-reference=SAD.Geltungsbereich_MQBw_Baseline.pseCheckSolenoidOpenCircuit, ecu-extract-reference=SAD.TopLevelCompositionPrototype.pseCheckSolenoidOpenCircuit
      pseCheckSolenoidOvervoltage_611: upstream-reference=SAD.Geltungsbereich_MQBw_Baseline.pseCheckSolenoidOvervoltage, ecu-extract-reference=SAD.TopLevelCompositionPrototype.pseCheckSolenoidOvervoltage
      pseCheckSolenoidShortToGND_612: upstream-reference=SAD.Geltungsbereich_MQBw_Baseline.pseCheckSolenoidShortToGND, ecu-extract-reference=SAD.TopLevelCompositionPrototype.pseCheckSolenoidShortToGND
      pseCheckSolenoidShortToVBAT_613: upstream-reference=SAD.Geltungsbereich_MQBw_Baseline.pseCheckSolenoidShortToVBAT, ecu-extract-reference=SAD.TopLevelCompositionPrototype.pseCheckSolenoidShortToVBAT
      pseDiagRequestServices_614: upstream-reference=SAD.Geltungsbereich_MQBw_Baseline.pseDiagRequestServices, ecu-extract-reference=SAD.TopLevelCompositionPrototype.pseDiagRequestServices
      au8DiagReq_615: upstream-reference=pseDiagRequestServices.SAD.Geltungsbereich_MQBw_Baseline.au8DiagReq, ecu-extract-reference=pseDiagRequestServices.SAD.TopLevelCompositionPrototype.au8DiagReq
      au8DiagReqComplement_616: upstream-reference=pseDiagRequestServices.SAD.Geltungsbereich_MQBw_Baseline.au8DiagReqComplement, ecu-extract-reference=pseDiagRequestServices.SAD.TopLevelCompositionPrototype.au8DiagReqComplement
      pseSolenoidPWM_617: upstream-reference=SAD.Geltungsbereich_MQBw_Baseline.pseSolenoidPWM, ecu-extract-reference=SAD.TopLevelCompositionPrototype.pseSolenoidPWM
      au16Pwm_618: upstream-reference=pseSolenoidPWM.SAD.Geltungsbereich_MQBw_Baseline.au16Pwm, ecu-extract-reference=pseSolenoidPWM.SAD.TopLevelCompositionPrototype.au16Pwm
      pseSolenoidStep_619: upstream-reference=SAD.Geltungsbereich_MQBw_Baseline.pseSolenoidStep, ecu-extract-reference=SAD.TopLevelCompositionPrototype.pseSolenoidStep
      au8CurrentStep_620: upstream-reference=pseSolenoidStep.SAD.Geltungsbereich_MQBw_Baseline.au8CurrentStep, ecu-extract-reference=pseSolenoidStep.SAD.TopLevelCompositionPrototype.au8CurrentStep
      psrSolenoidElectricalCharacteristics_621: upstream-reference=SAD.Geltungsbereich_MQBw_Baseline.psrSolenoidElectricalCharacteristics, ecu-extract-reference=SAD.TopLevelCompositionPrototype.psrSolenoidElectricalCharacteristics
      au32SolenoidmATarget_622: upstream-reference=psrSolenoidElectricalCharacteristics.SAD.Geltungsbereich_MQBw_Baseline.au32SolenoidmATarget, ecu-extract-reference=psrSolenoidElectricalCharacteristics.SAD.TopLevelCompositionPrototype.au32SolenoidmATarget
      psrSolenoidOpenCircutStatus_623: upstream-reference=SAD.Geltungsbereich_MQBw_Baseline.psrSolenoidOpenCircutStatus, ecu-extract-reference=SAD.TopLevelCompositionPrototype.psrSolenoidOpenCircutStatus
      au8SolenoidAutotestStatus_624: upstream-reference=psrSolenoidOpenCircutStatus.SAD.Geltungsbereich_MQBw_Baseline.au8SolenoidAutotestStatus, ecu-extract-reference=psrSolenoidOpenCircutStatus.SAD.TopLevelCompositionPrototype.au8SolenoidAutotestStatus
      psrSolenoidOvervoltageStatus_625: upstream-reference=SAD.Geltungsbereich_MQBw_Baseline.psrSolenoidOvervoltageStatus, ecu-extract-reference=SAD.TopLevelCompositionPrototype.psrSolenoidOvervoltageStatus
      au8SolenoidOvervoltageStatus_626: upstream-reference=psrSolenoidOvervoltageStatus.SAD.Geltungsbereich_MQBw_Baseline.au8SolenoidOvervoltageStatus, ecu-extract-reference=psrSolenoidOvervoltageStatus.SAD.TopLevelCompositionPrototype.au8SolenoidOvervoltageStatus
      psrSolenoidShortToGndStatus_627: upstream-reference=SAD.Geltungsbereich_MQBw_Baseline.psrSolenoidShortToGndStatus, ecu-extract-reference=SAD.TopLevelCompositionPrototype.psrSolenoidShortToGndStatus
      au8SolenoidAutotestStatus_628: upstream-reference=psrSolenoidShortToGndStatus.SAD.Geltungsbereich_MQBw_Baseline.au8SolenoidAutotestStatus, ecu-extract-reference=psrSolenoidShortToGndStatus.SAD.TopLevelCompositionPrototype.au8SolenoidAutotestStatus
      psrSolenoidShortToVccStatus_629: upstream-reference=SAD.Geltungsbereich_MQBw_Baseline.psrSolenoidShortToVccStatus, ecu-extract-reference=SAD.TopLevelCompositionPrototype.psrSolenoidShortToVccStatus
      au8SolenoidAutotestStatus_630: upstream-reference=psrSolenoidShortToVccStatus.SAD.Geltungsbereich_MQBw_Baseline.au8SolenoidAutotestStatus, ecu-extract-reference=psrSolenoidShortToVccStatus.SAD.TopLevelCompositionPrototype.au8SolenoidAutotestStatus
      ptrpAsrOsServicesSAD_631: upstream-reference=SAD.Geltungsbereich_MQBw_Baseline.ptrpAsrOsServicesSAD, ecu-extract-reference=SAD.TopLevelCompositionPrototype.ptrpAsrOsServicesSAD
      ptrpSadServicesBswMIf_632: upstream-reference=SAD.Geltungsbereich_MQBw_Baseline.ptrpSadServicesBswMIf, ecu-extract-reference=SAD.TopLevelCompositionPrototype.ptrpSadServicesBswMIf
      stProfileCfg_633: upstream-reference=SAD.Geltungsbereich_MQBw_Baseline.stProfileCfg, ecu-extract-reference=SAD.TopLevelCompositionPrototype.stProfileCfg
      SBC_634: upstream-reference=Geltungsbereich_MQBw_Baseline.SBC, ecu-extract-reference=TopLevelCompositionPrototype.SBC
      pclResetCause_635: upstream-reference=SBC.Geltungsbereich_MQBw_Baseline.pclResetCause, ecu-extract-reference=SBC.TopLevelCompositionPrototype.pclResetCause
      pclResetCauseNotification_636: upstream-reference=SBC.Geltungsbereich_MQBw_Baseline.pclResetCauseNotification, ecu-extract-reference=SBC.TopLevelCompositionPrototype.pclResetCauseNotification
      pseCheckSbcStatusInfo_637: upstream-reference=SBC.Geltungsbereich_MQBw_Baseline.pseCheckSbcStatusInfo, ecu-extract-reference=SBC.TopLevelCompositionPrototype.pseCheckSbcStatusInfo
      pseSbcServices_638: upstream-reference=SBC.Geltungsbereich_MQBw_Baseline.pseSbcServices, ecu-extract-reference=SBC.TopLevelCompositionPrototype.pseSbcServices
      pseSbcStatus_639: upstream-reference=SBC.Geltungsbereich_MQBw_Baseline.pseSbcStatus, ecu-extract-reference=SBC.TopLevelCompositionPrototype.pseSbcStatus
      pseSbcWdgAutotest_640: upstream-reference=SBC.Geltungsbereich_MQBw_Baseline.pseSbcWdgAutotest, ecu-extract-reference=SBC.TopLevelCompositionPrototype.pseSbcWdgAutotest
      psrSbcStatusFailiureSource_641: upstream-reference=SBC.Geltungsbereich_MQBw_Baseline.psrSbcStatusFailiureSource, ecu-extract-reference=SBC.TopLevelCompositionPrototype.psrSbcStatusFailiureSource
      u32SbcReg1Status_642: upstream-reference=psrSbcStatusFailiureSource.SBC.Geltungsbereich_MQBw_Baseline.u32SbcReg1Status, ecu-extract-reference=psrSbcStatusFailiureSource.SBC.TopLevelCompositionPrototype.u32SbcReg1Status
      ptrpAsrOsServicesSBC_643: upstream-reference=SBC.Geltungsbereich_MQBw_Baseline.ptrpAsrOsServicesSBC, ecu-extract-reference=SBC.TopLevelCompositionPrototype.ptrpAsrOsServicesSBC
      ptrpSbcServicesEcuM_644: upstream-reference=SBC.Geltungsbereich_MQBw_Baseline.ptrpSbcServicesEcuM, ecu-extract-reference=SBC.TopLevelCompositionPrototype.ptrpSbcServicesEcuM
      ptrrSpiIfServices_645: upstream-reference=SBC.Geltungsbereich_MQBw_Baseline.ptrrSpiIfServices, ecu-extract-reference=SBC.TopLevelCompositionPrototype.ptrrSpiIfServices
      STM_646: upstream-reference=Geltungsbereich_MQBw_Baseline.STM, ecu-extract-reference=TopLevelCompositionPrototype.STM
      pseSystemTime_647: upstream-reference=STM.Geltungsbereich_MQBw_Baseline.pseSystemTime, ecu-extract-reference=STM.TopLevelCompositionPrototype.pseSystemTime
      ptrpAsrOsServicesSTM_648: upstream-reference=STM.Geltungsbereich_MQBw_Baseline.ptrpAsrOsServicesSTM, ecu-extract-reference=STM.TopLevelCompositionPrototype.ptrpAsrOsServicesSTM
      SpiIf_649: upstream-reference=Geltungsbereich_MQBw_Baseline.SpiIf, ecu-extract-reference=TopLevelCompositionPrototype.SpiIf
      ptrpSpiIfServicesACC_650: upstream-reference=SpiIf.Geltungsbereich_MQBw_Baseline.ptrpSpiIfServicesACC, ecu-extract-reference=SpiIf.TopLevelCompositionPrototype.ptrpSpiIfServicesACC
      ptrpSpiIfServicesSBC_651: upstream-reference=SpiIf.Geltungsbereich_MQBw_Baseline.ptrpSpiIfServicesSBC, ecu-extract-reference=SpiIf.TopLevelCompositionPrototype.ptrpSpiIfServicesSBC
      ptrrAsrSpiServicesSpiIf_652: upstream-reference=SpiIf.Geltungsbereich_MQBw_Baseline.ptrrAsrSpiServicesSpiIf, ecu-extract-reference=SpiIf.TopLevelCompositionPrototype.ptrrAsrSpiServicesSpiIf
      T1_653: upstream-reference=Geltungsbereich_MQBw_Baseline.T1, ecu-extract-reference=TopLevelCompositionPrototype.T1
      eCS_654: upstream-reference=Geltungsbereich_MQBw_Baseline.eCS, ecu-extract-reference=TopLevelCompositionPrototype.eCS
      pclModeManagement_655: upstream-reference=eCS.Geltungsbereich_MQBw_Baseline.pclModeManagement, ecu-extract-reference=eCS.TopLevelCompositionPrototype.pclModeManagement
      prrAccelMtrPerSecSqd_656: upstream-reference=eCS.Geltungsbereich_MQBw_Baseline.prrAccelMtrPerSecSqd, ecu-extract-reference=eCS.TopLevelCompositionPrototype.prrAccelMtrPerSecSqd
      stAccelMtrPerSecSqd_657: upstream-reference=prrAccelMtrPerSecSqd.eCS.Geltungsbereich_MQBw_Baseline.stAccelMtrPerSecSqd, ecu-extract-reference=prrAccelMtrPerSecSqd.eCS.TopLevelCompositionPrototype.stAccelMtrPerSecSqd
      s16AxAppl_658: upstream-reference=prrAccelMtrPerSecSqd.eCS.Geltungsbereich_MQBw_Baseline.stAccelMtrPerSecSqd.s16AxAppl, ecu-extract-reference=prrAccelMtrPerSecSqd.eCS.TopLevelCompositionPrototype.stAccelMtrPerSecSqd.s16AxAppl
      s16AyAppl_659: upstream-reference=prrAccelMtrPerSecSqd.eCS.Geltungsbereich_MQBw_Baseline.stAccelMtrPerSecSqd.s16AyAppl, ecu-extract-reference=prrAccelMtrPerSecSqd.eCS.TopLevelCompositionPrototype.stAccelMtrPerSecSqd.s16AyAppl
      s16AzAppl_660: upstream-reference=prrAccelMtrPerSecSqd.eCS.Geltungsbereich_MQBw_Baseline.stAccelMtrPerSecSqd.s16AzAppl, ecu-extract-reference=prrAccelMtrPerSecSqd.eCS.TopLevelCompositionPrototype.stAccelMtrPerSecSqd.s16AzAppl
      psrEcsAlgoData_661: upstream-reference=eCS.Geltungsbereich_MQBw_Baseline.psrEcsAlgoData, ecu-extract-reference=eCS.TopLevelCompositionPrototype.psrEcsAlgoData
      u16BallPosition_662: upstream-reference=psrEcsAlgoData.eCS.Geltungsbereich_MQBw_Baseline.u16BallPosition, ecu-extract-reference=psrEcsAlgoData.eCS.TopLevelCompositionPrototype.u16BallPosition
      u8EcsFlag_663: upstream-reference=psrEcsAlgoData.eCS.Geltungsbereich_MQBw_Baseline.u8EcsFlag, ecu-extract-reference=psrEcsAlgoData.eCS.TopLevelCompositionPrototype.u8EcsFlag
      ptrpAsrOsServicesECS_664: upstream-reference=eCS.Geltungsbereich_MQBw_Baseline.ptrpAsrOsServicesECS, ecu-extract-reference=eCS.TopLevelCompositionPrototype.ptrpAsrOsServicesECS
      Dcm_665: upstream-reference=Geltungsbereich_MQBw_Baseline.Dcm, ecu-extract-reference=TopLevelCompositionPrototype.Dcm
      Dcm_ASR42_DCMServices_666: upstream-reference=Dcm.Geltungsbereich_MQBw_Baseline.Dcm_ASR42_DCMServices, ecu-extract-reference=Dcm.TopLevelCompositionPrototype.Dcm_ASR42_DCMServices
      DCMServices_667: upstream-reference=Dcm.Geltungsbereich_MQBw_Baseline.DCMServices, ecu-extract-reference=Dcm.TopLevelCompositionPrototype.DCMServices
      SecurityAccess_DcmDspSecurityAlv_668: upstream-reference=Dcm.Geltungsbereich_MQBw_Baseline.SecurityAccess_DcmDspSecurityAlv, ecu-extract-reference=Dcm.TopLevelCompositionPrototype.SecurityAccess_DcmDspSecurityAlv
      DataServices_DID_4024_SWSystemTimeData_669: upstream-reference=Dcm.Geltungsbereich_MQBw_Baseline.DataServices_DID_4024_SWSystemTimeData, ecu-extract-reference=Dcm.TopLevelCompositionPrototype.DataServices_DID_4024_SWSystemTimeData
      DataServices_DID_FD00_HWVersionData_670: upstream-reference=Dcm.Geltungsbereich_MQBw_Baseline.DataServices_DID_FD00_HWVersionData, ecu-extract-reference=Dcm.TopLevelCompositionPrototype.DataServices_DID_FD00_HWVersionData
      DataServices_DID_FD01_SWVersionData_671: upstream-reference=Dcm.Geltungsbereich_MQBw_Baseline.DataServices_DID_FD01_SWVersionData, ecu-extract-reference=Dcm.TopLevelCompositionPrototype.DataServices_DID_FD01_SWVersionData
      DataServices_DID_FD03_AEETraceabilityNumberData_672: upstream-reference=Dcm.Geltungsbereich_MQBw_Baseline.DataServices_DID_FD03_AEETraceabilityNumberData, ecu-extract-reference=Dcm.TopLevelCompositionPrototype.DataServices_DID_FD03_AEETraceabilityNumberData
      DataServices_DID_FD08_ResetCauseData_673: upstream-reference=Dcm.Geltungsbereich_MQBw_Baseline.DataServices_DID_FD08_ResetCauseData, ecu-extract-reference=Dcm.TopLevelCompositionPrototype.DataServices_DID_FD08_ResetCauseData
      DataServices_DID_FD09_LastWarmResetParamData_674: upstream-reference=Dcm.Geltungsbereich_MQBw_Baseline.DataServices_DID_FD09_LastWarmResetParamData, ecu-extract-reference=Dcm.TopLevelCompositionPrototype.DataServices_DID_FD09_LastWarmResetParamData
      DataServices_DID_FD62_EccOccurenceNbData_675: upstream-reference=Dcm.Geltungsbereich_MQBw_Baseline.DataServices_DID_FD62_EccOccurenceNbData, ecu-extract-reference=Dcm.TopLevelCompositionPrototype.DataServices_DID_FD62_EccOccurenceNbData
      DataServices_DID_FEFF_MeasurementFramesConfData_676: upstream-reference=Dcm.Geltungsbereich_MQBw_Baseline.DataServices_DID_FEFF_MeasurementFramesConfData, ecu-extract-reference=Dcm.TopLevelCompositionPrototype.DataServices_DID_FEFF_MeasurementFramesConfData
      DataServices_DID_FE00_AllEventStatusesRead_677: upstream-reference=Dcm.Geltungsbereich_MQBw_Baseline.DataServices_DID_FE00_AllEventStatusesRead, ecu-extract-reference=Dcm.TopLevelCompositionPrototype.DataServices_DID_FE00_AllEventStatusesRead
      DataServices_DID_FD8B_ECUManufacturingDateData_678: upstream-reference=Dcm.Geltungsbereich_MQBw_Baseline.DataServices_DID_FD8B_ECUManufacturingDateData, ecu-extract-reference=Dcm.TopLevelCompositionPrototype.DataServices_DID_FD8B_ECUManufacturingDateData
      DataServices_DID_FD8C_AssemblySerialNumber_679: upstream-reference=Dcm.Geltungsbereich_MQBw_Baseline.DataServices_DID_FD8C_AssemblySerialNumber, ecu-extract-reference=Dcm.TopLevelCompositionPrototype.DataServices_DID_FD8C_AssemblySerialNumber
      DataServices_DID_FD0F_BatteryMeasureData_680: upstream-reference=Dcm.Geltungsbereich_MQBw_Baseline.DataServices_DID_FD0F_BatteryMeasureData, ecu-extract-reference=Dcm.TopLevelCompositionPrototype.DataServices_DID_FD0F_BatteryMeasureData
      DataServices_DID_FD10_ECUTemperatureData_681: upstream-reference=Dcm.Geltungsbereich_MQBw_Baseline.DataServices_DID_FD10_ECUTemperatureData, ecu-extract-reference=Dcm.TopLevelCompositionPrototype.DataServices_DID_FD10_ECUTemperatureData
      DataServices_DID_FDE0_EcsVariantData_682: upstream-reference=Dcm.Geltungsbereich_MQBw_Baseline.DataServices_DID_FDE0_EcsVariantData, ecu-extract-reference=Dcm.TopLevelCompositionPrototype.DataServices_DID_FDE0_EcsVariantData
      DataServices_DID_FDE1_EcsParametersData_683: upstream-reference=Dcm.Geltungsbereich_MQBw_Baseline.DataServices_DID_FDE1_EcsParametersData, ecu-extract-reference=Dcm.TopLevelCompositionPrototype.DataServices_DID_FDE1_EcsParametersData
      DataServices_DID_FDE2_AccOffsetData_684: upstream-reference=Dcm.Geltungsbereich_MQBw_Baseline.DataServices_DID_FDE2_AccOffsetData, ecu-extract-reference=Dcm.TopLevelCompositionPrototype.DataServices_DID_FDE2_AccOffsetData
      DataServices_DID_FDE3_EcsProfilesData_685: upstream-reference=Dcm.Geltungsbereich_MQBw_Baseline.DataServices_DID_FDE3_EcsProfilesData, ecu-extract-reference=Dcm.TopLevelCompositionPrototype.DataServices_DID_FDE3_EcsProfilesData
      DataServices_DID_FDE4_EcsStepsData_686: upstream-reference=Dcm.Geltungsbereich_MQBw_Baseline.DataServices_DID_FDE4_EcsStepsData, ecu-extract-reference=Dcm.TopLevelCompositionPrototype.DataServices_DID_FDE4_EcsStepsData
      DataServices_DID_FDE5_EcsAccLowPassData_687: upstream-reference=Dcm.Geltungsbereich_MQBw_Baseline.DataServices_DID_FDE5_EcsAccLowPassData, ecu-extract-reference=Dcm.TopLevelCompositionPrototype.DataServices_DID_FDE5_EcsAccLowPassData
      DataServices_DID_FDE7_AlgoOutputDelayData_688: upstream-reference=Dcm.Geltungsbereich_MQBw_Baseline.DataServices_DID_FDE7_AlgoOutputDelayData, ecu-extract-reference=Dcm.TopLevelCompositionPrototype.DataServices_DID_FDE7_AlgoOutputDelayData
      DataServices_DID_FDE9_SensitivityLutData_689: upstream-reference=Dcm.Geltungsbereich_MQBw_Baseline.DataServices_DID_FDE9_SensitivityLutData, ecu-extract-reference=Dcm.TopLevelCompositionPrototype.DataServices_DID_FDE9_SensitivityLutData
      DataServices_DID_FDEA_SensitivityOptData_690: upstream-reference=Dcm.Geltungsbereich_MQBw_Baseline.DataServices_DID_FDEA_SensitivityOptData, ecu-extract-reference=Dcm.TopLevelCompositionPrototype.DataServices_DID_FDEA_SensitivityOptData
      DataServices_DID_FDFF_MeasurementFrameConfDataRam_691: upstream-reference=Dcm.Geltungsbereich_MQBw_Baseline.DataServices_DID_FDFF_MeasurementFrameConfDataRam, ecu-extract-reference=Dcm.TopLevelCompositionPrototype.DataServices_DID_FDFF_MeasurementFrameConfDataRam
      DataServices_DID_F187_VWSparePartNumberData_692: upstream-reference=Dcm.Geltungsbereich_MQBw_Baseline.DataServices_DID_F187_VWSparePartNumberData, ecu-extract-reference=Dcm.TopLevelCompositionPrototype.DataServices_DID_F187_VWSparePartNumberData
      DataServices_DID_F189_VWApplicationSoftwareVersionNumberData_693: upstream-reference=Dcm.Geltungsbereich_MQBw_Baseline.DataServices_DID_F189_VWApplicationSoftwareVersionNumberData, ecu-extract-reference=Dcm.TopLevelCompositionPrototype.DataServices_DID_F189_VWApplicationSoftwareVersionNumberData
      DataServices_DID_F191_VWECUHardwareNumberData_694: upstream-reference=Dcm.Geltungsbereich_MQBw_Baseline.DataServices_DID_F191_VWECUHardwareNumberData, ecu-extract-reference=Dcm.TopLevelCompositionPrototype.DataServices_DID_F191_VWECUHardwareNumberData
      DataServices_DID_F197_VWSystemNameOrEngineTypeData_695: upstream-reference=Dcm.Geltungsbereich_MQBw_Baseline.DataServices_DID_F197_VWSystemNameOrEngineTypeData, ecu-extract-reference=Dcm.TopLevelCompositionPrototype.DataServices_DID_F197_VWSystemNameOrEngineTypeData
      DataServices_DID_F1B4_TechnicalSpecificationsVersionData_696: upstream-reference=Dcm.Geltungsbereich_MQBw_Baseline.DataServices_DID_F1B4_TechnicalSpecificationsVersionData, ecu-extract-reference=Dcm.TopLevelCompositionPrototype.DataServices_DID_F1B4_TechnicalSpecificationsVersionData
      DataServices_DID_0407_VWLogicalSoftwareBlockCounterOfProgrammingAttemptsData_697: upstream-reference=Dcm.Geltungsbereich_MQBw_Baseline.DataServices_DID_0407_VWLogicalSoftwareBlockCounterOfProgrammingAttemptsData, ecu-extract-reference=Dcm.TopLevelCompositionPrototype.DataServices_DID_0407_VWLogicalSoftwareBlockCounterOfProgrammingAttemptsData
      DataServices_DID_040F_VWLogicalSoftwareBlockLockValueData_698: upstream-reference=Dcm.Geltungsbereich_MQBw_Baseline.DataServices_DID_040F_VWLogicalSoftwareBlockLockValueData, ecu-extract-reference=Dcm.TopLevelCompositionPrototype.DataServices_DID_040F_VWLogicalSoftwareBlockLockValueData
      DataServices_DID_0410_BootloaderTPBlocksizeData_699: upstream-reference=Dcm.Geltungsbereich_MQBw_Baseline.DataServices_DID_0410_BootloaderTPBlocksizeData, ecu-extract-reference=Dcm.TopLevelCompositionPrototype.DataServices_DID_0410_BootloaderTPBlocksizeData
      DataServices_DID_0448_ProgrammingPreconditionsData_700: upstream-reference=Dcm.Geltungsbereich_MQBw_Baseline.DataServices_DID_0448_ProgrammingPreconditionsData, ecu-extract-reference=Dcm.TopLevelCompositionPrototype.DataServices_DID_0448_ProgrammingPreconditionsData
      DataServices_DID_F1DF_ECUProgrammingInformationData_701: upstream-reference=Dcm.Geltungsbereich_MQBw_Baseline.DataServices_DID_F1DF_ECUProgrammingInformationData, ecu-extract-reference=Dcm.TopLevelCompositionPrototype.DataServices_DID_F1DF_ECUProgrammingInformationData
      DataServices_DID_F19E_ASAMODXFileIdentifierData_702: upstream-reference=Dcm.Geltungsbereich_MQBw_Baseline.DataServices_DID_F19E_ASAMODXFileIdentifierData, ecu-extract-reference=Dcm.TopLevelCompositionPrototype.DataServices_DID_F19E_ASAMODXFileIdentifierData
      DataServices_DID_F1A2_ASAMODXFileVersionData_703: upstream-reference=Dcm.Geltungsbereich_MQBw_Baseline.DataServices_DID_F1A2_ASAMODXFileVersionData, ecu-extract-reference=Dcm.TopLevelCompositionPrototype.DataServices_DID_F1A2_ASAMODXFileVersionData
      DataServices_DID_F1D5_FDSProjectData_704: upstream-reference=Dcm.Geltungsbereich_MQBw_Baseline.DataServices_DID_F1D5_FDSProjectData, ecu-extract-reference=Dcm.TopLevelCompositionPrototype.DataServices_DID_F1D5_FDSProjectData
      DataServices_DID_F1A3_VWECUHardwareVersionNumberData_705: upstream-reference=Dcm.Geltungsbereich_MQBw_Baseline.DataServices_DID_F1A3_VWECUHardwareVersionNumberData, ecu-extract-reference=Dcm.TopLevelCompositionPrototype.DataServices_DID_F1A3_VWECUHardwareVersionNumberData
      DataServices_DID_F18C_ECUSerialNumberData_706: upstream-reference=Dcm.Geltungsbereich_MQBw_Baseline.DataServices_DID_F18C_ECUSerialNumberData, ecu-extract-reference=Dcm.TopLevelCompositionPrototype.DataServices_DID_F18C_ECUSerialNumberData
      DataServices_DID_F1AB_VWLogicalSoftwareBlockVersionData_707: upstream-reference=Dcm.Geltungsbereich_MQBw_Baseline.DataServices_DID_F1AB_VWLogicalSoftwareBlockVersionData, ecu-extract-reference=Dcm.TopLevelCompositionPrototype.DataServices_DID_F1AB_VWLogicalSoftwareBlockVersionData
      DataServices_DID_F15B_FingerprintAndProgrammingDateOfLogicalSoftwareBlocksData_708: upstream-reference=Dcm.Geltungsbereich_MQBw_Baseline.DataServices_DID_F15B_FingerprintAndProgrammingDateOfLogicalSoftwareBlocksData, ecu-extract-reference=Dcm.TopLevelCompositionPrototype.DataServices_DID_F15B_FingerprintAndProgrammingDateOfLogicalSoftwareBlocksData
      DataServices_DID_0236_ProgrammingDataElockEcuData_709: upstream-reference=Dcm.Geltungsbereich_MQBw_Baseline.DataServices_DID_0236_ProgrammingDataElockEcuData, ecu-extract-reference=Dcm.TopLevelCompositionPrototype.DataServices_DID_0236_ProgrammingDataElockEcuData
      DataServices_DID_023E_WSCForProgrammingElockEcuData_710: upstream-reference=Dcm.Geltungsbereich_MQBw_Baseline.DataServices_DID_023E_WSCForProgrammingElockEcuData, ecu-extract-reference=Dcm.TopLevelCompositionPrototype.DataServices_DID_023E_WSCForProgrammingElockEcuData
      ServiceRequestSupplierNotification_DcmDslServiceRequestSupplierNotification_711: upstream-reference=Dcm.Geltungsbereich_MQBw_Baseline.ServiceRequestSupplierNotification_DcmDslServiceRequestSupplierNotification, ecu-extract-reference=Dcm.TopLevelCompositionPrototype.ServiceRequestSupplierNotification_DcmDslServiceRequestSupplierNotification
      RoutineServices_DcmDspRoutineCtrl_Lock_UnlockECU_712: upstream-reference=Dcm.Geltungsbereich_MQBw_Baseline.RoutineServices_DcmDspRoutineCtrl_Lock_UnlockECU, ecu-extract-reference=Dcm.TopLevelCompositionPrototype.RoutineServices_DcmDspRoutineCtrl_Lock_UnlockECU
      RoutineServices_DcmDspRoutineProcessMode_713: upstream-reference=Dcm.Geltungsbereich_MQBw_Baseline.RoutineServices_DcmDspRoutineProcessMode, ecu-extract-reference=Dcm.TopLevelCompositionPrototype.RoutineServices_DcmDspRoutineProcessMode
      RoutineServices_DcmDspRoutineAccCalib_714: upstream-reference=Dcm.Geltungsbereich_MQBw_Baseline.RoutineServices_DcmDspRoutineAccCalib, ecu-extract-reference=Dcm.TopLevelCompositionPrototype.RoutineServices_DcmDspRoutineAccCalib
      RoutineServices_DcmDspRoutineLockSolenoid_715: upstream-reference=Dcm.Geltungsbereich_MQBw_Baseline.RoutineServices_DcmDspRoutineLockSolenoid, ecu-extract-reference=Dcm.TopLevelCompositionPrototype.RoutineServices_DcmDspRoutineLockSolenoid
      RoutineServices_DcmDspRoutineEcuTempCalibration_716: upstream-reference=Dcm.Geltungsbereich_MQBw_Baseline.RoutineServices_DcmDspRoutineEcuTempCalibration, ecu-extract-reference=Dcm.TopLevelCompositionPrototype.RoutineServices_DcmDspRoutineEcuTempCalibration
      RoutineServices_DcmDspRoutineAccAngleOffsetCalibration_717: upstream-reference=Dcm.Geltungsbereich_MQBw_Baseline.RoutineServices_DcmDspRoutineAccAngleOffsetCalibration, ecu-extract-reference=Dcm.TopLevelCompositionPrototype.RoutineServices_DcmDspRoutineAccAngleOffsetCalibration
      RoutineServices_DcmDspRoutineRoutineCheckProgrammingPreconditions_718: upstream-reference=Dcm.Geltungsbereich_MQBw_Baseline.RoutineServices_DcmDspRoutineRoutineCheckProgrammingPreconditions, ecu-extract-reference=Dcm.TopLevelCompositionPrototype.RoutineServices_DcmDspRoutineRoutineCheckProgrammingPreconditions
      CallBackDCMRequestServices_CBReqServInd_1_719: upstream-reference=Dcm.Geltungsbereich_MQBw_Baseline.CallBackDCMRequestServices_CBReqServInd_1, ecu-extract-reference=Dcm.TopLevelCompositionPrototype.CallBackDCMRequestServices_CBReqServInd_1
      DcmIf_720: upstream-reference=Dcm.Geltungsbereich_MQBw_Baseline.DcmIf, ecu-extract-reference=Dcm.TopLevelCompositionPrototype.DcmIf
      Dem_721: upstream-reference=Geltungsbereich_MQBw_Baseline.Dem, ecu-extract-reference=TopLevelCompositionPrototype.Dem
      ASR42_EvtInfo_EVENT_CANSM_E_BUS_OFF_722: upstream-reference=Dem.Geltungsbereich_MQBw_Baseline.ASR42_EvtInfo_EVENT_CANSM_E_BUS_OFF, ecu-extract-reference=Dem.TopLevelCompositionPrototype.ASR42_EvtInfo_EVENT_CANSM_E_BUS_OFF
      ASR42_Event_EVENT_ADC_OUT_OF_ORDER_723: upstream-reference=Dem.Geltungsbereich_MQBw_Baseline.ASR42_Event_EVENT_ADC_OUT_OF_ORDER, ecu-extract-reference=Dem.TopLevelCompositionPrototype.ASR42_Event_EVENT_ADC_OUT_OF_ORDER
      ASR42_EvtInfo_EVENT_ADC_OUT_OF_ORDER_724: upstream-reference=Dem.Geltungsbereich_MQBw_Baseline.ASR42_EvtInfo_EVENT_ADC_OUT_OF_ORDER, ecu-extract-reference=Dem.TopLevelCompositionPrototype.ASR42_EvtInfo_EVENT_ADC_OUT_OF_ORDER
      ASR42_Event_EVENT_WARM_RESET_725: upstream-reference=Dem.Geltungsbereich_MQBw_Baseline.ASR42_Event_EVENT_WARM_RESET, ecu-extract-reference=Dem.TopLevelCompositionPrototype.ASR42_Event_EVENT_WARM_RESET
      ASR42_EvtInfo_EVENT_WARM_RESET_726: upstream-reference=Dem.Geltungsbereich_MQBw_Baseline.ASR42_EvtInfo_EVENT_WARM_RESET, ecu-extract-reference=Dem.TopLevelCompositionPrototype.ASR42_EvtInfo_EVENT_WARM_RESET
      ASR42_Event_EVENT_PFLASH_MEM_CORRUPT_727: upstream-reference=Dem.Geltungsbereich_MQBw_Baseline.ASR42_Event_EVENT_PFLASH_MEM_CORRUPT, ecu-extract-reference=Dem.TopLevelCompositionPrototype.ASR42_Event_EVENT_PFLASH_MEM_CORRUPT
      ASR42_EvtInfo_EVENT_PFLASH_MEM_CORRUPT_728: upstream-reference=Dem.Geltungsbereich_MQBw_Baseline.ASR42_EvtInfo_EVENT_PFLASH_MEM_CORRUPT, ecu-extract-reference=Dem.TopLevelCompositionPrototype.ASR42_EvtInfo_EVENT_PFLASH_MEM_CORRUPT
      ASR42_Event_EVENT_EXT_WDG_OUT_OF_ORDER_729: upstream-reference=Dem.Geltungsbereich_MQBw_Baseline.ASR42_Event_EVENT_EXT_WDG_OUT_OF_ORDER, ecu-extract-reference=Dem.TopLevelCompositionPrototype.ASR42_Event_EVENT_EXT_WDG_OUT_OF_ORDER
      ASR42_EvtInfo_EVENT_EXT_WDG_OUT_OF_ORDER_730: upstream-reference=Dem.Geltungsbereich_MQBw_Baseline.ASR42_EvtInfo_EVENT_EXT_WDG_OUT_OF_ORDER, ecu-extract-reference=Dem.TopLevelCompositionPrototype.ASR42_EvtInfo_EVENT_EXT_WDG_OUT_OF_ORDER
      ASR42_Event_EVENT_NVM_NOT_PRG_731: upstream-reference=Dem.Geltungsbereich_MQBw_Baseline.ASR42_Event_EVENT_NVM_NOT_PRG, ecu-extract-reference=Dem.TopLevelCompositionPrototype.ASR42_Event_EVENT_NVM_NOT_PRG
      ASR42_EvtInfo_EVENT_NVM_NOT_PRG_732: upstream-reference=Dem.Geltungsbereich_MQBw_Baseline.ASR42_EvtInfo_EVENT_NVM_NOT_PRG, ecu-extract-reference=Dem.TopLevelCompositionPrototype.ASR42_EvtInfo_EVENT_NVM_NOT_PRG
      ASR42_Event_EVENT_RAM_MEM_CORRUPT_733: upstream-reference=Dem.Geltungsbereich_MQBw_Baseline.ASR42_Event_EVENT_RAM_MEM_CORRUPT, ecu-extract-reference=Dem.TopLevelCompositionPrototype.ASR42_Event_EVENT_RAM_MEM_CORRUPT
      ASR42_EvtInfo_EVENT_RAM_MEM_CORRUPT_734: upstream-reference=Dem.Geltungsbereich_MQBw_Baseline.ASR42_EvtInfo_EVENT_RAM_MEM_CORRUPT, ecu-extract-reference=Dem.TopLevelCompositionPrototype.ASR42_EvtInfo_EVENT_RAM_MEM_CORRUPT
      ASR42_Event_EVENT_ADC_CALIB_735: upstream-reference=Dem.Geltungsbereich_MQBw_Baseline.ASR42_Event_EVENT_ADC_CALIB, ecu-extract-reference=Dem.TopLevelCompositionPrototype.ASR42_Event_EVENT_ADC_CALIB
      ASR42_EvtInfo_EVENT_ADC_CALIB_736: upstream-reference=Dem.Geltungsbereich_MQBw_Baseline.ASR42_EvtInfo_EVENT_ADC_CALIB, ecu-extract-reference=Dem.TopLevelCompositionPrototype.ASR42_EvtInfo_EVENT_ADC_CALIB
      ASR42_Event_EVENT_ECU_OVER_TEMPERATURE_737: upstream-reference=Dem.Geltungsbereich_MQBw_Baseline.ASR42_Event_EVENT_ECU_OVER_TEMPERATURE, ecu-extract-reference=Dem.TopLevelCompositionPrototype.ASR42_Event_EVENT_ECU_OVER_TEMPERATURE
      ASR42_EvtInfo_EVENT_ECU_OVER_TEMPERATURE_738: upstream-reference=Dem.Geltungsbereich_MQBw_Baseline.ASR42_EvtInfo_EVENT_ECU_OVER_TEMPERATURE, ecu-extract-reference=Dem.TopLevelCompositionPrototype.ASR42_EvtInfo_EVENT_ECU_OVER_TEMPERATURE
      ASR42_Event_EVENT_DFLASH_MEM_CORRUPT_739: upstream-reference=Dem.Geltungsbereich_MQBw_Baseline.ASR42_Event_EVENT_DFLASH_MEM_CORRUPT, ecu-extract-reference=Dem.TopLevelCompositionPrototype.ASR42_Event_EVENT_DFLASH_MEM_CORRUPT
      ASR42_EvtInfo_EVENT_DFLASH_MEM_CORRUPT_740: upstream-reference=Dem.Geltungsbereich_MQBw_Baseline.ASR42_EvtInfo_EVENT_DFLASH_MEM_CORRUPT, ecu-extract-reference=Dem.TopLevelCompositionPrototype.ASR42_EvtInfo_EVENT_DFLASH_MEM_CORRUPT
      ASR42_Event_EVENT_SBC_STATUS_FAILURE_741: upstream-reference=Dem.Geltungsbereich_MQBw_Baseline.ASR42_Event_EVENT_SBC_STATUS_FAILURE, ecu-extract-reference=Dem.TopLevelCompositionPrototype.ASR42_Event_EVENT_SBC_STATUS_FAILURE
      ASR42_EvtInfo_EVENT_SBC_STATUS_FAILURE_742: upstream-reference=Dem.Geltungsbereich_MQBw_Baseline.ASR42_EvtInfo_EVENT_SBC_STATUS_FAILURE, ecu-extract-reference=Dem.TopLevelCompositionPrototype.ASR42_EvtInfo_EVENT_SBC_STATUS_FAILURE
      ASR42_Event_EVENT_POWER_SUPPLY_OV_743: upstream-reference=Dem.Geltungsbereich_MQBw_Baseline.ASR42_Event_EVENT_POWER_SUPPLY_OV, ecu-extract-reference=Dem.TopLevelCompositionPrototype.ASR42_Event_EVENT_POWER_SUPPLY_OV
      ASR42_EvtInfo_EVENT_POWER_SUPPLY_OV_744: upstream-reference=Dem.Geltungsbereich_MQBw_Baseline.ASR42_EvtInfo_EVENT_POWER_SUPPLY_OV, ecu-extract-reference=Dem.TopLevelCompositionPrototype.ASR42_EvtInfo_EVENT_POWER_SUPPLY_OV
      ASR42_Event_EVENT_POWER_SUPPLY_UV_745: upstream-reference=Dem.Geltungsbereich_MQBw_Baseline.ASR42_Event_EVENT_POWER_SUPPLY_UV, ecu-extract-reference=Dem.TopLevelCompositionPrototype.ASR42_Event_EVENT_POWER_SUPPLY_UV
      ASR42_EvtInfo_EVENT_POWER_SUPPLY_UV_746: upstream-reference=Dem.Geltungsbereich_MQBw_Baseline.ASR42_EvtInfo_EVENT_POWER_SUPPLY_UV, ecu-extract-reference=Dem.TopLevelCompositionPrototype.ASR42_EvtInfo_EVENT_POWER_SUPPLY_UV
      ASR42_Event_EVENT_ACTUATOR_STATUS_747: upstream-reference=Dem.Geltungsbereich_MQBw_Baseline.ASR42_Event_EVENT_ACTUATOR_STATUS, ecu-extract-reference=Dem.TopLevelCompositionPrototype.ASR42_Event_EVENT_ACTUATOR_STATUS
      ASR42_EvtInfo_EVENT_ACTUATOR_STATUS_748: upstream-reference=Dem.Geltungsbereich_MQBw_Baseline.ASR42_EvtInfo_EVENT_ACTUATOR_STATUS, ecu-extract-reference=Dem.TopLevelCompositionPrototype.ASR42_EvtInfo_EVENT_ACTUATOR_STATUS
      ASR42_Event_EVENT_MCU_SELFTEST_749: upstream-reference=Dem.Geltungsbereich_MQBw_Baseline.ASR42_Event_EVENT_MCU_SELFTEST, ecu-extract-reference=Dem.TopLevelCompositionPrototype.ASR42_Event_EVENT_MCU_SELFTEST
      ASR42_EvtInfo_EVENT_MCU_SELFTEST_750: upstream-reference=Dem.Geltungsbereich_MQBw_Baseline.ASR42_EvtInfo_EVENT_MCU_SELFTEST, ecu-extract-reference=Dem.TopLevelCompositionPrototype.ASR42_EvtInfo_EVENT_MCU_SELFTEST
      ASR42_Event_EVENT_ACTUATOR_OPEN_CIRCUIT_751: upstream-reference=Dem.Geltungsbereich_MQBw_Baseline.ASR42_Event_EVENT_ACTUATOR_OPEN_CIRCUIT, ecu-extract-reference=Dem.TopLevelCompositionPrototype.ASR42_Event_EVENT_ACTUATOR_OPEN_CIRCUIT
      ASR42_EvtInfo_EVENT_ACTUATOR_OPEN_CIRCUIT_752: upstream-reference=Dem.Geltungsbereich_MQBw_Baseline.ASR42_EvtInfo_EVENT_ACTUATOR_OPEN_CIRCUIT, ecu-extract-reference=Dem.TopLevelCompositionPrototype.ASR42_EvtInfo_EVENT_ACTUATOR_OPEN_CIRCUIT
      ASR42_Event_EVENT_ACTUATOR_SHORT_TO_GND_753: upstream-reference=Dem.Geltungsbereich_MQBw_Baseline.ASR42_Event_EVENT_ACTUATOR_SHORT_TO_GND, ecu-extract-reference=Dem.TopLevelCompositionPrototype.ASR42_Event_EVENT_ACTUATOR_SHORT_TO_GND
      ASR42_EvtInfo_EVENT_ACTUATOR_SHORT_TO_GND_754: upstream-reference=Dem.Geltungsbereich_MQBw_Baseline.ASR42_EvtInfo_EVENT_ACTUATOR_SHORT_TO_GND, ecu-extract-reference=Dem.TopLevelCompositionPrototype.ASR42_EvtInfo_EVENT_ACTUATOR_SHORT_TO_GND
      ASR42_Event_EVENT_ACTUATOR_SHORT_TO_VBAT_755: upstream-reference=Dem.Geltungsbereich_MQBw_Baseline.ASR42_Event_EVENT_ACTUATOR_SHORT_TO_VBAT, ecu-extract-reference=Dem.TopLevelCompositionPrototype.ASR42_Event_EVENT_ACTUATOR_SHORT_TO_VBAT
      ASR42_EvtInfo_EVENT_ACTUATOR_SHORT_TO_VBAT_756: upstream-reference=Dem.Geltungsbereich_MQBw_Baseline.ASR42_EvtInfo_EVENT_ACTUATOR_SHORT_TO_VBAT, ecu-extract-reference=Dem.TopLevelCompositionPrototype.ASR42_EvtInfo_EVENT_ACTUATOR_SHORT_TO_VBAT
      ASR42_Event_EVENT_ACC_STATUS_FAILURE_757: upstream-reference=Dem.Geltungsbereich_MQBw_Baseline.ASR42_Event_EVENT_ACC_STATUS_FAILURE, ecu-extract-reference=Dem.TopLevelCompositionPrototype.ASR42_Event_EVENT_ACC_STATUS_FAILURE
      ASR42_EvtInfo_EVENT_ACC_STATUS_FAILURE_758: upstream-reference=Dem.Geltungsbereich_MQBw_Baseline.ASR42_EvtInfo_EVENT_ACC_STATUS_FAILURE, ecu-extract-reference=Dem.TopLevelCompositionPrototype.ASR42_EvtInfo_EVENT_ACC_STATUS_FAILURE
      ASR42_EvtInfo_EVENT_SPI_E_HW_ERROR_759: upstream-reference=Dem.Geltungsbereich_MQBw_Baseline.ASR42_EvtInfo_EVENT_SPI_E_HW_ERROR, ecu-extract-reference=Dem.TopLevelCompositionPrototype.ASR42_EvtInfo_EVENT_SPI_E_HW_ERROR
      ASR42_Event_EVENT_SOLENOID_OVERVOLTAGE_760: upstream-reference=Dem.Geltungsbereich_MQBw_Baseline.ASR42_Event_EVENT_SOLENOID_OVERVOLTAGE, ecu-extract-reference=Dem.TopLevelCompositionPrototype.ASR42_Event_EVENT_SOLENOID_OVERVOLTAGE
      ASR42_EvtInfo_EVENT_SOLENOID_OVERVOLTAGE_761: upstream-reference=Dem.Geltungsbereich_MQBw_Baseline.ASR42_EvtInfo_EVENT_SOLENOID_OVERVOLTAGE, ecu-extract-reference=Dem.TopLevelCompositionPrototype.ASR42_EvtInfo_EVENT_SOLENOID_OVERVOLTAGE
      ASR42_Event_EVENT_POWER_STAGE_FAILIURE_762: upstream-reference=Dem.Geltungsbereich_MQBw_Baseline.ASR42_Event_EVENT_POWER_STAGE_FAILIURE, ecu-extract-reference=Dem.TopLevelCompositionPrototype.ASR42_Event_EVENT_POWER_STAGE_FAILIURE
      ASR42_EvtInfo_EVENT_POWER_STAGE_FAILIURE_763: upstream-reference=Dem.Geltungsbereich_MQBw_Baseline.ASR42_EvtInfo_EVENT_POWER_STAGE_FAILIURE, ecu-extract-reference=Dem.TopLevelCompositionPrototype.ASR42_EvtInfo_EVENT_POWER_STAGE_FAILIURE
      ASR42_Event_EVENT_MCU_CRC_REGISTERS_764: upstream-reference=Dem.Geltungsbereich_MQBw_Baseline.ASR42_Event_EVENT_MCU_CRC_REGISTERS, ecu-extract-reference=Dem.TopLevelCompositionPrototype.ASR42_Event_EVENT_MCU_CRC_REGISTERS
      ASR42_EvtInfo_EVENT_MCU_CRC_REGISTERS_765: upstream-reference=Dem.Geltungsbereich_MQBw_Baseline.ASR42_EvtInfo_EVENT_MCU_CRC_REGISTERS, ecu-extract-reference=Dem.TopLevelCompositionPrototype.ASR42_EvtInfo_EVENT_MCU_CRC_REGISTERS
      ASR42_GeneralEvtInfo_766: upstream-reference=Dem.Geltungsbereich_MQBw_Baseline.ASR42_GeneralEvtInfo, ecu-extract-reference=Dem.TopLevelCompositionPrototype.ASR42_GeneralEvtInfo
      ASR42_OpCycle_DEM_OPCYC_POWER_767: upstream-reference=Dem.Geltungsbereich_MQBw_Baseline.ASR42_OpCycle_DEM_OPCYC_POWER, ecu-extract-reference=Dem.TopLevelCompositionPrototype.ASR42_OpCycle_DEM_OPCYC_POWER
      ASR42_OverflowIndPrimaryMemory_768: upstream-reference=Dem.Geltungsbereich_MQBw_Baseline.ASR42_OverflowIndPrimaryMemory, ecu-extract-reference=Dem.TopLevelCompositionPrototype.ASR42_OverflowIndPrimaryMemory
      ASR42_PowerTakeOffStatus_769: upstream-reference=Dem.Geltungsbereich_MQBw_Baseline.ASR42_PowerTakeOffStatus, ecu-extract-reference=Dem.TopLevelCompositionPrototype.ASR42_PowerTakeOffStatus
      EvtInfo_EVENT_CANSM_E_BUS_OFF_770: upstream-reference=Dem.Geltungsbereich_MQBw_Baseline.EvtInfo_EVENT_CANSM_E_BUS_OFF, ecu-extract-reference=Dem.TopLevelCompositionPrototype.EvtInfo_EVENT_CANSM_E_BUS_OFF
      Event_EVENT_ADC_OUT_OF_ORDER_771: upstream-reference=Dem.Geltungsbereich_MQBw_Baseline.Event_EVENT_ADC_OUT_OF_ORDER, ecu-extract-reference=Dem.TopLevelCompositionPrototype.Event_EVENT_ADC_OUT_OF_ORDER
      EvtInfo_EVENT_ADC_OUT_OF_ORDER_772: upstream-reference=Dem.Geltungsbereich_MQBw_Baseline.EvtInfo_EVENT_ADC_OUT_OF_ORDER, ecu-extract-reference=Dem.TopLevelCompositionPrototype.EvtInfo_EVENT_ADC_OUT_OF_ORDER
      Event_EVENT_WARM_RESET_773: upstream-reference=Dem.Geltungsbereich_MQBw_Baseline.Event_EVENT_WARM_RESET, ecu-extract-reference=Dem.TopLevelCompositionPrototype.Event_EVENT_WARM_RESET
      EvtInfo_EVENT_WARM_RESET_774: upstream-reference=Dem.Geltungsbereich_MQBw_Baseline.EvtInfo_EVENT_WARM_RESET, ecu-extract-reference=Dem.TopLevelCompositionPrototype.EvtInfo_EVENT_WARM_RESET
      Event_EVENT_PFLASH_MEM_CORRUPT_775: upstream-reference=Dem.Geltungsbereich_MQBw_Baseline.Event_EVENT_PFLASH_MEM_CORRUPT, ecu-extract-reference=Dem.TopLevelCompositionPrototype.Event_EVENT_PFLASH_MEM_CORRUPT
      EvtInfo_EVENT_PFLASH_MEM_CORRUPT_776: upstream-reference=Dem.Geltungsbereich_MQBw_Baseline.EvtInfo_EVENT_PFLASH_MEM_CORRUPT, ecu-extract-reference=Dem.TopLevelCompositionPrototype.EvtInfo_EVENT_PFLASH_MEM_CORRUPT
      Event_EVENT_EXT_WDG_OUT_OF_ORDER_777: upstream-reference=Dem.Geltungsbereich_MQBw_Baseline.Event_EVENT_EXT_WDG_OUT_OF_ORDER, ecu-extract-reference=Dem.TopLevelCompositionPrototype.Event_EVENT_EXT_WDG_OUT_OF_ORDER
      EvtInfo_EVENT_EXT_WDG_OUT_OF_ORDER_778: upstream-reference=Dem.Geltungsbereich_MQBw_Baseline.EvtInfo_EVENT_EXT_WDG_OUT_OF_ORDER, ecu-extract-reference=Dem.TopLevelCompositionPrototype.EvtInfo_EVENT_EXT_WDG_OUT_OF_ORDER
      Event_EVENT_NVM_NOT_PRG_779: upstream-reference=Dem.Geltungsbereich_MQBw_Baseline.Event_EVENT_NVM_NOT_PRG, ecu-extract-reference=Dem.TopLevelCompositionPrototype.Event_EVENT_NVM_NOT_PRG
      EvtInfo_EVENT_NVM_NOT_PRG_780: upstream-reference=Dem.Geltungsbereich_MQBw_Baseline.EvtInfo_EVENT_NVM_NOT_PRG, ecu-extract-reference=Dem.TopLevelCompositionPrototype.EvtInfo_EVENT_NVM_NOT_PRG
      Event_EVENT_RAM_MEM_CORRUPT_781: upstream-reference=Dem.Geltungsbereich_MQBw_Baseline.Event_EVENT_RAM_MEM_CORRUPT, ecu-extract-reference=Dem.TopLevelCompositionPrototype.Event_EVENT_RAM_MEM_CORRUPT
      EvtInfo_EVENT_RAM_MEM_CORRUPT_782: upstream-reference=Dem.Geltungsbereich_MQBw_Baseline.EvtInfo_EVENT_RAM_MEM_CORRUPT, ecu-extract-reference=Dem.TopLevelCompositionPrototype.EvtInfo_EVENT_RAM_MEM_CORRUPT
      Event_EVENT_ADC_CALIB_783: upstream-reference=Dem.Geltungsbereich_MQBw_Baseline.Event_EVENT_ADC_CALIB, ecu-extract-reference=Dem.TopLevelCompositionPrototype.Event_EVENT_ADC_CALIB
      EvtInfo_EVENT_ADC_CALIB_784: upstream-reference=Dem.Geltungsbereich_MQBw_Baseline.EvtInfo_EVENT_ADC_CALIB, ecu-extract-reference=Dem.TopLevelCompositionPrototype.EvtInfo_EVENT_ADC_CALIB
      Event_EVENT_ECU_OVER_TEMPERATURE_785: upstream-reference=Dem.Geltungsbereich_MQBw_Baseline.Event_EVENT_ECU_OVER_TEMPERATURE, ecu-extract-reference=Dem.TopLevelCompositionPrototype.Event_EVENT_ECU_OVER_TEMPERATURE
      EvtInfo_EVENT_ECU_OVER_TEMPERATURE_786: upstream-reference=Dem.Geltungsbereich_MQBw_Baseline.EvtInfo_EVENT_ECU_OVER_TEMPERATURE, ecu-extract-reference=Dem.TopLevelCompositionPrototype.EvtInfo_EVENT_ECU_OVER_TEMPERATURE
      Event_EVENT_DFLASH_MEM_CORRUPT_787: upstream-reference=Dem.Geltungsbereich_MQBw_Baseline.Event_EVENT_DFLASH_MEM_CORRUPT, ecu-extract-reference=Dem.TopLevelCompositionPrototype.Event_EVENT_DFLASH_MEM_CORRUPT
      EvtInfo_EVENT_DFLASH_MEM_CORRUPT_788: upstream-reference=Dem.Geltungsbereich_MQBw_Baseline.EvtInfo_EVENT_DFLASH_MEM_CORRUPT, ecu-extract-reference=Dem.TopLevelCompositionPrototype.EvtInfo_EVENT_DFLASH_MEM_CORRUPT
      Event_EVENT_SBC_STATUS_FAILURE_789: upstream-reference=Dem.Geltungsbereich_MQBw_Baseline.Event_EVENT_SBC_STATUS_FAILURE, ecu-extract-reference=Dem.TopLevelCompositionPrototype.Event_EVENT_SBC_STATUS_FAILURE
      EvtInfo_EVENT_SBC_STATUS_FAILURE_790: upstream-reference=Dem.Geltungsbereich_MQBw_Baseline.EvtInfo_EVENT_SBC_STATUS_FAILURE, ecu-extract-reference=Dem.TopLevelCompositionPrototype.EvtInfo_EVENT_SBC_STATUS_FAILURE
      Event_EVENT_POWER_SUPPLY_OV_791: upstream-reference=Dem.Geltungsbereich_MQBw_Baseline.Event_EVENT_POWER_SUPPLY_OV, ecu-extract-reference=Dem.TopLevelCompositionPrototype.Event_EVENT_POWER_SUPPLY_OV
      EvtInfo_EVENT_POWER_SUPPLY_OV_792: upstream-reference=Dem.Geltungsbereich_MQBw_Baseline.EvtInfo_EVENT_POWER_SUPPLY_OV, ecu-extract-reference=Dem.TopLevelCompositionPrototype.EvtInfo_EVENT_POWER_SUPPLY_OV
      Event_EVENT_POWER_SUPPLY_UV_793: upstream-reference=Dem.Geltungsbereich_MQBw_Baseline.Event_EVENT_POWER_SUPPLY_UV, ecu-extract-reference=Dem.TopLevelCompositionPrototype.Event_EVENT_POWER_SUPPLY_UV
      EvtInfo_EVENT_POWER_SUPPLY_UV_794: upstream-reference=Dem.Geltungsbereich_MQBw_Baseline.EvtInfo_EVENT_POWER_SUPPLY_UV, ecu-extract-reference=Dem.TopLevelCompositionPrototype.EvtInfo_EVENT_POWER_SUPPLY_UV
      Event_EVENT_ACTUATOR_STATUS_795: upstream-reference=Dem.Geltungsbereich_MQBw_Baseline.Event_EVENT_ACTUATOR_STATUS, ecu-extract-reference=Dem.TopLevelCompositionPrototype.Event_EVENT_ACTUATOR_STATUS
      EvtInfo_EVENT_ACTUATOR_STATUS_796: upstream-reference=Dem.Geltungsbereich_MQBw_Baseline.EvtInfo_EVENT_ACTUATOR_STATUS, ecu-extract-reference=Dem.TopLevelCompositionPrototype.EvtInfo_EVENT_ACTUATOR_STATUS
      Event_EVENT_MCU_SELFTEST_797: upstream-reference=Dem.Geltungsbereich_MQBw_Baseline.Event_EVENT_MCU_SELFTEST, ecu-extract-reference=Dem.TopLevelCompositionPrototype.Event_EVENT_MCU_SELFTEST
      EvtInfo_EVENT_MCU_SELFTEST_798: upstream-reference=Dem.Geltungsbereich_MQBw_Baseline.EvtInfo_EVENT_MCU_SELFTEST, ecu-extract-reference=Dem.TopLevelCompositionPrototype.EvtInfo_EVENT_MCU_SELFTEST
      Event_EVENT_ACTUATOR_OPEN_CIRCUIT_799: upstream-reference=Dem.Geltungsbereich_MQBw_Baseline.Event_EVENT_ACTUATOR_OPEN_CIRCUIT, ecu-extract-reference=Dem.TopLevelCompositionPrototype.Event_EVENT_ACTUATOR_OPEN_CIRCUIT
      EvtInfo_EVENT_ACTUATOR_OPEN_CIRCUIT_800: upstream-reference=Dem.Geltungsbereich_MQBw_Baseline.EvtInfo_EVENT_ACTUATOR_OPEN_CIRCUIT, ecu-extract-reference=Dem.TopLevelCompositionPrototype.EvtInfo_EVENT_ACTUATOR_OPEN_CIRCUIT
      Event_EVENT_ACTUATOR_SHORT_TO_GND_801: upstream-reference=Dem.Geltungsbereich_MQBw_Baseline.Event_EVENT_ACTUATOR_SHORT_TO_GND, ecu-extract-reference=Dem.TopLevelCompositionPrototype.Event_EVENT_ACTUATOR_SHORT_TO_GND
      EvtInfo_EVENT_ACTUATOR_SHORT_TO_GND_802: upstream-reference=Dem.Geltungsbereich_MQBw_Baseline.EvtInfo_EVENT_ACTUATOR_SHORT_TO_GND, ecu-extract-reference=Dem.TopLevelCompositionPrototype.EvtInfo_EVENT_ACTUATOR_SHORT_TO_GND
      Event_EVENT_ACTUATOR_SHORT_TO_VBAT_803: upstream-reference=Dem.Geltungsbereich_MQBw_Baseline.Event_EVENT_ACTUATOR_SHORT_TO_VBAT, ecu-extract-reference=Dem.TopLevelCompositionPrototype.Event_EVENT_ACTUATOR_SHORT_TO_VBAT
      EvtInfo_EVENT_ACTUATOR_SHORT_TO_VBAT_804: upstream-reference=Dem.Geltungsbereich_MQBw_Baseline.EvtInfo_EVENT_ACTUATOR_SHORT_TO_VBAT, ecu-extract-reference=Dem.TopLevelCompositionPrototype.EvtInfo_EVENT_ACTUATOR_SHORT_TO_VBAT
      Event_EVENT_ACC_STATUS_FAILURE_805: upstream-reference=Dem.Geltungsbereich_MQBw_Baseline.Event_EVENT_ACC_STATUS_FAILURE, ecu-extract-reference=Dem.TopLevelCompositionPrototype.Event_EVENT_ACC_STATUS_FAILURE
      EvtInfo_EVENT_ACC_STATUS_FAILURE_806: upstream-reference=Dem.Geltungsbereich_MQBw_Baseline.EvtInfo_EVENT_ACC_STATUS_FAILURE, ecu-extract-reference=Dem.TopLevelCompositionPrototype.EvtInfo_EVENT_ACC_STATUS_FAILURE
      EvtInfo_EVENT_SPI_E_HW_ERROR_807: upstream-reference=Dem.Geltungsbereich_MQBw_Baseline.EvtInfo_EVENT_SPI_E_HW_ERROR, ecu-extract-reference=Dem.TopLevelCompositionPrototype.EvtInfo_EVENT_SPI_E_HW_ERROR
      Event_EVENT_SOLENOID_OVERVOLTAGE_808: upstream-reference=Dem.Geltungsbereich_MQBw_Baseline.Event_EVENT_SOLENOID_OVERVOLTAGE, ecu-extract-reference=Dem.TopLevelCompositionPrototype.Event_EVENT_SOLENOID_OVERVOLTAGE
      EvtInfo_EVENT_SOLENOID_OVERVOLTAGE_809: upstream-reference=Dem.Geltungsbereich_MQBw_Baseline.EvtInfo_EVENT_SOLENOID_OVERVOLTAGE, ecu-extract-reference=Dem.TopLevelCompositionPrototype.EvtInfo_EVENT_SOLENOID_OVERVOLTAGE
      Event_EVENT_POWER_STAGE_FAILIURE_810: upstream-reference=Dem.Geltungsbereich_MQBw_Baseline.Event_EVENT_POWER_STAGE_FAILIURE, ecu-extract-reference=Dem.TopLevelCompositionPrototype.Event_EVENT_POWER_STAGE_FAILIURE
      EvtInfo_EVENT_POWER_STAGE_FAILIURE_811: upstream-reference=Dem.Geltungsbereich_MQBw_Baseline.EvtInfo_EVENT_POWER_STAGE_FAILIURE, ecu-extract-reference=Dem.TopLevelCompositionPrototype.EvtInfo_EVENT_POWER_STAGE_FAILIURE
      Event_EVENT_MCU_CRC_REGISTERS_812: upstream-reference=Dem.Geltungsbereich_MQBw_Baseline.Event_EVENT_MCU_CRC_REGISTERS, ecu-extract-reference=Dem.TopLevelCompositionPrototype.Event_EVENT_MCU_CRC_REGISTERS
      EvtInfo_EVENT_MCU_CRC_REGISTERS_813: upstream-reference=Dem.Geltungsbereich_MQBw_Baseline.EvtInfo_EVENT_MCU_CRC_REGISTERS, ecu-extract-reference=Dem.TopLevelCompositionPrototype.EvtInfo_EVENT_MCU_CRC_REGISTERS
      GeneralEvtInfo_814: upstream-reference=Dem.Geltungsbereich_MQBw_Baseline.GeneralEvtInfo, ecu-extract-reference=Dem.TopLevelCompositionPrototype.GeneralEvtInfo
      OpCycle_DEM_OPCYC_POWER_815: upstream-reference=Dem.Geltungsbereich_MQBw_Baseline.OpCycle_DEM_OPCYC_POWER, ecu-extract-reference=Dem.TopLevelCompositionPrototype.OpCycle_DEM_OPCYC_POWER
      OverflowIndPrimaryMemory_816: upstream-reference=Dem.Geltungsbereich_MQBw_Baseline.OverflowIndPrimaryMemory, ecu-extract-reference=Dem.TopLevelCompositionPrototype.OverflowIndPrimaryMemory
      Dcm_817: upstream-reference=Dem.Geltungsbereich_MQBw_Baseline.Dcm, ecu-extract-reference=Dem.TopLevelCompositionPrototype.Dcm
      CddIf_818: upstream-reference=Dem.Geltungsbereich_MQBw_Baseline.CddIf, ecu-extract-reference=Dem.TopLevelCompositionPrototype.CddIf
      PowerTakeOffStatus_819: upstream-reference=Dem.Geltungsbereich_MQBw_Baseline.PowerTakeOffStatus, ecu-extract-reference=Dem.TopLevelCompositionPrototype.PowerTakeOffStatus
      NvM_820: upstream-reference=Geltungsbereich_MQBw_Baseline.NvM, ecu-extract-reference=TopLevelCompositionPrototype.NvM
      PS_ASR42_NVM_BLOCK_DEM_DEFAULT_821: upstream-reference=NvM.Geltungsbereich_MQBw_Baseline.PS_ASR42_NVM_BLOCK_DEM_DEFAULT, ecu-extract-reference=NvM.TopLevelCompositionPrototype.PS_ASR42_NVM_BLOCK_DEM_DEFAULT
      PS_ASR42_ECC_COUNTERS_822: upstream-reference=NvM.Geltungsbereich_MQBw_Baseline.PS_ASR42_ECC_COUNTERS, ecu-extract-reference=NvM.TopLevelCompositionPrototype.PS_ASR42_ECC_COUNTERS
      PS_ASR42_WARM_RESET_COUNTERS_823: upstream-reference=NvM.Geltungsbereich_MQBw_Baseline.PS_ASR42_WARM_RESET_COUNTERS, ecu-extract-reference=NvM.TopLevelCompositionPrototype.PS_ASR42_WARM_RESET_COUNTERS
      PS_ASR42_SOLENOID_UNLOCK_CONF_PARAM_824: upstream-reference=NvM.Geltungsbereich_MQBw_Baseline.PS_ASR42_SOLENOID_UNLOCK_CONF_PARAM, ecu-extract-reference=NvM.TopLevelCompositionPrototype.PS_ASR42_SOLENOID_UNLOCK_CONF_PARAM
      PS_ASR42_AUTOTEST_ENABLE_PARAM_825: upstream-reference=NvM.Geltungsbereich_MQBw_Baseline.PS_ASR42_AUTOTEST_ENABLE_PARAM, ecu-extract-reference=NvM.TopLevelCompositionPrototype.PS_ASR42_AUTOTEST_ENABLE_PARAM
      PS_ASR42_LOCK_UNLOCK_ECU_826: upstream-reference=NvM.Geltungsbereich_MQBw_Baseline.PS_ASR42_LOCK_UNLOCK_ECU, ecu-extract-reference=NvM.TopLevelCompositionPrototype.PS_ASR42_LOCK_UNLOCK_ECU
      PS_ASR42_MEASUREMENT_FRAME_CONFIG_827: upstream-reference=NvM.Geltungsbereich_MQBw_Baseline.PS_ASR42_MEASUREMENT_FRAME_CONFIG, ecu-extract-reference=NvM.TopLevelCompositionPrototype.PS_ASR42_MEASUREMENT_FRAME_CONFIG
      PS_ASR42_HW_PART_NUMBER_828: upstream-reference=NvM.Geltungsbereich_MQBw_Baseline.PS_ASR42_HW_PART_NUMBER, ecu-extract-reference=NvM.TopLevelCompositionPrototype.PS_ASR42_HW_PART_NUMBER
      PS_ASR42_AEE_TRACEABILITY_NUMBER_829: upstream-reference=NvM.Geltungsbereich_MQBw_Baseline.PS_ASR42_AEE_TRACEABILITY_NUMBER, ecu-extract-reference=NvM.TopLevelCompositionPrototype.PS_ASR42_AEE_TRACEABILITY_NUMBER
      PS_ASR42_ECU_ASSEMBLY_SERIAL_NUMBER_830: upstream-reference=NvM.Geltungsbereich_MQBw_Baseline.PS_ASR42_ECU_ASSEMBLY_SERIAL_NUMBER, ecu-extract-reference=NvM.TopLevelCompositionPrototype.PS_ASR42_ECU_ASSEMBLY_SERIAL_NUMBER
      PS_ASR42_PROCESS_MODE_831: upstream-reference=NvM.Geltungsbereich_MQBw_Baseline.PS_ASR42_PROCESS_MODE, ecu-extract-reference=NvM.TopLevelCompositionPrototype.PS_ASR42_PROCESS_MODE
      PS_ASR42_ECS_VARIANT_832: upstream-reference=NvM.Geltungsbereich_MQBw_Baseline.PS_ASR42_ECS_VARIANT, ecu-extract-reference=NvM.TopLevelCompositionPrototype.PS_ASR42_ECS_VARIANT
      PS_ASR42_RESERVED_1_833: upstream-reference=NvM.Geltungsbereich_MQBw_Baseline.PS_ASR42_RESERVED_1, ecu-extract-reference=NvM.TopLevelCompositionPrototype.PS_ASR42_RESERVED_1
      PS_ASR42_ECS_ACC_OFFSETS_834: upstream-reference=NvM.Geltungsbereich_MQBw_Baseline.PS_ASR42_ECS_ACC_OFFSETS, ecu-extract-reference=NvM.TopLevelCompositionPrototype.PS_ASR42_ECS_ACC_OFFSETS
      PS_ASR42_ECS_BUCKLE_CONFIG_835: upstream-reference=NvM.Geltungsbereich_MQBw_Baseline.PS_ASR42_ECS_BUCKLE_CONFIG, ecu-extract-reference=NvM.TopLevelCompositionPrototype.PS_ASR42_ECS_BUCKLE_CONFIG
      PS_ASR42_ECS_CODING_VARIANT_836: upstream-reference=NvM.Geltungsbereich_MQBw_Baseline.PS_ASR42_ECS_CODING_VARIANT, ecu-extract-reference=NvM.TopLevelCompositionPrototype.PS_ASR42_ECS_CODING_VARIANT
      PS_ASR42_ECS_ACC_LOWPASS_837: upstream-reference=NvM.Geltungsbereich_MQBw_Baseline.PS_ASR42_ECS_ACC_LOWPASS, ecu-extract-reference=NvM.TopLevelCompositionPrototype.PS_ASR42_ECS_ACC_LOWPASS
      PS_ASR42_SBS_LAST_STATE_838: upstream-reference=NvM.Geltungsbereich_MQBw_Baseline.PS_ASR42_SBS_LAST_STATE, ecu-extract-reference=NvM.TopLevelCompositionPrototype.PS_ASR42_SBS_LAST_STATE
      PS_ASR42_ECS_ALGO_OUTPUT_DELAY_839: upstream-reference=NvM.Geltungsbereich_MQBw_Baseline.PS_ASR42_ECS_ALGO_OUTPUT_DELAY, ecu-extract-reference=NvM.TopLevelCompositionPrototype.PS_ASR42_ECS_ALGO_OUTPUT_DELAY
      PS_ASR42_ECS_SENSITIVITY_LUT_840: upstream-reference=NvM.Geltungsbereich_MQBw_Baseline.PS_ASR42_ECS_SENSITIVITY_LUT, ecu-extract-reference=NvM.TopLevelCompositionPrototype.PS_ASR42_ECS_SENSITIVITY_LUT
      PS_ASR42_ECS_SENSITIVITY_OPT_841: upstream-reference=NvM.Geltungsbereich_MQBw_Baseline.PS_ASR42_ECS_SENSITIVITY_OPT, ecu-extract-reference=NvM.TopLevelCompositionPrototype.PS_ASR42_ECS_SENSITIVITY_OPT
      PS_ASR42_ECU_TEMP_CALIBRATION_842: upstream-reference=NvM.Geltungsbereich_MQBw_Baseline.PS_ASR42_ECU_TEMP_CALIBRATION, ecu-extract-reference=NvM.TopLevelCompositionPrototype.PS_ASR42_ECU_TEMP_CALIBRATION
      PS_ASR42_ALV_NVM_VERSION_843: upstream-reference=NvM.Geltungsbereich_MQBw_Baseline.PS_ASR42_ALV_NVM_VERSION, ecu-extract-reference=NvM.TopLevelCompositionPrototype.PS_ASR42_ALV_NVM_VERSION
      PS_ASR42_MEAS_FRAME_RAM_ADDR_CFG_844: upstream-reference=NvM.Geltungsbereich_MQBw_Baseline.PS_ASR42_MEAS_FRAME_RAM_ADDR_CFG, ecu-extract-reference=NvM.TopLevelCompositionPrototype.PS_ASR42_MEAS_FRAME_RAM_ADDR_CFG
      PS_ASR42_ACC_AXIS_ANGLE_CALIBRATION_845: upstream-reference=NvM.Geltungsbereich_MQBw_Baseline.PS_ASR42_ACC_AXIS_ANGLE_CALIBRATION, ecu-extract-reference=NvM.TopLevelCompositionPrototype.PS_ASR42_ACC_AXIS_ANGLE_CALIBRATION
      PS_ASR42_EOL_COUNTERS_846: upstream-reference=NvM.Geltungsbereich_MQBw_Baseline.PS_ASR42_EOL_COUNTERS, ecu-extract-reference=NvM.TopLevelCompositionPrototype.PS_ASR42_EOL_COUNTERS
      PS_ASR42_RESERVED_4_847: upstream-reference=NvM.Geltungsbereich_MQBw_Baseline.PS_ASR42_RESERVED_4, ecu-extract-reference=NvM.TopLevelCompositionPrototype.PS_ASR42_RESERVED_4
      PS_ASR42_AUTOTEST_PARAM_848: upstream-reference=NvM.Geltungsbereich_MQBw_Baseline.PS_ASR42_AUTOTEST_PARAM, ecu-extract-reference=NvM.TopLevelCompositionPrototype.PS_ASR42_AUTOTEST_PARAM
      PS_ASR42_PHYS_MEASUREMENTS_849: upstream-reference=NvM.Geltungsbereich_MQBw_Baseline.PS_ASR42_PHYS_MEASUREMENTS, ecu-extract-reference=NvM.TopLevelCompositionPrototype.PS_ASR42_PHYS_MEASUREMENTS
      PS_ASR42_SOLENOID_PARAM_850: upstream-reference=NvM.Geltungsbereich_MQBw_Baseline.PS_ASR42_SOLENOID_PARAM, ecu-extract-reference=NvM.TopLevelCompositionPrototype.PS_ASR42_SOLENOID_PARAM
      PS_ASR42_ECS_PROFILES_851: upstream-reference=NvM.Geltungsbereich_MQBw_Baseline.PS_ASR42_ECS_PROFILES, ecu-extract-reference=NvM.TopLevelCompositionPrototype.PS_ASR42_ECS_PROFILES
      PS_ASR42_ECU_STATE_TIMING_PARAMETERS_852: upstream-reference=NvM.Geltungsbereich_MQBw_Baseline.PS_ASR42_ECU_STATE_TIMING_PARAMETERS, ecu-extract-reference=NvM.TopLevelCompositionPrototype.PS_ASR42_ECU_STATE_TIMING_PARAMETERS
      PS_ASR42_SPARE_PART_NUMBER_853: upstream-reference=NvM.Geltungsbereich_MQBw_Baseline.PS_ASR42_SPARE_PART_NUMBER, ecu-extract-reference=NvM.TopLevelCompositionPrototype.PS_ASR42_SPARE_PART_NUMBER
      PS_ASR42_HARDWARE_NUMBER_854: upstream-reference=NvM.Geltungsbereich_MQBw_Baseline.PS_ASR42_HARDWARE_NUMBER, ecu-extract-reference=NvM.TopLevelCompositionPrototype.PS_ASR42_HARDWARE_NUMBER
      PS_ASR42_SYSTEM_NAME_OR_ENGINE_TYPE_855: upstream-reference=NvM.Geltungsbereich_MQBw_Baseline.PS_ASR42_SYSTEM_NAME_OR_ENGINE_TYPE, ecu-extract-reference=NvM.TopLevelCompositionPrototype.PS_ASR42_SYSTEM_NAME_OR_ENGINE_TYPE
      PS_ASR42_BLOCK_FBL_856: upstream-reference=NvM.Geltungsbereich_MQBw_Baseline.PS_ASR42_BLOCK_FBL, ecu-extract-reference=NvM.TopLevelCompositionPrototype.PS_ASR42_BLOCK_FBL
      PS_ASR42_ODX_FILE_IDENTIFIER_857: upstream-reference=NvM.Geltungsbereich_MQBw_Baseline.PS_ASR42_ODX_FILE_IDENTIFIER, ecu-extract-reference=NvM.TopLevelCompositionPrototype.PS_ASR42_ODX_FILE_IDENTIFIER
      PS_ASR42_ODX_FILE_VERSION_858: upstream-reference=NvM.Geltungsbereich_MQBw_Baseline.PS_ASR42_ODX_FILE_VERSION, ecu-extract-reference=NvM.TopLevelCompositionPrototype.PS_ASR42_ODX_FILE_VERSION
      PS_ASR42_ECU_SERIAL_NUMBER_859: upstream-reference=NvM.Geltungsbereich_MQBw_Baseline.PS_ASR42_ECU_SERIAL_NUMBER, ecu-extract-reference=NvM.TopLevelCompositionPrototype.PS_ASR42_ECU_SERIAL_NUMBER
      PS_ASR42_LOGICAL_SW_BLOCK_VERSION_860: upstream-reference=NvM.Geltungsbereich_MQBw_Baseline.PS_ASR42_LOGICAL_SW_BLOCK_VERSION, ecu-extract-reference=NvM.TopLevelCompositionPrototype.PS_ASR42_LOGICAL_SW_BLOCK_VERSION
      PS_ASR42_HARDWARE_VERSION_NUMBER_861: upstream-reference=NvM.Geltungsbereich_MQBw_Baseline.PS_ASR42_HARDWARE_VERSION_NUMBER, ecu-extract-reference=NvM.TopLevelCompositionPrototype.PS_ASR42_HARDWARE_VERSION_NUMBER
      PS_ASR42_APP_SOFTWARE_VERSION_NUMBER_862: upstream-reference=NvM.Geltungsbereich_MQBw_Baseline.PS_ASR42_APP_SOFTWARE_VERSION_NUMBER, ecu-extract-reference=NvM.TopLevelCompositionPrototype.PS_ASR42_APP_SOFTWARE_VERSION_NUMBER
      PS_ASR42_ECS_STEPS_863: upstream-reference=NvM.Geltungsbereich_MQBw_Baseline.PS_ASR42_ECS_STEPS, ecu-extract-reference=NvM.TopLevelCompositionPrototype.PS_ASR42_ECS_STEPS
      PS_ASR42_ECS_PARAMETERS_864: upstream-reference=NvM.Geltungsbereich_MQBw_Baseline.PS_ASR42_ECS_PARAMETERS, ecu-extract-reference=NvM.TopLevelCompositionPrototype.PS_ASR42_ECS_PARAMETERS
      PS_NVM_BLOCK_DEM_DEFAULT_865: upstream-reference=NvM.Geltungsbereich_MQBw_Baseline.PS_NVM_BLOCK_DEM_DEFAULT, ecu-extract-reference=NvM.TopLevelCompositionPrototype.PS_NVM_BLOCK_DEM_DEFAULT
      PS_ECC_COUNTERS_866: upstream-reference=NvM.Geltungsbereich_MQBw_Baseline.PS_ECC_COUNTERS, ecu-extract-reference=NvM.TopLevelCompositionPrototype.PS_ECC_COUNTERS
      PS_WARM_RESET_COUNTERS_867: upstream-reference=NvM.Geltungsbereich_MQBw_Baseline.PS_WARM_RESET_COUNTERS, ecu-extract-reference=NvM.TopLevelCompositionPrototype.PS_WARM_RESET_COUNTERS
      PS_SOLENOID_UNLOCK_CONF_PARAM_868: upstream-reference=NvM.Geltungsbereich_MQBw_Baseline.PS_SOLENOID_UNLOCK_CONF_PARAM, ecu-extract-reference=NvM.TopLevelCompositionPrototype.PS_SOLENOID_UNLOCK_CONF_PARAM
      PS_AUTOTEST_ENABLE_PARAM_869: upstream-reference=NvM.Geltungsbereich_MQBw_Baseline.PS_AUTOTEST_ENABLE_PARAM, ecu-extract-reference=NvM.TopLevelCompositionPrototype.PS_AUTOTEST_ENABLE_PARAM
      PS_LOCK_UNLOCK_ECU_870: upstream-reference=NvM.Geltungsbereich_MQBw_Baseline.PS_LOCK_UNLOCK_ECU, ecu-extract-reference=NvM.TopLevelCompositionPrototype.PS_LOCK_UNLOCK_ECU
      PS_MEASUREMENT_FRAME_CONFIG_871: upstream-reference=NvM.Geltungsbereich_MQBw_Baseline.PS_MEASUREMENT_FRAME_CONFIG, ecu-extract-reference=NvM.TopLevelCompositionPrototype.PS_MEASUREMENT_FRAME_CONFIG
      PS_HW_PART_NUMBER_872: upstream-reference=NvM.Geltungsbereich_MQBw_Baseline.PS_HW_PART_NUMBER, ecu-extract-reference=NvM.TopLevelCompositionPrototype.PS_HW_PART_NUMBER
      PS_AEE_TRACEABILITY_NUMBER_873: upstream-reference=NvM.Geltungsbereich_MQBw_Baseline.PS_AEE_TRACEABILITY_NUMBER, ecu-extract-reference=NvM.TopLevelCompositionPrototype.PS_AEE_TRACEABILITY_NUMBER
      PS_ECU_ASSEMBLY_SERIAL_NUMBER_874: upstream-reference=NvM.Geltungsbereich_MQBw_Baseline.PS_ECU_ASSEMBLY_SERIAL_NUMBER, ecu-extract-reference=NvM.TopLevelCompositionPrototype.PS_ECU_ASSEMBLY_SERIAL_NUMBER
      PS_PROCESS_MODE_875: upstream-reference=NvM.Geltungsbereich_MQBw_Baseline.PS_PROCESS_MODE, ecu-extract-reference=NvM.TopLevelCompositionPrototype.PS_PROCESS_MODE
      PS_ECS_VARIANT_876: upstream-reference=NvM.Geltungsbereich_MQBw_Baseline.PS_ECS_VARIANT, ecu-extract-reference=NvM.TopLevelCompositionPrototype.PS_ECS_VARIANT
      PS_RESERVED_1_877: upstream-reference=NvM.Geltungsbereich_MQBw_Baseline.PS_RESERVED_1, ecu-extract-reference=NvM.TopLevelCompositionPrototype.PS_RESERVED_1
      PS_ECS_ACC_OFFSETS_878: upstream-reference=NvM.Geltungsbereich_MQBw_Baseline.PS_ECS_ACC_OFFSETS, ecu-extract-reference=NvM.TopLevelCompositionPrototype.PS_ECS_ACC_OFFSETS
      PS_ECS_BUCKLE_CONFIG_879: upstream-reference=NvM.Geltungsbereich_MQBw_Baseline.PS_ECS_BUCKLE_CONFIG, ecu-extract-reference=NvM.TopLevelCompositionPrototype.PS_ECS_BUCKLE_CONFIG
      PS_ECS_CODING_VARIANT_880: upstream-reference=NvM.Geltungsbereich_MQBw_Baseline.PS_ECS_CODING_VARIANT, ecu-extract-reference=NvM.TopLevelCompositionPrototype.PS_ECS_CODING_VARIANT
      PS_ECS_ACC_LOWPASS_881: upstream-reference=NvM.Geltungsbereich_MQBw_Baseline.PS_ECS_ACC_LOWPASS, ecu-extract-reference=NvM.TopLevelCompositionPrototype.PS_ECS_ACC_LOWPASS
      PS_SBS_LAST_STATE_882: upstream-reference=NvM.Geltungsbereich_MQBw_Baseline.PS_SBS_LAST_STATE, ecu-extract-reference=NvM.TopLevelCompositionPrototype.PS_SBS_LAST_STATE
      PS_ECS_ALGO_OUTPUT_DELAY_883: upstream-reference=NvM.Geltungsbereich_MQBw_Baseline.PS_ECS_ALGO_OUTPUT_DELAY, ecu-extract-reference=NvM.TopLevelCompositionPrototype.PS_ECS_ALGO_OUTPUT_DELAY
      PS_ECS_SENSITIVITY_LUT_884: upstream-reference=NvM.Geltungsbereich_MQBw_Baseline.PS_ECS_SENSITIVITY_LUT, ecu-extract-reference=NvM.TopLevelCompositionPrototype.PS_ECS_SENSITIVITY_LUT
      PS_ECS_SENSITIVITY_OPT_885: upstream-reference=NvM.Geltungsbereich_MQBw_Baseline.PS_ECS_SENSITIVITY_OPT, ecu-extract-reference=NvM.TopLevelCompositionPrototype.PS_ECS_SENSITIVITY_OPT
      PS_ECU_TEMP_CALIBRATION_886: upstream-reference=NvM.Geltungsbereich_MQBw_Baseline.PS_ECU_TEMP_CALIBRATION, ecu-extract-reference=NvM.TopLevelCompositionPrototype.PS_ECU_TEMP_CALIBRATION
      PS_ALV_NVM_VERSION_887: upstream-reference=NvM.Geltungsbereich_MQBw_Baseline.PS_ALV_NVM_VERSION, ecu-extract-reference=NvM.TopLevelCompositionPrototype.PS_ALV_NVM_VERSION
      PS_MEAS_FRAME_RAM_ADDR_CFG_888: upstream-reference=NvM.Geltungsbereich_MQBw_Baseline.PS_MEAS_FRAME_RAM_ADDR_CFG, ecu-extract-reference=NvM.TopLevelCompositionPrototype.PS_MEAS_FRAME_RAM_ADDR_CFG
      PS_ACC_AXIS_ANGLE_CALIBRATION_889: upstream-reference=NvM.Geltungsbereich_MQBw_Baseline.PS_ACC_AXIS_ANGLE_CALIBRATION, ecu-extract-reference=NvM.TopLevelCompositionPrototype.PS_ACC_AXIS_ANGLE_CALIBRATION
      PS_EOL_COUNTERS_890: upstream-reference=NvM.Geltungsbereich_MQBw_Baseline.PS_EOL_COUNTERS, ecu-extract-reference=NvM.TopLevelCompositionPrototype.PS_EOL_COUNTERS
      PS_RESERVED_4_891: upstream-reference=NvM.Geltungsbereich_MQBw_Baseline.PS_RESERVED_4, ecu-extract-reference=NvM.TopLevelCompositionPrototype.PS_RESERVED_4
      PS_AUTOTEST_PARAM_892: upstream-reference=NvM.Geltungsbereich_MQBw_Baseline.PS_AUTOTEST_PARAM, ecu-extract-reference=NvM.TopLevelCompositionPrototype.PS_AUTOTEST_PARAM
      PS_PHYS_MEASUREMENTS_893: upstream-reference=NvM.Geltungsbereich_MQBw_Baseline.PS_PHYS_MEASUREMENTS, ecu-extract-reference=NvM.TopLevelCompositionPrototype.PS_PHYS_MEASUREMENTS
      PS_SOLENOID_PARAM_894: upstream-reference=NvM.Geltungsbereich_MQBw_Baseline.PS_SOLENOID_PARAM, ecu-extract-reference=NvM.TopLevelCompositionPrototype.PS_SOLENOID_PARAM
      PS_ECS_PROFILES_895: upstream-reference=NvM.Geltungsbereich_MQBw_Baseline.PS_ECS_PROFILES, ecu-extract-reference=NvM.TopLevelCompositionPrototype.PS_ECS_PROFILES
      PS_ECU_STATE_TIMING_PARAMETERS_896: upstream-reference=NvM.Geltungsbereich_MQBw_Baseline.PS_ECU_STATE_TIMING_PARAMETERS, ecu-extract-reference=NvM.TopLevelCompositionPrototype.PS_ECU_STATE_TIMING_PARAMETERS
      PS_SPARE_PART_NUMBER_897: upstream-reference=NvM.Geltungsbereich_MQBw_Baseline.PS_SPARE_PART_NUMBER, ecu-extract-reference=NvM.TopLevelCompositionPrototype.PS_SPARE_PART_NUMBER
      PS_HARDWARE_NUMBER_898: upstream-reference=NvM.Geltungsbereich_MQBw_Baseline.PS_HARDWARE_NUMBER, ecu-extract-reference=NvM.TopLevelCompositionPrototype.PS_HARDWARE_NUMBER
      PS_SYSTEM_NAME_OR_ENGINE_TYPE_899: upstream-reference=NvM.Geltungsbereich_MQBw_Baseline.PS_SYSTEM_NAME_OR_ENGINE_TYPE, ecu-extract-reference=NvM.TopLevelCompositionPrototype.PS_SYSTEM_NAME_OR_ENGINE_TYPE
      PS_BLOCK_FBL_900: upstream-reference=NvM.Geltungsbereich_MQBw_Baseline.PS_BLOCK_FBL, ecu-extract-reference=NvM.TopLevelCompositionPrototype.PS_BLOCK_FBL
      PS_ODX_FILE_IDENTIFIER_901: upstream-reference=NvM.Geltungsbereich_MQBw_Baseline.PS_ODX_FILE_IDENTIFIER, ecu-extract-reference=NvM.TopLevelCompositionPrototype.PS_ODX_FILE_IDENTIFIER
      PS_ODX_FILE_VERSION_902: upstream-reference=NvM.Geltungsbereich_MQBw_Baseline.PS_ODX_FILE_VERSION, ecu-extract-reference=NvM.TopLevelCompositionPrototype.PS_ODX_FILE_VERSION
      PS_ECU_SERIAL_NUMBER_903: upstream-reference=NvM.Geltungsbereich_MQBw_Baseline.PS_ECU_SERIAL_NUMBER, ecu-extract-reference=NvM.TopLevelCompositionPrototype.PS_ECU_SERIAL_NUMBER
      PS_LOGICAL_SW_BLOCK_VERSION_904: upstream-reference=NvM.Geltungsbereich_MQBw_Baseline.PS_LOGICAL_SW_BLOCK_VERSION, ecu-extract-reference=NvM.TopLevelCompositionPrototype.PS_LOGICAL_SW_BLOCK_VERSION
      PS_HARDWARE_VERSION_NUMBER_905: upstream-reference=NvM.Geltungsbereich_MQBw_Baseline.PS_HARDWARE_VERSION_NUMBER, ecu-extract-reference=NvM.TopLevelCompositionPrototype.PS_HARDWARE_VERSION_NUMBER
      PS_APP_SOFTWARE_VERSION_NUMBER_906: upstream-reference=NvM.Geltungsbereich_MQBw_Baseline.PS_APP_SOFTWARE_VERSION_NUMBER, ecu-extract-reference=NvM.TopLevelCompositionPrototype.PS_APP_SOFTWARE_VERSION_NUMBER
      PS_ECS_STEPS_907: upstream-reference=NvM.Geltungsbereich_MQBw_Baseline.PS_ECS_STEPS, ecu-extract-reference=NvM.TopLevelCompositionPrototype.PS_ECS_STEPS
      PS_ECS_PARAMETERS_908: upstream-reference=NvM.Geltungsbereich_MQBw_Baseline.PS_ECS_PARAMETERS, ecu-extract-reference=NvM.TopLevelCompositionPrototype.PS_ECS_PARAMETERS
