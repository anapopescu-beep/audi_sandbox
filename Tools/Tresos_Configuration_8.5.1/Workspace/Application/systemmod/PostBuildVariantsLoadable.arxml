AUTOSAR XML (schema 4-2-1)
package /EB/PostBuildLoadable
  predefined variant DummyLoad: post-build-variant-criterion-value-set=PostBuildCriterionValueSet_DummyLoad
  post build variant criterion value set PostBuildCriterionValueSet_DummyLoad: post-build-variant-criterion-value{variant-criterion=DummyCrit, value=0}
package /EB/PostBuildLoadable/Criterions
  post build variant criterion DummyCrit: compu {0=Dummy}
