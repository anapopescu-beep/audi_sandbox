[part 2 of 2: package /EcuExtract]
AUTOSAR XML (schema 00046)
package /EcuExtract  (continued)
  flat map FlatMap
    905 x flat instance descriptor:
      ACC_0: upstream-reference=Geltungsbereich_MQBw_Baseline.ACC, ecu-extract-reference=TopLevelCompositionPrototype.ACC
      pclDioIfServices_1: upstream-reference=Geltungsbereich_MQBw_Baseline.ACC.pclDioIfServices, ecu-extract-reference=TopLevelCompositionPrototype.ACC.pclDioIfServices
      prrSolenoidProfile_2: upstream-reference=Geltungsbereich_MQBw_Baseline.ACC.prrSolenoidProfile, ecu-extract-reference=TopLevelCompositionPrototype.ACC.prrSolenoidProfile
      au8SelectedProfile_3: upstream-reference=Geltungsbereich_MQBw_Baseline.ACC.prrSolenoidProfile.au8SelectedProfile, ecu-extract-reference=TopLevelCompositionPrototype.ACC.prrSolenoidProfile.au8SelectedProfile
      pseAccRestartInit_4: upstream-reference=Geltungsbereich_MQBw_Baseline.ACC.pseAccRestartInit, ecu-extract-reference=TopLevelCompositionPrototype.ACC.pseAccRestartInit
      pseAccTemperatureSpiData_5: upstream-reference=Geltungsbereich_MQBw_Baseline.ACC.pseAccTemperatureSpiData, ecu-extract-reference=TopLevelCompositionPrototype.ACC.pseAccTemperatureSpiData
      pseCheckAccAlarmbPin_6: upstream-reference=Geltungsbereich_MQBw_Baseline.ACC.pseCheckAccAlarmbPin, ecu-extract-reference=TopLevelCompositionPrototype.ACC.pseCheckAccAlarmbPin
      psr3DAcceleration_7: upstream-reference=Geltungsbereich_MQBw_Baseline.ACC.psr3DAcceleration, ecu-extract-reference=TopLevelCompositionPrototype.ACC.psr3DAcceleration
      st3DAccel_8: upstream-reference=Geltungsbereich_MQBw_Baseline.ACC.psr3DAcceleration.st3DAccel, ecu-extract-reference=TopLevelCompositionPrototype.ACC.psr3DAcceleration.st3DAccel
      s16AxAppl_9: upstream-reference=Geltungsbereich_MQBw_Baseline.ACC.psr3DAcceleration.st3DAccel.s16AxAppl, ecu-extract-reference=TopLevelCompositionPrototype.ACC.psr3DAcceleration.st3DAccel.s16AxAppl
      s16AyAppl_10: upstream-reference=Geltungsbereich_MQBw_Baseline.ACC.psr3DAcceleration.st3DAccel.s16AyAppl, ecu-extract-reference=TopLevelCompositionPrototype.ACC.psr3DAcceleration.st3DAccel.s16AyAppl
      s16AzAppl_11: upstream-reference=Geltungsbereich_MQBw_Baseline.ACC.psr3DAcceleration.st3DAccel.s16AzAppl, ecu-extract-reference=TopLevelCompositionPrototype.ACC.psr3DAcceleration.st3DAccel.s16AzAppl
      psrACCServices_12: upstream-reference=Geltungsbereich_MQBw_Baseline.ACC.psrACCServices, ecu-extract-reference=TopLevelCompositionPrototype.ACC.psrACCServices
      u8AccInitStateMachine_13: upstream-reference=Geltungsbereich_MQBw_Baseline.ACC.psrACCServices.u8AccInitStateMachine, ecu-extract-reference=TopLevelCompositionPrototype.ACC.psrACCServices.u8AccInitStateMachine
      psrAccStatusFailiureSource_14: upstream-reference=Geltungsbereich_MQBw_Baseline.ACC.psrAccStatusFailiureSource, ecu-extract-reference=TopLevelCompositionPrototype.ACC.psrAccStatusFailiureSource
      u32AccAlarmRegStatus_15: upstream-reference=Geltungsbereich_MQBw_Baseline.ACC.psrAccStatusFailiureSource.u32AccAlarmRegStatus, ecu-extract-reference=TopLevelCompositionPrototype.ACC.psrAccStatusFailiureSource.u32AccAlarmRegStatus
      u8AccAlarmbPreinitSeqStatus_16: upstream-reference=Geltungsbereich_MQBw_Baseline.ACC.psrAccStatusFailiureSource.u8AccAlarmbPreinitSeqStatus, ecu-extract-reference=TopLevelCompositionPrototype.ACC.psrAccStatusFailiureSource.u8AccAlarmbPreinitSeqStatus
      u8AccCRCStatus_17: upstream-reference=Geltungsbereich_MQBw_Baseline.ACC.psrAccStatusFailiureSource.u8AccCRCStatus, ecu-extract-reference=TopLevelCompositionPrototype.ACC.psrAccStatusFailiureSource.u8AccCRCStatus
      u8AccReturnStatus_18: upstream-reference=Geltungsbereich_MQBw_Baseline.ACC.psrAccStatusFailiureSource.u8AccReturnStatus, ecu-extract-reference=TopLevelCompositionPrototype.ACC.psrAccStatusFailiureSource.u8AccReturnStatus
      u8AccelAxisBroken_19: upstream-reference=Geltungsbereich_MQBw_Baseline.ACC.psrAccStatusFailiureSource.u8AccelAxisBroken, ecu-extract-reference=TopLevelCompositionPrototype.ACC.psrAccStatusFailiureSource.u8AccelAxisBroken
      psrAccelMtrPerSecSqd_20: upstream-reference=Geltungsbereich_MQBw_Baseline.ACC.psrAccelMtrPerSecSqd, ecu-extract-reference=TopLevelCompositionPrototype.ACC.psrAccelMtrPerSecSqd
      stAccelMtrPerSecSqd_21: upstream-reference=Geltungsbereich_MQBw_Baseline.ACC.psrAccelMtrPerSecSqd.stAccelMtrPerSecSqd, ecu-extract-reference=TopLevelCompositionPrototype.ACC.psrAccelMtrPerSecSqd.stAccelMtrPerSecSqd
      s16AxAppl_22: upstream-reference=Geltungsbereich_MQBw_Baseline.ACC.psrAccelMtrPerSecSqd.stAccelMtrPerSecSqd.s16AxAppl, ecu-extract-reference=TopLevelCompositionPrototype.ACC.psrAccelMtrPerSecSqd.stAccelMtrPerSecSqd.s16AxAppl
      s16AyAppl_23: upstream-reference=Geltungsbereich_MQBw_Baseline.ACC.psrAccelMtrPerSecSqd.stAccelMtrPerSecSqd.s16AyAppl, ecu-extract-reference=TopLevelCompositionPrototype.ACC.psrAccelMtrPerSecSqd.stAccelMtrPerSecSqd.s16AyAppl
      s16AzAppl_24: upstream-reference=Geltungsbereich_MQBw_Baseline.ACC.psrAccelMtrPerSecSqd.stAccelMtrPerSecSqd.s16AzAppl, ecu-extract-reference=TopLevelCompositionPrototype.ACC.psrAccelMtrPerSecSqd.stAccelMtrPerSecSqd.s16AzAppl
      ptrpAsrOsServicesACC_25: upstream-reference=Geltungsbereich_MQBw_Baseline.ACC.ptrpAsrOsServicesACC, ecu-extract-reference=TopLevelCompositionPrototype.ACC.ptrpAsrOsServicesACC
      ptrrSpiIfServices_26: upstream-reference=Geltungsbereich_MQBw_Baseline.ACC.ptrrSpiIfServices, ecu-extract-reference=TopLevelCompositionPrototype.ACC.ptrrSpiIfServices
      ATM_27: upstream-reference=Geltungsbereich_MQBw_Baseline.ATM, ecu-extract-reference=TopLevelCompositionPrototype.ATM
      pclCheckAccAlarmbPin_28: upstream-reference=Geltungsbereich_MQBw_Baseline.ATM.pclCheckAccAlarmbPin, ecu-extract-reference=TopLevelCompositionPrototype.ATM.pclCheckAccAlarmbPin
      pclCheckActuatorState_29: upstream-reference=Geltungsbereich_MQBw_Baseline.ATM.pclCheckActuatorState, ecu-extract-reference=TopLevelCompositionPrototype.ATM.pclCheckActuatorState
      pclCheckAdc_30: upstream-reference=Geltungsbereich_MQBw_Baseline.ATM.pclCheckAdc, ecu-extract-reference=TopLevelCompositionPrototype.ATM.pclCheckAdc
      pclCheckAdcCalib_31: upstream-reference=Geltungsbereich_MQBw_Baseline.ATM.pclCheckAdcCalib, ecu-extract-reference=TopLevelCompositionPrototype.ATM.pclCheckAdcCalib
      pclCheckCrcOnMcuRegisters_32: upstream-reference=Geltungsbereich_MQBw_Baseline.ATM.pclCheckCrcOnMcuRegisters, ecu-extract-reference=TopLevelCompositionPrototype.ATM.pclCheckCrcOnMcuRegisters
      pclCheckMcuSelfTest_33: upstream-reference=Geltungsbereich_MQBw_Baseline.ATM.pclCheckMcuSelfTest, ecu-extract-reference=TopLevelCompositionPrototype.ATM.pclCheckMcuSelfTest
      pclCheckOpenCircuit_34: upstream-reference=Geltungsbereich_MQBw_Baseline.ATM.pclCheckOpenCircuit, ecu-extract-reference=TopLevelCompositionPrototype.ATM.pclCheckOpenCircuit
      pclCheckPowerStage_35: upstream-reference=Geltungsbereich_MQBw_Baseline.ATM.pclCheckPowerStage, ecu-extract-reference=TopLevelCompositionPrototype.ATM.pclCheckPowerStage
      pclCheckPowerSupplyOV_36: upstream-reference=Geltungsbereich_MQBw_Baseline.ATM.pclCheckPowerSupplyOV, ecu-extract-reference=TopLevelCompositionPrototype.ATM.pclCheckPowerSupplyOV
      pclCheckPowerSupplyUV_37: upstream-reference=Geltungsbereich_MQBw_Baseline.ATM.pclCheckPowerSupplyUV, ecu-extract-reference=TopLevelCompositionPrototype.ATM.pclCheckPowerSupplyUV
      pclCheckSbcStatusInfo_38: upstream-reference=Geltungsbereich_MQBw_Baseline.ATM.pclCheckSbcStatusInfo, ecu-extract-reference=TopLevelCompositionPrototype.ATM.pclCheckSbcStatusInfo
      pclCheckShortToGND_39: upstream-reference=Geltungsbereich_MQBw_Baseline.ATM.pclCheckShortToGND, ecu-extract-reference=TopLevelCompositionPrototype.ATM.pclCheckShortToGND
      pclCheckShortToVBAT_40: upstream-reference=Geltungsbereich_MQBw_Baseline.ATM.pclCheckShortToVBAT, ecu-extract-reference=TopLevelCompositionPrototype.ATM.pclCheckShortToVBAT
      pclCheckSolenoidOvervoltage_41: upstream-reference=Geltungsbereich_MQBw_Baseline.ATM.pclCheckSolenoidOvervoltage, ecu-extract-reference=TopLevelCompositionPrototype.ATM.pclCheckSolenoidOvervoltage
      pclEcuOverTemperature_42: upstream-reference=Geltungsbereich_MQBw_Baseline.ATM.pclEcuOverTemperature, ecu-extract-reference=TopLevelCompositionPrototype.ATM.pclEcuOverTemperature
      pclEvtAccStatusFailure_43: upstream-reference=Geltungsbereich_MQBw_Baseline.ATM.pclEvtAccStatusFailure, ecu-extract-reference=TopLevelCompositionPrototype.ATM.pclEvtAccStatusFailure
      pclEvtActuatorOpenCircuit_44: upstream-reference=Geltungsbereich_MQBw_Baseline.ATM.pclEvtActuatorOpenCircuit, ecu-extract-reference=TopLevelCompositionPrototype.ATM.pclEvtActuatorOpenCircuit
      pclEvtActuatorShortToGND_45: upstream-reference=Geltungsbereich_MQBw_Baseline.ATM.pclEvtActuatorShortToGND, ecu-extract-reference=TopLevelCompositionPrototype.ATM.pclEvtActuatorShortToGND
      pclEvtActuatorShortToVBAT_46: upstream-reference=Geltungsbereich_MQBw_Baseline.ATM.pclEvtActuatorShortToVBAT, ecu-extract-reference=TopLevelCompositionPrototype.ATM.pclEvtActuatorShortToVBAT
      pclEvtActuatorState_47: upstream-reference=Geltungsbereich_MQBw_Baseline.ATM.pclEvtActuatorState, ecu-extract-reference=TopLevelCompositionPrototype.ATM.pclEvtActuatorState
      pclEvtAdcCalibration_48: upstream-reference=Geltungsbereich_MQBw_Baseline.ATM.pclEvtAdcCalibration, ecu-extract-reference=TopLevelCompositionPrototype.ATM.pclEvtAdcCalibration
      pclEvtAdcOutOfOrder_49: upstream-reference=Geltungsbereich_MQBw_Baseline.ATM.pclEvtAdcOutOfOrder, ecu-extract-reference=TopLevelCompositionPrototype.ATM.pclEvtAdcOutOfOrder
      pclEvtEcuoverTemperature_50: upstream-reference=Geltungsbereich_MQBw_Baseline.ATM.pclEvtEcuoverTemperature, ecu-extract-reference=TopLevelCompositionPrototype.ATM.pclEvtEcuoverTemperature
      pclEvtExtWdgOutOfOrder_51: upstream-reference=Geltungsbereich_MQBw_Baseline.ATM.pclEvtExtWdgOutOfOrder, ecu-extract-reference=TopLevelCompositionPrototype.ATM.pclEvtExtWdgOutOfOrder
      pclEvtFlsEcc_52: upstream-reference=Geltungsbereich_MQBw_Baseline.ATM.pclEvtFlsEcc, ecu-extract-reference=TopLevelCompositionPrototype.ATM.pclEvtFlsEcc
      pclEvtMcuCrcRegisters_53: upstream-reference=Geltungsbereich_MQBw_Baseline.ATM.pclEvtMcuCrcRegisters, ecu-extract-reference=TopLevelCompositionPrototype.ATM.pclEvtMcuCrcRegisters
      pclEvtMcuSelftest_54: upstream-reference=Geltungsbereich_MQBw_Baseline.ATM.pclEvtMcuSelftest, ecu-extract-reference=TopLevelCompositionPrototype.ATM.pclEvtMcuSelftest
      pclEvtNvmEcc_55: upstream-reference=Geltungsbereich_MQBw_Baseline.ATM.pclEvtNvmEcc, ecu-extract-reference=TopLevelCompositionPrototype.ATM.pclEvtNvmEcc
      pclEvtNvmNotPrg_56: upstream-reference=Geltungsbereich_MQBw_Baseline.ATM.pclEvtNvmNotPrg, ecu-extract-reference=TopLevelCompositionPrototype.ATM.pclEvtNvmNotPrg
      pclEvtPowerStageFailiure_57: upstream-reference=Geltungsbereich_MQBw_Baseline.ATM.pclEvtPowerStageFailiure, ecu-extract-reference=TopLevelCompositionPrototype.ATM.pclEvtPowerStageFailiure
      pclEvtPowerSupllyOV_58: upstream-reference=Geltungsbereich_MQBw_Baseline.ATM.pclEvtPowerSupllyOV, ecu-extract-reference=TopLevelCompositionPrototype.ATM.pclEvtPowerSupllyOV
      pclEvtPowerSupllyUV_59: upstream-reference=Geltungsbereich_MQBw_Baseline.ATM.pclEvtPowerSupllyUV, ecu-extract-reference=TopLevelCompositionPrototype.ATM.pclEvtPowerSupllyUV
      pclEvtRamEcc_60: upstream-reference=Geltungsbereich_MQBw_Baseline.ATM.pclEvtRamEcc, ecu-extract-reference=TopLevelCompositionPrototype.ATM.pclEvtRamEcc
      pclEvtSbcStatusFailiure_61: upstream-reference=Geltungsbereich_MQBw_Baseline.ATM.pclEvtSbcStatusFailiure, ecu-extract-reference=TopLevelCompositionPrototype.ATM.pclEvtSbcStatusFailiure
      pclEvtSolenoidOvervoltage_62: upstream-reference=Geltungsbereich_MQBw_Baseline.ATM.pclEvtSolenoidOvervoltage, ecu-extract-reference=TopLevelCompositionPrototype.ATM.pclEvtSolenoidOvervoltage
      pclEvtWarmReset_63: upstream-reference=Geltungsbereich_MQBw_Baseline.ATM.pclEvtWarmReset, ecu-extract-reference=TopLevelCompositionPrototype.ATM.pclEvtWarmReset
      pclInjectError_64: upstream-reference=Geltungsbereich_MQBw_Baseline.ATM.pclInjectError, ecu-extract-reference=TopLevelCompositionPrototype.ATM.pclInjectError
      pclModeManagement_65: upstream-reference=Geltungsbereich_MQBw_Baseline.ATM.pclModeManagement, ecu-extract-reference=TopLevelCompositionPrototype.ATM.pclModeManagement
      pclRunEepromMemoryCorruption_66: upstream-reference=Geltungsbereich_MQBw_Baseline.ATM.pclRunEepromMemoryCorruption, ecu-extract-reference=TopLevelCompositionPrototype.ATM.pclRunEepromMemoryCorruption
      pclRunEepromMemoryNotProgrammed_67: upstream-reference=Geltungsbereich_MQBw_Baseline.ATM.pclRunEepromMemoryNotProgrammed, ecu-extract-reference=TopLevelCompositionPrototype.ATM.pclRunEepromMemoryNotProgrammed
      pclRunExtWDTest_68: upstream-reference=Geltungsbereich_MQBw_Baseline.ATM.pclRunExtWDTest, ecu-extract-reference=TopLevelCompositionPrototype.ATM.pclRunExtWDTest
      pclRunPFlashMemoryCorruption_69: upstream-reference=Geltungsbereich_MQBw_Baseline.ATM.pclRunPFlashMemoryCorruption, ecu-extract-reference=TopLevelCompositionPrototype.ATM.pclRunPFlashMemoryCorruption
      pclRunRamMemoryCorruption_70: upstream-reference=Geltungsbereich_MQBw_Baseline.ATM.pclRunRamMemoryCorruption, ecu-extract-reference=TopLevelCompositionPrototype.ATM.pclRunRamMemoryCorruption
      pclRunResetCause_71: upstream-reference=Geltungsbereich_MQBw_Baseline.ATM.pclRunResetCause, ecu-extract-reference=TopLevelCompositionPrototype.ATM.pclRunResetCause
      pseAutotestServices_72: upstream-reference=Geltungsbereich_MQBw_Baseline.ATM.pseAutotestServices, ecu-extract-reference=TopLevelCompositionPrototype.ATM.pseAutotestServices
      ptrpAtmServicesAsrOs_73: upstream-reference=Geltungsbereich_MQBw_Baseline.ATM.ptrpAtmServicesAsrOs, ecu-extract-reference=TopLevelCompositionPrototype.ATM.ptrpAtmServicesAsrOs
      ptrpAtmServicesBswMIf_74: upstream-reference=Geltungsbereich_MQBw_Baseline.ATM.ptrpAtmServicesBswMIf, ecu-extract-reference=TopLevelCompositionPrototype.ATM.ptrpAtmServicesBswMIf
      AdcIf_75: upstream-reference=Geltungsbereich_MQBw_Baseline.AdcIf, ecu-extract-reference=TopLevelCompositionPrototype.AdcIf
      prrAdcBufferServices_76: upstream-reference=Geltungsbereich_MQBw_Baseline.AdcIf.prrAdcBufferServices, ecu-extract-reference=TopLevelCompositionPrototype.AdcIf.prrAdcBufferServices
      aau16HistoricalAdcSamples_77: upstream-reference=Geltungsbereich_MQBw_Baseline.AdcIf.prrAdcBufferServices.aau16HistoricalAdcSamples, ecu-extract-reference=TopLevelCompositionPrototype.AdcIf.prrAdcBufferServices.aau16HistoricalAdcSamples
      u8HistoricalAdcSampleIndex_78: upstream-reference=Geltungsbereich_MQBw_Baseline.AdcIf.prrAdcBufferServices.u8HistoricalAdcSampleIndex, ecu-extract-reference=TopLevelCompositionPrototype.AdcIf.prrAdcBufferServices.u8HistoricalAdcSampleIndex
      pseAdcIfServices_79: upstream-reference=Geltungsbereich_MQBw_Baseline.AdcIf.pseAdcIfServices, ecu-extract-reference=TopLevelCompositionPrototype.AdcIf.pseAdcIfServices
      pseCheckAdc_80: upstream-reference=Geltungsbereich_MQBw_Baseline.AdcIf.pseCheckAdc, ecu-extract-reference=TopLevelCompositionPrototype.AdcIf.pseCheckAdc
      pseCheckAdcCalib_81: upstream-reference=Geltungsbereich_MQBw_Baseline.AdcIf.pseCheckAdcCalib, ecu-extract-reference=TopLevelCompositionPrototype.AdcIf.pseCheckAdcCalib
      pseRawAdcService_82: upstream-reference=Geltungsbereich_MQBw_Baseline.AdcIf.pseRawAdcService, ecu-extract-reference=TopLevelCompositionPrototype.AdcIf.pseRawAdcService
      ptrpAdcIfServicesBswMIf_83: upstream-reference=Geltungsbereich_MQBw_Baseline.AdcIf.ptrpAdcIfServicesBswMIf, ecu-extract-reference=TopLevelCompositionPrototype.AdcIf.ptrpAdcIfServicesBswMIf
      ptrpAsrGptServicesAdcIf_84: upstream-reference=Geltungsbereich_MQBw_Baseline.AdcIf.ptrpAsrGptServicesAdcIf, ecu-extract-reference=TopLevelCompositionPrototype.AdcIf.ptrpAsrGptServicesAdcIf
      ptrpEcuMIfServicesAdcIf_85: upstream-reference=Geltungsbereich_MQBw_Baseline.AdcIf.ptrpEcuMIfServicesAdcIf, ecu-extract-reference=TopLevelCompositionPrototype.AdcIf.ptrpEcuMIfServicesAdcIf
      ptrrAsrAdcServicesAdcIf_86: upstream-reference=Geltungsbereich_MQBw_Baseline.AdcIf.ptrrAsrAdcServicesAdcIf, ecu-extract-reference=TopLevelCompositionPrototype.AdcIf.ptrrAsrAdcServicesAdcIf
      ptrrAsrGptServicesAdcIf_87: upstream-reference=Geltungsbereich_MQBw_Baseline.AdcIf.ptrrAsrGptServicesAdcIf, ecu-extract-reference=TopLevelCompositionPrototype.AdcIf.ptrrAsrGptServicesAdcIf
      BswMIf_88: upstream-reference=Geltungsbereich_MQBw_Baseline.BswMIf, ecu-extract-reference=TopLevelCompositionPrototype.BswMIf
      pclCILGetEcuState_89: upstream-reference=Geltungsbereich_MQBw_Baseline.BswMIf.pclCILGetEcuState, ecu-extract-reference=TopLevelCompositionPrototype.BswMIf.pclCILGetEcuState
      pclDemSetOpCycle_90: upstream-reference=Geltungsbereich_MQBw_Baseline.BswMIf.pclDemSetOpCycle, ecu-extract-reference=TopLevelCompositionPrototype.BswMIf.pclDemSetOpCycle
      pclNotifyResetCause_91: upstream-reference=Geltungsbereich_MQBw_Baseline.BswMIf.pclNotifyResetCause, ecu-extract-reference=TopLevelCompositionPrototype.BswMIf.pclNotifyResetCause
      pclNvmIfServices_92: upstream-reference=Geltungsbereich_MQBw_Baseline.BswMIf.pclNvmIfServices, ecu-extract-reference=TopLevelCompositionPrototype.BswMIf.pclNvmIfServices
      pseEcuStateTransitions_93: upstream-reference=Geltungsbereich_MQBw_Baseline.BswMIf.pseEcuStateTransitions, ecu-extract-reference=TopLevelCompositionPrototype.BswMIf.pseEcuStateTransitions
      psePassengerOccupancyState_94: upstream-reference=Geltungsbereich_MQBw_Baseline.BswMIf.psePassengerOccupancyState, ecu-extract-reference=TopLevelCompositionPrototype.BswMIf.psePassengerOccupancyState
      psrBswMIfServices_95: upstream-reference=Geltungsbereich_MQBw_Baseline.BswMIf.psrBswMIfServices, ecu-extract-reference=TopLevelCompositionPrototype.BswMIf.psrBswMIfServices
      u8BlockRestoreStatus_96: upstream-reference=Geltungsbereich_MQBw_Baseline.BswMIf.psrBswMIfServices.u8BlockRestoreStatus, ecu-extract-reference=TopLevelCompositionPrototype.BswMIf.psrBswMIfServices.u8BlockRestoreStatus
      psrFsmSolenoidReqBswMIf_97: upstream-reference=Geltungsbereich_MQBw_Baseline.BswMIf.psrFsmSolenoidReqBswMIf, ecu-extract-reference=TopLevelCompositionPrototype.BswMIf.psrFsmSolenoidReqBswMIf
      au8DiagReq_98: upstream-reference=Geltungsbereich_MQBw_Baseline.BswMIf.psrFsmSolenoidReqBswMIf.au8DiagReq, ecu-extract-reference=TopLevelCompositionPrototype.BswMIf.psrFsmSolenoidReqBswMIf.au8DiagReq
      au8DiagReqComplement_99: upstream-reference=Geltungsbereich_MQBw_Baseline.BswMIf.psrFsmSolenoidReqBswMIf.au8DiagReqComplement, ecu-extract-reference=TopLevelCompositionPrototype.BswMIf.psrFsmSolenoidReqBswMIf.au8DiagReqComplement
      ptrpAsrBswMServicesBswMIf_100: upstream-reference=Geltungsbereich_MQBw_Baseline.BswMIf.ptrpAsrBswMServicesBswMIf, ecu-extract-reference=TopLevelCompositionPrototype.BswMIf.ptrpAsrBswMServicesBswMIf
      ptrpAsrGptServicesBswMIf_101: upstream-reference=Geltungsbereich_MQBw_Baseline.BswMIf.ptrpAsrGptServicesBswMIf, ecu-extract-reference=TopLevelCompositionPrototype.BswMIf.ptrpAsrGptServicesBswMIf
      ptrpAsrNvMServicesBswMIf_102: upstream-reference=Geltungsbereich_MQBw_Baseline.BswMIf.ptrpAsrNvMServicesBswMIf, ecu-extract-reference=TopLevelCompositionPrototype.BswMIf.ptrpAsrNvMServicesBswMIf
      ptrpAsrOsServicesBswMIf_103: upstream-reference=Geltungsbereich_MQBw_Baseline.BswMIf.ptrpAsrOsServicesBswMIf, ecu-extract-reference=TopLevelCompositionPrototype.BswMIf.ptrpAsrOsServicesBswMIf
      ptrpNmIfServicesBswMIf_104: upstream-reference=Geltungsbereich_MQBw_Baseline.BswMIf.ptrpNmIfServicesBswMIf, ecu-extract-reference=TopLevelCompositionPrototype.BswMIf.ptrpNmIfServicesBswMIf
      ptrrAdcIfServicesBswMIf_105: upstream-reference=Geltungsbereich_MQBw_Baseline.BswMIf.ptrrAdcIfServicesBswMIf, ecu-extract-reference=TopLevelCompositionPrototype.BswMIf.ptrrAdcIfServicesBswMIf
      ptrrAsrBswMServicesBswMIf_106: upstream-reference=Geltungsbereich_MQBw_Baseline.BswMIf.ptrrAsrBswMServicesBswMIf, ecu-extract-reference=TopLevelCompositionPrototype.BswMIf.ptrrAsrBswMServicesBswMIf
      ptrrAsrCanIfServicesBswMIf_107: upstream-reference=Geltungsbereich_MQBw_Baseline.BswMIf.ptrrAsrCanIfServicesBswMIf, ecu-extract-reference=TopLevelCompositionPrototype.BswMIf.ptrrAsrCanIfServicesBswMIf
      ptrrAsrCanSMServicesBswMIf_108: upstream-reference=Geltungsbereich_MQBw_Baseline.BswMIf.ptrrAsrCanSMServicesBswMIf, ecu-extract-reference=TopLevelCompositionPrototype.BswMIf.ptrrAsrCanSMServicesBswMIf
      ptrrAsrCanServicesBswMIf_109: upstream-reference=Geltungsbereich_MQBw_Baseline.BswMIf.ptrrAsrCanServicesBswMIf, ecu-extract-reference=TopLevelCompositionPrototype.BswMIf.ptrrAsrCanServicesBswMIf
      ptrrAsrCanTpServicesBswMIf_110: upstream-reference=Geltungsbereich_MQBw_Baseline.BswMIf.ptrrAsrCanTpServicesBswMIf, ecu-extract-reference=TopLevelCompositionPrototype.BswMIf.ptrrAsrCanTpServicesBswMIf
      ptrrAsrComMServicesBswMIf_111: upstream-reference=Geltungsbereich_MQBw_Baseline.BswMIf.ptrrAsrComMServicesBswMIf, ecu-extract-reference=TopLevelCompositionPrototype.BswMIf.ptrrAsrComMServicesBswMIf
      ptrrAsrComServicesBswMIf_112: upstream-reference=Geltungsbereich_MQBw_Baseline.BswMIf.ptrrAsrComServicesBswMIf, ecu-extract-reference=TopLevelCompositionPrototype.BswMIf.ptrrAsrComServicesBswMIf
      ptrrAsrDcmServicesBswMIf_113: upstream-reference=Geltungsbereich_MQBw_Baseline.BswMIf.ptrrAsrDcmServicesBswMIf, ecu-extract-reference=TopLevelCompositionPrototype.BswMIf.ptrrAsrDcmServicesBswMIf
      ptrrAsrDemServicesBswMIf_114: upstream-reference=Geltungsbereich_MQBw_Baseline.BswMIf.ptrrAsrDemServicesBswMIf, ecu-extract-reference=TopLevelCompositionPrototype.BswMIf.ptrrAsrDemServicesBswMIf
      ptrrAsrEcuMServicesBswMIf_115: upstream-reference=Geltungsbereich_MQBw_Baseline.BswMIf.ptrrAsrEcuMServicesBswMIf, ecu-extract-reference=TopLevelCompositionPrototype.BswMIf.ptrrAsrEcuMServicesBswMIf
      ptrrAsrFeeServicesBswMIf_116: upstream-reference=Geltungsbereich_MQBw_Baseline.BswMIf.ptrrAsrFeeServicesBswMIf, ecu-extract-reference=TopLevelCompositionPrototype.BswMIf.ptrrAsrFeeServicesBswMIf
      ptrrAsrFlsServicesBswMIf_117: upstream-reference=Geltungsbereich_MQBw_Baseline.BswMIf.ptrrAsrFlsServicesBswMIf, ecu-extract-reference=TopLevelCompositionPrototype.BswMIf.ptrrAsrFlsServicesBswMIf
      ptrrAsrGptServicesBswMIf_118: upstream-reference=Geltungsbereich_MQBw_Baseline.BswMIf.ptrrAsrGptServicesBswMIf, ecu-extract-reference=TopLevelCompositionPrototype.BswMIf.ptrrAsrGptServicesBswMIf
      ptrrAsrNvMServicesBswMIf_119: upstream-reference=Geltungsbereich_MQBw_Baseline.BswMIf.ptrrAsrNvMServicesBswMIf, ecu-extract-reference=TopLevelCompositionPrototype.BswMIf.ptrrAsrNvMServicesBswMIf
      ptrrAsrOsServicesBswMIf_120: upstream-reference=Geltungsbereich_MQBw_Baseline.BswMIf.ptrrAsrOsServicesBswMIf, ecu-extract-reference=TopLevelCompositionPrototype.BswMIf.ptrrAsrOsServicesBswMIf
      ptrrAsrPduRServicesBswMIf_121: upstream-reference=Geltungsbereich_MQBw_Baseline.BswMIf.ptrrAsrPduRServicesBswMIf, ecu-extract-reference=TopLevelCompositionPrototype.BswMIf.ptrrAsrPduRServicesBswMIf
      ptrrAsrRteServicesBswMIf_122: upstream-reference=Geltungsbereich_MQBw_Baseline.BswMIf.ptrrAsrRteServicesBswMIf, ecu-extract-reference=TopLevelCompositionPrototype.BswMIf.ptrrAsrRteServicesBswMIf
      ptrrAtmServicesBswMIf_123: upstream-reference=Geltungsbereich_MQBw_Baseline.BswMIf.ptrrAtmServicesBswMIf, ecu-extract-reference=TopLevelCompositionPrototype.BswMIf.ptrrAtmServicesBswMIf
      ptrrCilServicesBswMIf_124: upstream-reference=Geltungsbereich_MQBw_Baseline.BswMIf.ptrrCilServicesBswMIf, ecu-extract-reference=TopLevelCompositionPrototype.BswMIf.ptrrCilServicesBswMIf
      ptrrDiaServicesBswMIf_125: upstream-reference=Geltungsbereich_MQBw_Baseline.BswMIf.ptrrDiaServicesBswMIf, ecu-extract-reference=TopLevelCompositionPrototype.BswMIf.ptrrDiaServicesBswMIf
      ptrrFsmServicesBswMIf_126: upstream-reference=Geltungsbereich_MQBw_Baseline.BswMIf.ptrrFsmServicesBswMIf, ecu-extract-reference=TopLevelCompositionPrototype.BswMIf.ptrrFsmServicesBswMIf
      ptrrLpmServicesBswMIf_127: upstream-reference=Geltungsbereich_MQBw_Baseline.BswMIf.ptrrLpmServicesBswMIf, ecu-extract-reference=TopLevelCompositionPrototype.BswMIf.ptrrLpmServicesBswMIf
      ptrrMcuIfServicesBswMIf_128: upstream-reference=Geltungsbereich_MQBw_Baseline.BswMIf.ptrrMcuIfServicesBswMIf, ecu-extract-reference=TopLevelCompositionPrototype.BswMIf.ptrrMcuIfServicesBswMIf
      ptrrMicServices_129: upstream-reference=Geltungsbereich_MQBw_Baseline.BswMIf.ptrrMicServices, ecu-extract-reference=TopLevelCompositionPrototype.BswMIf.ptrrMicServices
      ptrrRcmServicesBswMIf_130: upstream-reference=Geltungsbereich_MQBw_Baseline.BswMIf.ptrrRcmServicesBswMIf, ecu-extract-reference=TopLevelCompositionPrototype.BswMIf.ptrrRcmServicesBswMIf
      ptrrSadServicesBswMIf_131: upstream-reference=Geltungsbereich_MQBw_Baseline.BswMIf.ptrrSadServicesBswMIf, ecu-extract-reference=TopLevelCompositionPrototype.BswMIf.ptrrSadServicesBswMIf
      CIL_132: upstream-reference=Geltungsbereich_MQBw_Baseline.CIL, ecu-extract-reference=TopLevelCompositionPrototype.CIL
      P_CAN_CanDataOut_Frame_0_133: upstream-reference=Geltungsbereich_MQBw_Baseline.CIL.P_CAN_CanDataOut_Frame_0, ecu-extract-reference=TopLevelCompositionPrototype.CIL.P_CAN_CanDataOut_Frame_0
      EcuCanDataOut_134: upstream-reference=Geltungsbereich_MQBw_Baseline.CIL.P_CAN_CanDataOut_Frame_0.EcuCanDataOut, ecu-extract-reference=TopLevelCompositionPrototype.CIL.P_CAN_CanDataOut_Frame_0.EcuCanDataOut
      u64Byte_0_7_135: upstream-reference=Geltungsbereich_MQBw_Baseline.CIL.P_CAN_CanDataOut_Frame_0.EcuCanDataOut.u64Byte_0_7, ecu-extract-reference=TopLevelCompositionPrototype.CIL.P_CAN_CanDataOut_Frame_0.EcuCanDataOut.u64Byte_0_7
      u64Byte_8_15_136: upstream-reference=Geltungsbereich_MQBw_Baseline.CIL.P_CAN_CanDataOut_Frame_0.EcuCanDataOut.u64Byte_8_15, ecu-extract-reference=TopLevelCompositionPrototype.CIL.P_CAN_CanDataOut_Frame_0.EcuCanDataOut.u64Byte_8_15
      u64Byte_16_23_137: upstream-reference=Geltungsbereich_MQBw_Baseline.CIL.P_CAN_CanDataOut_Frame_0.EcuCanDataOut.u64Byte_16_23, ecu-extract-reference=TopLevelCompositionPrototype.CIL.P_CAN_CanDataOut_Frame_0.EcuCanDataOut.u64Byte_16_23
      u64Byte_24_31_138: upstream-reference=Geltungsbereich_MQBw_Baseline.CIL.P_CAN_CanDataOut_Frame_0.EcuCanDataOut.u64Byte_24_31, ecu-extract-reference=TopLevelCompositionPrototype.CIL.P_CAN_CanDataOut_Frame_0.EcuCanDataOut.u64Byte_24_31
      u64Byte_32_39_139: upstream-reference=Geltungsbereich_MQBw_Baseline.CIL.P_CAN_CanDataOut_Frame_0.EcuCanDataOut.u64Byte_32_39, ecu-extract-reference=TopLevelCompositionPrototype.CIL.P_CAN_CanDataOut_Frame_0.EcuCanDataOut.u64Byte_32_39
      u64Byte_40_47_140: upstream-reference=Geltungsbereich_MQBw_Baseline.CIL.P_CAN_CanDataOut_Frame_0.EcuCanDataOut.u64Byte_40_47, ecu-extract-reference=TopLevelCompositionPrototype.CIL.P_CAN_CanDataOut_Frame_0.EcuCanDataOut.u64Byte_40_47
      u64Byte_48_55_141: upstream-reference=Geltungsbereich_MQBw_Baseline.CIL.P_CAN_CanDataOut_Frame_0.EcuCanDataOut.u64Byte_48_55, ecu-extract-reference=TopLevelCompositionPrototype.CIL.P_CAN_CanDataOut_Frame_0.EcuCanDataOut.u64Byte_48_55
      u64Byte_56_63_142: upstream-reference=Geltungsbereich_MQBw_Baseline.CIL.P_CAN_CanDataOut_Frame_0.EcuCanDataOut.u64Byte_56_63, ecu-extract-reference=TopLevelCompositionPrototype.CIL.P_CAN_CanDataOut_Frame_0.EcuCanDataOut.u64Byte_56_63
      P_CAN_GliwaDataIn_Frame_143: upstream-reference=Geltungsbereich_MQBw_Baseline.CIL.P_CAN_GliwaDataIn_Frame, ecu-extract-reference=TopLevelCompositionPrototype.CIL.P_CAN_GliwaDataIn_Frame
      GliwaCanDataIn_144: upstream-reference=Geltungsbereich_MQBw_Baseline.CIL.P_CAN_GliwaDataIn_Frame.GliwaCanDataIn, ecu-extract-reference=TopLevelCompositionPrototype.CIL.P_CAN_GliwaDataIn_Frame.GliwaCanDataIn
      u8Byte1_145: upstream-reference=Geltungsbereich_MQBw_Baseline.CIL.P_CAN_GliwaDataIn_Frame.GliwaCanDataIn.u8Byte1, ecu-extract-reference=TopLevelCompositionPrototype.CIL.P_CAN_GliwaDataIn_Frame.GliwaCanDataIn.u8Byte1
      u8Byte2_146: upstream-reference=Geltungsbereich_MQBw_Baseline.CIL.P_CAN_GliwaDataIn_Frame.GliwaCanDataIn.u8Byte2, ecu-extract-reference=TopLevelCompositionPrototype.CIL.P_CAN_GliwaDataIn_Frame.GliwaCanDataIn.u8Byte2
      u8Byte3_147: upstream-reference=Geltungsbereich_MQBw_Baseline.CIL.P_CAN_GliwaDataIn_Frame.GliwaCanDataIn.u8Byte3, ecu-extract-reference=TopLevelCompositionPrototype.CIL.P_CAN_GliwaDataIn_Frame.GliwaCanDataIn.u8Byte3
      u8Byte4_148: upstream-reference=Geltungsbereich_MQBw_Baseline.CIL.P_CAN_GliwaDataIn_Frame.GliwaCanDataIn.u8Byte4, ecu-extract-reference=TopLevelCompositionPrototype.CIL.P_CAN_GliwaDataIn_Frame.GliwaCanDataIn.u8Byte4
      u8Byte5_149: upstream-reference=Geltungsbereich_MQBw_Baseline.CIL.P_CAN_GliwaDataIn_Frame.GliwaCanDataIn.u8Byte5, ecu-extract-reference=TopLevelCompositionPrototype.CIL.P_CAN_GliwaDataIn_Frame.GliwaCanDataIn.u8Byte5
      u8Byte6_150: upstream-reference=Geltungsbereich_MQBw_Baseline.CIL.P_CAN_GliwaDataIn_Frame.GliwaCanDataIn.u8Byte6, ecu-extract-reference=TopLevelCompositionPrototype.CIL.P_CAN_GliwaDataIn_Frame.GliwaCanDataIn.u8Byte6
      u8Byte7_151: upstream-reference=Geltungsbereich_MQBw_Baseline.CIL.P_CAN_GliwaDataIn_Frame.GliwaCanDataIn.u8Byte7, ecu-extract-reference=TopLevelCompositionPrototype.CIL.P_CAN_GliwaDataIn_Frame.GliwaCanDataIn.u8Byte7
      u8Byte0_152: upstream-reference=Geltungsbereich_MQBw_Baseline.CIL.P_CAN_GliwaDataIn_Frame.GliwaCanDataIn.u8Byte0, ecu-extract-reference=TopLevelCompositionPrototype.CIL.P_CAN_GliwaDataIn_Frame.GliwaCanDataIn.u8Byte0
      P_CAN_GliwaDataOut_Frame_153: upstream-reference=Geltungsbereich_MQBw_Baseline.CIL.P_CAN_GliwaDataOut_Frame, ecu-extract-reference=TopLevelCompositionPrototype.CIL.P_CAN_GliwaDataOut_Frame
      GliwaCanDataOut_154: upstream-reference=Geltungsbereich_MQBw_Baseline.CIL.P_CAN_GliwaDataOut_Frame.GliwaCanDataOut, ecu-extract-reference=TopLevelCompositionPrototype.CIL.P_CAN_GliwaDataOut_Frame.GliwaCanDataOut
      u64Byte_0_7_155: upstream-reference=Geltungsbereich_MQBw_Baseline.CIL.P_CAN_GliwaDataOut_Frame.GliwaCanDataOut.u64Byte_0_7, ecu-extract-reference=TopLevelCompositionPrototype.CIL.P_CAN_GliwaDataOut_Frame.GliwaCanDataOut.u64Byte_0_7
      u64Byte_8_15_156: upstream-reference=Geltungsbereich_MQBw_Baseline.CIL.P_CAN_GliwaDataOut_Frame.GliwaCanDataOut.u64Byte_8_15, ecu-extract-reference=TopLevelCompositionPrototype.CIL.P_CAN_GliwaDataOut_Frame.GliwaCanDataOut.u64Byte_8_15
      u64Byte_16_23_157: upstream-reference=Geltungsbereich_MQBw_Baseline.CIL.P_CAN_GliwaDataOut_Frame.GliwaCanDataOut.u64Byte_16_23, ecu-extract-reference=TopLevelCompositionPrototype.CIL.P_CAN_GliwaDataOut_Frame.GliwaCanDataOut.u64Byte_16_23
      u64Byte_24_31_158: upstream-reference=Geltungsbereich_MQBw_Baseline.CIL.P_CAN_GliwaDataOut_Frame.GliwaCanDataOut.u64Byte_24_31, ecu-extract-reference=TopLevelCompositionPrototype.CIL.P_CAN_GliwaDataOut_Frame.GliwaCanDataOut.u64Byte_24_31
      u64Byte_32_39_159: upstream-reference=Geltungsbereich_MQBw_Baseline.CIL.P_CAN_GliwaDataOut_Frame.GliwaCanDataOut.u64Byte_32_39, ecu-extract-reference=TopLevelCompositionPrototype.CIL.P_CAN_GliwaDataOut_Frame.GliwaCanDataOut.u64Byte_32_39
      u64Byte_40_47_160: upstream-reference=Geltungsbereich_MQBw_Baseline.CIL.P_CAN_GliwaDataOut_Frame.GliwaCanDataOut.u64Byte_40_47, ecu-extract-reference=TopLevelCompositionPrototype.CIL.P_CAN_GliwaDataOut_Frame.GliwaCanDataOut.u64Byte_40_47
      u64Byte_48_55_161: upstream-reference=Geltungsbereich_MQBw_Baseline.CIL.P_CAN_GliwaDataOut_Frame.GliwaCanDataOut.u64Byte_48_55, ecu-extract-reference=TopLevelCompositionPrototype.CIL.P_CAN_GliwaDataOut_Frame.GliwaCanDataOut.u64Byte_48_55
      u64Byte_56_63_162: upstream-reference=Geltungsbereich_MQBw_Baseline.CIL.P_CAN_GliwaDataOut_Frame.GliwaCanDataOut.u64Byte_56_63, ecu-extract-reference=TopLevelCompositionPrototype.CIL.P_CAN_GliwaDataOut_Frame.GliwaCanDataOut.u64Byte_56_63
      P_CAN_MF_Frame_163: upstream-reference=Geltungsbereich_MQBw_Baseline.CIL.P_CAN_MF_Frame, ecu-extract-reference=TopLevelCompositionPrototype.CIL.P_CAN_MF_Frame
      stMFData_164: upstream-reference=Geltungsbereich_MQBw_Baseline.CIL.P_CAN_MF_Frame.stMFData, ecu-extract-reference=TopLevelCompositionPrototype.CIL.P_CAN_MF_Frame.stMFData
      u64Byte_0_7_165: upstream-reference=Geltungsbereich_MQBw_Baseline.CIL.P_CAN_MF_Frame.stMFData.u64Byte_0_7, ecu-extract-reference=TopLevelCompositionPrototype.CIL.P_CAN_MF_Frame.stMFData.u64Byte_0_7
      u64Byte_8_15_166: upstream-reference=Geltungsbereich_MQBw_Baseline.CIL.P_CAN_MF_Frame.stMFData.u64Byte_8_15, ecu-extract-reference=TopLevelCompositionPrototype.CIL.P_CAN_MF_Frame.stMFData.u64Byte_8_15
      u64Byte_16_23_167: upstream-reference=Geltungsbereich_MQBw_Baseline.CIL.P_CAN_MF_Frame.stMFData.u64Byte_16_23, ecu-extract-reference=TopLevelCompositionPrototype.CIL.P_CAN_MF_Frame.stMFData.u64Byte_16_23
      u64Byte_24_31_168: upstream-reference=Geltungsbereich_MQBw_Baseline.CIL.P_CAN_MF_Frame.stMFData.u64Byte_24_31, ecu-extract-reference=TopLevelCompositionPrototype.CIL.P_CAN_MF_Frame.stMFData.u64Byte_24_31
      u64Byte_32_39_169: upstream-reference=Geltungsbereich_MQBw_Baseline.CIL.P_CAN_MF_Frame.stMFData.u64Byte_32_39, ecu-extract-reference=TopLevelCompositionPrototype.CIL.P_CAN_MF_Frame.stMFData.u64Byte_32_39
      u64Byte_40_47_170: upstream-reference=Geltungsbereich_MQBw_Baseline.CIL.P_CAN_MF_Frame.stMFData.u64Byte_40_47, ecu-extract-reference=TopLevelCompositionPrototype.CIL.P_CAN_MF_Frame.stMFData.u64Byte_40_47
      u64Byte_48_55_171: upstream-reference=Geltungsbereich_MQBw_Baseline.CIL.P_CAN_MF_Frame.stMFData.u64Byte_48_55, ecu-extract-reference=TopLevelCompositionPrototype.CIL.P_CAN_MF_Frame.stMFData.u64Byte_48_55
      u64Byte_56_63_172: upstream-reference=Geltungsbereich_MQBw_Baseline.CIL.P_CAN_MF_Frame.stMFData.u64Byte_56_63, ecu-extract-reference=TopLevelCompositionPrototype.CIL.P_CAN_MF_Frame.stMFData.u64Byte_56_63
      P_CAN_MF_Logger_Frame_173: upstream-reference=Geltungsbereich_MQBw_Baseline.CIL.P_CAN_MF_Logger_Frame, ecu-extract-reference=TopLevelCompositionPrototype.CIL.P_CAN_MF_Logger_Frame
      MfLogger_174: upstream-reference=Geltungsbereich_MQBw_Baseline.CIL.P_CAN_MF_Logger_Frame.MfLogger, ecu-extract-reference=TopLevelCompositionPrototype.CIL.P_CAN_MF_Logger_Frame.MfLogger
      RP_IF_AB_Crash_Int_XIX_Grundumfang_XIX_eCS_175: upstream-reference=Geltungsbereich_MQBw_Baseline.CIL.RP_IF_AB_Crash_Int_XIX_Grundumfang_XIX_eCS, ecu-extract-reference=TopLevelCompositionPrototype.CIL.RP_IF_AB_Crash_Int_XIX_Grundumfang_XIX_eCS
      DE_AB_Crash_Int_176: upstream-reference=Geltungsbereich_MQBw_Baseline.CIL.RP_IF_AB_Crash_Int_XIX_Grundumfang_XIX_eCS.DE_AB_Crash_Int, ecu-extract-reference=TopLevelCompositionPrototype.CIL.RP_IF_AB_Crash_Int_XIX_Grundumfang_XIX_eCS.DE_AB_Crash_Int
      RP_IF_AB_Gurtschloss_BF_XIX_Grundumfang_XIX_eCS_177: upstream-reference=Geltungsbereich_MQBw_Baseline.CIL.RP_IF_AB_Gurtschloss_BF_XIX_Grundumfang_XIX_eCS, ecu-extract-reference=TopLevelCompositionPrototype.CIL.RP_IF_AB_Gurtschloss_BF_XIX_Grundumfang_XIX_eCS
      DE_AB_Gurtschloss_BF_178: upstream-reference=Geltungsbereich_MQBw_Baseline.CIL.RP_IF_AB_Gurtschloss_BF_XIX_Grundumfang_XIX_eCS.DE_AB_Gurtschloss_BF, ecu-extract-reference=TopLevelCompositionPrototype.CIL.RP_IF_AB_Gurtschloss_BF_XIX_Grundumfang_XIX_eCS.DE_AB_Gurtschloss_BF
      RP_IF_AB_Gurtschloss_FA_XIX_Grundumfang_XIX_eCS_179: upstream-reference=Geltungsbereich_MQBw_Baseline.CIL.RP_IF_AB_Gurtschloss_FA_XIX_Grundumfang_XIX_eCS, ecu-extract-reference=TopLevelCompositionPrototype.CIL.RP_IF_AB_Gurtschloss_FA_XIX_Grundumfang_XIX_eCS
      DE_AB_Gurtschloss_FA_180: upstream-reference=Geltungsbereich_MQBw_Baseline.CIL.RP_IF_AB_Gurtschloss_FA_XIX_Grundumfang_XIX_eCS.DE_AB_Gurtschloss_FA, ecu-extract-reference=TopLevelCompositionPrototype.CIL.RP_IF_AB_Gurtschloss_FA_XIX_Grundumfang_XIX_eCS.DE_AB_Gurtschloss_FA
      RP_IF_AB_Gurtschloss_Reihe2_BF_XIX_Grundumfang_XIX_eCS_181: upstream-reference=Geltungsbereich_MQBw_Baseline.CIL.RP_IF_AB_Gurtschloss_Reihe2_BF_XIX_Grundumfang_XIX_eCS, ecu-extract-reference=TopLevelCompositionPrototype.CIL.RP_IF_AB_Gurtschloss_Reihe2_BF_XIX_Grundumfang_XIX_eCS
      DE_AB_Gurtschloss_Reihe2_BF_182: upstream-reference=Geltungsbereich_MQBw_Baseline.CIL.RP_IF_AB_Gurtschloss_Reihe2_BF_XIX_Grundumfang_XIX_eCS.DE_AB_Gurtschloss_Reihe2_BF, ecu-extract-reference=TopLevelCompositionPrototype.CIL.RP_IF_AB_Gurtschloss_Reihe2_BF_XIX_Grundumfang_XIX_eCS.DE_AB_Gurtschloss_Reihe2_BF
      RP_IF_AB_Gurtschloss_Reihe2_FA_XIX_Grundumfang_XIX_eCS_183: upstream-reference=Geltungsbereich_MQBw_Baseline.CIL.RP_IF_AB_Gurtschloss_Reihe2_FA_XIX_Grundumfang_XIX_eCS, ecu-extract-reference=TopLevelCompositionPrototype.CIL.RP_IF_AB_Gurtschloss_Reihe2_FA_XIX_Grundumfang_XIX_eCS
      DE_AB_Gurtschloss_Reihe2_FA_184: upstream-reference=Geltungsbereich_MQBw_Baseline.CIL.RP_IF_AB_Gurtschloss_Reihe2_FA_XIX_Grundumfang_XIX_eCS.DE_AB_Gurtschloss_Reihe2_FA, ecu-extract-reference=TopLevelCompositionPrototype.CIL.RP_IF_AB_Gurtschloss_Reihe2_FA_XIX_Grundumfang_XIX_eCS.DE_AB_Gurtschloss_Reihe2_FA
      RP_IF_AB_Gurtschloss_Reihe3_BF_XIX_Grundumfang_XIX_eCS_185: upstream-reference=Geltungsbereich_MQBw_Baseline.CIL.RP_IF_AB_Gurtschloss_Reihe3_BF_XIX_Grundumfang_XIX_eCS, ecu-extract-reference=TopLevelCompositionPrototype.CIL.RP_IF_AB_Gurtschloss_Reihe3_BF_XIX_Grundumfang_XIX_eCS
      DE_AB_Gurtschloss_Reihe3_BF_186: upstream-reference=Geltungsbereich_MQBw_Baseline.CIL.RP_IF_AB_Gurtschloss_Reihe3_BF_XIX_Grundumfang_XIX_eCS.DE_AB_Gurtschloss_Reihe3_BF, ecu-extract-reference=TopLevelCompositionPrototype.CIL.RP_IF_AB_Gurtschloss_Reihe3_BF_XIX_Grundumfang_XIX_eCS.DE_AB_Gurtschloss_Reihe3_BF
      RP_IF_AB_Gurtschloss_Reihe3_FA_XIX_Grundumfang_XIX_eCS_187: upstream-reference=Geltungsbereich_MQBw_Baseline.CIL.RP_IF_AB_Gurtschloss_Reihe3_FA_XIX_Grundumfang_XIX_eCS, ecu-extract-reference=TopLevelCompositionPrototype.CIL.RP_IF_AB_Gurtschloss_Reihe3_FA_XIX_Grundumfang_XIX_eCS
      DE_AB_Gurtschloss_Reihe3_FA_188: upstream-reference=Geltungsbereich_MQBw_Baseline.CIL.RP_IF_AB_Gurtschloss_Reihe3_FA_XIX_Grundumfang_XIX_eCS.DE_AB_Gurtschloss_Reihe3_FA, ecu-extract-reference=TopLevelCompositionPrototype.CIL.RP_IF_AB_Gurtschloss_Reihe3_FA_XIX_Grundumfang_XIX_eCS.DE_AB_Gurtschloss_Reihe3_FA
      RP_IF_AB_eCS_Aktuatortest_BF_XIX_Grundumfang_XIX_eCS_189: upstream-reference=Geltungsbereich_MQBw_Baseline.CIL.RP_IF_AB_eCS_Aktuatortest_BF_XIX_Grundumfang_XIX_eCS, ecu-extract-reference=TopLevelCompositionPrototype.CIL.RP_IF_AB_eCS_Aktuatortest_BF_XIX_Grundumfang_XIX_eCS
      DE_AB_eCS_Aktuatortest_BF_190: upstream-reference=Geltungsbereich_MQBw_Baseline.CIL.RP_IF_AB_eCS_Aktuatortest_BF_XIX_Grundumfang_XIX_eCS.DE_AB_eCS_Aktuatortest_BF, ecu-extract-reference=TopLevelCompositionPrototype.CIL.RP_IF_AB_eCS_Aktuatortest_BF_XIX_Grundumfang_XIX_eCS.DE_AB_eCS_Aktuatortest_BF
      RP_IF_AB_eCS_Aktuatortest_FA_XIX_Grundumfang_XIX_eCS_191: upstream-reference=Geltungsbereich_MQBw_Baseline.CIL.RP_IF_AB_eCS_Aktuatortest_FA_XIX_Grundumfang_XIX_eCS, ecu-extract-reference=TopLevelCompositionPrototype.CIL.RP_IF_AB_eCS_Aktuatortest_FA_XIX_Grundumfang_XIX_eCS
      DE_AB_eCS_Aktuatortest_FA_192: upstream-reference=Geltungsbereich_MQBw_Baseline.CIL.RP_IF_AB_eCS_Aktuatortest_FA_XIX_Grundumfang_XIX_eCS.DE_AB_eCS_Aktuatortest_FA, ecu-extract-reference=TopLevelCompositionPrototype.CIL.RP_IF_AB_eCS_Aktuatortest_FA_XIX_Grundumfang_XIX_eCS.DE_AB_eCS_Aktuatortest_FA
      RP_IF_AB_eCS_Aktuatortest_Reihe2_BF_XIX_Grundumfang_XIX_eCS_193: upstream-reference=Geltungsbereich_MQBw_Baseline.CIL.RP_IF_AB_eCS_Aktuatortest_Reihe2_BF_XIX_Grundumfang_XIX_eCS, ecu-extract-reference=TopLevelCompositionPrototype.CIL.RP_IF_AB_eCS_Aktuatortest_Reihe2_BF_XIX_Grundumfang_XIX_eCS
      DE_AB_eCS_Aktuatortest_Reihe2_BF_194: upstream-reference=Geltungsbereich_MQBw_Baseline.CIL.RP_IF_AB_eCS_Aktuatortest_Reihe2_BF_XIX_Grundumfang_XIX_eCS.DE_AB_eCS_Aktuatortest_Reihe2_BF, ecu-extract-reference=TopLevelCompositionPrototype.CIL.RP_IF_AB_eCS_Aktuatortest_Reihe2_BF_XIX_Grundumfang_XIX_eCS.DE_AB_eCS_Aktuatortest_Reihe2_BF
      RP_IF_AB_eCS_Aktuatortest_Reihe2_FA_XIX_Grundumfang_XIX_eCS_195: upstream-reference=Geltungsbereich_MQBw_Baseline.CIL.RP_IF_AB_eCS_Aktuatortest_Reihe2_FA_XIX_Grundumfang_XIX_eCS, ecu-extract-reference=TopLevelCompositionPrototype.CIL.RP_IF_AB_eCS_Aktuatortest_Reihe2_FA_XIX_Grundumfang_XIX_eCS
      DE_AB_eCS_Aktuatortest_Reihe2_FA_196: upstream-reference=Geltungsbereich_MQBw_Baseline.CIL.RP_IF_AB_eCS_Aktuatortest_Reihe2_FA_XIX_Grundumfang_XIX_eCS.DE_AB_eCS_Aktuatortest_Reihe2_FA, ecu-extract-reference=TopLevelCompositionPrototype.CIL.RP_IF_AB_eCS_Aktuatortest_Reihe2_FA_XIX_Grundumfang_XIX_eCS.DE_AB_eCS_Aktuatortest_Reihe2_FA
      RP_IF_AB_eCS_Aktuatortest_Reihe3_BF_XIX_Grundumfang_XIX_eCS_197: upstream-reference=Geltungsbereich_MQBw_Baseline.CIL.RP_IF_AB_eCS_Aktuatortest_Reihe3_BF_XIX_Grundumfang_XIX_eCS, ecu-extract-reference=TopLevelCompositionPrototype.CIL.RP_IF_AB_eCS_Aktuatortest_Reihe3_BF_XIX_Grundumfang_XIX_eCS
      DE_AB_eCS_Aktuatortest_Reihe3_BF_198: upstream-reference=Geltungsbereich_MQBw_Baseline.CIL.RP_IF_AB_eCS_Aktuatortest_Reihe3_BF_XIX_Grundumfang_XIX_eCS.DE_AB_eCS_Aktuatortest_Reihe3_BF, ecu-extract-reference=TopLevelCompositionPrototype.CIL.RP_IF_AB_eCS_Aktuatortest_Reihe3_BF_XIX_Grundumfang_XIX_eCS.DE_AB_eCS_Aktuatortest_Reihe3_BF
      RP_IF_AB_eCS_Aktuatortest_Reihe3_FA_XIX_Grundumfang_XIX_eCS_199: upstream-reference=Geltungsbereich_MQBw_Baseline.CIL.RP_IF_AB_eCS_Aktuatortest_Reihe3_FA_XIX_Grundumfang_XIX_eCS, ecu-extract-reference=TopLevelCompositionPrototype.CIL.RP_IF_AB_eCS_Aktuatortest_Reihe3_FA_XIX_Grundumfang_XIX_eCS
      DE_AB_eCS_Aktuatortest_Reihe3_FA_200: upstream-reference=Geltungsbereich_MQBw_Baseline.CIL.RP_IF_AB_eCS_Aktuatortest_Reihe3_FA_XIX_Grundumfang_XIX_eCS.DE_AB_eCS_Aktuatortest_Reihe3_FA, ecu-extract-reference=TopLevelCompositionPrototype.CIL.RP_IF_AB_eCS_Aktuatortest_Reihe3_FA_XIX_Grundumfang_XIX_eCS.DE_AB_eCS_Aktuatortest_Reihe3_FA
      SP_IF_eCS_Error_Reihe1_BFS_1_201: upstream-reference=Geltungsbereich_MQBw_Baseline.CIL.SP_IF_eCS_Error_Reihe1_BFS_1, ecu-extract-reference=TopLevelCompositionPrototype.CIL.SP_IF_eCS_Error_Reihe1_BFS_1
      DE_eCS_Error_Reihe1_BFS_1_202: upstream-reference=Geltungsbereich_MQBw_Baseline.CIL.SP_IF_eCS_Error_Reihe1_BFS_1.DE_eCS_Error_Reihe1_BFS_1, ecu-extract-reference=TopLevelCompositionPrototype.CIL.SP_IF_eCS_Error_Reihe1_BFS_1.DE_eCS_Error_Reihe1_BFS_1
      SP_IF_eCS_Error_Reihe1_BFS_2_203: upstream-reference=Geltungsbereich_MQBw_Baseline.CIL.SP_IF_eCS_Error_Reihe1_BFS_2, ecu-extract-reference=TopLevelCompositionPrototype.CIL.SP_IF_eCS_Error_Reihe1_BFS_2
      DE_eCS_Error_Reihe1_BFS_2_204: upstream-reference=Geltungsbereich_MQBw_Baseline.CIL.SP_IF_eCS_Error_Reihe1_BFS_2.DE_eCS_Error_Reihe1_BFS_2, ecu-extract-reference=TopLevelCompositionPrototype.CIL.SP_IF_eCS_Error_Reihe1_BFS_2.DE_eCS_Error_Reihe1_BFS_2
      SP_IF_eCS_Error_Reihe1_FS_1_205: upstream-reference=Geltungsbereich_MQBw_Baseline.CIL.SP_IF_eCS_Error_Reihe1_FS_1, ecu-extract-reference=TopLevelCompositionPrototype.CIL.SP_IF_eCS_Error_Reihe1_FS_1
      DE_eCS_Error_Reihe1_FS_1_206: upstream-reference=Geltungsbereich_MQBw_Baseline.CIL.SP_IF_eCS_Error_Reihe1_FS_1.DE_eCS_Error_Reihe1_FS_1, ecu-extract-reference=TopLevelCompositionPrototype.CIL.SP_IF_eCS_Error_Reihe1_FS_1.DE_eCS_Error_Reihe1_FS_1
      SP_IF_eCS_Error_Reihe1_FS_2_207: upstream-reference=Geltungsbereich_MQBw_Baseline.CIL.SP_IF_eCS_Error_Reihe1_FS_2, ecu-extract-reference=TopLevelCompositionPrototype.CIL.SP_IF_eCS_Error_Reihe1_FS_2
      DE_eCS_Error_Reihe1_FS_2_208: upstream-reference=Geltungsbereich_MQBw_Baseline.CIL.SP_IF_eCS_Error_Reihe1_FS_2.DE_eCS_Error_Reihe1_FS_2, ecu-extract-reference=TopLevelCompositionPrototype.CIL.SP_IF_eCS_Error_Reihe1_FS_2.DE_eCS_Error_Reihe1_FS_2
      SP_IF_eCS_Error_Reihe2_BFS_209: upstream-reference=Geltungsbereich_MQBw_Baseline.CIL.SP_IF_eCS_Error_Reihe2_BFS, ecu-extract-reference=TopLevelCompositionPrototype.CIL.SP_IF_eCS_Error_Reihe2_BFS
      DE_eCS_Error_Reihe2_BFS_210: upstream-reference=Geltungsbereich_MQBw_Baseline.CIL.SP_IF_eCS_Error_Reihe2_BFS.DE_eCS_Error_Reihe2_BFS, ecu-extract-reference=TopLevelCompositionPrototype.CIL.SP_IF_eCS_Error_Reihe2_BFS.DE_eCS_Error_Reihe2_BFS
      SP_IF_eCS_Error_Reihe2_FS_211: upstream-reference=Geltungsbereich_MQBw_Baseline.CIL.SP_IF_eCS_Error_Reihe2_FS, ecu-extract-reference=TopLevelCompositionPrototype.CIL.SP_IF_eCS_Error_Reihe2_FS
      DE_eCS_Error_Reihe2_FS_212: upstream-reference=Geltungsbereich_MQBw_Baseline.CIL.SP_IF_eCS_Error_Reihe2_FS.DE_eCS_Error_Reihe2_FS, ecu-extract-reference=TopLevelCompositionPrototype.CIL.SP_IF_eCS_Error_Reihe2_FS.DE_eCS_Error_Reihe2_FS
      SP_IF_eCS_Gurtschloss_Status_Reihe2_BF_XIX_Grundumfang_XIX_eCS_213: upstream-reference=Geltungsbereich_MQBw_Baseline.CIL.SP_IF_eCS_Gurtschloss_Status_Reihe2_BF_XIX_Grundumfang_XIX_eCS, ecu-extract-reference=TopLevelCompositionPrototype.CIL.SP_IF_eCS_Gurtschloss_Status_Reihe2_BF_XIX_Grundumfang_XIX_eCS
      DE_eCS_Gurtschloss_Status_Reihe2_BF_214: upstream-reference=Geltungsbereich_MQBw_Baseline.CIL.SP_IF_eCS_Gurtschloss_Status_Reihe2_BF_XIX_Grundumfang_XIX_eCS.DE_eCS_Gurtschloss_Status_Reihe2_BF, ecu-extract-reference=TopLevelCompositionPrototype.CIL.SP_IF_eCS_Gurtschloss_Status_Reihe2_BF_XIX_Grundumfang_XIX_eCS.DE_eCS_Gurtschloss_Status_Reihe2_BF
      SP_IF_eCS_Gurtschloss_Status_Reihe2_FA_XIX_Grundumfang_XIX_eCS_215: upstream-reference=Geltungsbereich_MQBw_Baseline.CIL.SP_IF_eCS_Gurtschloss_Status_Reihe2_FA_XIX_Grundumfang_XIX_eCS, ecu-extract-reference=TopLevelCompositionPrototype.CIL.SP_IF_eCS_Gurtschloss_Status_Reihe2_FA_XIX_Grundumfang_XIX_eCS
      DE_eCS_Gurtschloss_Status_Reihe2_FA_216: upstream-reference=Geltungsbereich_MQBw_Baseline.CIL.SP_IF_eCS_Gurtschloss_Status_Reihe2_FA_XIX_Grundumfang_XIX_eCS.DE_eCS_Gurtschloss_Status_Reihe2_FA, ecu-extract-reference=TopLevelCompositionPrototype.CIL.SP_IF_eCS_Gurtschloss_Status_Reihe2_FA_XIX_Grundumfang_XIX_eCS.DE_eCS_Gurtschloss_Status_Reihe2_FA
      SP_IF_eCS_HW_defekt_XIX_Grundumfang_XIX_eCS_217: upstream-reference=Geltungsbereich_MQBw_Baseline.CIL.SP_IF_eCS_HW_defekt_XIX_Grundumfang_XIX_eCS, ecu-extract-reference=TopLevelCompositionPrototype.CIL.SP_IF_eCS_HW_defekt_XIX_Grundumfang_XIX_eCS
      DE_eCS_HW_defekt_218: upstream-reference=Geltungsbereich_MQBw_Baseline.CIL.SP_IF_eCS_HW_defekt_XIX_Grundumfang_XIX_eCS.DE_eCS_HW_defekt, ecu-extract-reference=TopLevelCompositionPrototype.CIL.SP_IF_eCS_HW_defekt_XIX_Grundumfang_XIX_eCS.DE_eCS_HW_defekt
      SP_IF_eCS_SBS_Belegung_Reihe2_BF_XIX_Grundumfang_XIX_eCS_219: upstream-reference=Geltungsbereich_MQBw_Baseline.CIL.SP_IF_eCS_SBS_Belegung_Reihe2_BF_XIX_Grundumfang_XIX_eCS, ecu-extract-reference=TopLevelCompositionPrototype.CIL.SP_IF_eCS_SBS_Belegung_Reihe2_BF_XIX_Grundumfang_XIX_eCS
      DE_eCS_SBS_Belegung_Reihe2_BF_220: upstream-reference=Geltungsbereich_MQBw_Baseline.CIL.SP_IF_eCS_SBS_Belegung_Reihe2_BF_XIX_Grundumfang_XIX_eCS.DE_eCS_SBS_Belegung_Reihe2_BF, ecu-extract-reference=TopLevelCompositionPrototype.CIL.SP_IF_eCS_SBS_Belegung_Reihe2_BF_XIX_Grundumfang_XIX_eCS.DE_eCS_SBS_Belegung_Reihe2_BF
      SP_IF_eCS_SBS_Belegung_Reihe2_FA_XIX_Grundumfang_XIX_eCS_221: upstream-reference=Geltungsbereich_MQBw_Baseline.CIL.SP_IF_eCS_SBS_Belegung_Reihe2_FA_XIX_Grundumfang_XIX_eCS, ecu-extract-reference=TopLevelCompositionPrototype.CIL.SP_IF_eCS_SBS_Belegung_Reihe2_FA_XIX_Grundumfang_XIX_eCS
      DE_eCS_SBS_Belegung_Reihe2_FA_222: upstream-reference=Geltungsbereich_MQBw_Baseline.CIL.SP_IF_eCS_SBS_Belegung_Reihe2_FA_XIX_Grundumfang_XIX_eCS.DE_eCS_SBS_Belegung_Reihe2_FA, ecu-extract-reference=TopLevelCompositionPrototype.CIL.SP_IF_eCS_SBS_Belegung_Reihe2_FA_XIX_Grundumfang_XIX_eCS.DE_eCS_SBS_Belegung_Reihe2_FA
      SP_IF_eCS_SBS_LastState_Reihe2_BFS_223: upstream-reference=Geltungsbereich_MQBw_Baseline.CIL.SP_IF_eCS_SBS_LastState_Reihe2_BFS, ecu-extract-reference=TopLevelCompositionPrototype.CIL.SP_IF_eCS_SBS_LastState_Reihe2_BFS
      DE_eCS_SBS_LastState_Reihe2_BFS_224: upstream-reference=Geltungsbereich_MQBw_Baseline.CIL.SP_IF_eCS_SBS_LastState_Reihe2_BFS.DE_eCS_SBS_LastState_Reihe2_BFS, ecu-extract-reference=TopLevelCompositionPrototype.CIL.SP_IF_eCS_SBS_LastState_Reihe2_BFS.DE_eCS_SBS_LastState_Reihe2_BFS
      SP_IF_eCS_SBS_LastState_Reihe2_FS_225: upstream-reference=Geltungsbereich_MQBw_Baseline.CIL.SP_IF_eCS_SBS_LastState_Reihe2_FS, ecu-extract-reference=TopLevelCompositionPrototype.CIL.SP_IF_eCS_SBS_LastState_Reihe2_FS
      DE_eCS_SBS_LastState_Reihe2_FS_226: upstream-reference=Geltungsbereich_MQBw_Baseline.CIL.SP_IF_eCS_SBS_LastState_Reihe2_FS.DE_eCS_SBS_LastState_Reihe2_FS, ecu-extract-reference=TopLevelCompositionPrototype.CIL.SP_IF_eCS_SBS_LastState_Reihe2_FS.DE_eCS_SBS_LastState_Reihe2_FS
      SP_IF_eCS_Status_Verr_Reihe1_BFS_1_227: upstream-reference=Geltungsbereich_MQBw_Baseline.CIL.SP_IF_eCS_Status_Verr_Reihe1_BFS_1, ecu-extract-reference=TopLevelCompositionPrototype.CIL.SP_IF_eCS_Status_Verr_Reihe1_BFS_1
      DE_eCS_Status_Verr_Reihe1_BFS_1_228: upstream-reference=Geltungsbereich_MQBw_Baseline.CIL.SP_IF_eCS_Status_Verr_Reihe1_BFS_1.DE_eCS_Status_Verr_Reihe1_BFS_1, ecu-extract-reference=TopLevelCompositionPrototype.CIL.SP_IF_eCS_Status_Verr_Reihe1_BFS_1.DE_eCS_Status_Verr_Reihe1_BFS_1
      SP_IF_eCS_Status_Verr_Reihe1_BFS_2_229: upstream-reference=Geltungsbereich_MQBw_Baseline.CIL.SP_IF_eCS_Status_Verr_Reihe1_BFS_2, ecu-extract-reference=TopLevelCompositionPrototype.CIL.SP_IF_eCS_Status_Verr_Reihe1_BFS_2
      DE_eCS_Status_Verr_Reihe1_BFS_2_230: upstream-reference=Geltungsbereich_MQBw_Baseline.CIL.SP_IF_eCS_Status_Verr_Reihe1_BFS_2.DE_eCS_Status_Verr_Reihe1_BFS_2, ecu-extract-reference=TopLevelCompositionPrototype.CIL.SP_IF_eCS_Status_Verr_Reihe1_BFS_2.DE_eCS_Status_Verr_Reihe1_BFS_2
      SP_IF_eCS_Status_Verr_Reihe1_FS_1_231: upstream-reference=Geltungsbereich_MQBw_Baseline.CIL.SP_IF_eCS_Status_Verr_Reihe1_FS_1, ecu-extract-reference=TopLevelCompositionPrototype.CIL.SP_IF_eCS_Status_Verr_Reihe1_FS_1
      DE_eCS_Status_Verr_Reihe1_FS_1_232: upstream-reference=Geltungsbereich_MQBw_Baseline.CIL.SP_IF_eCS_Status_Verr_Reihe1_FS_1.DE_eCS_Status_Verr_Reihe1_FS_1, ecu-extract-reference=TopLevelCompositionPrototype.CIL.SP_IF_eCS_Status_Verr_Reihe1_FS_1.DE_eCS_Status_Verr_Reihe1_FS_1
      SP_IF_eCS_Status_Verr_Reihe1_FS_2_233: upstream-reference=Geltungsbereich_MQBw_Baseline.CIL.SP_IF_eCS_Status_Verr_Reihe1_FS_2, ecu-extract-reference=TopLevelCompositionPrototype.CIL.SP_IF_eCS_Status_Verr_Reihe1_FS_2
      DE_eCS_Status_Verr_Reihe1_FS_2_234: upstream-reference=Geltungsbereich_MQBw_Baseline.CIL.SP_IF_eCS_Status_Verr_Reihe1_FS_2.DE_eCS_Status_Verr_Reihe1_FS_2, ecu-extract-reference=TopLevelCompositionPrototype.CIL.SP_IF_eCS_Status_Verr_Reihe1_FS_2.DE_eCS_Status_Verr_Reihe1_FS_2
      SP_IF_eCS_Status_Verr_Reihe2_BFS_235: upstream-reference=Geltungsbereich_MQBw_Baseline.CIL.SP_IF_eCS_Status_Verr_Reihe2_BFS, ecu-extract-reference=TopLevelCompositionPrototype.CIL.SP_IF_eCS_Status_Verr_Reihe2_BFS
      DE_eCS_Status_Verr_Reihe2_BFS_236: upstream-reference=Geltungsbereich_MQBw_Baseline.CIL.SP_IF_eCS_Status_Verr_Reihe2_BFS.DE_eCS_Status_Verr_Reihe2_BFS, ecu-extract-reference=TopLevelCompositionPrototype.CIL.SP_IF_eCS_Status_Verr_Reihe2_BFS.DE_eCS_Status_Verr_Reihe2_BFS
      SP_IF_eCS_Status_Verr_Reihe2_FS_237: upstream-reference=Geltungsbereich_MQBw_Baseline.CIL.SP_IF_eCS_Status_Verr_Reihe2_FS, ecu-extract-reference=TopLevelCompositionPrototype.CIL.SP_IF_eCS_Status_Verr_Reihe2_FS
      DE_eCS_Status_Verr_Reihe2_FS_238: upstream-reference=Geltungsbereich_MQBw_Baseline.CIL.SP_IF_eCS_Status_Verr_Reihe2_FS.DE_eCS_Status_Verr_Reihe2_FS, ecu-extract-reference=TopLevelCompositionPrototype.CIL.SP_IF_eCS_Status_Verr_Reihe2_FS.DE_eCS_Status_Verr_Reihe2_FS
      SP_IF_eCS_Status_XIX_Grundumfang_XIX_eCS_239: upstream-reference=Geltungsbereich_MQBw_Baseline.CIL.SP_IF_eCS_Status_XIX_Grundumfang_XIX_eCS, ecu-extract-reference=TopLevelCompositionPrototype.CIL.SP_IF_eCS_Status_XIX_Grundumfang_XIX_eCS
      DE_eCS_Status_240: upstream-reference=Geltungsbereich_MQBw_Baseline.CIL.SP_IF_eCS_Status_XIX_Grundumfang_XIX_eCS.DE_eCS_Status, ecu-extract-reference=TopLevelCompositionPrototype.CIL.SP_IF_eCS_Status_XIX_Grundumfang_XIX_eCS.DE_eCS_Status
      SP_IF_eCS_Stoerung_XIX_Grundumfang_XIX_eCS_241: upstream-reference=Geltungsbereich_MQBw_Baseline.CIL.SP_IF_eCS_Stoerung_XIX_Grundumfang_XIX_eCS, ecu-extract-reference=TopLevelCompositionPrototype.CIL.SP_IF_eCS_Stoerung_XIX_Grundumfang_XIX_eCS
      DE_eCS_Stoerung_242: upstream-reference=Geltungsbereich_MQBw_Baseline.CIL.SP_IF_eCS_Stoerung_XIX_Grundumfang_XIX_eCS.DE_eCS_Stoerung, ecu-extract-reference=TopLevelCompositionPrototype.CIL.SP_IF_eCS_Stoerung_XIX_Grundumfang_XIX_eCS.DE_eCS_Stoerung
      pclAccSensor_243: upstream-reference=Geltungsbereich_MQBw_Baseline.CIL.pclAccSensor, ecu-extract-reference=TopLevelCompositionPrototype.CIL.pclAccSensor
      pclConvAdcService_244: upstream-reference=Geltungsbereich_MQBw_Baseline.CIL.pclConvAdcService, ecu-extract-reference=TopLevelCompositionPrototype.CIL.pclConvAdcService
      pclEcuCharacterstics_245: upstream-reference=Geltungsbereich_MQBw_Baseline.CIL.pclEcuCharacterstics, ecu-extract-reference=TopLevelCompositionPrototype.CIL.pclEcuCharacterstics
      pclMcuCharacteristics_246: upstream-reference=Geltungsbereich_MQBw_Baseline.CIL.pclMcuCharacteristics, ecu-extract-reference=TopLevelCompositionPrototype.CIL.pclMcuCharacteristics
      pclModeManagement_247: upstream-reference=Geltungsbereich_MQBw_Baseline.CIL.pclModeManagement, ecu-extract-reference=TopLevelCompositionPrototype.CIL.pclModeManagement
      pclPtcSensor_248: upstream-reference=Geltungsbereich_MQBw_Baseline.CIL.pclPtcSensor, ecu-extract-reference=TopLevelCompositionPrototype.CIL.pclPtcSensor
      pclSolenoidCharacteristics_249: upstream-reference=Geltungsbereich_MQBw_Baseline.CIL.pclSolenoidCharacteristics, ecu-extract-reference=TopLevelCompositionPrototype.CIL.pclSolenoidCharacteristics
      pclSolenoidProfile_250: upstream-reference=Geltungsbereich_MQBw_Baseline.CIL.pclSolenoidProfile, ecu-extract-reference=TopLevelCompositionPrototype.CIL.pclSolenoidProfile
      au8SelectedProfile_251: upstream-reference=Geltungsbereich_MQBw_Baseline.CIL.pclSolenoidProfile.au8SelectedProfile, ecu-extract-reference=TopLevelCompositionPrototype.CIL.pclSolenoidProfile.au8SelectedProfile
      pclSolenoidStep_252: upstream-reference=Geltungsbereich_MQBw_Baseline.CIL.pclSolenoidStep, ecu-extract-reference=TopLevelCompositionPrototype.CIL.pclSolenoidStep
      au8CurrentStep_253: upstream-reference=Geltungsbereich_MQBw_Baseline.CIL.pclSolenoidStep.au8CurrentStep, ecu-extract-reference=TopLevelCompositionPrototype.CIL.pclSolenoidStep.au8CurrentStep
      prr3DAcceleration_254: upstream-reference=Geltungsbereich_MQBw_Baseline.CIL.prr3DAcceleration, ecu-extract-reference=TopLevelCompositionPrototype.CIL.prr3DAcceleration
      st3DAccel_255: upstream-reference=Geltungsbereich_MQBw_Baseline.CIL.prr3DAcceleration.st3DAccel, ecu-extract-reference=TopLevelCompositionPrototype.CIL.prr3DAcceleration.st3DAccel
      s16AxAppl_256: upstream-reference=Geltungsbereich_MQBw_Baseline.CIL.prr3DAcceleration.st3DAccel.s16AxAppl, ecu-extract-reference=TopLevelCompositionPrototype.CIL.prr3DAcceleration.st3DAccel.s16AxAppl
      s16AyAppl_257: upstream-reference=Geltungsbereich_MQBw_Baseline.CIL.prr3DAcceleration.st3DAccel.s16AyAppl, ecu-extract-reference=TopLevelCompositionPrototype.CIL.prr3DAcceleration.st3DAccel.s16AyAppl
      s16AzAppl_258: upstream-reference=Geltungsbereich_MQBw_Baseline.CIL.prr3DAcceleration.st3DAccel.s16AzAppl, ecu-extract-reference=TopLevelCompositionPrototype.CIL.prr3DAcceleration.st3DAccel.s16AzAppl
      prrAccStatusFailiureSource_259: upstream-reference=Geltungsbereich_MQBw_Baseline.CIL.prrAccStatusFailiureSource, ecu-extract-reference=TopLevelCompositionPrototype.CIL.prrAccStatusFailiureSource
      u32AccAlarmRegStatus_260: upstream-reference=Geltungsbereich_MQBw_Baseline.CIL.prrAccStatusFailiureSource.u32AccAlarmRegStatus, ecu-extract-reference=TopLevelCompositionPrototype.CIL.prrAccStatusFailiureSource.u32AccAlarmRegStatus
      u8AccAlarmbPreinitSeqStatus_261: upstream-reference=Geltungsbereich_MQBw_Baseline.CIL.prrAccStatusFailiureSource.u8AccAlarmbPreinitSeqStatus, ecu-extract-reference=TopLevelCompositionPrototype.CIL.prrAccStatusFailiureSource.u8AccAlarmbPreinitSeqStatus
      u8AccCRCStatus_262: upstream-reference=Geltungsbereich_MQBw_Baseline.CIL.prrAccStatusFailiureSource.u8AccCRCStatus, ecu-extract-reference=TopLevelCompositionPrototype.CIL.prrAccStatusFailiureSource.u8AccCRCStatus
      u8AccReturnStatus_263: upstream-reference=Geltungsbereich_MQBw_Baseline.CIL.prrAccStatusFailiureSource.u8AccReturnStatus, ecu-extract-reference=TopLevelCompositionPrototype.CIL.prrAccStatusFailiureSource.u8AccReturnStatus
      u8AccelAxisBroken_264: upstream-reference=Geltungsbereich_MQBw_Baseline.CIL.prrAccStatusFailiureSource.u8AccelAxisBroken, ecu-extract-reference=TopLevelCompositionPrototype.CIL.prrAccStatusFailiureSource.u8AccelAxisBroken
      prrAccelMtrPerSecSqd_265: upstream-reference=Geltungsbereich_MQBw_Baseline.CIL.prrAccelMtrPerSecSqd, ecu-extract-reference=TopLevelCompositionPrototype.CIL.prrAccelMtrPerSecSqd
      stAccelMtrPerSecSqd_266: upstream-reference=Geltungsbereich_MQBw_Baseline.CIL.prrAccelMtrPerSecSqd.stAccelMtrPerSecSqd, ecu-extract-reference=TopLevelCompositionPrototype.CIL.prrAccelMtrPerSecSqd.stAccelMtrPerSecSqd
      s16AxAppl_267: upstream-reference=Geltungsbereich_MQBw_Baseline.CIL.prrAccelMtrPerSecSqd.stAccelMtrPerSecSqd.s16AxAppl, ecu-extract-reference=TopLevelCompositionPrototype.CIL.prrAccelMtrPerSecSqd.stAccelMtrPerSecSqd.s16AxAppl
      s16AyAppl_268: upstream-reference=Geltungsbereich_MQBw_Baseline.CIL.prrAccelMtrPerSecSqd.stAccelMtrPerSecSqd.s16AyAppl, ecu-extract-reference=TopLevelCompositionPrototype.CIL.prrAccelMtrPerSecSqd.stAccelMtrPerSecSqd.s16AyAppl
      s16AzAppl_269: upstream-reference=Geltungsbereich_MQBw_Baseline.CIL.prrAccelMtrPerSecSqd.stAccelMtrPerSecSqd.s16AzAppl, ecu-extract-reference=TopLevelCompositionPrototype.CIL.prrAccelMtrPerSecSqd.stAccelMtrPerSecSqd.s16AzAppl
      prrBuckleStatus_270: upstream-reference=Geltungsbereich_MQBw_Baseline.CIL.prrBuckleStatus, ecu-extract-reference=TopLevelCompositionPrototype.CIL.prrBuckleStatus
      au8BuckleStatus_271: upstream-reference=Geltungsbereich_MQBw_Baseline.CIL.prrBuckleStatus.au8BuckleStatus, ecu-extract-reference=TopLevelCompositionPrototype.CIL.prrBuckleStatus.au8BuckleStatus
      prrEcsAlgoData_272: upstream-reference=Geltungsbereich_MQBw_Baseline.CIL.prrEcsAlgoData, ecu-extract-reference=TopLevelCompositionPrototype.CIL.prrEcsAlgoData
      u16BallPosition_273: upstream-reference=Geltungsbereich_MQBw_Baseline.CIL.prrEcsAlgoData.u16BallPosition, ecu-extract-reference=TopLevelCompositionPrototype.CIL.prrEcsAlgoData.u16BallPosition
      u8EcsFlag_274: upstream-reference=Geltungsbereich_MQBw_Baseline.CIL.prrEcsAlgoData.u8EcsFlag, ecu-extract-reference=TopLevelCompositionPrototype.CIL.prrEcsAlgoData.u8EcsFlag
      prrSbcStatusFailiureSource_275: upstream-reference=Geltungsbereich_MQBw_Baseline.CIL.prrSbcStatusFailiureSource, ecu-extract-reference=TopLevelCompositionPrototype.CIL.prrSbcStatusFailiureSource
      u32SbcReg1Status_276: upstream-reference=Geltungsbereich_MQBw_Baseline.CIL.prrSbcStatusFailiureSource.u32SbcReg1Status, ecu-extract-reference=TopLevelCompositionPrototype.CIL.prrSbcStatusFailiureSource.u32SbcReg1Status
      prrSeatOccupancySensorStatus_277: upstream-reference=Geltungsbereich_MQBw_Baseline.CIL.prrSeatOccupancySensorStatus, ecu-extract-reference=TopLevelCompositionPrototype.CIL.prrSeatOccupancySensorStatus
      au8SeatOccupancySensorStatus_278: upstream-reference=Geltungsbereich_MQBw_Baseline.CIL.prrSeatOccupancySensorStatus.au8SeatOccupancySensorStatus, ecu-extract-reference=TopLevelCompositionPrototype.CIL.prrSeatOccupancySensorStatus.au8SeatOccupancySensorStatus
      prrSolenoidOCStatus_279: upstream-reference=Geltungsbereich_MQBw_Baseline.CIL.prrSolenoidOCStatus, ecu-extract-reference=TopLevelCompositionPrototype.CIL.prrSolenoidOCStatus
      au8SolenoidAutotestStatus_280: upstream-reference=Geltungsbereich_MQBw_Baseline.CIL.prrSolenoidOCStatus.au8SolenoidAutotestStatus, ecu-extract-reference=TopLevelCompositionPrototype.CIL.prrSolenoidOCStatus.au8SolenoidAutotestStatus
      prrSolenoidOvervoltageStatus_281: upstream-reference=Geltungsbereich_MQBw_Baseline.CIL.prrSolenoidOvervoltageStatus, ecu-extract-reference=TopLevelCompositionPrototype.CIL.prrSolenoidOvervoltageStatus
      au8SolenoidOvervoltageStatus_282: upstream-reference=Geltungsbereich_MQBw_Baseline.CIL.prrSolenoidOvervoltageStatus.au8SolenoidOvervoltageStatus, ecu-extract-reference=TopLevelCompositionPrototype.CIL.prrSolenoidOvervoltageStatus.au8SolenoidOvervoltageStatus
      prrSolenoidPWM_283: upstream-reference=Geltungsbereich_MQBw_Baseline.CIL.prrSolenoidPWM, ecu-extract-reference=TopLevelCompositionPrototype.CIL.prrSolenoidPWM
      au16Pwm_284: upstream-reference=Geltungsbereich_MQBw_Baseline.CIL.prrSolenoidPWM.au16Pwm, ecu-extract-reference=TopLevelCompositionPrototype.CIL.prrSolenoidPWM.au16Pwm
      prrSolenoidShortToGndStatus_285: upstream-reference=Geltungsbereich_MQBw_Baseline.CIL.prrSolenoidShortToGndStatus, ecu-extract-reference=TopLevelCompositionPrototype.CIL.prrSolenoidShortToGndStatus
      au8SolenoidAutotestStatus_286: upstream-reference=Geltungsbereich_MQBw_Baseline.CIL.prrSolenoidShortToGndStatus.au8SolenoidAutotestStatus, ecu-extract-reference=TopLevelCompositionPrototype.CIL.prrSolenoidShortToGndStatus.au8SolenoidAutotestStatus
      prrSolenoidShortToVccStatus_287: upstream-reference=Geltungsbereich_MQBw_Baseline.CIL.prrSolenoidShortToVccStatus, ecu-extract-reference=TopLevelCompositionPrototype.CIL.prrSolenoidShortToVccStatus
      au8SolenoidAutotestStatus_288: upstream-reference=Geltungsbereich_MQBw_Baseline.CIL.prrSolenoidShortToVccStatus.au8SolenoidAutotestStatus, ecu-extract-reference=TopLevelCompositionPrototype.CIL.prrSolenoidShortToVccStatus.au8SolenoidAutotestStatus
      prrSolenoidState_289: upstream-reference=Geltungsbereich_MQBw_Baseline.CIL.prrSolenoidState, ecu-extract-reference=TopLevelCompositionPrototype.CIL.prrSolenoidState
      au8SolenoidState_290: upstream-reference=Geltungsbereich_MQBw_Baseline.CIL.prrSolenoidState.au8SolenoidState, ecu-extract-reference=TopLevelCompositionPrototype.CIL.prrSolenoidState.au8SolenoidState
      prrSolenoidStuckStatus_291: upstream-reference=Geltungsbereich_MQBw_Baseline.CIL.prrSolenoidStuckStatus, ecu-extract-reference=TopLevelCompositionPrototype.CIL.prrSolenoidStuckStatus
      au8SolenoidIsStuck_292: upstream-reference=Geltungsbereich_MQBw_Baseline.CIL.prrSolenoidStuckStatus.au8SolenoidIsStuck, ecu-extract-reference=TopLevelCompositionPrototype.CIL.prrSolenoidStuckStatus.au8SolenoidIsStuck
      pseSetEcuStateSignal_293: upstream-reference=Geltungsbereich_MQBw_Baseline.CIL.pseSetEcuStateSignal, ecu-extract-reference=TopLevelCompositionPrototype.CIL.pseSetEcuStateSignal
      psrCILData_294: upstream-reference=Geltungsbereich_MQBw_Baseline.CIL.psrCILData, ecu-extract-reference=TopLevelCompositionPrototype.CIL.psrCILData
      au8MergedBuckleStatus_295: upstream-reference=Geltungsbereich_MQBw_Baseline.CIL.psrCILData.au8MergedBuckleStatus, ecu-extract-reference=TopLevelCompositionPrototype.CIL.psrCILData.au8MergedBuckleStatus
      psrCrashStatus_296: upstream-reference=Geltungsbereich_MQBw_Baseline.CIL.psrCrashStatus, ecu-extract-reference=TopLevelCompositionPrototype.CIL.psrCrashStatus
      u8IsCrashActive_297: upstream-reference=Geltungsbereich_MQBw_Baseline.CIL.psrCrashStatus.u8IsCrashActive, ecu-extract-reference=TopLevelCompositionPrototype.CIL.psrCrashStatus.u8IsCrashActive
      psrEcsDiagRequest_298: upstream-reference=Geltungsbereich_MQBw_Baseline.CIL.psrEcsDiagRequest, ecu-extract-reference=TopLevelCompositionPrototype.CIL.psrEcsDiagRequest
      au8DiagReq_299: upstream-reference=Geltungsbereich_MQBw_Baseline.CIL.psrEcsDiagRequest.au8DiagReq, ecu-extract-reference=TopLevelCompositionPrototype.CIL.psrEcsDiagRequest.au8DiagReq
      au8DiagReqComplement_300: upstream-reference=Geltungsbereich_MQBw_Baseline.CIL.psrEcsDiagRequest.au8DiagReqComplement, ecu-extract-reference=TopLevelCompositionPrototype.CIL.psrEcsDiagRequest.au8DiagReqComplement
      ptrpAsrOsServicesCIL_301: upstream-reference=Geltungsbereich_MQBw_Baseline.CIL.ptrpAsrOsServicesCIL, ecu-extract-reference=TopLevelCompositionPrototype.CIL.ptrpAsrOsServicesCIL
      ptrpCilServicesBswMIf_302: upstream-reference=Geltungsbereich_MQBw_Baseline.CIL.ptrpCilServicesBswMIf, ecu-extract-reference=TopLevelCompositionPrototype.CIL.ptrpCilServicesBswMIf
      DIA_303: upstream-reference=Geltungsbereich_MQBw_Baseline.DIA, ecu-extract-reference=TopLevelCompositionPrototype.DIA
      pclAccSensor_304: upstream-reference=Geltungsbereich_MQBw_Baseline.DIA.pclAccSensor, ecu-extract-reference=TopLevelCompositionPrototype.DIA.pclAccSensor
      pclConvAdcService_305: upstream-reference=Geltungsbereich_MQBw_Baseline.DIA.pclConvAdcService, ecu-extract-reference=TopLevelCompositionPrototype.DIA.pclConvAdcService
      pclDemServices_306: upstream-reference=Geltungsbereich_MQBw_Baseline.DIA.pclDemServices, ecu-extract-reference=TopLevelCompositionPrototype.DIA.pclDemServices
      pclEcuCharacterstics_307: upstream-reference=Geltungsbereich_MQBw_Baseline.DIA.pclEcuCharacterstics, ecu-extract-reference=TopLevelCompositionPrototype.DIA.pclEcuCharacterstics
      pclFsmServices_308: upstream-reference=Geltungsbereich_MQBw_Baseline.DIA.pclFsmServices, ecu-extract-reference=TopLevelCompositionPrototype.DIA.pclFsmServices
      pclMcuCharacteristics_309: upstream-reference=Geltungsbereich_MQBw_Baseline.DIA.pclMcuCharacteristics, ecu-extract-reference=TopLevelCompositionPrototype.DIA.pclMcuCharacteristics
      pclNvmIfServices_310: upstream-reference=Geltungsbereich_MQBw_Baseline.DIA.pclNvmIfServices, ecu-extract-reference=TopLevelCompositionPrototype.DIA.pclNvmIfServices
      pclPtcSensor_311: upstream-reference=Geltungsbereich_MQBw_Baseline.DIA.pclPtcSensor, ecu-extract-reference=TopLevelCompositionPrototype.DIA.pclPtcSensor
      pclResetCause_312: upstream-reference=Geltungsbereich_MQBw_Baseline.DIA.pclResetCause, ecu-extract-reference=TopLevelCompositionPrototype.DIA.pclResetCause
      pclResetCauseNotification_313: upstream-reference=Geltungsbereich_MQBw_Baseline.DIA.pclResetCauseNotification, ecu-extract-reference=TopLevelCompositionPrototype.DIA.pclResetCauseNotification
      pclSystemTime_314: upstream-reference=Geltungsbereich_MQBw_Baseline.DIA.pclSystemTime, ecu-extract-reference=TopLevelCompositionPrototype.DIA.pclSystemTime
      prr3DAcceleration_315: upstream-reference=Geltungsbereich_MQBw_Baseline.DIA.prr3DAcceleration, ecu-extract-reference=TopLevelCompositionPrototype.DIA.prr3DAcceleration
      st3DAccel_316: upstream-reference=Geltungsbereich_MQBw_Baseline.DIA.prr3DAcceleration.st3DAccel, ecu-extract-reference=TopLevelCompositionPrototype.DIA.prr3DAcceleration.st3DAccel
      s16AxAppl_317: upstream-reference=Geltungsbereich_MQBw_Baseline.DIA.prr3DAcceleration.st3DAccel.s16AxAppl, ecu-extract-reference=TopLevelCompositionPrototype.DIA.prr3DAcceleration.st3DAccel.s16AxAppl
      s16AyAppl_318: upstream-reference=Geltungsbereich_MQBw_Baseline.DIA.prr3DAcceleration.st3DAccel.s16AyAppl, ecu-extract-reference=TopLevelCompositionPrototype.DIA.prr3DAcceleration.st3DAccel.s16AyAppl
      s16AzAppl_319: upstream-reference=Geltungsbereich_MQBw_Baseline.DIA.prr3DAcceleration.st3DAccel.s16AzAppl, ecu-extract-reference=TopLevelCompositionPrototype.DIA.prr3DAcceleration.st3DAccel.s16AzAppl
      pseCallBackDCMRequestServices_CBReqServInd_1_320: upstream-reference=Geltungsbereich_MQBw_Baseline.DIA.pseCallBackDCMRequestServices_CBReqServInd_1, ecu-extract-reference=TopLevelCompositionPrototype.DIA.pseCallBackDCMRequestServices_CBReqServInd_1
      pseDID_0236_ProgrammingDataElockEcu_321: upstream-reference=Geltungsbereich_MQBw_Baseline.DIA.pseDID_0236_ProgrammingDataElockEcu, ecu-extract-reference=TopLevelCompositionPrototype.DIA.pseDID_0236_ProgrammingDataElockEcu
      pseDID_023E_WSCForProgrammingElockEcu_322: upstream-reference=Geltungsbereich_MQBw_Baseline.DIA.pseDID_023E_WSCForProgrammingElockEcu, ecu-extract-reference=TopLevelCompositionPrototype.DIA.pseDID_023E_WSCForProgrammingElockEcu
      pseDID_0407_VWLogicalSoftwareBlockCounterOfProgrammingAttempts_323: upstream-reference=Geltungsbereich_MQBw_Baseline.DIA.pseDID_0407_VWLogicalSoftwareBlockCounterOfProgrammingAttempts, ecu-extract-reference=TopLevelCompositionPrototype.DIA.pseDID_0407_VWLogicalSoftwareBlockCounterOfProgrammingAttempts
      pseDID_040F_VWLogicalSoftwareBlockLockValue_324: upstream-reference=Geltungsbereich_MQBw_Baseline.DIA.pseDID_040F_VWLogicalSoftwareBlockLockValue, ecu-extract-reference=TopLevelCompositionPrototype.DIA.pseDID_040F_VWLogicalSoftwareBlockLockValue
      pseDID_0410_BootloaderTPBlocksize_325: upstream-reference=Geltungsbereich_MQBw_Baseline.DIA.pseDID_0410_BootloaderTPBlocksize, ecu-extract-reference=TopLevelCompositionPrototype.DIA.pseDID_0410_BootloaderTPBlocksize
      pseDID_0448_ProgrammingPreconditions_326: upstream-reference=Geltungsbereich_MQBw_Baseline.DIA.pseDID_0448_ProgrammingPreconditions, ecu-extract-reference=TopLevelCompositionPrototype.DIA.pseDID_0448_ProgrammingPreconditions
      pseDID_4024_SWSystemTime_327: upstream-reference=Geltungsbereich_MQBw_Baseline.DIA.pseDID_4024_SWSystemTime, ecu-extract-reference=TopLevelCompositionPrototype.DIA.pseDID_4024_SWSystemTime
      pseDID_F15B_FingerprintAndProgrammingDateOfLogicalSoftwareBlocks_328: upstream-reference=Geltungsbereich_MQBw_Baseline.DIA.pseDID_F15B_FingerprintAndProgrammingDateOfLogicalSoftwareBlocks, ecu-extract-reference=TopLevelCompositionPrototype.DIA.pseDID_F15B_FingerprintAndProgrammingDateOfLogicalSoftwareBlocks
      pseDID_F187_VWSparePartNumber_329: upstream-reference=Geltungsbereich_MQBw_Baseline.DIA.pseDID_F187_VWSparePartNumber, ecu-extract-reference=TopLevelCompositionPrototype.DIA.pseDID_F187_VWSparePartNumber
      pseDID_F189_VWApplicationSoftwareVersionNumber_330: upstream-reference=Geltungsbereich_MQBw_Baseline.DIA.pseDID_F189_VWApplicationSoftwareVersionNumber, ecu-extract-reference=TopLevelCompositionPrototype.DIA.pseDID_F189_VWApplicationSoftwareVersionNumber
      pseDID_F18C_ECUSerialNumberData_331: upstream-reference=Geltungsbereich_MQBw_Baseline.DIA.pseDID_F18C_ECUSerialNumberData, ecu-extract-reference=TopLevelCompositionPrototype.DIA.pseDID_F18C_ECUSerialNumberData
      pseDID_F191_VWECUHardwareNumber_332: upstream-reference=Geltungsbereich_MQBw_Baseline.DIA.pseDID_F191_VWECUHardwareNumber, ecu-extract-reference=TopLevelCompositionPrototype.DIA.pseDID_F191_VWECUHardwareNumber
      pseDID_F197_VWSystemNameOrEngineType_333: upstream-reference=Geltungsbereich_MQBw_Baseline.DIA.pseDID_F197_VWSystemNameOrEngineType, ecu-extract-reference=TopLevelCompositionPrototype.DIA.pseDID_F197_VWSystemNameOrEngineType
      pseDID_F19E_ASAMODXFileIdentifier_334: upstream-reference=Geltungsbereich_MQBw_Baseline.DIA.pseDID_F19E_ASAMODXFileIdentifier, ecu-extract-reference=TopLevelCompositionPrototype.DIA.pseDID_F19E_ASAMODXFileIdentifier
      pseDID_F1A2_ASAMODXFileVersion_335: upstream-reference=Geltungsbereich_MQBw_Baseline.DIA.pseDID_F1A2_ASAMODXFileVersion, ecu-extract-reference=TopLevelCompositionPrototype.DIA.pseDID_F1A2_ASAMODXFileVersion
      pseDID_F1A3_VWECUHardwareVersionNumber_336: upstream-reference=Geltungsbereich_MQBw_Baseline.DIA.pseDID_F1A3_VWECUHardwareVersionNumber, ecu-extract-reference=TopLevelCompositionPrototype.DIA.pseDID_F1A3_VWECUHardwareVersionNumber
      pseDID_F1AB_VWLogicalSoftwareBlockVersion_337: upstream-reference=Geltungsbereich_MQBw_Baseline.DIA.pseDID_F1AB_VWLogicalSoftwareBlockVersion, ecu-extract-reference=TopLevelCompositionPrototype.DIA.pseDID_F1AB_VWLogicalSoftwareBlockVersion
      pseDID_F1B4_TechnicalSpecificationsVersion_338: upstream-reference=Geltungsbereich_MQBw_Baseline.DIA.pseDID_F1B4_TechnicalSpecificationsVersion, ecu-extract-reference=TopLevelCompositionPrototype.DIA.pseDID_F1B4_TechnicalSpecificationsVersion
      pseDID_F1D5_FDSProject_339: upstream-reference=Geltungsbereich_MQBw_Baseline.DIA.pseDID_F1D5_FDSProject, ecu-extract-reference=TopLevelCompositionPrototype.DIA.pseDID_F1D5_FDSProject
      pseDID_F1DF_ECUProgrammingInformation_340: upstream-reference=Geltungsbereich_MQBw_Baseline.DIA.pseDID_F1DF_ECUProgrammingInformation, ecu-extract-reference=TopLevelCompositionPrototype.DIA.pseDID_F1DF_ECUProgrammingInformation
      pseDID_FD00_HWVersion_341: upstream-reference=Geltungsbereich_MQBw_Baseline.DIA.pseDID_FD00_HWVersion, ecu-extract-reference=TopLevelCompositionPrototype.DIA.pseDID_FD00_HWVersion
      pseDID_FD01_SWVersion_342: upstream-reference=Geltungsbereich_MQBw_Baseline.DIA.pseDID_FD01_SWVersion, ecu-extract-reference=TopLevelCompositionPrototype.DIA.pseDID_FD01_SWVersion
      pseDID_FD03_AEETraceabilityNumber_343: upstream-reference=Geltungsbereich_MQBw_Baseline.DIA.pseDID_FD03_AEETraceabilityNumber, ecu-extract-reference=TopLevelCompositionPrototype.DIA.pseDID_FD03_AEETraceabilityNumber
      pseDID_FD08_ResetCause_344: upstream-reference=Geltungsbereich_MQBw_Baseline.DIA.pseDID_FD08_ResetCause, ecu-extract-reference=TopLevelCompositionPrototype.DIA.pseDID_FD08_ResetCause
      pseDID_FD09_LastWarmResetParam_345: upstream-reference=Geltungsbereich_MQBw_Baseline.DIA.pseDID_FD09_LastWarmResetParam, ecu-extract-reference=TopLevelCompositionPrototype.DIA.pseDID_FD09_LastWarmResetParam
      pseDID_FD0F_BatteryMeasure_346: upstream-reference=Geltungsbereich_MQBw_Baseline.DIA.pseDID_FD0F_BatteryMeasure, ecu-extract-reference=TopLevelCompositionPrototype.DIA.pseDID_FD0F_BatteryMeasure
      pseDID_FD10_ECUTemperature_347: upstream-reference=Geltungsbereich_MQBw_Baseline.DIA.pseDID_FD10_ECUTemperature, ecu-extract-reference=TopLevelCompositionPrototype.DIA.pseDID_FD10_ECUTemperature
      pseDID_FD62_EccOccurenceNb_348: upstream-reference=Geltungsbereich_MQBw_Baseline.DIA.pseDID_FD62_EccOccurenceNb, ecu-extract-reference=TopLevelCompositionPrototype.DIA.pseDID_FD62_EccOccurenceNb
      pseDID_FD8B_ECUManufacturingDate_349: upstream-reference=Geltungsbereich_MQBw_Baseline.DIA.pseDID_FD8B_ECUManufacturingDate, ecu-extract-reference=TopLevelCompositionPrototype.DIA.pseDID_FD8B_ECUManufacturingDate
      pseDID_FD8C_AssemblySerialNumber_350: upstream-reference=Geltungsbereich_MQBw_Baseline.DIA.pseDID_FD8C_AssemblySerialNumber, ecu-extract-reference=TopLevelCompositionPrototype.DIA.pseDID_FD8C_AssemblySerialNumber
      pseDID_FDE0_EcsVariant_351: upstream-reference=Geltungsbereich_MQBw_Baseline.DIA.pseDID_FDE0_EcsVariant, ecu-extract-reference=TopLevelCompositionPrototype.DIA.pseDID_FDE0_EcsVariant
      pseDID_FDE1_EcsParameters_352: upstream-reference=Geltungsbereich_MQBw_Baseline.DIA.pseDID_FDE1_EcsParameters, ecu-extract-reference=TopLevelCompositionPrototype.DIA.pseDID_FDE1_EcsParameters
      pseDID_FDE2_EcsAccOffsets_353: upstream-reference=Geltungsbereich_MQBw_Baseline.DIA.pseDID_FDE2_EcsAccOffsets, ecu-extract-reference=TopLevelCompositionPrototype.DIA.pseDID_FDE2_EcsAccOffsets
      pseDID_FDE3_EcsProfiles_354: upstream-reference=Geltungsbereich_MQBw_Baseline.DIA.pseDID_FDE3_EcsProfiles, ecu-extract-reference=TopLevelCompositionPrototype.DIA.pseDID_FDE3_EcsProfiles
      pseDID_FDE4_EcsSteps_355: upstream-reference=Geltungsbereich_MQBw_Baseline.DIA.pseDID_FDE4_EcsSteps, ecu-extract-reference=TopLevelCompositionPrototype.DIA.pseDID_FDE4_EcsSteps
      pseDID_FDE5_EcsAccLowPass_356: upstream-reference=Geltungsbereich_MQBw_Baseline.DIA.pseDID_FDE5_EcsAccLowPass, ecu-extract-reference=TopLevelCompositionPrototype.DIA.pseDID_FDE5_EcsAccLowPass
      pseDID_FDE7_EcsAlgoOutputDelay_357: upstream-reference=Geltungsbereich_MQBw_Baseline.DIA.pseDID_FDE7_EcsAlgoOutputDelay, ecu-extract-reference=TopLevelCompositionPrototype.DIA.pseDID_FDE7_EcsAlgoOutputDelay
      pseDID_FDE9_SensitivityLutData_358: upstream-reference=Geltungsbereich_MQBw_Baseline.DIA.pseDID_FDE9_SensitivityLutData, ecu-extract-reference=TopLevelCompositionPrototype.DIA.pseDID_FDE9_SensitivityLutData
      pseDID_FDEA_SensitivityOptData_359: upstream-reference=Geltungsbereich_MQBw_Baseline.DIA.pseDID_FDEA_SensitivityOptData, ecu-extract-reference=TopLevelCompositionPrototype.DIA.pseDID_FDEA_SensitivityOptData
      pseDID_FDFF_MeasurementFrameRamConf_360: upstream-reference=Geltungsbereich_MQBw_Baseline.DIA.pseDID_FDFF_MeasurementFrameRamConf, ecu-extract-reference=TopLevelCompositionPrototype.DIA.pseDID_FDFF_MeasurementFrameRamConf
      pseDID_FE00_AllEventStatusesRead_361: upstream-reference=Geltungsbereich_MQBw_Baseline.DIA.pseDID_FE00_AllEventStatusesRead, ecu-extract-reference=TopLevelCompositionPrototype.DIA.pseDID_FE00_AllEventStatusesRead
      pseDID_FEFF_MeasurementFramesConf_362: upstream-reference=Geltungsbereich_MQBw_Baseline.DIA.pseDID_FEFF_MeasurementFramesConf, ecu-extract-reference=TopLevelCompositionPrototype.DIA.pseDID_FEFF_MeasurementFramesConf
      pseEcsDiagRequest_363: upstream-reference=Geltungsbereich_MQBw_Baseline.DIA.pseEcsDiagRequest, ecu-extract-reference=TopLevelCompositionPrototype.DIA.pseEcsDiagRequest
      au8DiagReq_364: upstream-reference=Geltungsbereich_MQBw_Baseline.DIA.pseEcsDiagRequest.au8DiagReq, ecu-extract-reference=TopLevelCompositionPrototype.DIA.pseEcsDiagRequest.au8DiagReq
      au8DiagReqComplement_365: upstream-reference=Geltungsbereich_MQBw_Baseline.DIA.pseEcsDiagRequest.au8DiagReqComplement, ecu-extract-reference=TopLevelCompositionPrototype.DIA.pseEcsDiagRequest.au8DiagReqComplement
      pseNvpBlockData_366: upstream-reference=Geltungsbereich_MQBw_Baseline.DIA.pseNvpBlockData, ecu-extract-reference=TopLevelCompositionPrototype.DIA.pseNvpBlockData
      u8NvpEcuLockStatus_367: upstream-reference=Geltungsbereich_MQBw_Baseline.DIA.pseNvpBlockData.u8NvpEcuLockStatus, ecu-extract-reference=TopLevelCompositionPrototype.DIA.pseNvpBlockData.u8NvpEcuLockStatus
      u8NvpProcessMode_368: upstream-reference=Geltungsbereich_MQBw_Baseline.DIA.pseNvpBlockData.u8NvpProcessMode, ecu-extract-reference=TopLevelCompositionPrototype.DIA.pseNvpBlockData.u8NvpProcessMode
      pseRoutineControl_AccAngleOffsetCalibration_369: upstream-reference=Geltungsbereich_MQBw_Baseline.DIA.pseRoutineControl_AccAngleOffsetCalibration, ecu-extract-reference=TopLevelCompositionPrototype.DIA.pseRoutineControl_AccAngleOffsetCalibration
      pseRoutineControl_AccCalib_370: upstream-reference=Geltungsbereich_MQBw_Baseline.DIA.pseRoutineControl_AccCalib, ecu-extract-reference=TopLevelCompositionPrototype.DIA.pseRoutineControl_AccCalib
      pseRoutineControl_CheckProgrammingPreconditions_371: upstream-reference=Geltungsbereich_MQBw_Baseline.DIA.pseRoutineControl_CheckProgrammingPreconditions, ecu-extract-reference=TopLevelCompositionPrototype.DIA.pseRoutineControl_CheckProgrammingPreconditions
      pseRoutineControl_EcuTempCalibration_372: upstream-reference=Geltungsbereich_MQBw_Baseline.DIA.pseRoutineControl_EcuTempCalibration, ecu-extract-reference=TopLevelCompositionPrototype.DIA.pseRoutineControl_EcuTempCalibration
      pseRoutineControl_LockSolenoid_373: upstream-reference=Geltungsbereich_MQBw_Baseline.DIA.pseRoutineControl_LockSolenoid, ecu-extract-reference=TopLevelCompositionPrototype.DIA.pseRoutineControl_LockSolenoid
      pseRoutineControl_LockUnlockECU_374: upstream-reference=Geltungsbereich_MQBw_Baseline.DIA.pseRoutineControl_LockUnlockECU, ecu-extract-reference=TopLevelCompositionPrototype.DIA.pseRoutineControl_LockUnlockECU
      pseRoutineControl_ProcessModeRoutine_375: upstream-reference=Geltungsbereich_MQBw_Baseline.DIA.pseRoutineControl_ProcessModeRoutine, ecu-extract-reference=TopLevelCompositionPrototype.DIA.pseRoutineControl_ProcessModeRoutine
      pseSecurityAccess_376: upstream-reference=Geltungsbereich_MQBw_Baseline.DIA.pseSecurityAccess, ecu-extract-reference=TopLevelCompositionPrototype.DIA.pseSecurityAccess
      pseServiceRequestSupplierNotification_377: upstream-reference=Geltungsbereich_MQBw_Baseline.DIA.pseServiceRequestSupplierNotification, ecu-extract-reference=TopLevelCompositionPrototype.DIA.pseServiceRequestSupplierNotification
      ptrpDiaServicesBswMIf_378: upstream-reference=Geltungsbereich_MQBw_Baseline.DIA.ptrpDiaServicesBswMIf, ecu-extract-reference=TopLevelCompositionPrototype.DIA.ptrpDiaServicesBswMIf
      DcmIf_379: upstream-reference=Geltungsbereich_MQBw_Baseline.DcmIf, ecu-extract-reference=TopLevelCompositionPrototype.DcmIf
      pclNvmIfServices_380: upstream-reference=Geltungsbereich_MQBw_Baseline.DcmIf.pclNvmIfServices, ecu-extract-reference=TopLevelCompositionPrototype.DcmIf.pclNvmIfServices
      pseNvpBlockData_381: upstream-reference=Geltungsbereich_MQBw_Baseline.DcmIf.pseNvpBlockData, ecu-extract-reference=TopLevelCompositionPrototype.DcmIf.pseNvpBlockData
      u8NvpEcuLockStatus_382: upstream-reference=Geltungsbereich_MQBw_Baseline.DcmIf.pseNvpBlockData.u8NvpEcuLockStatus, ecu-extract-reference=TopLevelCompositionPrototype.DcmIf.pseNvpBlockData.u8NvpEcuLockStatus
      u8NvpProcessMode_383: upstream-reference=Geltungsbereich_MQBw_Baseline.DcmIf.pseNvpBlockData.u8NvpProcessMode, ecu-extract-reference=TopLevelCompositionPrototype.DcmIf.pseNvpBlockData.u8NvpProcessMode
      ptrpAsrDcmServicesDcmIf_384: upstream-reference=Geltungsbereich_MQBw_Baseline.DcmIf.ptrpAsrDcmServicesDcmIf, ecu-extract-reference=TopLevelCompositionPrototype.DcmIf.ptrpAsrDcmServicesDcmIf
      DemIf_385: upstream-reference=Geltungsbereich_MQBw_Baseline.DemIf, ecu-extract-reference=TopLevelCompositionPrototype.DemIf
      pseDemIfEventServices_386: upstream-reference=Geltungsbereich_MQBw_Baseline.DemIf.pseDemIfEventServices, ecu-extract-reference=TopLevelCompositionPrototype.DemIf.pseDemIfEventServices
      ptrpAsrDemServicesDemIf_387: upstream-reference=Geltungsbereich_MQBw_Baseline.DemIf.ptrpAsrDemServicesDemIf, ecu-extract-reference=TopLevelCompositionPrototype.DemIf.ptrpAsrDemServicesDemIf
      DioIf_388: upstream-reference=Geltungsbereich_MQBw_Baseline.DioIf, ecu-extract-reference=TopLevelCompositionPrototype.DioIf
      psrDioIfServices_389: upstream-reference=Geltungsbereich_MQBw_Baseline.DioIf.psrDioIfServices, ecu-extract-reference=TopLevelCompositionPrototype.DioIf.psrDioIfServices
      ptrpEcuMIfServicesDioIf_390: upstream-reference=Geltungsbereich_MQBw_Baseline.DioIf.ptrpEcuMIfServicesDioIf, ecu-extract-reference=TopLevelCompositionPrototype.DioIf.ptrpEcuMIfServicesDioIf
      ptrrAsrDioServicesDioIf_391: upstream-reference=Geltungsbereich_MQBw_Baseline.DioIf.ptrrAsrDioServicesDioIf, ecu-extract-reference=TopLevelCompositionPrototype.DioIf.ptrrAsrDioServicesDioIf
      EFX_392: upstream-reference=Geltungsbereich_MQBw_Baseline.EFX, ecu-extract-reference=TopLevelCompositionPrototype.EFX
      pseEfxServices_393: upstream-reference=Geltungsbereich_MQBw_Baseline.EFX.pseEfxServices, ecu-extract-reference=TopLevelCompositionPrototype.EFX.pseEfxServices
      EIM_394: upstream-reference=Geltungsbereich_MQBw_Baseline.EIM, ecu-extract-reference=TopLevelCompositionPrototype.EIM
      pclDemDiagMonitor_395: upstream-reference=Geltungsbereich_MQBw_Baseline.EIM.pclDemDiagMonitor, ecu-extract-reference=TopLevelCompositionPrototype.EIM.pclDemDiagMonitor
      prrFSMSolenoidProfile_396: upstream-reference=Geltungsbereich_MQBw_Baseline.EIM.prrFSMSolenoidProfile, ecu-extract-reference=TopLevelCompositionPrototype.EIM.prrFSMSolenoidProfile
      au8SelectedProfile_397: upstream-reference=Geltungsbereich_MQBw_Baseline.EIM.prrFSMSolenoidProfile.au8SelectedProfile, ecu-extract-reference=TopLevelCompositionPrototype.EIM.prrFSMSolenoidProfile.au8SelectedProfile
      pseInjectError_398: upstream-reference=Geltungsbereich_MQBw_Baseline.EIM.pseInjectError, ecu-extract-reference=TopLevelCompositionPrototype.EIM.pseInjectError
      EcuMIf_399: upstream-reference=Geltungsbereich_MQBw_Baseline.EcuMIf, ecu-extract-reference=TopLevelCompositionPrototype.EcuMIf
      pclNotifyResetCause_400: upstream-reference=Geltungsbereich_MQBw_Baseline.EcuMIf.pclNotifyResetCause, ecu-extract-reference=TopLevelCompositionPrototype.EcuMIf.pclNotifyResetCause
      pclSbcServices_401: upstream-reference=Geltungsbereich_MQBw_Baseline.EcuMIf.pclSbcServices, ecu-extract-reference=TopLevelCompositionPrototype.EcuMIf.pclSbcServices
      ptrpAsrCanServicesEcuMIf_402: upstream-reference=Geltungsbereich_MQBw_Baseline.EcuMIf.ptrpAsrCanServicesEcuMIf, ecu-extract-reference=TopLevelCompositionPrototype.EcuMIf.ptrpAsrCanServicesEcuMIf
      ptrpAsrEcuMServicesEcuMIf_403: upstream-reference=Geltungsbereich_MQBw_Baseline.EcuMIf.ptrpAsrEcuMServicesEcuMIf, ecu-extract-reference=TopLevelCompositionPrototype.EcuMIf.ptrpAsrEcuMServicesEcuMIf
      ptrrAsrAdcServicesEcuMIf_404: upstream-reference=Geltungsbereich_MQBw_Baseline.EcuMIf.ptrrAsrAdcServicesEcuMIf, ecu-extract-reference=TopLevelCompositionPrototype.EcuMIf.ptrrAsrAdcServicesEcuMIf
      ptrrAsrCanIfServicesEcuMIf_405: upstream-reference=Geltungsbereich_MQBw_Baseline.EcuMIf.ptrrAsrCanIfServicesEcuMIf, ecu-extract-reference=TopLevelCompositionPrototype.EcuMIf.ptrrAsrCanIfServicesEcuMIf
      ptrrAsrCanServicesEcuMIf_406: upstream-reference=Geltungsbereich_MQBw_Baseline.EcuMIf.ptrrAsrCanServicesEcuMIf, ecu-extract-reference=TopLevelCompositionPrototype.EcuMIf.ptrrAsrCanServicesEcuMIf
      ptrrAsrDemServicesEcuMIf_407: upstream-reference=Geltungsbereich_MQBw_Baseline.EcuMIf.ptrrAsrDemServicesEcuMIf, ecu-extract-reference=TopLevelCompositionPrototype.EcuMIf.ptrrAsrDemServicesEcuMIf
      ptrrAsrEcuMServicesEcuMIf_408: upstream-reference=Geltungsbereich_MQBw_Baseline.EcuMIf.ptrrAsrEcuMServicesEcuMIf, ecu-extract-reference=TopLevelCompositionPrototype.EcuMIf.ptrrAsrEcuMServicesEcuMIf
      ptrrAsrFeeServicesEcuMIf_409: upstream-reference=Geltungsbereich_MQBw_Baseline.EcuMIf.ptrrAsrFeeServicesEcuMIf, ecu-extract-reference=TopLevelCompositionPrototype.EcuMIf.ptrrAsrFeeServicesEcuMIf
      ptrrAsrFlsServicesEcuMIf_410: upstream-reference=Geltungsbereich_MQBw_Baseline.EcuMIf.ptrrAsrFlsServicesEcuMIf, ecu-extract-reference=TopLevelCompositionPrototype.EcuMIf.ptrrAsrFlsServicesEcuMIf
      ptrrAsrMcuServicesEcuMIf_411: upstream-reference=Geltungsbereich_MQBw_Baseline.EcuMIf.ptrrAsrMcuServicesEcuMIf, ecu-extract-reference=TopLevelCompositionPrototype.EcuMIf.ptrrAsrMcuServicesEcuMIf
      ptrrAsrPwmServicesEcuMIf_412: upstream-reference=Geltungsbereich_MQBw_Baseline.EcuMIf.ptrrAsrPwmServicesEcuMIf, ecu-extract-reference=TopLevelCompositionPrototype.EcuMIf.ptrrAsrPwmServicesEcuMIf
      ptrrEcuMIfServicesAdcIf_413: upstream-reference=Geltungsbereich_MQBw_Baseline.EcuMIf.ptrrEcuMIfServicesAdcIf, ecu-extract-reference=TopLevelCompositionPrototype.EcuMIf.ptrrEcuMIfServicesAdcIf
      ptrrEcuMIfServicesDioIf_414: upstream-reference=Geltungsbereich_MQBw_Baseline.EcuMIf.ptrrEcuMIfServicesDioIf, ecu-extract-reference=TopLevelCompositionPrototype.EcuMIf.ptrrEcuMIfServicesDioIf
      ptrrSpiServicesEcuMIf_415: upstream-reference=Geltungsbereich_MQBw_Baseline.EcuMIf.ptrrSpiServicesEcuMIf, ecu-extract-reference=TopLevelCompositionPrototype.EcuMIf.ptrrSpiServicesEcuMIf
      FSM_416: upstream-reference=Geltungsbereich_MQBw_Baseline.FSM, ecu-extract-reference=TopLevelCompositionPrototype.FSM
      pclAutotestServices_417: upstream-reference=Geltungsbereich_MQBw_Baseline.FSM.pclAutotestServices, ecu-extract-reference=TopLevelCompositionPrototype.FSM.pclAutotestServices
      pclConvAdcService_418: upstream-reference=Geltungsbereich_MQBw_Baseline.FSM.pclConvAdcService, ecu-extract-reference=TopLevelCompositionPrototype.FSM.pclConvAdcService
      pclDemIfEventSerices_419: upstream-reference=Geltungsbereich_MQBw_Baseline.FSM.pclDemIfEventSerices, ecu-extract-reference=TopLevelCompositionPrototype.FSM.pclDemIfEventSerices
      pclDemServices_420: upstream-reference=Geltungsbereich_MQBw_Baseline.FSM.pclDemServices, ecu-extract-reference=TopLevelCompositionPrototype.FSM.pclDemServices
      pclNvmIfServices_421: upstream-reference=Geltungsbereich_MQBw_Baseline.FSM.pclNvmIfServices, ecu-extract-reference=TopLevelCompositionPrototype.FSM.pclNvmIfServices
      prrACCServices_422: upstream-reference=Geltungsbereich_MQBw_Baseline.FSM.prrACCServices, ecu-extract-reference=TopLevelCompositionPrototype.FSM.prrACCServices
      u8AccInitStateMachine_423: upstream-reference=Geltungsbereich_MQBw_Baseline.FSM.prrACCServices.u8AccInitStateMachine, ecu-extract-reference=TopLevelCompositionPrototype.FSM.prrACCServices.u8AccInitStateMachine
      prrBswMIfServices_424: upstream-reference=Geltungsbereich_MQBw_Baseline.FSM.prrBswMIfServices, ecu-extract-reference=TopLevelCompositionPrototype.FSM.prrBswMIfServices
      u8BlockRestoreStatus_425: upstream-reference=Geltungsbereich_MQBw_Baseline.FSM.prrBswMIfServices.u8BlockRestoreStatus, ecu-extract-reference=TopLevelCompositionPrototype.FSM.prrBswMIfServices.u8BlockRestoreStatus
      prrCILData_426: upstream-reference=Geltungsbereich_MQBw_Baseline.FSM.prrCILData, ecu-extract-reference=TopLevelCompositionPrototype.FSM.prrCILData
      au8MergedBuckleStatus_427: upstream-reference=Geltungsbereich_MQBw_Baseline.FSM.prrCILData.au8MergedBuckleStatus, ecu-extract-reference=TopLevelCompositionPrototype.FSM.prrCILData.au8MergedBuckleStatus
      prrCrashStatus_428: upstream-reference=Geltungsbereich_MQBw_Baseline.FSM.prrCrashStatus, ecu-extract-reference=TopLevelCompositionPrototype.FSM.prrCrashStatus
      u8IsCrashActive_429: upstream-reference=Geltungsbereich_MQBw_Baseline.FSM.prrCrashStatus.u8IsCrashActive, ecu-extract-reference=TopLevelCompositionPrototype.FSM.prrCrashStatus.u8IsCrashActive
      prrEcsAlgoFlag_430: upstream-reference=Geltungsbereich_MQBw_Baseline.FSM.prrEcsAlgoFlag, ecu-extract-reference=TopLevelCompositionPrototype.FSM.prrEcsAlgoFlag
      u16BallPosition_431: upstream-reference=Geltungsbereich_MQBw_Baseline.FSM.prrEcsAlgoFlag.u16BallPosition, ecu-extract-reference=TopLevelCompositionPrototype.FSM.prrEcsAlgoFlag.u16BallPosition
      u8EcsFlag_432: upstream-reference=Geltungsbereich_MQBw_Baseline.FSM.prrEcsAlgoFlag.u8EcsFlag, ecu-extract-reference=TopLevelCompositionPrototype.FSM.prrEcsAlgoFlag.u8EcsFlag
      prrEcsDiagRequest_433: upstream-reference=Geltungsbereich_MQBw_Baseline.FSM.prrEcsDiagRequest, ecu-extract-reference=TopLevelCompositionPrototype.FSM.prrEcsDiagRequest
      au8DiagReq_434: upstream-reference=Geltungsbereich_MQBw_Baseline.FSM.prrEcsDiagRequest.au8DiagReq, ecu-extract-reference=TopLevelCompositionPrototype.FSM.prrEcsDiagRequest.au8DiagReq
      au8DiagReqComplement_435: upstream-reference=Geltungsbereich_MQBw_Baseline.FSM.prrEcsDiagRequest.au8DiagReqComplement, ecu-extract-reference=TopLevelCompositionPrototype.FSM.prrEcsDiagRequest.au8DiagReqComplement
      prrSolenoidConfirmation_436: upstream-reference=Geltungsbereich_MQBw_Baseline.FSM.prrSolenoidConfirmation, ecu-extract-reference=TopLevelCompositionPrototype.FSM.prrSolenoidConfirmation
      au8SolenoidStatus_437: upstream-reference=Geltungsbereich_MQBw_Baseline.FSM.prrSolenoidConfirmation.au8SolenoidStatus, ecu-extract-reference=TopLevelCompositionPrototype.FSM.prrSolenoidConfirmation.au8SolenoidStatus
      prrSolenoidOpenCircuitStatus_438: upstream-reference=Geltungsbereich_MQBw_Baseline.FSM.prrSolenoidOpenCircuitStatus, ecu-extract-reference=TopLevelCompositionPrototype.FSM.prrSolenoidOpenCircuitStatus
      au8SolenoidAutotestStatus_439: upstream-reference=Geltungsbereich_MQBw_Baseline.FSM.prrSolenoidOpenCircuitStatus.au8SolenoidAutotestStatus, ecu-extract-reference=TopLevelCompositionPrototype.FSM.prrSolenoidOpenCircuitStatus.au8SolenoidAutotestStatus
      prrSolenoidOverVoltageStatus_440: upstream-reference=Geltungsbereich_MQBw_Baseline.FSM.prrSolenoidOverVoltageStatus, ecu-extract-reference=TopLevelCompositionPrototype.FSM.prrSolenoidOverVoltageStatus
      au8SolenoidOvervoltageStatus_441: upstream-reference=Geltungsbereich_MQBw_Baseline.FSM.prrSolenoidOverVoltageStatus.au8SolenoidOvervoltageStatus, ecu-extract-reference=TopLevelCompositionPrototype.FSM.prrSolenoidOverVoltageStatus.au8SolenoidOvervoltageStatus
      prrSolenoidShortToGndStatus_442: upstream-reference=Geltungsbereich_MQBw_Baseline.FSM.prrSolenoidShortToGndStatus, ecu-extract-reference=TopLevelCompositionPrototype.FSM.prrSolenoidShortToGndStatus
      au8SolenoidAutotestStatus_443: upstream-reference=Geltungsbereich_MQBw_Baseline.FSM.prrSolenoidShortToGndStatus.au8SolenoidAutotestStatus, ecu-extract-reference=TopLevelCompositionPrototype.FSM.prrSolenoidShortToGndStatus.au8SolenoidAutotestStatus
      pseFsmServices_444: upstream-reference=Geltungsbereich_MQBw_Baseline.FSM.pseFsmServices, ecu-extract-reference=TopLevelCompositionPrototype.FSM.pseFsmServices
      pseModeManagement_445: upstream-reference=Geltungsbereich_MQBw_Baseline.FSM.pseModeManagement, ecu-extract-reference=TopLevelCompositionPrototype.FSM.pseModeManagement
      psrSolenoidProfile_446: upstream-reference=Geltungsbereich_MQBw_Baseline.FSM.psrSolenoidProfile, ecu-extract-reference=TopLevelCompositionPrototype.FSM.psrSolenoidProfile
      au8SelectedProfile_447: upstream-reference=Geltungsbereich_MQBw_Baseline.FSM.psrSolenoidProfile.au8SelectedProfile, ecu-extract-reference=TopLevelCompositionPrototype.FSM.psrSolenoidProfile.au8SelectedProfile
      psrSolenoidState_448: upstream-reference=Geltungsbereich_MQBw_Baseline.FSM.psrSolenoidState, ecu-extract-reference=TopLevelCompositionPrototype.FSM.psrSolenoidState
      au8SolenoidState_449: upstream-reference=Geltungsbereich_MQBw_Baseline.FSM.psrSolenoidState.au8SolenoidState, ecu-extract-reference=TopLevelCompositionPrototype.FSM.psrSolenoidState.au8SolenoidState
      psrSolenoidStuckStatus_450: upstream-reference=Geltungsbereich_MQBw_Baseline.FSM.psrSolenoidStuckStatus, ecu-extract-reference=TopLevelCompositionPrototype.FSM.psrSolenoidStuckStatus
      au8SolenoidIsStuck_451: upstream-reference=Geltungsbereich_MQBw_Baseline.FSM.psrSolenoidStuckStatus.au8SolenoidIsStuck, ecu-extract-reference=TopLevelCompositionPrototype.FSM.psrSolenoidStuckStatus.au8SolenoidIsStuck
      ptrpAsrOsServicesFSM_452: upstream-reference=Geltungsbereich_MQBw_Baseline.FSM.ptrpAsrOsServicesFSM, ecu-extract-reference=TopLevelCompositionPrototype.FSM.ptrpAsrOsServicesFSM
      ptrpFsmServicesBswMIf_453: upstream-reference=Geltungsbereich_MQBw_Baseline.FSM.ptrpFsmServicesBswMIf, ecu-extract-reference=TopLevelCompositionPrototype.FSM.ptrpFsmServicesBswMIf
      FSM_u32_ModesStatus_454: upstream-reference=Geltungsbereich_MQBw_Baseline.FSM.FSM_u32_ModesStatus, ecu-extract-reference=TopLevelCompositionPrototype.FSM.FSM_u32_ModesStatus
      FSM_u32_ModesStatusComplement_455: upstream-reference=Geltungsbereich_MQBw_Baseline.FSM.FSM_u32_ModesStatusComplement, ecu-extract-reference=TopLevelCompositionPrototype.FSM.FSM_u32_ModesStatusComplement
      IoHwAb_456: upstream-reference=Geltungsbereich_MQBw_Baseline.IoHwAb, ecu-extract-reference=TopLevelCompositionPrototype.IoHwAb
      pclAccSpiData_457: upstream-reference=Geltungsbereich_MQBw_Baseline.IoHwAb.pclAccSpiData, ecu-extract-reference=TopLevelCompositionPrototype.IoHwAb.pclAccSpiData
      pclAutotestServices_458: upstream-reference=Geltungsbereich_MQBw_Baseline.IoHwAb.pclAutotestServices, ecu-extract-reference=TopLevelCompositionPrototype.IoHwAb.pclAutotestServices
      pclDioIfServices_459: upstream-reference=Geltungsbereich_MQBw_Baseline.IoHwAb.pclDioIfServices, ecu-extract-reference=TopLevelCompositionPrototype.IoHwAb.pclDioIfServices
      pclEfxServices_460: upstream-reference=Geltungsbereich_MQBw_Baseline.IoHwAb.pclEfxServices, ecu-extract-reference=TopLevelCompositionPrototype.IoHwAb.pclEfxServices
      pclModeManagement_461: upstream-reference=Geltungsbereich_MQBw_Baseline.IoHwAb.pclModeManagement, ecu-extract-reference=TopLevelCompositionPrototype.IoHwAb.pclModeManagement
      pclNvmIfServices_462: upstream-reference=Geltungsbereich_MQBw_Baseline.IoHwAb.pclNvmIfServices, ecu-extract-reference=TopLevelCompositionPrototype.IoHwAb.pclNvmIfServices
      pclPassengerOccupancyState_463: upstream-reference=Geltungsbereich_MQBw_Baseline.IoHwAb.pclPassengerOccupancyState, ecu-extract-reference=TopLevelCompositionPrototype.IoHwAb.pclPassengerOccupancyState
      pclRawAdcService_464: upstream-reference=Geltungsbereich_MQBw_Baseline.IoHwAb.pclRawAdcService, ecu-extract-reference=TopLevelCompositionPrototype.IoHwAb.pclRawAdcService
      pclSolenoidProfile_465: upstream-reference=Geltungsbereich_MQBw_Baseline.IoHwAb.pclSolenoidProfile, ecu-extract-reference=TopLevelCompositionPrototype.IoHwAb.pclSolenoidProfile
      au8SelectedProfile_466: upstream-reference=Geltungsbereich_MQBw_Baseline.IoHwAb.pclSolenoidProfile.au8SelectedProfile, ecu-extract-reference=TopLevelCompositionPrototype.IoHwAb.pclSolenoidProfile.au8SelectedProfile
      pclSolenoidStep_467: upstream-reference=Geltungsbereich_MQBw_Baseline.IoHwAb.pclSolenoidStep, ecu-extract-reference=TopLevelCompositionPrototype.IoHwAb.pclSolenoidStep
      au8CurrentStep_468: upstream-reference=Geltungsbereich_MQBw_Baseline.IoHwAb.pclSolenoidStep.au8CurrentStep, ecu-extract-reference=TopLevelCompositionPrototype.IoHwAb.pclSolenoidStep.au8CurrentStep
      pclUnlockTimeout_469: upstream-reference=Geltungsbereich_MQBw_Baseline.IoHwAb.pclUnlockTimeout, ecu-extract-reference=TopLevelCompositionPrototype.IoHwAb.pclUnlockTimeout
      prrAdcBufferServices_470: upstream-reference=Geltungsbereich_MQBw_Baseline.IoHwAb.prrAdcBufferServices, ecu-extract-reference=TopLevelCompositionPrototype.IoHwAb.prrAdcBufferServices
      aau16HistoricalAdcSamples_471: upstream-reference=Geltungsbereich_MQBw_Baseline.IoHwAb.prrAdcBufferServices.aau16HistoricalAdcSamples, ecu-extract-reference=TopLevelCompositionPrototype.IoHwAb.prrAdcBufferServices.aau16HistoricalAdcSamples
      u8HistoricalAdcSampleIndex_472: upstream-reference=Geltungsbereich_MQBw_Baseline.IoHwAb.prrAdcBufferServices.u8HistoricalAdcSampleIndex, ecu-extract-reference=TopLevelCompositionPrototype.IoHwAb.prrAdcBufferServices.u8HistoricalAdcSampleIndex
      prrSolenoidElectricalCharacteristics_473: upstream-reference=Geltungsbereich_MQBw_Baseline.IoHwAb.prrSolenoidElectricalCharacteristics, ecu-extract-reference=TopLevelCompositionPrototype.IoHwAb.prrSolenoidElectricalCharacteristics
      au32SolenoidmATarget_474: upstream-reference=Geltungsbereich_MQBw_Baseline.IoHwAb.prrSolenoidElectricalCharacteristics.au32SolenoidmATarget, ecu-extract-reference=TopLevelCompositionPrototype.IoHwAb.prrSolenoidElectricalCharacteristics.au32SolenoidmATarget
      prrSolenoidPwm_475: upstream-reference=Geltungsbereich_MQBw_Baseline.IoHwAb.prrSolenoidPwm, ecu-extract-reference=TopLevelCompositionPrototype.IoHwAb.prrSolenoidPwm
      au16Pwm_476: upstream-reference=Geltungsbereich_MQBw_Baseline.IoHwAb.prrSolenoidPwm.au16Pwm, ecu-extract-reference=TopLevelCompositionPrototype.IoHwAb.prrSolenoidPwm.au16Pwm
      pseAccSensor_477: upstream-reference=Geltungsbereich_MQBw_Baseline.IoHwAb.pseAccSensor, ecu-extract-reference=TopLevelCompositionPrototype.IoHwAb.pseAccSensor
      pseCheckPowerSupplyOV_478: upstream-reference=Geltungsbereich_MQBw_Baseline.IoHwAb.pseCheckPowerSupplyOV, ecu-extract-reference=TopLevelCompositionPrototype.IoHwAb.pseCheckPowerSupplyOV
      pseCheckPowerSupplyUV_479: upstream-reference=Geltungsbereich_MQBw_Baseline.IoHwAb.pseCheckPowerSupplyUV, ecu-extract-reference=TopLevelCompositionPrototype.IoHwAb.pseCheckPowerSupplyUV
      pseConvAdcService_480: upstream-reference=Geltungsbereich_MQBw_Baseline.IoHwAb.pseConvAdcService, ecu-extract-reference=TopLevelCompositionPrototype.IoHwAb.pseConvAdcService
      pseEcuCharacteristics_481: upstream-reference=Geltungsbereich_MQBw_Baseline.IoHwAb.pseEcuCharacteristics, ecu-extract-reference=TopLevelCompositionPrototype.IoHwAb.pseEcuCharacteristics
      pseEcuOverTemperature_482: upstream-reference=Geltungsbereich_MQBw_Baseline.IoHwAb.pseEcuOverTemperature, ecu-extract-reference=TopLevelCompositionPrototype.IoHwAb.pseEcuOverTemperature
      pseHandleSeatCurrentCircuit_483: upstream-reference=Geltungsbereich_MQBw_Baseline.IoHwAb.pseHandleSeatCurrentCircuit, ecu-extract-reference=TopLevelCompositionPrototype.IoHwAb.pseHandleSeatCurrentCircuit
      pseLowPowerWakeUp_484: upstream-reference=Geltungsbereich_MQBw_Baseline.IoHwAb.pseLowPowerWakeUp, ecu-extract-reference=TopLevelCompositionPrototype.IoHwAb.pseLowPowerWakeUp
      pseMcuCharacteristics_485: upstream-reference=Geltungsbereich_MQBw_Baseline.IoHwAb.pseMcuCharacteristics, ecu-extract-reference=TopLevelCompositionPrototype.IoHwAb.pseMcuCharacteristics
      psePtcSensor_486: upstream-reference=Geltungsbereich_MQBw_Baseline.IoHwAb.psePtcSensor, ecu-extract-reference=TopLevelCompositionPrototype.IoHwAb.psePtcSensor
      pseSolenoidCharacterstics_487: upstream-reference=Geltungsbereich_MQBw_Baseline.IoHwAb.pseSolenoidCharacterstics, ecu-extract-reference=TopLevelCompositionPrototype.IoHwAb.pseSolenoidCharacterstics
      psrBuckleStatus_488: upstream-reference=Geltungsbereich_MQBw_Baseline.IoHwAb.psrBuckleStatus, ecu-extract-reference=TopLevelCompositionPrototype.IoHwAb.psrBuckleStatus
      au8BuckleStatus_489: upstream-reference=Geltungsbereich_MQBw_Baseline.IoHwAb.psrBuckleStatus.au8BuckleStatus, ecu-extract-reference=TopLevelCompositionPrototype.IoHwAb.psrBuckleStatus.au8BuckleStatus
      psrSeatOccupancySensorStatus_490: upstream-reference=Geltungsbereich_MQBw_Baseline.IoHwAb.psrSeatOccupancySensorStatus, ecu-extract-reference=TopLevelCompositionPrototype.IoHwAb.psrSeatOccupancySensorStatus
      au8SeatOccupancySensorStatus_491: upstream-reference=Geltungsbereich_MQBw_Baseline.IoHwAb.psrSeatOccupancySensorStatus.au8SeatOccupancySensorStatus, ecu-extract-reference=TopLevelCompositionPrototype.IoHwAb.psrSeatOccupancySensorStatus.au8SeatOccupancySensorStatus
      psrSolenoidConfirmation_492: upstream-reference=Geltungsbereich_MQBw_Baseline.IoHwAb.psrSolenoidConfirmation, ecu-extract-reference=TopLevelCompositionPrototype.IoHwAb.psrSolenoidConfirmation
      au8SolenoidStatus_493: upstream-reference=Geltungsbereich_MQBw_Baseline.IoHwAb.psrSolenoidConfirmation.au8SolenoidStatus, ecu-extract-reference=TopLevelCompositionPrototype.IoHwAb.psrSolenoidConfirmation.au8SolenoidStatus
      ptrpAsrOsServicesIoHwAb_494: upstream-reference=Geltungsbereich_MQBw_Baseline.IoHwAb.ptrpAsrOsServicesIoHwAb, ecu-extract-reference=TopLevelCompositionPrototype.IoHwAb.ptrpAsrOsServicesIoHwAb
      LPM_495: upstream-reference=Geltungsbereich_MQBw_Baseline.LPM, ecu-extract-reference=TopLevelCompositionPrototype.LPM
      pclAccRestartInit_496: upstream-reference=Geltungsbereich_MQBw_Baseline.LPM.pclAccRestartInit, ecu-extract-reference=TopLevelCompositionPrototype.LPM.pclAccRestartInit
      pclAdcIfServices_497: upstream-reference=Geltungsbereich_MQBw_Baseline.LPM.pclAdcIfServices, ecu-extract-reference=TopLevelCompositionPrototype.LPM.pclAdcIfServices
      pclHandleSeatCurrentCircuit_498: upstream-reference=Geltungsbereich_MQBw_Baseline.LPM.pclHandleSeatCurrentCircuit, ecu-extract-reference=TopLevelCompositionPrototype.LPM.pclHandleSeatCurrentCircuit
      pclLowPowerWakeUp_499: upstream-reference=Geltungsbereich_MQBw_Baseline.LPM.pclLowPowerWakeUp, ecu-extract-reference=TopLevelCompositionPrototype.LPM.pclLowPowerWakeUp
      pclSbcServices_500: upstream-reference=Geltungsbereich_MQBw_Baseline.LPM.pclSbcServices, ecu-extract-reference=TopLevelCompositionPrototype.LPM.pclSbcServices
      ptrpLpmServicesAsrOs_501: upstream-reference=Geltungsbereich_MQBw_Baseline.LPM.ptrpLpmServicesAsrOs, ecu-extract-reference=TopLevelCompositionPrototype.LPM.ptrpLpmServicesAsrOs
      ptrpLpmServicesBswMIf_502: upstream-reference=Geltungsbereich_MQBw_Baseline.LPM.ptrpLpmServicesBswMIf, ecu-extract-reference=TopLevelCompositionPrototype.LPM.ptrpLpmServicesBswMIf
      MIC_503: upstream-reference=Geltungsbereich_MQBw_Baseline.MIC, ecu-extract-reference=TopLevelCompositionPrototype.MIC
      p_ptrrMicServicesBswMIf_504: upstream-reference=Geltungsbereich_MQBw_Baseline.MIC.p_ptrrMicServicesBswMIf, ecu-extract-reference=TopLevelCompositionPrototype.MIC.p_ptrrMicServicesBswMIf
      p_ptrrMicServicesOsIf_505: upstream-reference=Geltungsbereich_MQBw_Baseline.MIC.p_ptrrMicServicesOsIf, ecu-extract-reference=TopLevelCompositionPrototype.MIC.p_ptrrMicServicesOsIf
      pclNvmIfServices_506: upstream-reference=Geltungsbereich_MQBw_Baseline.MIC.pclNvmIfServices, ecu-extract-reference=TopLevelCompositionPrototype.MIC.pclNvmIfServices
      pclResetCause_507: upstream-reference=Geltungsbereich_MQBw_Baseline.MIC.pclResetCause, ecu-extract-reference=TopLevelCompositionPrototype.MIC.pclResetCause
      pclResetCauseNotification_508: upstream-reference=Geltungsbereich_MQBw_Baseline.MIC.pclResetCauseNotification, ecu-extract-reference=TopLevelCompositionPrototype.MIC.pclResetCauseNotification
      pclSbcServices_509: upstream-reference=Geltungsbereich_MQBw_Baseline.MIC.pclSbcServices, ecu-extract-reference=TopLevelCompositionPrototype.MIC.pclSbcServices
      pseRunEepromMemoryCorruption_510: upstream-reference=Geltungsbereich_MQBw_Baseline.MIC.pseRunEepromMemoryCorruption, ecu-extract-reference=TopLevelCompositionPrototype.MIC.pseRunEepromMemoryCorruption
      pseRunPFlashMemoryCorruption_511: upstream-reference=Geltungsbereich_MQBw_Baseline.MIC.pseRunPFlashMemoryCorruption, ecu-extract-reference=TopLevelCompositionPrototype.MIC.pseRunPFlashMemoryCorruption
      pseRunRamMemoryCorruption_512: upstream-reference=Geltungsbereich_MQBw_Baseline.MIC.pseRunRamMemoryCorruption, ecu-extract-reference=TopLevelCompositionPrototype.MIC.pseRunRamMemoryCorruption
      McuIf_513: upstream-reference=Geltungsbereich_MQBw_Baseline.McuIf, ecu-extract-reference=TopLevelCompositionPrototype.McuIf
      pseCheckCrcOnMcuRegisters_514: upstream-reference=Geltungsbereich_MQBw_Baseline.McuIf.pseCheckCrcOnMcuRegisters, ecu-extract-reference=TopLevelCompositionPrototype.McuIf.pseCheckCrcOnMcuRegisters
      pseCheckMcuSelfTest_515: upstream-reference=Geltungsbereich_MQBw_Baseline.McuIf.pseCheckMcuSelfTest, ecu-extract-reference=TopLevelCompositionPrototype.McuIf.pseCheckMcuSelfTest
      ptrpMcuIfServicesBswmIf_516: upstream-reference=Geltungsbereich_MQBw_Baseline.McuIf.ptrpMcuIfServicesBswmIf, ecu-extract-reference=TopLevelCompositionPrototype.McuIf.ptrpMcuIfServicesBswmIf
      NVP_517: upstream-reference=Geltungsbereich_MQBw_Baseline.NVP, ecu-extract-reference=TopLevelCompositionPrototype.NVP
      pseNvpBlockDataDcmIf_518: upstream-reference=Geltungsbereich_MQBw_Baseline.NVP.pseNvpBlockDataDcmIf, ecu-extract-reference=TopLevelCompositionPrototype.NVP.pseNvpBlockDataDcmIf
      u8NvpEcuLockStatus_519: upstream-reference=Geltungsbereich_MQBw_Baseline.NVP.pseNvpBlockDataDcmIf.u8NvpEcuLockStatus, ecu-extract-reference=TopLevelCompositionPrototype.NVP.pseNvpBlockDataDcmIf.u8NvpEcuLockStatus
      u8NvpProcessMode_520: upstream-reference=Geltungsbereich_MQBw_Baseline.NVP.pseNvpBlockDataDcmIf.u8NvpProcessMode, ecu-extract-reference=TopLevelCompositionPrototype.NVP.pseNvpBlockDataDcmIf.u8NvpProcessMode
      pseNvpBlockDataDia_521: upstream-reference=Geltungsbereich_MQBw_Baseline.NVP.pseNvpBlockDataDia, ecu-extract-reference=TopLevelCompositionPrototype.NVP.pseNvpBlockDataDia
      u8NvpEcuLockStatus_522: upstream-reference=Geltungsbereich_MQBw_Baseline.NVP.pseNvpBlockDataDia.u8NvpEcuLockStatus, ecu-extract-reference=TopLevelCompositionPrototype.NVP.pseNvpBlockDataDia.u8NvpEcuLockStatus
      u8NvpProcessMode_523: upstream-reference=Geltungsbereich_MQBw_Baseline.NVP.pseNvpBlockDataDia.u8NvpProcessMode, ecu-extract-reference=TopLevelCompositionPrototype.NVP.pseNvpBlockDataDia.u8NvpProcessMode
      NmIf_524: upstream-reference=Geltungsbereich_MQBw_Baseline.NmIf, ecu-extract-reference=TopLevelCompositionPrototype.NmIf
      pclEcuStateTransitionBswMIf_525: upstream-reference=Geltungsbereich_MQBw_Baseline.NmIf.pclEcuStateTransitionBswMIf, ecu-extract-reference=TopLevelCompositionPrototype.NmIf.pclEcuStateTransitionBswMIf
      ptrpAsrComServicesNmIf_526: upstream-reference=Geltungsbereich_MQBw_Baseline.NmIf.ptrpAsrComServicesNmIf, ecu-extract-reference=TopLevelCompositionPrototype.NmIf.ptrpAsrComServicesNmIf
      ptrpAsrOsServicesNmIf_527: upstream-reference=Geltungsbereich_MQBw_Baseline.NmIf.ptrpAsrOsServicesNmIf, ecu-extract-reference=TopLevelCompositionPrototype.NmIf.ptrpAsrOsServicesNmIf
      ptrrAsrBswMServicesNmIf_528: upstream-reference=Geltungsbereich_MQBw_Baseline.NmIf.ptrrAsrBswMServicesNmIf, ecu-extract-reference=TopLevelCompositionPrototype.NmIf.ptrrAsrBswMServicesNmIf
      ptrrAsrComMServicesNmIf_529: upstream-reference=Geltungsbereich_MQBw_Baseline.NmIf.ptrrAsrComMServicesNmIf, ecu-extract-reference=TopLevelCompositionPrototype.NmIf.ptrrAsrComMServicesNmIf
      ptrrNmIfServicesBswMIf_530: upstream-reference=Geltungsbereich_MQBw_Baseline.NmIf.ptrrNmIfServicesBswMIf, ecu-extract-reference=TopLevelCompositionPrototype.NmIf.ptrrNmIfServicesBswMIf
      NvmIf_531: upstream-reference=Geltungsbereich_MQBw_Baseline.NvmIf, ecu-extract-reference=TopLevelCompositionPrototype.NvmIf
      pclNvmService_AccAngleCalibration_532: upstream-reference=Geltungsbereich_MQBw_Baseline.NvmIf.pclNvmService_AccAngleCalibration, ecu-extract-reference=TopLevelCompositionPrototype.NvmIf.pclNvmService_AccAngleCalibration
      pclNvmService_AeeTraceabilityNumber_533: upstream-reference=Geltungsbereich_MQBw_Baseline.NvmIf.pclNvmService_AeeTraceabilityNumber, ecu-extract-reference=TopLevelCompositionPrototype.NvmIf.pclNvmService_AeeTraceabilityNumber
      pclNvmService_AlvNvmVersion_534: upstream-reference=Geltungsbereich_MQBw_Baseline.NvmIf.pclNvmService_AlvNvmVersion, ecu-extract-reference=TopLevelCompositionPrototype.NvmIf.pclNvmService_AlvNvmVersion
      pclNvmService_AssemblySerialNumber_535: upstream-reference=Geltungsbereich_MQBw_Baseline.NvmIf.pclNvmService_AssemblySerialNumber, ecu-extract-reference=TopLevelCompositionPrototype.NvmIf.pclNvmService_AssemblySerialNumber
      pclNvmService_EcsAccLowPass_536: upstream-reference=Geltungsbereich_MQBw_Baseline.NvmIf.pclNvmService_EcsAccLowPass, ecu-extract-reference=TopLevelCompositionPrototype.NvmIf.pclNvmService_EcsAccLowPass
      pclNvmService_EcsAccOffsets_537: upstream-reference=Geltungsbereich_MQBw_Baseline.NvmIf.pclNvmService_EcsAccOffsets, ecu-extract-reference=TopLevelCompositionPrototype.NvmIf.pclNvmService_EcsAccOffsets
      pclNvmService_EcsAlgoOutputDelay_538: upstream-reference=Geltungsbereich_MQBw_Baseline.NvmIf.pclNvmService_EcsAlgoOutputDelay, ecu-extract-reference=TopLevelCompositionPrototype.NvmIf.pclNvmService_EcsAlgoOutputDelay
      pclNvmService_EcsParameters_539: upstream-reference=Geltungsbereich_MQBw_Baseline.NvmIf.pclNvmService_EcsParameters, ecu-extract-reference=TopLevelCompositionPrototype.NvmIf.pclNvmService_EcsParameters
      pclNvmService_EcsProfiles_540: upstream-reference=Geltungsbereich_MQBw_Baseline.NvmIf.pclNvmService_EcsProfiles, ecu-extract-reference=TopLevelCompositionPrototype.NvmIf.pclNvmService_EcsProfiles
      pclNvmService_EcsSensitivityLUT_541: upstream-reference=Geltungsbereich_MQBw_Baseline.NvmIf.pclNvmService_EcsSensitivityLUT, ecu-extract-reference=TopLevelCompositionPrototype.NvmIf.pclNvmService_EcsSensitivityLUT
      pclNvmService_EcsSensitivityOPT_542: upstream-reference=Geltungsbereich_MQBw_Baseline.NvmIf.pclNvmService_EcsSensitivityOPT, ecu-extract-reference=TopLevelCompositionPrototype.NvmIf.pclNvmService_EcsSensitivityOPT
      pclNvmService_EcsSteps_543: upstream-reference=Geltungsbereich_MQBw_Baseline.NvmIf.pclNvmService_EcsSteps, ecu-extract-reference=TopLevelCompositionPrototype.NvmIf.pclNvmService_EcsSteps
      pclNvmService_EcsVariant_544: upstream-reference=Geltungsbereich_MQBw_Baseline.NvmIf.pclNvmService_EcsVariant, ecu-extract-reference=TopLevelCompositionPrototype.NvmIf.pclNvmService_EcsVariant
      pclNvmService_EcuStateTimingParam_545: upstream-reference=Geltungsbereich_MQBw_Baseline.NvmIf.pclNvmService_EcuStateTimingParam, ecu-extract-reference=TopLevelCompositionPrototype.NvmIf.pclNvmService_EcuStateTimingParam
      pclNvmService_EolCounters_546: upstream-reference=Geltungsbereich_MQBw_Baseline.NvmIf.pclNvmService_EolCounters, ecu-extract-reference=TopLevelCompositionPrototype.NvmIf.pclNvmService_EolCounters
      pclNvmService_HwPartNumber_547: upstream-reference=Geltungsbereich_MQBw_Baseline.NvmIf.pclNvmService_HwPartNumber, ecu-extract-reference=TopLevelCompositionPrototype.NvmIf.pclNvmService_HwPartNumber
      pclNvmService_LockUnlockECU_548: upstream-reference=Geltungsbereich_MQBw_Baseline.NvmIf.pclNvmService_LockUnlockECU, ecu-extract-reference=TopLevelCompositionPrototype.NvmIf.pclNvmService_LockUnlockECU
      pclNvmService_OemAppSwVersionNumber_549: upstream-reference=Geltungsbereich_MQBw_Baseline.NvmIf.pclNvmService_OemAppSwVersionNumber, ecu-extract-reference=TopLevelCompositionPrototype.NvmIf.pclNvmService_OemAppSwVersionNumber
      pclNvmService_OemEcuSerialNumber_550: upstream-reference=Geltungsbereich_MQBw_Baseline.NvmIf.pclNvmService_OemEcuSerialNumber, ecu-extract-reference=TopLevelCompositionPrototype.NvmIf.pclNvmService_OemEcuSerialNumber
      pclNvmService_OemFlashBootloader_551: upstream-reference=Geltungsbereich_MQBw_Baseline.NvmIf.pclNvmService_OemFlashBootloader, ecu-extract-reference=TopLevelCompositionPrototype.NvmIf.pclNvmService_OemFlashBootloader
      pclNvmService_OemHardwareNumber_552: upstream-reference=Geltungsbereich_MQBw_Baseline.NvmIf.pclNvmService_OemHardwareNumber, ecu-extract-reference=TopLevelCompositionPrototype.NvmIf.pclNvmService_OemHardwareNumber
      pclNvmService_OemHardwareVersionNumber_553: upstream-reference=Geltungsbereich_MQBw_Baseline.NvmIf.pclNvmService_OemHardwareVersionNumber, ecu-extract-reference=TopLevelCompositionPrototype.NvmIf.pclNvmService_OemHardwareVersionNumber
      pclNvmService_OemLogicalBlockVersion_554: upstream-reference=Geltungsbereich_MQBw_Baseline.NvmIf.pclNvmService_OemLogicalBlockVersion, ecu-extract-reference=TopLevelCompositionPrototype.NvmIf.pclNvmService_OemLogicalBlockVersion
      pclNvmService_OemOdxIdentifier_555: upstream-reference=Geltungsbereich_MQBw_Baseline.NvmIf.pclNvmService_OemOdxIdentifier, ecu-extract-reference=TopLevelCompositionPrototype.NvmIf.pclNvmService_OemOdxIdentifier
      pclNvmService_OemOdxVersion_556: upstream-reference=Geltungsbereich_MQBw_Baseline.NvmIf.pclNvmService_OemOdxVersion, ecu-extract-reference=TopLevelCompositionPrototype.NvmIf.pclNvmService_OemOdxVersion
      pclNvmService_OemSparePartNumber_557: upstream-reference=Geltungsbereich_MQBw_Baseline.NvmIf.pclNvmService_OemSparePartNumber, ecu-extract-reference=TopLevelCompositionPrototype.NvmIf.pclNvmService_OemSparePartNumber
      pclNvmService_OemSystemName_558: upstream-reference=Geltungsbereich_MQBw_Baseline.NvmIf.pclNvmService_OemSystemName, ecu-extract-reference=TopLevelCompositionPrototype.NvmIf.pclNvmService_OemSystemName
      pclNvmService_PhysicalMeasurements_559: upstream-reference=Geltungsbereich_MQBw_Baseline.NvmIf.pclNvmService_PhysicalMeasurements, ecu-extract-reference=TopLevelCompositionPrototype.NvmIf.pclNvmService_PhysicalMeasurements
      pclNvmService_SBSLastState_560: upstream-reference=Geltungsbereich_MQBw_Baseline.NvmIf.pclNvmService_SBSLastState, ecu-extract-reference=TopLevelCompositionPrototype.NvmIf.pclNvmService_SBSLastState
      pclNvmService_SolenoidParam_561: upstream-reference=Geltungsbereich_MQBw_Baseline.NvmIf.pclNvmService_SolenoidParam, ecu-extract-reference=TopLevelCompositionPrototype.NvmIf.pclNvmService_SolenoidParam
      pclNvmServices_AutotestEnableParam_562: upstream-reference=Geltungsbereich_MQBw_Baseline.NvmIf.pclNvmServices_AutotestEnableParam, ecu-extract-reference=TopLevelCompositionPrototype.NvmIf.pclNvmServices_AutotestEnableParam
      pclNvmServices_AutotestParam_563: upstream-reference=Geltungsbereich_MQBw_Baseline.NvmIf.pclNvmServices_AutotestParam, ecu-extract-reference=TopLevelCompositionPrototype.NvmIf.pclNvmServices_AutotestParam
      pclNvmServices_DemDefault_564: upstream-reference=Geltungsbereich_MQBw_Baseline.NvmIf.pclNvmServices_DemDefault, ecu-extract-reference=TopLevelCompositionPrototype.NvmIf.pclNvmServices_DemDefault
      pclNvmServices_EccCounters_565: upstream-reference=Geltungsbereich_MQBw_Baseline.NvmIf.pclNvmServices_EccCounters, ecu-extract-reference=TopLevelCompositionPrototype.NvmIf.pclNvmServices_EccCounters
      pclNvmServices_EcuTempCalibration_566: upstream-reference=Geltungsbereich_MQBw_Baseline.NvmIf.pclNvmServices_EcuTempCalibration, ecu-extract-reference=TopLevelCompositionPrototype.NvmIf.pclNvmServices_EcuTempCalibration
      pclNvmServices_MeasFrameCfg_567: upstream-reference=Geltungsbereich_MQBw_Baseline.NvmIf.pclNvmServices_MeasFrameCfg, ecu-extract-reference=TopLevelCompositionPrototype.NvmIf.pclNvmServices_MeasFrameCfg
      pclNvmServices_MeasFrameRamCfg_568: upstream-reference=Geltungsbereich_MQBw_Baseline.NvmIf.pclNvmServices_MeasFrameRamCfg, ecu-extract-reference=TopLevelCompositionPrototype.NvmIf.pclNvmServices_MeasFrameRamCfg
      pclNvmServices_ProcessMode_569: upstream-reference=Geltungsbereich_MQBw_Baseline.NvmIf.pclNvmServices_ProcessMode, ecu-extract-reference=TopLevelCompositionPrototype.NvmIf.pclNvmServices_ProcessMode
      pclNvmServices_WarmResetCounters_570: upstream-reference=Geltungsbereich_MQBw_Baseline.NvmIf.pclNvmServices_WarmResetCounters, ecu-extract-reference=TopLevelCompositionPrototype.NvmIf.pclNvmServices_WarmResetCounters
      pseNvmIfServices_571: upstream-reference=Geltungsbereich_MQBw_Baseline.NvmIf.pseNvmIfServices, ecu-extract-reference=TopLevelCompositionPrototype.NvmIf.pseNvmIfServices
      pseRunEepromMemoryNotProgrammed_572: upstream-reference=Geltungsbereich_MQBw_Baseline.NvmIf.pseRunEepromMemoryNotProgrammed, ecu-extract-reference=TopLevelCompositionPrototype.NvmIf.pseRunEepromMemoryNotProgrammed
      OsIf_573: upstream-reference=Geltungsbereich_MQBw_Baseline.OsIf, ecu-extract-reference=TopLevelCompositionPrototype.OsIf
      pclRcmServices_574: upstream-reference=Geltungsbereich_MQBw_Baseline.OsIf.pclRcmServices, ecu-extract-reference=TopLevelCompositionPrototype.OsIf.pclRcmServices
      pclResetCauseNotification_575: upstream-reference=Geltungsbereich_MQBw_Baseline.OsIf.pclResetCauseNotification, ecu-extract-reference=TopLevelCompositionPrototype.OsIf.pclResetCauseNotification
      ptrpAsrOsServicesOsIf_576: upstream-reference=Geltungsbereich_MQBw_Baseline.OsIf.ptrpAsrOsServicesOsIf, ecu-extract-reference=TopLevelCompositionPrototype.OsIf.ptrpAsrOsServicesOsIf
      ptrrAsrBswMServicesOsIf_577: upstream-reference=Geltungsbereich_MQBw_Baseline.OsIf.ptrrAsrBswMServicesOsIf, ecu-extract-reference=TopLevelCompositionPrototype.OsIf.ptrrAsrBswMServicesOsIf
      ptrrAsrEcuMServicesOsIf_578: upstream-reference=Geltungsbereich_MQBw_Baseline.OsIf.ptrrAsrEcuMServicesOsIf, ecu-extract-reference=TopLevelCompositionPrototype.OsIf.ptrrAsrEcuMServicesOsIf
      ptrrMicServices_579: upstream-reference=Geltungsbereich_MQBw_Baseline.OsIf.ptrrMicServices, ecu-extract-reference=TopLevelCompositionPrototype.OsIf.ptrrMicServices
      PwmIf_580: upstream-reference=Geltungsbereich_MQBw_Baseline.PwmIf, ecu-extract-reference=TopLevelCompositionPrototype.PwmIf
      psePwmServices_581: upstream-reference=Geltungsbereich_MQBw_Baseline.PwmIf.psePwmServices, ecu-extract-reference=TopLevelCompositionPrototype.PwmIf.psePwmServices
      ptrrAsrPwmServicesPwmIf_582: upstream-reference=Geltungsbereich_MQBw_Baseline.PwmIf.ptrrAsrPwmServicesPwmIf, ecu-extract-reference=TopLevelCompositionPrototype.PwmIf.ptrrAsrPwmServicesPwmIf
      RCM_583: upstream-reference=Geltungsbereich_MQBw_Baseline.RCM, ecu-extract-reference=TopLevelCompositionPrototype.RCM
      pclNvmIfServices_584: upstream-reference=Geltungsbereich_MQBw_Baseline.RCM.pclNvmIfServices, ecu-extract-reference=TopLevelCompositionPrototype.RCM.pclNvmIfServices
      pclSbcWdgServices_585: upstream-reference=Geltungsbereich_MQBw_Baseline.RCM.pclSbcWdgServices, ecu-extract-reference=TopLevelCompositionPrototype.RCM.pclSbcWdgServices
      pseOSErrorReport_586: upstream-reference=Geltungsbereich_MQBw_Baseline.RCM.pseOSErrorReport, ecu-extract-reference=TopLevelCompositionPrototype.RCM.pseOSErrorReport
      pseResetCause_587: upstream-reference=Geltungsbereich_MQBw_Baseline.RCM.pseResetCause, ecu-extract-reference=TopLevelCompositionPrototype.RCM.pseResetCause
      pseResetCauseNotification_588: upstream-reference=Geltungsbereich_MQBw_Baseline.RCM.pseResetCauseNotification, ecu-extract-reference=TopLevelCompositionPrototype.RCM.pseResetCauseNotification
      pseRunResetCause_589: upstream-reference=Geltungsbereich_MQBw_Baseline.RCM.pseRunResetCause, ecu-extract-reference=TopLevelCompositionPrototype.RCM.pseRunResetCause
      ptrpRcmServicesBswMIf_590: upstream-reference=Geltungsbereich_MQBw_Baseline.RCM.ptrpRcmServicesBswMIf, ecu-extract-reference=TopLevelCompositionPrototype.RCM.ptrpRcmServicesBswMIf
      u8ResetCause_591: upstream-reference=Geltungsbereich_MQBw_Baseline.RCM.u8ResetCause, ecu-extract-reference=TopLevelCompositionPrototype.RCM.u8ResetCause
      SAD_592: upstream-reference=Geltungsbereich_MQBw_Baseline.SAD, ecu-extract-reference=TopLevelCompositionPrototype.SAD
      pclAutotestServices_593: upstream-reference=Geltungsbereich_MQBw_Baseline.SAD.pclAutotestServices, ecu-extract-reference=TopLevelCompositionPrototype.SAD.pclAutotestServices
      pclConvAdcService_594: upstream-reference=Geltungsbereich_MQBw_Baseline.SAD.pclConvAdcService, ecu-extract-reference=TopLevelCompositionPrototype.SAD.pclConvAdcService
      pclDioIfServices_595: upstream-reference=Geltungsbereich_MQBw_Baseline.SAD.pclDioIfServices, ecu-extract-reference=TopLevelCompositionPrototype.SAD.pclDioIfServices
      pclEvtActuatorOpenCircuit_596: upstream-reference=Geltungsbereich_MQBw_Baseline.SAD.pclEvtActuatorOpenCircuit, ecu-extract-reference=TopLevelCompositionPrototype.SAD.pclEvtActuatorOpenCircuit
      pclEvtActuatorShortToGround_597: upstream-reference=Geltungsbereich_MQBw_Baseline.SAD.pclEvtActuatorShortToGround, ecu-extract-reference=TopLevelCompositionPrototype.SAD.pclEvtActuatorShortToGround
      pclEvtActuatorShortToVbat_598: upstream-reference=Geltungsbereich_MQBw_Baseline.SAD.pclEvtActuatorShortToVbat, ecu-extract-reference=TopLevelCompositionPrototype.SAD.pclEvtActuatorShortToVbat
      pclEvtSolenoidOvervoltage_599: upstream-reference=Geltungsbereich_MQBw_Baseline.SAD.pclEvtSolenoidOvervoltage, ecu-extract-reference=TopLevelCompositionPrototype.SAD.pclEvtSolenoidOvervoltage
      pclModeManagement_600: upstream-reference=Geltungsbereich_MQBw_Baseline.SAD.pclModeManagement, ecu-extract-reference=TopLevelCompositionPrototype.SAD.pclModeManagement
      pclPwmServices_601: upstream-reference=Geltungsbereich_MQBw_Baseline.SAD.pclPwmServices, ecu-extract-reference=TopLevelCompositionPrototype.SAD.pclPwmServices
      prrSolenoidProfile_602: upstream-reference=Geltungsbereich_MQBw_Baseline.SAD.prrSolenoidProfile, ecu-extract-reference=TopLevelCompositionPrototype.SAD.prrSolenoidProfile
      au8SelectedProfile_603: upstream-reference=Geltungsbereich_MQBw_Baseline.SAD.prrSolenoidProfile.au8SelectedProfile, ecu-extract-reference=TopLevelCompositionPrototype.SAD.prrSolenoidProfile.au8SelectedProfile
      prrSolenoidState_604: upstream-reference=Geltungsbereich_MQBw_Baseline.SAD.prrSolenoidState, ecu-extract-reference=TopLevelCompositionPrototype.SAD.prrSolenoidState
      au8SolenoidState_605: upstream-reference=Geltungsbereich_MQBw_Baseline.SAD.prrSolenoidState.au8SolenoidState, ecu-extract-reference=TopLevelCompositionPrototype.SAD.prrSolenoidState.au8SolenoidState
      prrSolenoidStuckStatus_606: upstream-reference=Geltungsbereich_MQBw_Baseline.SAD.prrSolenoidStuckStatus, ecu-extract-reference=TopLevelCompositionPrototype.SAD.prrSolenoidStuckStatus
      au8SolenoidIsStuck_607: upstream-reference=Geltungsbereich_MQBw_Baseline.SAD.prrSolenoidStuckStatus.au8SolenoidIsStuck, ecu-extract-reference=TopLevelCompositionPrototype.SAD.prrSolenoidStuckStatus.au8SolenoidIsStuck
      pseCheckActuatorState_608: upstream-reference=Geltungsbereich_MQBw_Baseline.SAD.pseCheckActuatorState, ecu-extract-reference=TopLevelCompositionPrototype.SAD.pseCheckActuatorState
      pseCheckPowerStage_609: upstream-reference=Geltungsbereich_MQBw_Baseline.SAD.pseCheckPowerStage, ecu-extract-reference=TopLevelCompositionPrototype.SAD.pseCheckPowerStage
      pseCheckSolenoidOpenCircuit_610: upstream-reference=Geltungsbereich_MQBw_Baseline.SAD.pseCheckSolenoidOpenCircuit, ecu-extract-reference=TopLevelCompositionPrototype.SAD.pseCheckSolenoidOpenCircuit
      pseCheckSolenoidOvervoltage_611: upstream-reference=Geltungsbereich_MQBw_Baseline.SAD.pseCheckSolenoidOvervoltage, ecu-extract-reference=TopLevelCompositionPrototype.SAD.pseCheckSolenoidOvervoltage
      pseCheckSolenoidShortToGND_612: upstream-reference=Geltungsbereich_MQBw_Baseline.SAD.pseCheckSolenoidShortToGND, ecu-extract-reference=TopLevelCompositionPrototype.SAD.pseCheckSolenoidShortToGND
      pseCheckSolenoidShortToVBAT_613: upstream-reference=Geltungsbereich_MQBw_Baseline.SAD.pseCheckSolenoidShortToVBAT, ecu-extract-reference=TopLevelCompositionPrototype.SAD.pseCheckSolenoidShortToVBAT
      pseDiagRequestServices_614: upstream-reference=Geltungsbereich_MQBw_Baseline.SAD.pseDiagRequestServices, ecu-extract-reference=TopLevelCompositionPrototype.SAD.pseDiagRequestServices
      au8DiagReq_615: upstream-reference=Geltungsbereich_MQBw_Baseline.SAD.pseDiagRequestServices.au8DiagReq, ecu-extract-reference=TopLevelCompositionPrototype.SAD.pseDiagRequestServices.au8DiagReq
      au8DiagReqComplement_616: upstream-reference=Geltungsbereich_MQBw_Baseline.SAD.pseDiagRequestServices.au8DiagReqComplement, ecu-extract-reference=TopLevelCompositionPrototype.SAD.pseDiagRequestServices.au8DiagReqComplement
      pseSolenoidPWM_617: upstream-reference=Geltungsbereich_MQBw_Baseline.SAD.pseSolenoidPWM, ecu-extract-reference=TopLevelCompositionPrototype.SAD.pseSolenoidPWM
      au16Pwm_618: upstream-reference=Geltungsbereich_MQBw_Baseline.SAD.pseSolenoidPWM.au16Pwm, ecu-extract-reference=TopLevelCompositionPrototype.SAD.pseSolenoidPWM.au16Pwm
      pseSolenoidStep_619: upstream-reference=Geltungsbereich_MQBw_Baseline.SAD.pseSolenoidStep, ecu-extract-reference=TopLevelCompositionPrototype.SAD.pseSolenoidStep
      au8CurrentStep_620: upstream-reference=Geltungsbereich_MQBw_Baseline.SAD.pseSolenoidStep.au8CurrentStep, ecu-extract-reference=TopLevelCompositionPrototype.SAD.pseSolenoidStep.au8CurrentStep
      psrSolenoidElectricalCharacteristics_621: upstream-reference=Geltungsbereich_MQBw_Baseline.SAD.psrSolenoidElectricalCharacteristics, ecu-extract-reference=TopLevelCompositionPrototype.SAD.psrSolenoidElectricalCharacteristics
      au32SolenoidmATarget_622: upstream-reference=Geltungsbereich_MQBw_Baseline.SAD.psrSolenoidElectricalCharacteristics.au32SolenoidmATarget, ecu-extract-reference=TopLevelCompositionPrototype.SAD.psrSolenoidElectricalCharacteristics.au32SolenoidmATarget
      psrSolenoidOpenCircutStatus_623: upstream-reference=Geltungsbereich_MQBw_Baseline.SAD.psrSolenoidOpenCircutStatus, ecu-extract-reference=TopLevelCompositionPrototype.SAD.psrSolenoidOpenCircutStatus
      au8SolenoidAutotestStatus_624: upstream-reference=Geltungsbereich_MQBw_Baseline.SAD.psrSolenoidOpenCircutStatus.au8SolenoidAutotestStatus, ecu-extract-reference=TopLevelCompositionPrototype.SAD.psrSolenoidOpenCircutStatus.au8SolenoidAutotestStatus
      psrSolenoidOvervoltageStatus_625: upstream-reference=Geltungsbereich_MQBw_Baseline.SAD.psrSolenoidOvervoltageStatus, ecu-extract-reference=TopLevelCompositionPrototype.SAD.psrSolenoidOvervoltageStatus
      au8SolenoidOvervoltageStatus_626: upstream-reference=Geltungsbereich_MQBw_Baseline.SAD.psrSolenoidOvervoltageStatus.au8SolenoidOvervoltageStatus, ecu-extract-reference=TopLevelCompositionPrototype.SAD.psrSolenoidOvervoltageStatus.au8SolenoidOvervoltageStatus
      psrSolenoidShortToGndStatus_627: upstream-reference=Geltungsbereich_MQBw_Baseline.SAD.psrSolenoidShortToGndStatus, ecu-extract-reference=TopLevelCompositionPrototype.SAD.psrSolenoidShortToGndStatus
      au8SolenoidAutotestStatus_628: upstream-reference=Geltungsbereich_MQBw_Baseline.SAD.psrSolenoidShortToGndStatus.au8SolenoidAutotestStatus, ecu-extract-reference=TopLevelCompositionPrototype.SAD.psrSolenoidShortToGndStatus.au8SolenoidAutotestStatus
      psrSolenoidShortToVccStatus_629: upstream-reference=Geltungsbereich_MQBw_Baseline.SAD.psrSolenoidShortToVccStatus, ecu-extract-reference=TopLevelCompositionPrototype.SAD.psrSolenoidShortToVccStatus
      au8SolenoidAutotestStatus_630: upstream-reference=Geltungsbereich_MQBw_Baseline.SAD.psrSolenoidShortToVccStatus.au8SolenoidAutotestStatus, ecu-extract-reference=TopLevelCompositionPrototype.SAD.psrSolenoidShortToVccStatus.au8SolenoidAutotestStatus
      ptrpAsrOsServicesSAD_631: upstream-reference=Geltungsbereich_MQBw_Baseline.SAD.ptrpAsrOsServicesSAD, ecu-extract-reference=TopLevelCompositionPrototype.SAD.ptrpAsrOsServicesSAD
      ptrpSadServicesBswMIf_632: upstream-reference=Geltungsbereich_MQBw_Baseline.SAD.ptrpSadServicesBswMIf, ecu-extract-reference=TopLevelCompositionPrototype.SAD.ptrpSadServicesBswMIf
      stProfileCfg_633: upstream-reference=Geltungsbereich_MQBw_Baseline.SAD.stProfileCfg, ecu-extract-reference=TopLevelCompositionPrototype.SAD.stProfileCfg
      SBC_634: upstream-reference=Geltungsbereich_MQBw_Baseline.SBC, ecu-extract-reference=TopLevelCompositionPrototype.SBC
      pclResetCause_635: upstream-reference=Geltungsbereich_MQBw_Baseline.SBC.pclResetCause, ecu-extract-reference=TopLevelCompositionPrototype.SBC.pclResetCause
      pclResetCauseNotification_636: upstream-reference=Geltungsbereich_MQBw_Baseline.SBC.pclResetCauseNotification, ecu-extract-reference=TopLevelCompositionPrototype.SBC.pclResetCauseNotification
      pseCheckSbcStatusInfo_637: upstream-reference=Geltungsbereich_MQBw_Baseline.SBC.pseCheckSbcStatusInfo, ecu-extract-reference=TopLevelCompositionPrototype.SBC.pseCheckSbcStatusInfo
      pseSbcServices_638: upstream-reference=Geltungsbereich_MQBw_Baseline.SBC.pseSbcServices, ecu-extract-reference=TopLevelCompositionPrototype.SBC.pseSbcServices
      pseSbcStatus_639: upstream-reference=Geltungsbereich_MQBw_Baseline.SBC.pseSbcStatus, ecu-extract-reference=TopLevelCompositionPrototype.SBC.pseSbcStatus
      pseSbcWdgAutotest_640: upstream-reference=Geltungsbereich_MQBw_Baseline.SBC.pseSbcWdgAutotest, ecu-extract-reference=TopLevelCompositionPrototype.SBC.pseSbcWdgAutotest
      psrSbcStatusFailiureSource_641: upstream-reference=Geltungsbereich_MQBw_Baseline.SBC.psrSbcStatusFailiureSource, ecu-extract-reference=TopLevelCompositionPrototype.SBC.psrSbcStatusFailiureSource
      u32SbcReg1Status_642: upstream-reference=Geltungsbereich_MQBw_Baseline.SBC.psrSbcStatusFailiureSource.u32SbcReg1Status, ecu-extract-reference=TopLevelCompositionPrototype.SBC.psrSbcStatusFailiureSource.u32SbcReg1Status
      ptrpAsrOsServicesSBC_643: upstream-reference=Geltungsbereich_MQBw_Baseline.SBC.ptrpAsrOsServicesSBC, ecu-extract-reference=TopLevelCompositionPrototype.SBC.ptrpAsrOsServicesSBC
      ptrpSbcServicesEcuM_644: upstream-reference=Geltungsbereich_MQBw_Baseline.SBC.ptrpSbcServicesEcuM, ecu-extract-reference=TopLevelCompositionPrototype.SBC.ptrpSbcServicesEcuM
      ptrrSpiIfServices_645: upstream-reference=Geltungsbereich_MQBw_Baseline.SBC.ptrrSpiIfServices, ecu-extract-reference=TopLevelCompositionPrototype.SBC.ptrrSpiIfServices
      STM_646: upstream-reference=Geltungsbereich_MQBw_Baseline.STM, ecu-extract-reference=TopLevelCompositionPrototype.STM
      pseSystemTime_647: upstream-reference=Geltungsbereich_MQBw_Baseline.STM.pseSystemTime, ecu-extract-reference=TopLevelCompositionPrototype.STM.pseSystemTime
      ptrpAsrOsServicesSTM_648: upstream-reference=Geltungsbereich_MQBw_Baseline.STM.ptrpAsrOsServicesSTM, ecu-extract-reference=TopLevelCompositionPrototype.STM.ptrpAsrOsServicesSTM
      SpiIf_649: upstream-reference=Geltungsbereich_MQBw_Baseline.SpiIf, ecu-extract-reference=TopLevelCompositionPrototype.SpiIf
      ptrpSpiIfServicesACC_650: upstream-reference=Geltungsbereich_MQBw_Baseline.SpiIf.ptrpSpiIfServicesACC, ecu-extract-reference=TopLevelCompositionPrototype.SpiIf.ptrpSpiIfServicesACC
      ptrpSpiIfServicesSBC_651: upstream-reference=Geltungsbereich_MQBw_Baseline.SpiIf.ptrpSpiIfServicesSBC, ecu-extract-reference=TopLevelCompositionPrototype.SpiIf.ptrpSpiIfServicesSBC
      ptrrAsrSpiServicesSpiIf_652: upstream-reference=Geltungsbereich_MQBw_Baseline.SpiIf.ptrrAsrSpiServicesSpiIf, ecu-extract-reference=TopLevelCompositionPrototype.SpiIf.ptrrAsrSpiServicesSpiIf
      T1_653: upstream-reference=Geltungsbereich_MQBw_Baseline.T1, ecu-extract-reference=TopLevelCompositionPrototype.T1
      eCS_654: upstream-reference=Geltungsbereich_MQBw_Baseline.eCS, ecu-extract-reference=TopLevelCompositionPrototype.eCS
      pclModeManagement_655: upstream-reference=Geltungsbereich_MQBw_Baseline.eCS.pclModeManagement, ecu-extract-reference=TopLevelCompositionPrototype.eCS.pclModeManagement
      prrAccelMtrPerSecSqd_656: upstream-reference=Geltungsbereich_MQBw_Baseline.eCS.prrAccelMtrPerSecSqd, ecu-extract-reference=TopLevelCompositionPrototype.eCS.prrAccelMtrPerSecSqd
      stAccelMtrPerSecSqd_657: upstream-reference=Geltungsbereich_MQBw_Baseline.eCS.prrAccelMtrPerSecSqd.stAccelMtrPerSecSqd, ecu-extract-reference=TopLevelCompositionPrototype.eCS.prrAccelMtrPerSecSqd.stAccelMtrPerSecSqd
      s16AxAppl_658: upstream-reference=Geltungsbereich_MQBw_Baseline.eCS.prrAccelMtrPerSecSqd.stAccelMtrPerSecSqd.s16AxAppl, ecu-extract-reference=TopLevelCompositionPrototype.eCS.prrAccelMtrPerSecSqd.stAccelMtrPerSecSqd.s16AxAppl
      s16AyAppl_659: upstream-reference=Geltungsbereich_MQBw_Baseline.eCS.prrAccelMtrPerSecSqd.stAccelMtrPerSecSqd.s16AyAppl, ecu-extract-reference=TopLevelCompositionPrototype.eCS.prrAccelMtrPerSecSqd.stAccelMtrPerSecSqd.s16AyAppl
      s16AzAppl_660: upstream-reference=Geltungsbereich_MQBw_Baseline.eCS.prrAccelMtrPerSecSqd.stAccelMtrPerSecSqd.s16AzAppl, ecu-extract-reference=TopLevelCompositionPrototype.eCS.prrAccelMtrPerSecSqd.stAccelMtrPerSecSqd.s16AzAppl
      psrEcsAlgoData_661: upstream-reference=Geltungsbereich_MQBw_Baseline.eCS.psrEcsAlgoData, ecu-extract-reference=TopLevelCompositionPrototype.eCS.psrEcsAlgoData
      u16BallPosition_662: upstream-reference=Geltungsbereich_MQBw_Baseline.eCS.psrEcsAlgoData.u16BallPosition, ecu-extract-reference=TopLevelCompositionPrototype.eCS.psrEcsAlgoData.u16BallPosition
      u8EcsFlag_663: upstream-reference=Geltungsbereich_MQBw_Baseline.eCS.psrEcsAlgoData.u8EcsFlag, ecu-extract-reference=TopLevelCompositionPrototype.eCS.psrEcsAlgoData.u8EcsFlag
      ptrpAsrOsServicesECS_664: upstream-reference=Geltungsbereich_MQBw_Baseline.eCS.ptrpAsrOsServicesECS, ecu-extract-reference=TopLevelCompositionPrototype.eCS.ptrpAsrOsServicesECS
      Dcm_665: upstream-reference=Geltungsbereich_MQBw_Baseline.Dcm, ecu-extract-reference=TopLevelCompositionPrototype.Dcm
      Dcm_ASR42_DCMServices_666: upstream-reference=Geltungsbereich_MQBw_Baseline.Dcm.Dcm_ASR42_DCMServices, ecu-extract-reference=TopLevelCompositionPrototype.Dcm.Dcm_ASR42_DCMServices
      DCMServices_667: upstream-reference=Geltungsbereich_MQBw_Baseline.Dcm.DCMServices, ecu-extract-reference=TopLevelCompositionPrototype.Dcm.DCMServices
      SecurityAccess_DcmDspSecurityAlv_668: upstream-reference=Geltungsbereich_MQBw_Baseline.Dcm.SecurityAccess_DcmDspSecurityAlv, ecu-extract-reference=TopLevelCompositionPrototype.Dcm.SecurityAccess_DcmDspSecurityAlv
      DataServices_DID_4024_SWSystemTimeData_669: upstream-reference=Geltungsbereich_MQBw_Baseline.Dcm.DataServices_DID_4024_SWSystemTimeData, ecu-extract-reference=TopLevelCompositionPrototype.Dcm.DataServices_DID_4024_SWSystemTimeData
      DataServices_DID_FD00_HWVersionData_670: upstream-reference=Geltungsbereich_MQBw_Baseline.Dcm.DataServices_DID_FD00_HWVersionData, ecu-extract-reference=TopLevelCompositionPrototype.Dcm.DataServices_DID_FD00_HWVersionData
      DataServices_DID_FD01_SWVersionData_671: upstream-reference=Geltungsbereich_MQBw_Baseline.Dcm.DataServices_DID_FD01_SWVersionData, ecu-extract-reference=TopLevelCompositionPrototype.Dcm.DataServices_DID_FD01_SWVersionData
      DataServices_DID_FD03_AEETraceabilityNumberData_672: upstream-reference=Geltungsbereich_MQBw_Baseline.Dcm.DataServices_DID_FD03_AEETraceabilityNumberData, ecu-extract-reference=TopLevelCompositionPrototype.Dcm.DataServices_DID_FD03_AEETraceabilityNumberData
      DataServices_DID_FD08_ResetCauseData_673: upstream-reference=Geltungsbereich_MQBw_Baseline.Dcm.DataServices_DID_FD08_ResetCauseData, ecu-extract-reference=TopLevelCompositionPrototype.Dcm.DataServices_DID_FD08_ResetCauseData
      DataServices_DID_FD09_LastWarmResetParamData_674: upstream-reference=Geltungsbereich_MQBw_Baseline.Dcm.DataServices_DID_FD09_LastWarmResetParamData, ecu-extract-reference=TopLevelCompositionPrototype.Dcm.DataServices_DID_FD09_LastWarmResetParamData
      DataServices_DID_FD62_EccOccurenceNbData_675: upstream-reference=Geltungsbereich_MQBw_Baseline.Dcm.DataServices_DID_FD62_EccOccurenceNbData, ecu-extract-reference=TopLevelCompositionPrototype.Dcm.DataServices_DID_FD62_EccOccurenceNbData
      DataServices_DID_FEFF_MeasurementFramesConfData_676: upstream-reference=Geltungsbereich_MQBw_Baseline.Dcm.DataServices_DID_FEFF_MeasurementFramesConfData, ecu-extract-reference=TopLevelCompositionPrototype.Dcm.DataServices_DID_FEFF_MeasurementFramesConfData
      DataServices_DID_FE00_AllEventStatusesRead_677: upstream-reference=Geltungsbereich_MQBw_Baseline.Dcm.DataServices_DID_FE00_AllEventStatusesRead, ecu-extract-reference=TopLevelCompositionPrototype.Dcm.DataServices_DID_FE00_AllEventStatusesRead
      DataServices_DID_FD8B_ECUManufacturingDateData_678: upstream-reference=Geltungsbereich_MQBw_Baseline.Dcm.DataServices_DID_FD8B_ECUManufacturingDateData, ecu-extract-reference=TopLevelCompositionPrototype.Dcm.DataServices_DID_FD8B_ECUManufacturingDateData
      DataServices_DID_FD8C_AssemblySerialNumber_679: upstream-reference=Geltungsbereich_MQBw_Baseline.Dcm.DataServices_DID_FD8C_AssemblySerialNumber, ecu-extract-reference=TopLevelCompositionPrototype.Dcm.DataServices_DID_FD8C_AssemblySerialNumber
      DataServices_DID_FD0F_BatteryMeasureData_680: upstream-reference=Geltungsbereich_MQBw_Baseline.Dcm.DataServices_DID_FD0F_BatteryMeasureData, ecu-extract-reference=TopLevelCompositionPrototype.Dcm.DataServices_DID_FD0F_BatteryMeasureData
      DataServices_DID_FD10_ECUTemperatureData_681: upstream-reference=Geltungsbereich_MQBw_Baseline.Dcm.DataServices_DID_FD10_ECUTemperatureData, ecu-extract-reference=TopLevelCompositionPrototype.Dcm.DataServices_DID_FD10_ECUTemperatureData
      DataServices_DID_FDE0_EcsVariantData_682: upstream-reference=Geltungsbereich_MQBw_Baseline.Dcm.DataServices_DID_FDE0_EcsVariantData, ecu-extract-reference=TopLevelCompositionPrototype.Dcm.DataServices_DID_FDE0_EcsVariantData
      DataServices_DID_FDE1_EcsParametersData_683: upstream-reference=Geltungsbereich_MQBw_Baseline.Dcm.DataServices_DID_FDE1_EcsParametersData, ecu-extract-reference=TopLevelCompositionPrototype.Dcm.DataServices_DID_FDE1_EcsParametersData
      DataServices_DID_FDE2_AccOffsetData_684: upstream-reference=Geltungsbereich_MQBw_Baseline.Dcm.DataServices_DID_FDE2_AccOffsetData, ecu-extract-reference=TopLevelCompositionPrototype.Dcm.DataServices_DID_FDE2_AccOffsetData
      DataServices_DID_FDE3_EcsProfilesData_685: upstream-reference=Geltungsbereich_MQBw_Baseline.Dcm.DataServices_DID_FDE3_EcsProfilesData, ecu-extract-reference=TopLevelCompositionPrototype.Dcm.DataServices_DID_FDE3_EcsProfilesData
      DataServices_DID_FDE4_EcsStepsData_686: upstream-reference=Geltungsbereich_MQBw_Baseline.Dcm.DataServices_DID_FDE4_EcsStepsData, ecu-extract-reference=TopLevelCompositionPrototype.Dcm.DataServices_DID_FDE4_EcsStepsData
      DataServices_DID_FDE5_EcsAccLowPassData_687: upstream-reference=Geltungsbereich_MQBw_Baseline.Dcm.DataServices_DID_FDE5_EcsAccLowPassData, ecu-extract-reference=TopLevelCompositionPrototype.Dcm.DataServices_DID_FDE5_EcsAccLowPassData
      DataServices_DID_FDE7_AlgoOutputDelayData_688: upstream-reference=Geltungsbereich_MQBw_Baseline.Dcm.DataServices_DID_FDE7_AlgoOutputDelayData, ecu-extract-reference=TopLevelCompositionPrototype.Dcm.DataServices_DID_FDE7_AlgoOutputDelayData
      DataServices_DID_FDE9_SensitivityLutData_689: upstream-reference=Geltungsbereich_MQBw_Baseline.Dcm.DataServices_DID_FDE9_SensitivityLutData, ecu-extract-reference=TopLevelCompositionPrototype.Dcm.DataServices_DID_FDE9_SensitivityLutData
      DataServices_DID_FDEA_SensitivityOptData_690: upstream-reference=Geltungsbereich_MQBw_Baseline.Dcm.DataServices_DID_FDEA_SensitivityOptData, ecu-extract-reference=TopLevelCompositionPrototype.Dcm.DataServices_DID_FDEA_SensitivityOptData
      DataServices_DID_FDFF_MeasurementFrameConfDataRam_691: upstream-reference=Geltungsbereich_MQBw_Baseline.Dcm.DataServices_DID_FDFF_MeasurementFrameConfDataRam, ecu-extract-reference=TopLevelCompositionPrototype.Dcm.DataServices_DID_FDFF_MeasurementFrameConfDataRam
      DataServices_DID_F187_VWSparePartNumberData_692: upstream-reference=Geltungsbereich_MQBw_Baseline.Dcm.DataServices_DID_F187_VWSparePartNumberData, ecu-extract-reference=TopLevelCompositionPrototype.Dcm.DataServices_DID_F187_VWSparePartNumberData
      DataServices_DID_F189_VWApplicationSoftwareVersionNumberData_693: upstream-reference=Geltungsbereich_MQBw_Baseline.Dcm.DataServices_DID_F189_VWApplicationSoftwareVersionNumberData, ecu-extract-reference=TopLevelCompositionPrototype.Dcm.DataServices_DID_F189_VWApplicationSoftwareVersionNumberData
      DataServices_DID_F191_VWECUHardwareNumberData_694: upstream-reference=Geltungsbereich_MQBw_Baseline.Dcm.DataServices_DID_F191_VWECUHardwareNumberData, ecu-extract-reference=TopLevelCompositionPrototype.Dcm.DataServices_DID_F191_VWECUHardwareNumberData
      DataServices_DID_F197_VWSystemNameOrEngineTypeData_695: upstream-reference=Geltungsbereich_MQBw_Baseline.Dcm.DataServices_DID_F197_VWSystemNameOrEngineTypeData, ecu-extract-reference=TopLevelCompositionPrototype.Dcm.DataServices_DID_F197_VWSystemNameOrEngineTypeData
      DataServices_DID_F1B4_TechnicalSpecificationsVersionData_696: upstream-reference=Geltungsbereich_MQBw_Baseline.Dcm.DataServices_DID_F1B4_TechnicalSpecificationsVersionData, ecu-extract-reference=TopLevelCompositionPrototype.Dcm.DataServices_DID_F1B4_TechnicalSpecificationsVersionData
      DataServices_DID_0407_VWLogicalSoftwareBlockCounterOfProgrammingAttemptsData_697: upstream-reference=Geltungsbereich_MQBw_Baseline.Dcm.DataServices_DID_0407_VWLogicalSoftwareBlockCounterOfProgrammingAttemptsData, ecu-extract-reference=TopLevelCompositionPrototype.Dcm.DataServices_DID_0407_VWLogicalSoftwareBlockCounterOfProgrammingAttemptsData
      DataServices_DID_040F_VWLogicalSoftwareBlockLockValueData_698: upstream-reference=Geltungsbereich_MQBw_Baseline.Dcm.DataServices_DID_040F_VWLogicalSoftwareBlockLockValueData, ecu-extract-reference=TopLevelCompositionPrototype.Dcm.DataServices_DID_040F_VWLogicalSoftwareBlockLockValueData
      DataServices_DID_0410_BootloaderTPBlocksizeData_699: upstream-reference=Geltungsbereich_MQBw_Baseline.Dcm.DataServices_DID_0410_BootloaderTPBlocksizeData, ecu-extract-reference=TopLevelCompositionPrototype.Dcm.DataServices_DID_0410_BootloaderTPBlocksizeData
      DataServices_DID_0448_ProgrammingPreconditionsData_700: upstream-reference=Geltungsbereich_MQBw_Baseline.Dcm.DataServices_DID_0448_ProgrammingPreconditionsData, ecu-extract-reference=TopLevelCompositionPrototype.Dcm.DataServices_DID_0448_ProgrammingPreconditionsData
      DataServices_DID_F1DF_ECUProgrammingInformationData_701: upstream-reference=Geltungsbereich_MQBw_Baseline.Dcm.DataServices_DID_F1DF_ECUProgrammingInformationData, ecu-extract-reference=TopLevelCompositionPrototype.Dcm.DataServices_DID_F1DF_ECUProgrammingInformationData
      DataServices_DID_F19E_ASAMODXFileIdentifierData_702: upstream-reference=Geltungsbereich_MQBw_Baseline.Dcm.DataServices_DID_F19E_ASAMODXFileIdentifierData, ecu-extract-reference=TopLevelCompositionPrototype.Dcm.DataServices_DID_F19E_ASAMODXFileIdentifierData
      DataServices_DID_F1A2_ASAMODXFileVersionData_703: upstream-reference=Geltungsbereich_MQBw_Baseline.Dcm.DataServices_DID_F1A2_ASAMODXFileVersionData, ecu-extract-reference=TopLevelCompositionPrototype.Dcm.DataServices_DID_F1A2_ASAMODXFileVersionData
      DataServices_DID_F1D5_FDSProjectData_704: upstream-reference=Geltungsbereich_MQBw_Baseline.Dcm.DataServices_DID_F1D5_FDSProjectData, ecu-extract-reference=TopLevelCompositionPrototype.Dcm.DataServices_DID_F1D5_FDSProjectData
      DataServices_DID_F1A3_VWECUHardwareVersionNumberData_705: upstream-reference=Geltungsbereich_MQBw_Baseline.Dcm.DataServices_DID_F1A3_VWECUHardwareVersionNumberData, ecu-extract-reference=TopLevelCompositionPrototype.Dcm.DataServices_DID_F1A3_VWECUHardwareVersionNumberData
      DataServices_DID_F18C_ECUSerialNumberData_706: upstream-reference=Geltungsbereich_MQBw_Baseline.Dcm.DataServices_DID_F18C_ECUSerialNumberData, ecu-extract-reference=TopLevelCompositionPrototype.Dcm.DataServices_DID_F18C_ECUSerialNumberData
      DataServices_DID_F1AB_VWLogicalSoftwareBlockVersionData_707: upstream-reference=Geltungsbereich_MQBw_Baseline.Dcm.DataServices_DID_F1AB_VWLogicalSoftwareBlockVersionData, ecu-extract-reference=TopLevelCompositionPrototype.Dcm.DataServices_DID_F1AB_VWLogicalSoftwareBlockVersionData
      DataServices_DID_F15B_FingerprintAndProgrammingDateOfLogicalSoftwareBlocksData_708: upstream-reference=Geltungsbereich_MQBw_Baseline.Dcm.DataServices_DID_F15B_FingerprintAndProgrammingDateOfLogicalSoftwareBlocksData, ecu-extract-reference=TopLevelCompositionPrototype.Dcm.DataServices_DID_F15B_FingerprintAndProgrammingDateOfLogicalSoftwareBlocksData
      DataServices_DID_0236_ProgrammingDataElockEcuData_709: upstream-reference=Geltungsbereich_MQBw_Baseline.Dcm.DataServices_DID_0236_ProgrammingDataElockEcuData, ecu-extract-reference=TopLevelCompositionPrototype.Dcm.DataServices_DID_0236_ProgrammingDataElockEcuData
      DataServices_DID_023E_WSCForProgrammingElockEcuData_710: upstream-reference=Geltungsbereich_MQBw_Baseline.Dcm.DataServices_DID_023E_WSCForProgrammingElockEcuData, ecu-extract-reference=TopLevelCompositionPrototype.Dcm.DataServices_DID_023E_WSCForProgrammingElockEcuData
      ServiceRequestSupplierNotification_DcmDslServiceRequestSupplierNotification_711: upstream-reference=Geltungsbereich_MQBw_Baseline.Dcm.ServiceRequestSupplierNotification_DcmDslServiceRequestSupplierNotification, ecu-extract-reference=TopLevelCompositionPrototype.Dcm.ServiceRequestSupplierNotification_DcmDslServiceRequestSupplierNotification
      RoutineServices_DcmDspRoutineCtrl_Lock_UnlockECU_712: upstream-reference=Geltungsbereich_MQBw_Baseline.Dcm.RoutineServices_DcmDspRoutineCtrl_Lock_UnlockECU, ecu-extract-reference=TopLevelCompositionPrototype.Dcm.RoutineServices_DcmDspRoutineCtrl_Lock_UnlockECU
      RoutineServices_DcmDspRoutineProcessMode_713: upstream-reference=Geltungsbereich_MQBw_Baseline.Dcm.RoutineServices_DcmDspRoutineProcessMode, ecu-extract-reference=TopLevelCompositionPrototype.Dcm.RoutineServices_DcmDspRoutineProcessMode
      RoutineServices_DcmDspRoutineAccCalib_714: upstream-reference=Geltungsbereich_MQBw_Baseline.Dcm.RoutineServices_DcmDspRoutineAccCalib, ecu-extract-reference=TopLevelCompositionPrototype.Dcm.RoutineServices_DcmDspRoutineAccCalib
      RoutineServices_DcmDspRoutineLockSolenoid_715: upstream-reference=Geltungsbereich_MQBw_Baseline.Dcm.RoutineServices_DcmDspRoutineLockSolenoid, ecu-extract-reference=TopLevelCompositionPrototype.Dcm.RoutineServices_DcmDspRoutineLockSolenoid
      RoutineServices_DcmDspRoutineEcuTempCalibration_716: upstream-reference=Geltungsbereich_MQBw_Baseline.Dcm.RoutineServices_DcmDspRoutineEcuTempCalibration, ecu-extract-reference=TopLevelCompositionPrototype.Dcm.RoutineServices_DcmDspRoutineEcuTempCalibration
      RoutineServices_DcmDspRoutineAccAngleOffsetCalibration_717: upstream-reference=Geltungsbereich_MQBw_Baseline.Dcm.RoutineServices_DcmDspRoutineAccAngleOffsetCalibration, ecu-extract-reference=TopLevelCompositionPrototype.Dcm.RoutineServices_DcmDspRoutineAccAngleOffsetCalibration
      RoutineServices_DcmDspRoutineRoutineCheckProgrammingPreconditions_718: upstream-reference=Geltungsbereich_MQBw_Baseline.Dcm.RoutineServices_DcmDspRoutineRoutineCheckProgrammingPreconditions, ecu-extract-reference=TopLevelCompositionPrototype.Dcm.RoutineServices_DcmDspRoutineRoutineCheckProgrammingPreconditions
      CallBackDCMRequestServices_CBReqServInd_1_719: upstream-reference=Geltungsbereich_MQBw_Baseline.Dcm.CallBackDCMRequestServices_CBReqServInd_1, ecu-extract-reference=TopLevelCompositionPrototype.Dcm.CallBackDCMRequestServices_CBReqServInd_1
      Dem_720: upstream-reference=Geltungsbereich_MQBw_Baseline.Dem, ecu-extract-reference=TopLevelCompositionPrototype.Dem
      ASR42_EvtInfo_EVENT_CANSM_E_BUS_OFF_721: upstream-reference=Geltungsbereich_MQBw_Baseline.Dem.ASR42_EvtInfo_EVENT_CANSM_E_BUS_OFF, ecu-extract-reference=TopLevelCompositionPrototype.Dem.ASR42_EvtInfo_EVENT_CANSM_E_BUS_OFF
      ASR42_Event_EVENT_ADC_OUT_OF_ORDER_722: upstream-reference=Geltungsbereich_MQBw_Baseline.Dem.ASR42_Event_EVENT_ADC_OUT_OF_ORDER, ecu-extract-reference=TopLevelCompositionPrototype.Dem.ASR42_Event_EVENT_ADC_OUT_OF_ORDER
      ASR42_EvtInfo_EVENT_ADC_OUT_OF_ORDER_723: upstream-reference=Geltungsbereich_MQBw_Baseline.Dem.ASR42_EvtInfo_EVENT_ADC_OUT_OF_ORDER, ecu-extract-reference=TopLevelCompositionPrototype.Dem.ASR42_EvtInfo_EVENT_ADC_OUT_OF_ORDER
      ASR42_Event_EVENT_WARM_RESET_724: upstream-reference=Geltungsbereich_MQBw_Baseline.Dem.ASR42_Event_EVENT_WARM_RESET, ecu-extract-reference=TopLevelCompositionPrototype.Dem.ASR42_Event_EVENT_WARM_RESET
      ASR42_EvtInfo_EVENT_WARM_RESET_725: upstream-reference=Geltungsbereich_MQBw_Baseline.Dem.ASR42_EvtInfo_EVENT_WARM_RESET, ecu-extract-reference=TopLevelCompositionPrototype.Dem.ASR42_EvtInfo_EVENT_WARM_RESET
      ASR42_Event_EVENT_PFLASH_MEM_CORRUPT_726: upstream-reference=Geltungsbereich_MQBw_Baseline.Dem.ASR42_Event_EVENT_PFLASH_MEM_CORRUPT, ecu-extract-reference=TopLevelCompositionPrototype.Dem.ASR42_Event_EVENT_PFLASH_MEM_CORRUPT
      ASR42_EvtInfo_EVENT_PFLASH_MEM_CORRUPT_727: upstream-reference=Geltungsbereich_MQBw_Baseline.Dem.ASR42_EvtInfo_EVENT_PFLASH_MEM_CORRUPT, ecu-extract-reference=TopLevelCompositionPrototype.Dem.ASR42_EvtInfo_EVENT_PFLASH_MEM_CORRUPT
      ASR42_Event_EVENT_EXT_WDG_OUT_OF_ORDER_728: upstream-reference=Geltungsbereich_MQBw_Baseline.Dem.ASR42_Event_EVENT_EXT_WDG_OUT_OF_ORDER, ecu-extract-reference=TopLevelCompositionPrototype.Dem.ASR42_Event_EVENT_EXT_WDG_OUT_OF_ORDER
      ASR42_EvtInfo_EVENT_EXT_WDG_OUT_OF_ORDER_729: upstream-reference=Geltungsbereich_MQBw_Baseline.Dem.ASR42_EvtInfo_EVENT_EXT_WDG_OUT_OF_ORDER, ecu-extract-reference=TopLevelCompositionPrototype.Dem.ASR42_EvtInfo_EVENT_EXT_WDG_OUT_OF_ORDER
      ASR42_Event_EVENT_NVM_NOT_PRG_730: upstream-reference=Geltungsbereich_MQBw_Baseline.Dem.ASR42_Event_EVENT_NVM_NOT_PRG, ecu-extract-reference=TopLevelCompositionPrototype.Dem.ASR42_Event_EVENT_NVM_NOT_PRG
      ASR42_EvtInfo_EVENT_NVM_NOT_PRG_731: upstream-reference=Geltungsbereich_MQBw_Baseline.Dem.ASR42_EvtInfo_EVENT_NVM_NOT_PRG, ecu-extract-reference=TopLevelCompositionPrototype.Dem.ASR42_EvtInfo_EVENT_NVM_NOT_PRG
      ASR42_Event_EVENT_RAM_MEM_CORRUPT_732: upstream-reference=Geltungsbereich_MQBw_Baseline.Dem.ASR42_Event_EVENT_RAM_MEM_CORRUPT, ecu-extract-reference=TopLevelCompositionPrototype.Dem.ASR42_Event_EVENT_RAM_MEM_CORRUPT
      ASR42_EvtInfo_EVENT_RAM_MEM_CORRUPT_733: upstream-reference=Geltungsbereich_MQBw_Baseline.Dem.ASR42_EvtInfo_EVENT_RAM_MEM_CORRUPT, ecu-extract-reference=TopLevelCompositionPrototype.Dem.ASR42_EvtInfo_EVENT_RAM_MEM_CORRUPT
      ASR42_Event_EVENT_ADC_CALIB_734: upstream-reference=Geltungsbereich_MQBw_Baseline.Dem.ASR42_Event_EVENT_ADC_CALIB, ecu-extract-reference=TopLevelCompositionPrototype.Dem.ASR42_Event_EVENT_ADC_CALIB
      ASR42_EvtInfo_EVENT_ADC_CALIB_735: upstream-reference=Geltungsbereich_MQBw_Baseline.Dem.ASR42_EvtInfo_EVENT_ADC_CALIB, ecu-extract-reference=TopLevelCompositionPrototype.Dem.ASR42_EvtInfo_EVENT_ADC_CALIB
      ASR42_Event_EVENT_ECU_OVER_TEMPERATURE_736: upstream-reference=Geltungsbereich_MQBw_Baseline.Dem.ASR42_Event_EVENT_ECU_OVER_TEMPERATURE, ecu-extract-reference=TopLevelCompositionPrototype.Dem.ASR42_Event_EVENT_ECU_OVER_TEMPERATURE
      ASR42_EvtInfo_EVENT_ECU_OVER_TEMPERATURE_737: upstream-reference=Geltungsbereich_MQBw_Baseline.Dem.ASR42_EvtInfo_EVENT_ECU_OVER_TEMPERATURE, ecu-extract-reference=TopLevelCompositionPrototype.Dem.ASR42_EvtInfo_EVENT_ECU_OVER_TEMPERATURE
      ASR42_Event_EVENT_DFLASH_MEM_CORRUPT_738: upstream-reference=Geltungsbereich_MQBw_Baseline.Dem.ASR42_Event_EVENT_DFLASH_MEM_CORRUPT, ecu-extract-reference=TopLevelCompositionPrototype.Dem.ASR42_Event_EVENT_DFLASH_MEM_CORRUPT
      ASR42_EvtInfo_EVENT_DFLASH_MEM_CORRUPT_739: upstream-reference=Geltungsbereich_MQBw_Baseline.Dem.ASR42_EvtInfo_EVENT_DFLASH_MEM_CORRUPT, ecu-extract-reference=TopLevelCompositionPrototype.Dem.ASR42_EvtInfo_EVENT_DFLASH_MEM_CORRUPT
      ASR42_Event_EVENT_SBC_STATUS_FAILURE_740: upstream-reference=Geltungsbereich_MQBw_Baseline.Dem.ASR42_Event_EVENT_SBC_STATUS_FAILURE, ecu-extract-reference=TopLevelCompositionPrototype.Dem.ASR42_Event_EVENT_SBC_STATUS_FAILURE
      ASR42_EvtInfo_EVENT_SBC_STATUS_FAILURE_741: upstream-reference=Geltungsbereich_MQBw_Baseline.Dem.ASR42_EvtInfo_EVENT_SBC_STATUS_FAILURE, ecu-extract-reference=TopLevelCompositionPrototype.Dem.ASR42_EvtInfo_EVENT_SBC_STATUS_FAILURE
      ASR42_Event_EVENT_POWER_SUPPLY_OV_742: upstream-reference=Geltungsbereich_MQBw_Baseline.Dem.ASR42_Event_EVENT_POWER_SUPPLY_OV, ecu-extract-reference=TopLevelCompositionPrototype.Dem.ASR42_Event_EVENT_POWER_SUPPLY_OV
      ASR42_EvtInfo_EVENT_POWER_SUPPLY_OV_743: upstream-reference=Geltungsbereich_MQBw_Baseline.Dem.ASR42_EvtInfo_EVENT_POWER_SUPPLY_OV, ecu-extract-reference=TopLevelCompositionPrototype.Dem.ASR42_EvtInfo_EVENT_POWER_SUPPLY_OV
      ASR42_Event_EVENT_POWER_SUPPLY_UV_744: upstream-reference=Geltungsbereich_MQBw_Baseline.Dem.ASR42_Event_EVENT_POWER_SUPPLY_UV, ecu-extract-reference=TopLevelCompositionPrototype.Dem.ASR42_Event_EVENT_POWER_SUPPLY_UV
      ASR42_EvtInfo_EVENT_POWER_SUPPLY_UV_745: upstream-reference=Geltungsbereich_MQBw_Baseline.Dem.ASR42_EvtInfo_EVENT_POWER_SUPPLY_UV, ecu-extract-reference=TopLevelCompositionPrototype.Dem.ASR42_EvtInfo_EVENT_POWER_SUPPLY_UV
      ASR42_Event_EVENT_ACTUATOR_STATUS_746: upstream-reference=Geltungsbereich_MQBw_Baseline.Dem.ASR42_Event_EVENT_ACTUATOR_STATUS, ecu-extract-reference=TopLevelCompositionPrototype.Dem.ASR42_Event_EVENT_ACTUATOR_STATUS
      ASR42_EvtInfo_EVENT_ACTUATOR_STATUS_747: upstream-reference=Geltungsbereich_MQBw_Baseline.Dem.ASR42_EvtInfo_EVENT_ACTUATOR_STATUS, ecu-extract-reference=TopLevelCompositionPrototype.Dem.ASR42_EvtInfo_EVENT_ACTUATOR_STATUS
      ASR42_Event_EVENT_MCU_SELFTEST_748: upstream-reference=Geltungsbereich_MQBw_Baseline.Dem.ASR42_Event_EVENT_MCU_SELFTEST, ecu-extract-reference=TopLevelCompositionPrototype.Dem.ASR42_Event_EVENT_MCU_SELFTEST
      ASR42_EvtInfo_EVENT_MCU_SELFTEST_749: upstream-reference=Geltungsbereich_MQBw_Baseline.Dem.ASR42_EvtInfo_EVENT_MCU_SELFTEST, ecu-extract-reference=TopLevelCompositionPrototype.Dem.ASR42_EvtInfo_EVENT_MCU_SELFTEST
      ASR42_Event_EVENT_ACTUATOR_OPEN_CIRCUIT_750: upstream-reference=Geltungsbereich_MQBw_Baseline.Dem.ASR42_Event_EVENT_ACTUATOR_OPEN_CIRCUIT, ecu-extract-reference=TopLevelCompositionPrototype.Dem.ASR42_Event_EVENT_ACTUATOR_OPEN_CIRCUIT
      ASR42_EvtInfo_EVENT_ACTUATOR_OPEN_CIRCUIT_751: upstream-reference=Geltungsbereich_MQBw_Baseline.Dem.ASR42_EvtInfo_EVENT_ACTUATOR_OPEN_CIRCUIT, ecu-extract-reference=TopLevelCompositionPrototype.Dem.ASR42_EvtInfo_EVENT_ACTUATOR_OPEN_CIRCUIT
      ASR42_Event_EVENT_ACTUATOR_SHORT_TO_GND_752: upstream-reference=Geltungsbereich_MQBw_Baseline.Dem.ASR42_Event_EVENT_ACTUATOR_SHORT_TO_GND, ecu-extract-reference=TopLevelCompositionPrototype.Dem.ASR42_Event_EVENT_ACTUATOR_SHORT_TO_GND
      ASR42_EvtInfo_EVENT_ACTUATOR_SHORT_TO_GND_753: upstream-reference=Geltungsbereich_MQBw_Baseline.Dem.ASR42_EvtInfo_EVENT_ACTUATOR_SHORT_TO_GND, ecu-extract-reference=TopLevelCompositionPrototype.Dem.ASR42_EvtInfo_EVENT_ACTUATOR_SHORT_TO_GND
      ASR42_Event_EVENT_ACTUATOR_SHORT_TO_VBAT_754: upstream-reference=Geltungsbereich_MQBw_Baseline.Dem.ASR42_Event_EVENT_ACTUATOR_SHORT_TO_VBAT, ecu-extract-reference=TopLevelCompositionPrototype.Dem.ASR42_Event_EVENT_ACTUATOR_SHORT_TO_VBAT
      ASR42_EvtInfo_EVENT_ACTUATOR_SHORT_TO_VBAT_755: upstream-reference=Geltungsbereich_MQBw_Baseline.Dem.ASR42_EvtInfo_EVENT_ACTUATOR_SHORT_TO_VBAT, ecu-extract-reference=TopLevelCompositionPrototype.Dem.ASR42_EvtInfo_EVENT_ACTUATOR_SHORT_TO_VBAT
      ASR42_Event_EVENT_ACC_STATUS_FAILURE_756: upstream-reference=Geltungsbereich_MQBw_Baseline.Dem.ASR42_Event_EVENT_ACC_STATUS_FAILURE, ecu-extract-reference=TopLevelCompositionPrototype.Dem.ASR42_Event_EVENT_ACC_STATUS_FAILURE
      ASR42_EvtInfo_EVENT_ACC_STATUS_FAILURE_757: upstream-reference=Geltungsbereich_MQBw_Baseline.Dem.ASR42_EvtInfo_EVENT_ACC_STATUS_FAILURE, ecu-extract-reference=TopLevelCompositionPrototype.Dem.ASR42_EvtInfo_EVENT_ACC_STATUS_FAILURE
      ASR42_EvtInfo_EVENT_SPI_E_HW_ERROR_758: upstream-reference=Geltungsbereich_MQBw_Baseline.Dem.ASR42_EvtInfo_EVENT_SPI_E_HW_ERROR, ecu-extract-reference=TopLevelCompositionPrototype.Dem.ASR42_EvtInfo_EVENT_SPI_E_HW_ERROR
      ASR42_Event_EVENT_SOLENOID_OVERVOLTAGE_759: upstream-reference=Geltungsbereich_MQBw_Baseline.Dem.ASR42_Event_EVENT_SOLENOID_OVERVOLTAGE, ecu-extract-reference=TopLevelCompositionPrototype.Dem.ASR42_Event_EVENT_SOLENOID_OVERVOLTAGE
      ASR42_EvtInfo_EVENT_SOLENOID_OVERVOLTAGE_760: upstream-reference=Geltungsbereich_MQBw_Baseline.Dem.ASR42_EvtInfo_EVENT_SOLENOID_OVERVOLTAGE, ecu-extract-reference=TopLevelCompositionPrototype.Dem.ASR42_EvtInfo_EVENT_SOLENOID_OVERVOLTAGE
      ASR42_Event_EVENT_POWER_STAGE_FAILIURE_761: upstream-reference=Geltungsbereich_MQBw_Baseline.Dem.ASR42_Event_EVENT_POWER_STAGE_FAILIURE, ecu-extract-reference=TopLevelCompositionPrototype.Dem.ASR42_Event_EVENT_POWER_STAGE_FAILIURE
      ASR42_EvtInfo_EVENT_POWER_STAGE_FAILIURE_762: upstream-reference=Geltungsbereich_MQBw_Baseline.Dem.ASR42_EvtInfo_EVENT_POWER_STAGE_FAILIURE, ecu-extract-reference=TopLevelCompositionPrototype.Dem.ASR42_EvtInfo_EVENT_POWER_STAGE_FAILIURE
      ASR42_Event_EVENT_MCU_CRC_REGISTERS_763: upstream-reference=Geltungsbereich_MQBw_Baseline.Dem.ASR42_Event_EVENT_MCU_CRC_REGISTERS, ecu-extract-reference=TopLevelCompositionPrototype.Dem.ASR42_Event_EVENT_MCU_CRC_REGISTERS
      ASR42_EvtInfo_EVENT_MCU_CRC_REGISTERS_764: upstream-reference=Geltungsbereich_MQBw_Baseline.Dem.ASR42_EvtInfo_EVENT_MCU_CRC_REGISTERS, ecu-extract-reference=TopLevelCompositionPrototype.Dem.ASR42_EvtInfo_EVENT_MCU_CRC_REGISTERS
      ASR42_GeneralEvtInfo_765: upstream-reference=Geltungsbereich_MQBw_Baseline.Dem.ASR42_GeneralEvtInfo, ecu-extract-reference=TopLevelCompositionPrototype.Dem.ASR42_GeneralEvtInfo
      ASR42_OpCycle_DEM_OPCYC_POWER_766: upstream-reference=Geltungsbereich_MQBw_Baseline.Dem.ASR42_OpCycle_DEM_OPCYC_POWER, ecu-extract-reference=TopLevelCompositionPrototype.Dem.ASR42_OpCycle_DEM_OPCYC_POWER
      ASR42_OverflowIndPrimaryMemory_767: upstream-reference=Geltungsbereich_MQBw_Baseline.Dem.ASR42_OverflowIndPrimaryMemory, ecu-extract-reference=TopLevelCompositionPrototype.Dem.ASR42_OverflowIndPrimaryMemory
      EvtInfo_EVENT_CANSM_E_BUS_OFF_768: upstream-reference=Geltungsbereich_MQBw_Baseline.Dem.EvtInfo_EVENT_CANSM_E_BUS_OFF, ecu-extract-reference=TopLevelCompositionPrototype.Dem.EvtInfo_EVENT_CANSM_E_BUS_OFF
      Event_EVENT_ADC_OUT_OF_ORDER_769: upstream-reference=Geltungsbereich_MQBw_Baseline.Dem.Event_EVENT_ADC_OUT_OF_ORDER, ecu-extract-reference=TopLevelCompositionPrototype.Dem.Event_EVENT_ADC_OUT_OF_ORDER
      EvtInfo_EVENT_ADC_OUT_OF_ORDER_770: upstream-reference=Geltungsbereich_MQBw_Baseline.Dem.EvtInfo_EVENT_ADC_OUT_OF_ORDER, ecu-extract-reference=TopLevelCompositionPrototype.Dem.EvtInfo_EVENT_ADC_OUT_OF_ORDER
      Event_EVENT_WARM_RESET_771: upstream-reference=Geltungsbereich_MQBw_Baseline.Dem.Event_EVENT_WARM_RESET, ecu-extract-reference=TopLevelCompositionPrototype.Dem.Event_EVENT_WARM_RESET
      EvtInfo_EVENT_WARM_RESET_772: upstream-reference=Geltungsbereich_MQBw_Baseline.Dem.EvtInfo_EVENT_WARM_RESET, ecu-extract-reference=TopLevelCompositionPrototype.Dem.EvtInfo_EVENT_WARM_RESET
      Event_EVENT_PFLASH_MEM_CORRUPT_773: upstream-reference=Geltungsbereich_MQBw_Baseline.Dem.Event_EVENT_PFLASH_MEM_CORRUPT, ecu-extract-reference=TopLevelCompositionPrototype.Dem.Event_EVENT_PFLASH_MEM_CORRUPT
      EvtInfo_EVENT_PFLASH_MEM_CORRUPT_774: upstream-reference=Geltungsbereich_MQBw_Baseline.Dem.EvtInfo_EVENT_PFLASH_MEM_CORRUPT, ecu-extract-reference=TopLevelCompositionPrototype.Dem.EvtInfo_EVENT_PFLASH_MEM_CORRUPT
      Event_EVENT_EXT_WDG_OUT_OF_ORDER_775: upstream-reference=Geltungsbereich_MQBw_Baseline.Dem.Event_EVENT_EXT_WDG_OUT_OF_ORDER, ecu-extract-reference=TopLevelCompositionPrototype.Dem.Event_EVENT_EXT_WDG_OUT_OF_ORDER
      EvtInfo_EVENT_EXT_WDG_OUT_OF_ORDER_776: upstream-reference=Geltungsbereich_MQBw_Baseline.Dem.EvtInfo_EVENT_EXT_WDG_OUT_OF_ORDER, ecu-extract-reference=TopLevelCompositionPrototype.Dem.EvtInfo_EVENT_EXT_WDG_OUT_OF_ORDER
      Event_EVENT_NVM_NOT_PRG_777: upstream-reference=Geltungsbereich_MQBw_Baseline.Dem.Event_EVENT_NVM_NOT_PRG, ecu-extract-reference=TopLevelCompositionPrototype.Dem.Event_EVENT_NVM_NOT_PRG
      EvtInfo_EVENT_NVM_NOT_PRG_778: upstream-reference=Geltungsbereich_MQBw_Baseline.Dem.EvtInfo_EVENT_NVM_NOT_PRG, ecu-extract-reference=TopLevelCompositionPrototype.Dem.EvtInfo_EVENT_NVM_NOT_PRG
      Event_EVENT_RAM_MEM_CORRUPT_779: upstream-reference=Geltungsbereich_MQBw_Baseline.Dem.Event_EVENT_RAM_MEM_CORRUPT, ecu-extract-reference=TopLevelCompositionPrototype.Dem.Event_EVENT_RAM_MEM_CORRUPT
      EvtInfo_EVENT_RAM_MEM_CORRUPT_780: upstream-reference=Geltungsbereich_MQBw_Baseline.Dem.EvtInfo_EVENT_RAM_MEM_CORRUPT, ecu-extract-reference=TopLevelCompositionPrototype.Dem.EvtInfo_EVENT_RAM_MEM_CORRUPT
      Event_EVENT_ADC_CALIB_781: upstream-reference=Geltungsbereich_MQBw_Baseline.Dem.Event_EVENT_ADC_CALIB, ecu-extract-reference=TopLevelCompositionPrototype.Dem.Event_EVENT_ADC_CALIB
      EvtInfo_EVENT_ADC_CALIB_782: upstream-reference=Geltungsbereich_MQBw_Baseline.Dem.EvtInfo_EVENT_ADC_CALIB, ecu-extract-reference=TopLevelCompositionPrototype.Dem.EvtInfo_EVENT_ADC_CALIB
      Event_EVENT_ECU_OVER_TEMPERATURE_783: upstream-reference=Geltungsbereich_MQBw_Baseline.Dem.Event_EVENT_ECU_OVER_TEMPERATURE, ecu-extract-reference=TopLevelCompositionPrototype.Dem.Event_EVENT_ECU_OVER_TEMPERATURE
      EvtInfo_EVENT_ECU_OVER_TEMPERATURE_784: upstream-reference=Geltungsbereich_MQBw_Baseline.Dem.EvtInfo_EVENT_ECU_OVER_TEMPERATURE, ecu-extract-reference=TopLevelCompositionPrototype.Dem.EvtInfo_EVENT_ECU_OVER_TEMPERATURE
      Event_EVENT_DFLASH_MEM_CORRUPT_785: upstream-reference=Geltungsbereich_MQBw_Baseline.Dem.Event_EVENT_DFLASH_MEM_CORRUPT, ecu-extract-reference=TopLevelCompositionPrototype.Dem.Event_EVENT_DFLASH_MEM_CORRUPT
      EvtInfo_EVENT_DFLASH_MEM_CORRUPT_786: upstream-reference=Geltungsbereich_MQBw_Baseline.Dem.EvtInfo_EVENT_DFLASH_MEM_CORRUPT, ecu-extract-reference=TopLevelCompositionPrototype.Dem.EvtInfo_EVENT_DFLASH_MEM_CORRUPT
      Event_EVENT_SBC_STATUS_FAILURE_787: upstream-reference=Geltungsbereich_MQBw_Baseline.Dem.Event_EVENT_SBC_STATUS_FAILURE, ecu-extract-reference=TopLevelCompositionPrototype.Dem.Event_EVENT_SBC_STATUS_FAILURE
      EvtInfo_EVENT_SBC_STATUS_FAILURE_788: upstream-reference=Geltungsbereich_MQBw_Baseline.Dem.EvtInfo_EVENT_SBC_STATUS_FAILURE, ecu-extract-reference=TopLevelCompositionPrototype.Dem.EvtInfo_EVENT_SBC_STATUS_FAILURE
      Event_EVENT_POWER_SUPPLY_OV_789: upstream-reference=Geltungsbereich_MQBw_Baseline.Dem.Event_EVENT_POWER_SUPPLY_OV, ecu-extract-reference=TopLevelCompositionPrototype.Dem.Event_EVENT_POWER_SUPPLY_OV
      EvtInfo_EVENT_POWER_SUPPLY_OV_790: upstream-reference=Geltungsbereich_MQBw_Baseline.Dem.EvtInfo_EVENT_POWER_SUPPLY_OV, ecu-extract-reference=TopLevelCompositionPrototype.Dem.EvtInfo_EVENT_POWER_SUPPLY_OV
      Event_EVENT_POWER_SUPPLY_UV_791: upstream-reference=Geltungsbereich_MQBw_Baseline.Dem.Event_EVENT_POWER_SUPPLY_UV, ecu-extract-reference=TopLevelCompositionPrototype.Dem.Event_EVENT_POWER_SUPPLY_UV
      EvtInfo_EVENT_POWER_SUPPLY_UV_792: upstream-reference=Geltungsbereich_MQBw_Baseline.Dem.EvtInfo_EVENT_POWER_SUPPLY_UV, ecu-extract-reference=TopLevelCompositionPrototype.Dem.EvtInfo_EVENT_POWER_SUPPLY_UV
      Event_EVENT_ACTUATOR_STATUS_793: upstream-reference=Geltungsbereich_MQBw_Baseline.Dem.Event_EVENT_ACTUATOR_STATUS, ecu-extract-reference=TopLevelCompositionPrototype.Dem.Event_EVENT_ACTUATOR_STATUS
      EvtInfo_EVENT_ACTUATOR_STATUS_794: upstream-reference=Geltungsbereich_MQBw_Baseline.Dem.EvtInfo_EVENT_ACTUATOR_STATUS, ecu-extract-reference=TopLevelCompositionPrototype.Dem.EvtInfo_EVENT_ACTUATOR_STATUS
      Event_EVENT_MCU_SELFTEST_795: upstream-reference=Geltungsbereich_MQBw_Baseline.Dem.Event_EVENT_MCU_SELFTEST, ecu-extract-reference=TopLevelCompositionPrototype.Dem.Event_EVENT_MCU_SELFTEST
      EvtInfo_EVENT_MCU_SELFTEST_796: upstream-reference=Geltungsbereich_MQBw_Baseline.Dem.EvtInfo_EVENT_MCU_SELFTEST, ecu-extract-reference=TopLevelCompositionPrototype.Dem.EvtInfo_EVENT_MCU_SELFTEST
      Event_EVENT_ACTUATOR_OPEN_CIRCUIT_797: upstream-reference=Geltungsbereich_MQBw_Baseline.Dem.Event_EVENT_ACTUATOR_OPEN_CIRCUIT, ecu-extract-reference=TopLevelCompositionPrototype.Dem.Event_EVENT_ACTUATOR_OPEN_CIRCUIT
      EvtInfo_EVENT_ACTUATOR_OPEN_CIRCUIT_798: upstream-reference=Geltungsbereich_MQBw_Baseline.Dem.EvtInfo_EVENT_ACTUATOR_OPEN_CIRCUIT, ecu-extract-reference=TopLevelCompositionPrototype.Dem.EvtInfo_EVENT_ACTUATOR_OPEN_CIRCUIT
      Event_EVENT_ACTUATOR_SHORT_TO_GND_799: upstream-reference=Geltungsbereich_MQBw_Baseline.Dem.Event_EVENT_ACTUATOR_SHORT_TO_GND, ecu-extract-reference=TopLevelCompositionPrototype.Dem.Event_EVENT_ACTUATOR_SHORT_TO_GND
      EvtInfo_EVENT_ACTUATOR_SHORT_TO_GND_800: upstream-reference=Geltungsbereich_MQBw_Baseline.Dem.EvtInfo_EVENT_ACTUATOR_SHORT_TO_GND, ecu-extract-reference=TopLevelCompositionPrototype.Dem.EvtInfo_EVENT_ACTUATOR_SHORT_TO_GND
      Event_EVENT_ACTUATOR_SHORT_TO_VBAT_801: upstream-reference=Geltungsbereich_MQBw_Baseline.Dem.Event_EVENT_ACTUATOR_SHORT_TO_VBAT, ecu-extract-reference=TopLevelCompositionPrototype.Dem.Event_EVENT_ACTUATOR_SHORT_TO_VBAT
      EvtInfo_EVENT_ACTUATOR_SHORT_TO_VBAT_802: upstream-reference=Geltungsbereich_MQBw_Baseline.Dem.EvtInfo_EVENT_ACTUATOR_SHORT_TO_VBAT, ecu-extract-reference=TopLevelCompositionPrototype.Dem.EvtInfo_EVENT_ACTUATOR_SHORT_TO_VBAT
      Event_EVENT_ACC_STATUS_FAILURE_803: upstream-reference=Geltungsbereich_MQBw_Baseline.Dem.Event_EVENT_ACC_STATUS_FAILURE, ecu-extract-reference=TopLevelCompositionPrototype.Dem.Event_EVENT_ACC_STATUS_FAILURE
      EvtInfo_EVENT_ACC_STATUS_FAILURE_804: upstream-reference=Geltungsbereich_MQBw_Baseline.Dem.EvtInfo_EVENT_ACC_STATUS_FAILURE, ecu-extract-reference=TopLevelCompositionPrototype.Dem.EvtInfo_EVENT_ACC_STATUS_FAILURE
      EvtInfo_EVENT_SPI_E_HW_ERROR_805: upstream-reference=Geltungsbereich_MQBw_Baseline.Dem.EvtInfo_EVENT_SPI_E_HW_ERROR, ecu-extract-reference=TopLevelCompositionPrototype.Dem.EvtInfo_EVENT_SPI_E_HW_ERROR
      Event_EVENT_SOLENOID_OVERVOLTAGE_806: upstream-reference=Geltungsbereich_MQBw_Baseline.Dem.Event_EVENT_SOLENOID_OVERVOLTAGE, ecu-extract-reference=TopLevelCompositionPrototype.Dem.Event_EVENT_SOLENOID_OVERVOLTAGE
      EvtInfo_EVENT_SOLENOID_OVERVOLTAGE_807: upstream-reference=Geltungsbereich_MQBw_Baseline.Dem.EvtInfo_EVENT_SOLENOID_OVERVOLTAGE, ecu-extract-reference=TopLevelCompositionPrototype.Dem.EvtInfo_EVENT_SOLENOID_OVERVOLTAGE
      Event_EVENT_POWER_STAGE_FAILIURE_808: upstream-reference=Geltungsbereich_MQBw_Baseline.Dem.Event_EVENT_POWER_STAGE_FAILIURE, ecu-extract-reference=TopLevelCompositionPrototype.Dem.Event_EVENT_POWER_STAGE_FAILIURE
      EvtInfo_EVENT_POWER_STAGE_FAILIURE_809: upstream-reference=Geltungsbereich_MQBw_Baseline.Dem.EvtInfo_EVENT_POWER_STAGE_FAILIURE, ecu-extract-reference=TopLevelCompositionPrototype.Dem.EvtInfo_EVENT_POWER_STAGE_FAILIURE
      Event_EVENT_MCU_CRC_REGISTERS_810: upstream-reference=Geltungsbereich_MQBw_Baseline.Dem.Event_EVENT_MCU_CRC_REGISTERS, ecu-extract-reference=TopLevelCompositionPrototype.Dem.Event_EVENT_MCU_CRC_REGISTERS
      EvtInfo_EVENT_MCU_CRC_REGISTERS_811: upstream-reference=Geltungsbereich_MQBw_Baseline.Dem.EvtInfo_EVENT_MCU_CRC_REGISTERS, ecu-extract-reference=TopLevelCompositionPrototype.Dem.EvtInfo_EVENT_MCU_CRC_REGISTERS
      GeneralEvtInfo_812: upstream-reference=Geltungsbereich_MQBw_Baseline.Dem.GeneralEvtInfo, ecu-extract-reference=TopLevelCompositionPrototype.Dem.GeneralEvtInfo
      OpCycle_DEM_OPCYC_POWER_813: upstream-reference=Geltungsbereich_MQBw_Baseline.Dem.OpCycle_DEM_OPCYC_POWER, ecu-extract-reference=TopLevelCompositionPrototype.Dem.OpCycle_DEM_OPCYC_POWER
      OverflowIndPrimaryMemory_814: upstream-reference=Geltungsbereich_MQBw_Baseline.Dem.OverflowIndPrimaryMemory, ecu-extract-reference=TopLevelCompositionPrototype.Dem.OverflowIndPrimaryMemory
      CddIf_815: upstream-reference=Geltungsbereich_MQBw_Baseline.Dem.CddIf, ecu-extract-reference=TopLevelCompositionPrototype.Dem.CddIf
      NvM_816: upstream-reference=Geltungsbereich_MQBw_Baseline.NvM, ecu-extract-reference=TopLevelCompositionPrototype.NvM
      PS_ASR42_NVM_BLOCK_DEM_DEFAULT_817: upstream-reference=Geltungsbereich_MQBw_Baseline.NvM.PS_ASR42_NVM_BLOCK_DEM_DEFAULT, ecu-extract-reference=TopLevelCompositionPrototype.NvM.PS_ASR42_NVM_BLOCK_DEM_DEFAULT
      PS_ASR42_ECC_COUNTERS_818: upstream-reference=Geltungsbereich_MQBw_Baseline.NvM.PS_ASR42_ECC_COUNTERS, ecu-extract-reference=TopLevelCompositionPrototype.NvM.PS_ASR42_ECC_COUNTERS
      PS_ASR42_WARM_RESET_COUNTERS_819: upstream-reference=Geltungsbereich_MQBw_Baseline.NvM.PS_ASR42_WARM_RESET_COUNTERS, ecu-extract-reference=TopLevelCompositionPrototype.NvM.PS_ASR42_WARM_RESET_COUNTERS
      PS_ASR42_SOLENOID_UNLOCK_CONF_PARAM_820: upstream-reference=Geltungsbereich_MQBw_Baseline.NvM.PS_ASR42_SOLENOID_UNLOCK_CONF_PARAM, ecu-extract-reference=TopLevelCompositionPrototype.NvM.PS_ASR42_SOLENOID_UNLOCK_CONF_PARAM
      PS_ASR42_AUTOTEST_ENABLE_PARAM_821: upstream-reference=Geltungsbereich_MQBw_Baseline.NvM.PS_ASR42_AUTOTEST_ENABLE_PARAM, ecu-extract-reference=TopLevelCompositionPrototype.NvM.PS_ASR42_AUTOTEST_ENABLE_PARAM
      PS_ASR42_LOCK_UNLOCK_ECU_822: upstream-reference=Geltungsbereich_MQBw_Baseline.NvM.PS_ASR42_LOCK_UNLOCK_ECU, ecu-extract-reference=TopLevelCompositionPrototype.NvM.PS_ASR42_LOCK_UNLOCK_ECU
      PS_ASR42_MEASUREMENT_FRAME_CONFIG_823: upstream-reference=Geltungsbereich_MQBw_Baseline.NvM.PS_ASR42_MEASUREMENT_FRAME_CONFIG, ecu-extract-reference=TopLevelCompositionPrototype.NvM.PS_ASR42_MEASUREMENT_FRAME_CONFIG
      PS_ASR42_HW_PART_NUMBER_824: upstream-reference=Geltungsbereich_MQBw_Baseline.NvM.PS_ASR42_HW_PART_NUMBER, ecu-extract-reference=TopLevelCompositionPrototype.NvM.PS_ASR42_HW_PART_NUMBER
      PS_ASR42_AEE_TRACEABILITY_NUMBER_825: upstream-reference=Geltungsbereich_MQBw_Baseline.NvM.PS_ASR42_AEE_TRACEABILITY_NUMBER, ecu-extract-reference=TopLevelCompositionPrototype.NvM.PS_ASR42_AEE_TRACEABILITY_NUMBER
      PS_ASR42_ECU_ASSEMBLY_SERIAL_NUMBER_826: upstream-reference=Geltungsbereich_MQBw_Baseline.NvM.PS_ASR42_ECU_ASSEMBLY_SERIAL_NUMBER, ecu-extract-reference=TopLevelCompositionPrototype.NvM.PS_ASR42_ECU_ASSEMBLY_SERIAL_NUMBER
      PS_ASR42_PROCESS_MODE_827: upstream-reference=Geltungsbereich_MQBw_Baseline.NvM.PS_ASR42_PROCESS_MODE, ecu-extract-reference=TopLevelCompositionPrototype.NvM.PS_ASR42_PROCESS_MODE
      PS_ASR42_ECS_VARIANT_828: upstream-reference=Geltungsbereich_MQBw_Baseline.NvM.PS_ASR42_ECS_VARIANT, ecu-extract-reference=TopLevelCompositionPrototype.NvM.PS_ASR42_ECS_VARIANT
      PS_ASR42_RESERVED_1_829: upstream-reference=Geltungsbereich_MQBw_Baseline.NvM.PS_ASR42_RESERVED_1, ecu-extract-reference=TopLevelCompositionPrototype.NvM.PS_ASR42_RESERVED_1
      PS_ASR42_ECS_ACC_OFFSETS_830: upstream-reference=Geltungsbereich_MQBw_Baseline.NvM.PS_ASR42_ECS_ACC_OFFSETS, ecu-extract-reference=TopLevelCompositionPrototype.NvM.PS_ASR42_ECS_ACC_OFFSETS
      PS_ASR42_ECS_BUCKLE_CONFIG_831: upstream-reference=Geltungsbereich_MQBw_Baseline.NvM.PS_ASR42_ECS_BUCKLE_CONFIG, ecu-extract-reference=TopLevelCompositionPrototype.NvM.PS_ASR42_ECS_BUCKLE_CONFIG
      PS_ASR42_ECS_CODING_VARIANT_832: upstream-reference=Geltungsbereich_MQBw_Baseline.NvM.PS_ASR42_ECS_CODING_VARIANT, ecu-extract-reference=TopLevelCompositionPrototype.NvM.PS_ASR42_ECS_CODING_VARIANT
      PS_ASR42_ECS_ACC_LOWPASS_833: upstream-reference=Geltungsbereich_MQBw_Baseline.NvM.PS_ASR42_ECS_ACC_LOWPASS, ecu-extract-reference=TopLevelCompositionPrototype.NvM.PS_ASR42_ECS_ACC_LOWPASS
      PS_ASR42_SBS_LAST_STATE_834: upstream-reference=Geltungsbereich_MQBw_Baseline.NvM.PS_ASR42_SBS_LAST_STATE, ecu-extract-reference=TopLevelCompositionPrototype.NvM.PS_ASR42_SBS_LAST_STATE
      PS_ASR42_ECS_ALGO_OUTPUT_DELAY_835: upstream-reference=Geltungsbereich_MQBw_Baseline.NvM.PS_ASR42_ECS_ALGO_OUTPUT_DELAY, ecu-extract-reference=TopLevelCompositionPrototype.NvM.PS_ASR42_ECS_ALGO_OUTPUT_DELAY
      PS_ASR42_ECS_SENSITIVITY_LUT_836: upstream-reference=Geltungsbereich_MQBw_Baseline.NvM.PS_ASR42_ECS_SENSITIVITY_LUT, ecu-extract-reference=TopLevelCompositionPrototype.NvM.PS_ASR42_ECS_SENSITIVITY_LUT
      PS_ASR42_ECS_SENSITIVITY_OPT_837: upstream-reference=Geltungsbereich_MQBw_Baseline.NvM.PS_ASR42_ECS_SENSITIVITY_OPT, ecu-extract-reference=TopLevelCompositionPrototype.NvM.PS_ASR42_ECS_SENSITIVITY_OPT
      PS_ASR42_ECU_TEMP_CALIBRATION_838: upstream-reference=Geltungsbereich_MQBw_Baseline.NvM.PS_ASR42_ECU_TEMP_CALIBRATION, ecu-extract-reference=TopLevelCompositionPrototype.NvM.PS_ASR42_ECU_TEMP_CALIBRATION
      PS_ASR42_ALV_NVM_VERSION_839: upstream-reference=Geltungsbereich_MQBw_Baseline.NvM.PS_ASR42_ALV_NVM_VERSION, ecu-extract-reference=TopLevelCompositionPrototype.NvM.PS_ASR42_ALV_NVM_VERSION
      PS_ASR42_MEAS_FRAME_RAM_ADDR_CFG_840: upstream-reference=Geltungsbereich_MQBw_Baseline.NvM.PS_ASR42_MEAS_FRAME_RAM_ADDR_CFG, ecu-extract-reference=TopLevelCompositionPrototype.NvM.PS_ASR42_MEAS_FRAME_RAM_ADDR_CFG
      PS_ASR42_ACC_AXIS_ANGLE_CALIBRATION_841: upstream-reference=Geltungsbereich_MQBw_Baseline.NvM.PS_ASR42_ACC_AXIS_ANGLE_CALIBRATION, ecu-extract-reference=TopLevelCompositionPrototype.NvM.PS_ASR42_ACC_AXIS_ANGLE_CALIBRATION
      PS_ASR42_EOL_COUNTERS_842: upstream-reference=Geltungsbereich_MQBw_Baseline.NvM.PS_ASR42_EOL_COUNTERS, ecu-extract-reference=TopLevelCompositionPrototype.NvM.PS_ASR42_EOL_COUNTERS
      PS_ASR42_RESERVED_4_843: upstream-reference=Geltungsbereich_MQBw_Baseline.NvM.PS_ASR42_RESERVED_4, ecu-extract-reference=TopLevelCompositionPrototype.NvM.PS_ASR42_RESERVED_4
      PS_ASR42_AUTOTEST_PARAM_844: upstream-reference=Geltungsbereich_MQBw_Baseline.NvM.PS_ASR42_AUTOTEST_PARAM, ecu-extract-reference=TopLevelCompositionPrototype.NvM.PS_ASR42_AUTOTEST_PARAM
      PS_ASR42_PHYS_MEASUREMENTS_845: upstream-reference=Geltungsbereich_MQBw_Baseline.NvM.PS_ASR42_PHYS_MEASUREMENTS, ecu-extract-reference=TopLevelCompositionPrototype.NvM.PS_ASR42_PHYS_MEASUREMENTS
      PS_ASR42_SOLENOID_PARAM_846: upstream-reference=Geltungsbereich_MQBw_Baseline.NvM.PS_ASR42_SOLENOID_PARAM, ecu-extract-reference=TopLevelCompositionPrototype.NvM.PS_ASR42_SOLENOID_PARAM
      PS_ASR42_ECS_PROFILES_847: upstream-reference=Geltungsbereich_MQBw_Baseline.NvM.PS_ASR42_ECS_PROFILES, ecu-extract-reference=TopLevelCompositionPrototype.NvM.PS_ASR42_ECS_PROFILES
      PS_ASR42_ECU_STATE_TIMING_PARAMETERS_848: upstream-reference=Geltungsbereich_MQBw_Baseline.NvM.PS_ASR42_ECU_STATE_TIMING_PARAMETERS, ecu-extract-reference=TopLevelCompositionPrototype.NvM.PS_ASR42_ECU_STATE_TIMING_PARAMETERS
      PS_ASR42_SPARE_PART_NUMBER_849: upstream-reference=Geltungsbereich_MQBw_Baseline.NvM.PS_ASR42_SPARE_PART_NUMBER, ecu-extract-reference=TopLevelCompositionPrototype.NvM.PS_ASR42_SPARE_PART_NUMBER
      PS_ASR42_HARDWARE_NUMBER_850: upstream-reference=Geltungsbereich_MQBw_Baseline.NvM.PS_ASR42_HARDWARE_NUMBER, ecu-extract-reference=TopLevelCompositionPrototype.NvM.PS_ASR42_HARDWARE_NUMBER
      PS_ASR42_SYSTEM_NAME_OR_ENGINE_TYPE_851: upstream-reference=Geltungsbereich_MQBw_Baseline.NvM.PS_ASR42_SYSTEM_NAME_OR_ENGINE_TYPE, ecu-extract-reference=TopLevelCompositionPrototype.NvM.PS_ASR42_SYSTEM_NAME_OR_ENGINE_TYPE
      PS_ASR42_BLOCK_FBL_852: upstream-reference=Geltungsbereich_MQBw_Baseline.NvM.PS_ASR42_BLOCK_FBL, ecu-extract-reference=TopLevelCompositionPrototype.NvM.PS_ASR42_BLOCK_FBL
      PS_ASR42_ODX_FILE_IDENTIFIER_853: upstream-reference=Geltungsbereich_MQBw_Baseline.NvM.PS_ASR42_ODX_FILE_IDENTIFIER, ecu-extract-reference=TopLevelCompositionPrototype.NvM.PS_ASR42_ODX_FILE_IDENTIFIER
      PS_ASR42_ODX_FILE_VERSION_854: upstream-reference=Geltungsbereich_MQBw_Baseline.NvM.PS_ASR42_ODX_FILE_VERSION, ecu-extract-reference=TopLevelCompositionPrototype.NvM.PS_ASR42_ODX_FILE_VERSION
      PS_ASR42_ECU_SERIAL_NUMBER_855: upstream-reference=Geltungsbereich_MQBw_Baseline.NvM.PS_ASR42_ECU_SERIAL_NUMBER, ecu-extract-reference=TopLevelCompositionPrototype.NvM.PS_ASR42_ECU_SERIAL_NUMBER
      PS_ASR42_LOGICAL_SW_BLOCK_VERSION_856: upstream-reference=Geltungsbereich_MQBw_Baseline.NvM.PS_ASR42_LOGICAL_SW_BLOCK_VERSION, ecu-extract-reference=TopLevelCompositionPrototype.NvM.PS_ASR42_LOGICAL_SW_BLOCK_VERSION
      PS_ASR42_HARDWARE_VERSION_NUMBER_857: upstream-reference=Geltungsbereich_MQBw_Baseline.NvM.PS_ASR42_HARDWARE_VERSION_NUMBER, ecu-extract-reference=TopLevelCompositionPrototype.NvM.PS_ASR42_HARDWARE_VERSION_NUMBER
      PS_ASR42_APP_SOFTWARE_VERSION_NUMBER_858: upstream-reference=Geltungsbereich_MQBw_Baseline.NvM.PS_ASR42_APP_SOFTWARE_VERSION_NUMBER, ecu-extract-reference=TopLevelCompositionPrototype.NvM.PS_ASR42_APP_SOFTWARE_VERSION_NUMBER
      PS_ASR42_ECS_STEPS_859: upstream-reference=Geltungsbereich_MQBw_Baseline.NvM.PS_ASR42_ECS_STEPS, ecu-extract-reference=TopLevelCompositionPrototype.NvM.PS_ASR42_ECS_STEPS
      PS_ASR42_ECS_PARAMETERS_860: upstream-reference=Geltungsbereich_MQBw_Baseline.NvM.PS_ASR42_ECS_PARAMETERS, ecu-extract-reference=TopLevelCompositionPrototype.NvM.PS_ASR42_ECS_PARAMETERS
      PS_NVM_BLOCK_DEM_DEFAULT_861: upstream-reference=Geltungsbereich_MQBw_Baseline.NvM.PS_NVM_BLOCK_DEM_DEFAULT, ecu-extract-reference=TopLevelCompositionPrototype.NvM.PS_NVM_BLOCK_DEM_DEFAULT
      PS_ECC_COUNTERS_862: upstream-reference=Geltungsbereich_MQBw_Baseline.NvM.PS_ECC_COUNTERS, ecu-extract-reference=TopLevelCompositionPrototype.NvM.PS_ECC_COUNTERS
      PS_WARM_RESET_COUNTERS_863: upstream-reference=Geltungsbereich_MQBw_Baseline.NvM.PS_WARM_RESET_COUNTERS, ecu-extract-reference=TopLevelCompositionPrototype.NvM.PS_WARM_RESET_COUNTERS
      PS_SOLENOID_UNLOCK_CONF_PARAM_864: upstream-reference=Geltungsbereich_MQBw_Baseline.NvM.PS_SOLENOID_UNLOCK_CONF_PARAM, ecu-extract-reference=TopLevelCompositionPrototype.NvM.PS_SOLENOID_UNLOCK_CONF_PARAM
      PS_AUTOTEST_ENABLE_PARAM_865: upstream-reference=Geltungsbereich_MQBw_Baseline.NvM.PS_AUTOTEST_ENABLE_PARAM, ecu-extract-reference=TopLevelCompositionPrototype.NvM.PS_AUTOTEST_ENABLE_PARAM
      PS_LOCK_UNLOCK_ECU_866: upstream-reference=Geltungsbereich_MQBw_Baseline.NvM.PS_LOCK_UNLOCK_ECU, ecu-extract-reference=TopLevelCompositionPrototype.NvM.PS_LOCK_UNLOCK_ECU
      PS_MEASUREMENT_FRAME_CONFIG_867: upstream-reference=Geltungsbereich_MQBw_Baseline.NvM.PS_MEASUREMENT_FRAME_CONFIG, ecu-extract-reference=TopLevelCompositionPrototype.NvM.PS_MEASUREMENT_FRAME_CONFIG
      PS_HW_PART_NUMBER_868: upstream-reference=Geltungsbereich_MQBw_Baseline.NvM.PS_HW_PART_NUMBER, ecu-extract-reference=TopLevelCompositionPrototype.NvM.PS_HW_PART_NUMBER
      PS_AEE_TRACEABILITY_NUMBER_869: upstream-reference=Geltungsbereich_MQBw_Baseline.NvM.PS_AEE_TRACEABILITY_NUMBER, ecu-extract-reference=TopLevelCompositionPrototype.NvM.PS_AEE_TRACEABILITY_NUMBER
      PS_ECU_ASSEMBLY_SERIAL_NUMBER_870: upstream-reference=Geltungsbereich_MQBw_Baseline.NvM.PS_ECU_ASSEMBLY_SERIAL_NUMBER, ecu-extract-reference=TopLevelCompositionPrototype.NvM.PS_ECU_ASSEMBLY_SERIAL_NUMBER
      PS_PROCESS_MODE_871: upstream-reference=Geltungsbereich_MQBw_Baseline.NvM.PS_PROCESS_MODE, ecu-extract-reference=TopLevelCompositionPrototype.NvM.PS_PROCESS_MODE
      PS_ECS_VARIANT_872: upstream-reference=Geltungsbereich_MQBw_Baseline.NvM.PS_ECS_VARIANT, ecu-extract-reference=TopLevelCompositionPrototype.NvM.PS_ECS_VARIANT
      PS_RESERVED_1_873: upstream-reference=Geltungsbereich_MQBw_Baseline.NvM.PS_RESERVED_1, ecu-extract-reference=TopLevelCompositionPrototype.NvM.PS_RESERVED_1
      PS_ECS_ACC_OFFSETS_874: upstream-reference=Geltungsbereich_MQBw_Baseline.NvM.PS_ECS_ACC_OFFSETS, ecu-extract-reference=TopLevelCompositionPrototype.NvM.PS_ECS_ACC_OFFSETS
      PS_ECS_BUCKLE_CONFIG_875: upstream-reference=Geltungsbereich_MQBw_Baseline.NvM.PS_ECS_BUCKLE_CONFIG, ecu-extract-reference=TopLevelCompositionPrototype.NvM.PS_ECS_BUCKLE_CONFIG
      PS_ECS_CODING_VARIANT_876: upstream-reference=Geltungsbereich_MQBw_Baseline.NvM.PS_ECS_CODING_VARIANT, ecu-extract-reference=TopLevelCompositionPrototype.NvM.PS_ECS_CODING_VARIANT
      PS_ECS_ACC_LOWPASS_877: upstream-reference=Geltungsbereich_MQBw_Baseline.NvM.PS_ECS_ACC_LOWPASS, ecu-extract-reference=TopLevelCompositionPrototype.NvM.PS_ECS_ACC_LOWPASS
      PS_SBS_LAST_STATE_878: upstream-reference=Geltungsbereich_MQBw_Baseline.NvM.PS_SBS_LAST_STATE, ecu-extract-reference=TopLevelCompositionPrototype.NvM.PS_SBS_LAST_STATE
      PS_ECS_ALGO_OUTPUT_DELAY_879: upstream-reference=Geltungsbereich_MQBw_Baseline.NvM.PS_ECS_ALGO_OUTPUT_DELAY, ecu-extract-reference=TopLevelCompositionPrototype.NvM.PS_ECS_ALGO_OUTPUT_DELAY
      PS_ECS_SENSITIVITY_LUT_880: upstream-reference=Geltungsbereich_MQBw_Baseline.NvM.PS_ECS_SENSITIVITY_LUT, ecu-extract-reference=TopLevelCompositionPrototype.NvM.PS_ECS_SENSITIVITY_LUT
      PS_ECS_SENSITIVITY_OPT_881: upstream-reference=Geltungsbereich_MQBw_Baseline.NvM.PS_ECS_SENSITIVITY_OPT, ecu-extract-reference=TopLevelCompositionPrototype.NvM.PS_ECS_SENSITIVITY_OPT
      PS_ECU_TEMP_CALIBRATION_882: upstream-reference=Geltungsbereich_MQBw_Baseline.NvM.PS_ECU_TEMP_CALIBRATION, ecu-extract-reference=TopLevelCompositionPrototype.NvM.PS_ECU_TEMP_CALIBRATION
      PS_ALV_NVM_VERSION_883: upstream-reference=Geltungsbereich_MQBw_Baseline.NvM.PS_ALV_NVM_VERSION, ecu-extract-reference=TopLevelCompositionPrototype.NvM.PS_ALV_NVM_VERSION
      PS_MEAS_FRAME_RAM_ADDR_CFG_884: upstream-reference=Geltungsbereich_MQBw_Baseline.NvM.PS_MEAS_FRAME_RAM_ADDR_CFG, ecu-extract-reference=TopLevelCompositionPrototype.NvM.PS_MEAS_FRAME_RAM_ADDR_CFG
      PS_ACC_AXIS_ANGLE_CALIBRATION_885: upstream-reference=Geltungsbereich_MQBw_Baseline.NvM.PS_ACC_AXIS_ANGLE_CALIBRATION, ecu-extract-reference=TopLevelCompositionPrototype.NvM.PS_ACC_AXIS_ANGLE_CALIBRATION
      PS_EOL_COUNTERS_886: upstream-reference=Geltungsbereich_MQBw_Baseline.NvM.PS_EOL_COUNTERS, ecu-extract-reference=TopLevelCompositionPrototype.NvM.PS_EOL_COUNTERS
      PS_RESERVED_4_887: upstream-reference=Geltungsbereich_MQBw_Baseline.NvM.PS_RESERVED_4, ecu-extract-reference=TopLevelCompositionPrototype.NvM.PS_RESERVED_4
      PS_AUTOTEST_PARAM_888: upstream-reference=Geltungsbereich_MQBw_Baseline.NvM.PS_AUTOTEST_PARAM, ecu-extract-reference=TopLevelCompositionPrototype.NvM.PS_AUTOTEST_PARAM
      PS_PHYS_MEASUREMENTS_889: upstream-reference=Geltungsbereich_MQBw_Baseline.NvM.PS_PHYS_MEASUREMENTS, ecu-extract-reference=TopLevelCompositionPrototype.NvM.PS_PHYS_MEASUREMENTS
      PS_SOLENOID_PARAM_890: upstream-reference=Geltungsbereich_MQBw_Baseline.NvM.PS_SOLENOID_PARAM, ecu-extract-reference=TopLevelCompositionPrototype.NvM.PS_SOLENOID_PARAM
      PS_ECS_PROFILES_891: upstream-reference=Geltungsbereich_MQBw_Baseline.NvM.PS_ECS_PROFILES, ecu-extract-reference=TopLevelCompositionPrototype.NvM.PS_ECS_PROFILES
      PS_ECU_STATE_TIMING_PARAMETERS_892: upstream-reference=Geltungsbereich_MQBw_Baseline.NvM.PS_ECU_STATE_TIMING_PARAMETERS, ecu-extract-reference=TopLevelCompositionPrototype.NvM.PS_ECU_STATE_TIMING_PARAMETERS
      PS_SPARE_PART_NUMBER_893: upstream-reference=Geltungsbereich_MQBw_Baseline.NvM.PS_SPARE_PART_NUMBER, ecu-extract-reference=TopLevelCompositionPrototype.NvM.PS_SPARE_PART_NUMBER
      PS_HARDWARE_NUMBER_894: upstream-reference=Geltungsbereich_MQBw_Baseline.NvM.PS_HARDWARE_NUMBER, ecu-extract-reference=TopLevelCompositionPrototype.NvM.PS_HARDWARE_NUMBER
      PS_SYSTEM_NAME_OR_ENGINE_TYPE_895: upstream-reference=Geltungsbereich_MQBw_Baseline.NvM.PS_SYSTEM_NAME_OR_ENGINE_TYPE, ecu-extract-reference=TopLevelCompositionPrototype.NvM.PS_SYSTEM_NAME_OR_ENGINE_TYPE
      PS_BLOCK_FBL_896: upstream-reference=Geltungsbereich_MQBw_Baseline.NvM.PS_BLOCK_FBL, ecu-extract-reference=TopLevelCompositionPrototype.NvM.PS_BLOCK_FBL
      PS_ODX_FILE_IDENTIFIER_897: upstream-reference=Geltungsbereich_MQBw_Baseline.NvM.PS_ODX_FILE_IDENTIFIER, ecu-extract-reference=TopLevelCompositionPrototype.NvM.PS_ODX_FILE_IDENTIFIER
      PS_ODX_FILE_VERSION_898: upstream-reference=Geltungsbereich_MQBw_Baseline.NvM.PS_ODX_FILE_VERSION, ecu-extract-reference=TopLevelCompositionPrototype.NvM.PS_ODX_FILE_VERSION
      PS_ECU_SERIAL_NUMBER_899: upstream-reference=Geltungsbereich_MQBw_Baseline.NvM.PS_ECU_SERIAL_NUMBER, ecu-extract-reference=TopLevelCompositionPrototype.NvM.PS_ECU_SERIAL_NUMBER
      PS_LOGICAL_SW_BLOCK_VERSION_900: upstream-reference=Geltungsbereich_MQBw_Baseline.NvM.PS_LOGICAL_SW_BLOCK_VERSION, ecu-extract-reference=TopLevelCompositionPrototype.NvM.PS_LOGICAL_SW_BLOCK_VERSION
      PS_HARDWARE_VERSION_NUMBER_901: upstream-reference=Geltungsbereich_MQBw_Baseline.NvM.PS_HARDWARE_VERSION_NUMBER, ecu-extract-reference=TopLevelCompositionPrototype.NvM.PS_HARDWARE_VERSION_NUMBER
      PS_APP_SOFTWARE_VERSION_NUMBER_902: upstream-reference=Geltungsbereich_MQBw_Baseline.NvM.PS_APP_SOFTWARE_VERSION_NUMBER, ecu-extract-reference=TopLevelCompositionPrototype.NvM.PS_APP_SOFTWARE_VERSION_NUMBER
      PS_ECS_STEPS_903: upstream-reference=Geltungsbereich_MQBw_Baseline.NvM.PS_ECS_STEPS, ecu-extract-reference=TopLevelCompositionPrototype.NvM.PS_ECS_STEPS
      PS_ECS_PARAMETERS_904: upstream-reference=Geltungsbereich_MQBw_Baseline.NvM.PS_ECS_PARAMETERS, ecu-extract-reference=TopLevelCompositionPrototype.NvM.PS_ECS_PARAMETERS
