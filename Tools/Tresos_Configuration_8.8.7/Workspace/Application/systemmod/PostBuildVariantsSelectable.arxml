AUTOSAR XML (schema 4-2-1)
package /EB/PostBuildSelectable
  predefined variant TDK_4G: post-build-variant-criterion-value-set=PostBuildCriterionValueSet_TDK_4G
  post build variant criterion value set PostBuildCriterionValueSet_TDK_4G: post-build-variant-criterion-value{variant-criterion=AccelResolution, value=1}
package /EB/PostBuildSelectable/Criterions
  post build variant criterion AccelResolution: compu {0=TDK_2G, 1=TDK_4G}
